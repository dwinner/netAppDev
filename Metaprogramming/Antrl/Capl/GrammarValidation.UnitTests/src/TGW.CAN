/*@!Encoding:1252*/
/*
Copyright ( C ) Continental AG 2012



Based on Version  1.0, 12.05.10   from M.Dangelmeyr      IBD im Auftrag von EP/ESE   Daimler AG

Date of creation :  14.04.2011

Created by :                 Hans Jürgen Hipp


Version info

1.0	   10.2013	Inital versioning introduced
1.1	04.11.2013	HMI_2013_42a database
1.2	12.02.2014	HMI_2014_05a database
// #VERSION#
// #VERSION_END#
*/


variables
{
    const TRUE =    0xAA;
    const FALSE =   0x00;
    const cManual = 0x00;
    const cAuto =   0xAA;
    
    const byte VS30_with_HU = 0x00;
    const byte VS30_without_HU = 0x01;

    msTimer t_DBKomTimer_20ms;      // Timer zum zyklischen Aufruf der DBKom-Task
    int c_tDBKomTimer_20ms = 20;    // msec
    msTimer t_DBKomTimer_5ms;       // Timer zum zyklischen Aufruf der DBKom-Task
    int c_tDBKomTimer_5ms = 5;      // msec


    // BA_DEF_ BO_  "GenMsgSendType" ENUM
    //  0 : cyclicX
    //  1 : spontanX
    //  2 : cyclicIfActiveX
    //  3 : spontanWithDelay
    //  4 : cyclicAndSpontanX
    //  5 : cyclicAndSpontanWithDelay
    //  6 : spontanWithRepitition
    //  7 : cyclicIfActiveAndSpontanWD
    //  8 : cyclicIfActiveFast
    //  9 : cyclicWithRepeatOnDemand
    //  10 : none


// #VAR_DEF#
//  message   ActvComf_Rq_AR ID: 850 ---- Sendeart 5 cyclicAndSpontanWithDelay
    message   ActvComf_Rq_AR _mActvComf_Rq_AR;
    int      _ActvComf_Rq_AR_Timebase;
    int      _ActvComf_Rq_AR_CycleCount;
    int      _ActvComf_Rq_AR_StartDelay;
    int      _ActvComf_Rq_AR_MinDelay;
    int      _ActvComf_Rq_AR_Cnt;
    int      _ActvComf_Rq_AR_SpontanFlag;
    int      _ActvComf_Rq_AR_DelayCnt;
    msTimer _tActvComf_Rq_AR;
	
//  message   ActvComf_Rq2_AR  ID: 1106 --- Sendeart 5 cyclicAndSpontanWithDelay --- 
    message   ActvComf_Rq2_AR _mActvComf_Rq2_AR;
    int      _ActvComf_Rq2_AR_Timebase;
    int      _ActvComf_Rq2_AR_CycleCount;
    int      _ActvComf_Rq2_AR_Cnt;
    int      _ActvComf_Rq2_AR_StartDelay;
    int      _ActvComf_Rq2_AR_SpontanFlag;
    int      _ActvComf_Rq2_AR_MinDelay;
    int      _ActvComf_Rq2_AR_DelayCnt;
    msTimer _tActvComf_Rq2_AR;
	
//  message   Adapt_Seat_D_Rq_AR ID: 1202 ---- Sendeart 9 cyclicWithRepeatOnDemand
    message   Adapt_Seat_D_Rq_AR _mAdapt_Seat_D_Rq_AR;
    int      _Adapt_Seat_D_Rq_AR_Timebase;
    int      _Adapt_Seat_D_Rq_AR_CycleCount;
    int      _Adapt_Seat_D_Rq_AR_StartDelay;
    int      _Adapt_Seat_D_Rq_AR_Cnt;
    int      _Adapt_Seat_D_Rq_AR_MsgRepetitions;
    msTimer _tAdapt_Seat_D_Rq_AR;

//  message   ADAS_CURRENT_ATTRIBUTES_AR ID: 987 --- Sendeart cyclicX --- 
    message   ADAS_CURRENT_ATTRIBUTES_AR _mADAS_CURRENT_ATTRIBUTES_AR;
    int      _ADAS_CURRENT_ATTRIBUTES_AR_Timebase;
    int      _ADAS_CURRENT_ATTRIBUTES_AR_CycleCount;
    int      _ADAS_CURRENT_ATTRIBUTES_AR_StartDelay;
    int      _ADAS_CURRENT_ATTRIBUTES_AR_Cnt;
    msTimer _tADAS_CURRENT_ATTRIBUTES_AR;

//  message   ADAS_POSITION_AR ID: 989 --- Sendeart cyclicX --- 
    message   ADAS_POSITION_AR _mADAS_POSITION_AR;
    int      _ADAS_POSITION_AR_Timebase;
    int      _ADAS_POSITION_AR_CycleCount;
    int      _ADAS_POSITION_AR_StartDelay;
    int      _ADAS_POSITION_AR_Cnt;
    msTimer _tADAS_POSITION_AR;

//  message   ADAS_PREDICTION_AR ID: 521 --- Sendeart cyclicX --- 
    message   ADAS_PREDICTION_AR _mADAS_PREDICTION_AR;
    int      _ADAS_PREDICTION_AR_Timebase;
    int      _ADAS_PREDICTION_AR_CycleCount;
    int      _ADAS_PREDICTION_AR_StartDelay;
    int      _ADAS_PREDICTION_AR_Cnt;
    msTimer _tADAS_PREDICTION_AR;

//  message   ADAS_PROFILE_LONG_AR ID: 991 --- Sendeart cyclicX --- 
    message   ADAS_PROFILE_LONG_AR _mADAS_PROFILE_LONG_AR;
    int      _ADAS_PROFILE_LONG_AR_Timebase;
    int      _ADAS_PROFILE_LONG_AR_CycleCount;
    int      _ADAS_PROFILE_LONG_AR_StartDelay;
    int      _ADAS_PROFILE_LONG_AR_Cnt;
    msTimer _tADAS_PROFILE_LONG_AR;

//  message   ADAS_PROFILE_SHORT_AR ID: 523 --- Sendeart cyclicX --- 
    message   ADAS_PROFILE_SHORT_AR _mADAS_PROFILE_SHORT_AR;
    int      _ADAS_PROFILE_SHORT_AR_Timebase;
    int      _ADAS_PROFILE_SHORT_AR_CycleCount;
    int      _ADAS_PROFILE_SHORT_AR_StartDelay;
    int      _ADAS_PROFILE_SHORT_AR_Cnt;
    msTimer _tADAS_PROFILE_SHORT_AR;

//  message   ADASLR_POSITION_AR ID: 1221 --- Sendeart cyclicX --- 
    message   ADASLR_POSITION_AR _mADASLR_POSITION_AR;
    int      _ADASLR_POSITION_AR_Timebase;
    int      _ADASLR_POSITION_AR_CycleCount;
    int      _ADASLR_POSITION_AR_StartDelay;
    int      _ADASLR_POSITION_AR_Cnt;
    msTimer _tADASLR_POSITION_AR;

//  message   ADASLR_PROFILE_LONG_AR ID: 990 --- Sendeart cyclicX --- 
    message   ADASLR_PROFILE_LONG_AR _mADASLR_PROFILE_LONG_AR;
    int      _ADASLR_PROFILE_LONG_AR_Timebase;
    int      _ADASLR_PROFILE_LONG_AR_CycleCount;
    int      _ADASLR_PROFILE_LONG_AR_StartDelay;
    int      _ADASLR_PROFILE_LONG_AR_Cnt;
    msTimer _tADASLR_PROFILE_LONG_AR;

//  message   Car2X_Disp_Rq_AR: 886 --- Sendeart cyclicAndSpontanWithDelay --- 
    message   Car2X_Disp_Rq_AR _mCar2X_Disp_Rq_AR;
    int      _Car2X_Disp_Rq_AR_Timebase;
    int      _Car2X_Disp_Rq_AR_CycleCount;
    int      _Car2X_Disp_Rq_AR_StartDelay;
    int      _Car2X_Disp_Rq_AR_Cnt;
    int      _Car2X_Disp_Rq_AR_SpontanFlag;
    msTimer _tCar2X_Disp_Rq_AR;
	
//  message   CCGW_Disp_Rq_AR: 2463105024 --- Sendeart cyclicAndSpontanWithDelay --- 
    message   CCGW_Disp_Rq_AR _mCCGW_Disp_Rq_AR;
    int      _CCGW_Disp_Rq_AR_Timebase;
    int      _CCGW_Disp_Rq_AR_CycleCount;
    int      _CCGW_Disp_Rq_AR_StartDelay;
    int      _CCGW_Disp_Rq_AR_Cnt;
    int      _CCGW_Disp_Rq_AR_SpontanFlag;
    msTimer _tCCGW_Disp_Rq_AR;

//  message   CCGW_Disp_Rq2_AR: 2463367168  --- Sendeart cyclicAndSpontanWithDelay --- 
    message   CCGW_Disp_Rq2_AR _mCCGW_Disp_Rq2_AR;
    int      _CCGW_Disp_Rq2_AR_Timebase;
    int      _CCGW_Disp_Rq2_AR_CycleCount;
    int      _CCGW_Disp_Rq2_AR_StartDelay;
    int      _CCGW_Disp_Rq2_AR_Cnt;
    int      _CCGW_Disp_Rq2_AR_SpontanFlag;
    msTimer _tCCGW_Disp_Rq2_AR;	
	
//  message   CCGW_Disp_Rq3_AR: 2428239872  --- Sendeart cyclicAndSpontanWithDelay --- 
    message   CCGW_Disp_Rq3_AR _mCCGW_Disp_Rq3_AR;
    int      _CCGW_Disp_Rq3_AR_Timebase;
    int      _CCGW_Disp_Rq3_AR_CycleCount;
    int      _CCGW_Disp_Rq3_AR_StartDelay;
    int      _CCGW_Disp_Rq3_AR_Cnt;
    int      _CCGW_Disp_Rq3_AR_SpontanFlag;
    msTimer _tCCGW_Disp_Rq3_AR;

//  message   CC_Rq_ActvComf_AR ID: 205 ---- Sendeart 2 cyclicIfActiveX --- 
    message   CC_Rq_ActvComf_AR _mCC_Rq_ActvComf_AR;
    int      _CC_Rq_ActvComf_AR_Timebase;
    int      _CC_Rq_ActvComf_AR_CycleCount;
    int      _CC_Rq_ActvComf_AR_StartDelay;
    int      _CC_Rq_ActvComf_AR_Cnt;
    int      _CC_Rq_ActvComf_AR_Active;
    int      _CC_Rq_ActvComf_AR_SigActivity;
    int      _CC_Rq_ActvComf_AR_CC_ActvComf_Rq_LastState = 0;
    msTimer _tCC_Rq_ActvComf_AR;

//  message   COMM_WMI_EIS_AR ID: 123 --- Sendeart 0 cyclicX --- 
    message   COMM_WMI_EIS_AR _mCOMM_WMI_EIS_AR;
    int      _COMM_WMI_EIS_AR_Timebase;
    int      _COMM_WMI_EIS_AR_SpontanFlag;
    msTimer _tCOMM_WMI_EIS_AR;
	
//  message   COMM_TGW_EIS_AR ID: 187 --- Sendeart 1 spontanX --- 
    message   COMM_TGW_EIS_AR _mCOMM_TGW_EIS_AR;
    int      _COMM_TGW_EIS_AR_Timebase;
    int      _COMM_TGW_EIS_AR_SpontanFlag;
    msTimer _tCOMM_TGW_EIS_AR;	

//  message   Config_HU_AR ID: 1215 --- Sendeart cyclicAndSpontanWithDelay --- 
    message   Config_HU_AR _mConfig_HU_AR;
    int      _Config_HU_AR_Timebase;
    int      _Config_HU_AR_CycleCount;
    int      _Config_HU_AR_StartDelay;
    int      _Config_HU_AR_Cnt;
    int      _Config_HU_AR_SpontanFlag;
    msTimer _tConfig_HU_AR;

//  message   Config_HU2_AR ID: 1123 --- Sendeart cyclicAndSpontanWithDelay --- 
//    message   Config_HU2_AR _mConfig_HU2_AR;
//    int      _Config_HU2_AR_Timebase;
//    int      _Config_HU2_AR_CycleCount;
//    int      _Config_HU2_AR_StartDelay;
//    int      _Config_HU2_AR_MinDelay;
//    int      _Config_HU2_AR_Cnt;
//    int      _Config_HU2_AR_SpontanFlag;
//    int      _Config_HU2_AR_DelayCnt;
//    msTimer _tConfig_HU2_AR;

//  message   Config_HU3_AR ID: 1188 --- Sendeart cyclicAndSpontanWithDelay
    message   Config_HU3_AR _mConfig_HU3_AR;
    int      _Config_HU3_AR_Timebase;
    int      _Config_HU3_AR_CycleCount;
    int      _Config_HU3_AR_StartDelay;
    int      _Config_HU3_AR_Cnt;
    int      _Config_HU3_AR_SpontanFlag;
    msTimer _tConfig_HU3_AR;

//  message   Config_HU4_AR2 ID: 1124 ---- Sendeart 5 cyclicAndSpontanWithDelay
    message   Config_HU4_AR _mConfig_HU4_AR;
    int      _Config_HU4_AR_Timebase;
    int      _Config_HU4_AR_CycleCount;
    int      _Config_HU4_AR_StartDelay;
    int      _Config_HU4_AR_MinDelay;
    int      _Config_HU4_AR_Cnt;
    int      _Config_HU4_AR_SpontanFlag;
    int      _Config_HU4_AR_DelayCnt;
    msTimer _tConfig_HU4_AR;

//  message   Config_HU5_AR ID: 1168 ---- Sendeart 5 cyclicAndSpontanWithDelay
    message   Config_HU5_AR _mConfig_HU5_AR;
    int      _Config_HU5_AR_Timebase;
    int      _Config_HU5_AR_CycleCount;
    int      _Config_HU5_AR_StartDelay;
    int      _Config_HU5_AR_MinDelay;
    int      _Config_HU5_AR_Cnt;
    int      _Config_HU5_AR_SpontanFlag;
    int      _Config_HU5_AR_DelayCnt;
    msTimer _tConfig_HU5_AR;
	
//  message   Config_HU6_AR ID: 1148 ---- Sendeart 5 cyclicAndSpontanWithDelay
    message   Config_HU6_AR _mConfig_HU6_AR;
    int      _Config_HU6_AR_Timebase;
    int      _Config_HU6_AR_CycleCount;
    int      _Config_HU6_AR_StartDelay;
    int      _Config_HU6_AR_MinDelay;
    int      _Config_HU6_AR_Cnt;
    int      _Config_HU6_AR_SpontanFlag;
    int      _Config_HU6_AR_DelayCnt;
    msTimer _tConfig_HU6_AR;	

//  message   Config_HU7_AR ID: 820 ---- Sendeart 5 cyclicAndSpontanWithDelay
    message   Config_HU7_AR _mConfig_HU7_AR;
    int      _Config_HU7_AR_Timebase;
    int      _Config_HU7_AR_CycleCount;
    int      _Config_HU7_AR_StartDelay;
    int      _Config_HU7_AR_MinDelay;
    int      _Config_HU7_AR_Cnt;
    int      _Config_HU7_AR_SpontanFlag;
    int      _Config_HU7_AR_DelayCnt;
    msTimer _tConfig_HU7_AR;	  
  
//  message   Config_HU_Disp_Rq_AR ID: 1090 ---- Sendeart 5 cyclicAndSpontanWithDelay
    message   Config_HU_Disp_Rq_AR _mConfig_HU_Disp_Rq_AR;
    int      _Config_HU_Disp_Rq_AR_Timebase;
    int      _Config_HU_Disp_Rq_AR_CycleCount;
    int      _Config_HU_Disp_Rq_AR_StartDelay;
    int      _Config_HU_Disp_Rq_AR_MinDelay;
    int      _Config_HU_Disp_Rq_AR_Cnt;
    int      _Config_HU_Disp_Rq_AR_SpontanFlag;
    int      _Config_HU_Disp_Rq_AR_DelayCnt;
    msTimer _tConfig_HU_Disp_Rq_AR;

//  message   Ctrl_C_Stat2_AR ID: 501 --- Sendeart 2 cyclicIfActiveX --- 
    message   Ctrl_C_Stat2_AR _mCtrl_C_Stat2_AR;
    int      _Ctrl_C_Stat2_AR_Timebase;
    int      _Ctrl_C_Stat2_AR_CycleCount;
    int      _Ctrl_C_Stat2_AR_StartDelay;
    int      _Ctrl_C_Stat2_AR_Cnt;
    int      _Ctrl_C_Stat2_AR_SpontanFlag;
    msTimer _tCtrl_C_Stat2_AR;
    
//  message   Ctrl_C_Stat3_AR ID: 627 --- Sendeart cyclicAndSpontanWithDelay --- 
    message   Ctrl_C_Stat3_AR _mCtrl_C_Stat3_AR;
    int      _Ctrl_C_Stat3_AR_Timebase;
    int      _Ctrl_C_Stat3_AR_CycleCount;
    int      _Ctrl_C_Stat3_AR_StartDelay;
    int      _Ctrl_C_Stat3_AR_Cnt;
    int      _Ctrl_C_Stat3_AR_SpontanFlag;
    msTimer _tCtrl_C_Stat3_AR;

//  message   Ctrl_C_Stat4_AR ID: 438 --- Sendeart cyclicAndSpontanWithDelay --- 
    message   Ctrl_C_Stat4_AR _mCtrl_C_Stat4_AR;
    int      _Ctrl_C_Stat4_AR_Timebase;
    int      _Ctrl_C_Stat4_AR_CycleCount;
    int      _Ctrl_C_Stat4_AR_StartDelay;
    int      _Ctrl_C_Stat4_AR_Cnt;
    int      _Ctrl_C_Stat4_AR_SpontanFlag;
    msTimer _tCtrl_C_Stat4_AR;

//  message   DISP_C_Stat_AR ID: 505 --- Sendeart cyclicAndSpontanWithDelay --- 
    message   DISP_C_Stat_AR _mDISP_C_Stat_AR;
    int      _DISP_C_Stat_AR_Timebase;
    int      _DISP_C_Stat_AR_CycleCount;
    int      _DISP_C_Stat_AR_StartDelay;
    int      _DISP_C_Stat_AR_Cnt;
    int      _DISP_C_Stat_AR_SpontanFlag;
    msTimer _tDISP_C_Stat_AR;

//  message   DPC_IndMd_Rq_AR ID: 631 --- Sendeart cyclicAndSpontanWithDelay --- 
    message   DPC_IndMd_Rq_AR _mDPC_IndMd_Rq_AR;
    int      _DPC_IndMd_Rq_AR_Timebase;
    int      _DPC_IndMd_Rq_AR_CycleCount;
    int      _DPC_IndMd_Rq_AR_StartDelay;
    int      _DPC_IndMd_Rq_AR_MinDelay;
    int      _DPC_IndMd_Rq_AR_Cnt;
    int      _DPC_IndMd_Rq_AR_SpontanFlag;
    int      _DPC_IndMd_Rq_AR_DelayCnt;

    byte     _DPC_IndMd_Rq_AR_E2E_Armed;
    byte     _DPC_IndMd_Rq_AR_CRC_ErrorCnt;
    byte     _DPC_IndMd_Rq_AR_SQC_TriggPos;
    int      _DPC_IndMd_Rq_AR_SQC_WrongSeqJump;
    byte     _DPC_IndMd_Rq_AR_SQC_RepeatedCnt;
    byte     _DPC_IndMd_Rq_AR_MSG_DropCnt;
    byte     _DPC_IndMd_Rq_AR_CRC_Offset[16] = { 185, 124,  63, 253, 192, 131,  70,   9, 199, 138,  77,  16, 206, 145,  84,  23 };
    msTimer _tDPC_IndMd_Rq_AR;

//  message   DPC_MdSel_Rq_AR ID: 1056 --- Sendeart cyclicAndSpontanWithDelay --- 
    message   DPC_MdSel_Rq_AR _mDPC_MdSel_Rq_AR;
    int      _DPC_MdSel_Rq_AR_Timebase;
    int      _DPC_MdSel_Rq_AR_CycleCount;
    int      _DPC_MdSel_Rq_AR_StartDelay;
    int      _DPC_MdSel_Rq_AR_MinDelay;
    int      _DPC_MdSel_Rq_AR_Cnt;
    int      _DPC_MdSel_Rq_AR_SpontanFlag;
    int      _DPC_MdSel_Rq_AR_DelayCnt;
    msTimer _tDPC_MdSel_Rq_AR;
	
//	message	 DPC_Sw_HU_AMG_AR ID: 466
	message	 DPC_Sw_HU_AMG_AR _mDPC_Sw_HU_AMG_AR;
	int		_DPC_Sw_HU_AMG_AR_Timebase;
	int		_DPC_Sw_HU_AMG_AR_CycleCount;
	int		_DPC_Sw_HU_AMG_AR_StartDelay;
	int		_DPC_Sw_HU_AMG_AR_MinDelay;
	int		_DPC_Sw_HU_AMG_AR_Cnt;
	int		_DPC_Sw_HU_AMG_AR_SpontanFlag;
	int		_DPC_Sw_HU_AMG_AR_DelayCnt;
	msTimer	_tDPC_Sw_HU_AMG_AR;
	
	byte     _DPC_Sw_HU_AMG_AR_E2E_Armed;
    byte     _DPC_Sw_HU_AMG_AR_CRC_ErrorCnt;
    byte     _DPC_Sw_HU_AMG_AR_SQC_TriggPos;
    int      _DPC_Sw_HU_AMG_AR_SQC_WrongSeqJump;
    byte     _DPC_Sw_HU_AMG_AR_SQC_RepeatedCnt;
    byte     _DPC_Sw_HU_AMG_AR_MSG_DropCnt;
    byte     _DPC_Sw_HU_AMG_AR_CRC_Offset[16] = { 185, 124,  63, 253, 192, 131,  70,   9, 199, 138,  77,  16, 206, 145,  84,  23 };


//  message   FlashOverTheAir_Rq_AR ID: 1166 --- Sendeart cyclicAndSpontanWithDelay --- 
    message   FlashOverTheAir_Rq_AR _mFlashOverTheAir_Rq_AR;
    int      _FlashOverTheAir_Rq_AR_Timebase;
    int      _FlashOverTheAir_Rq_AR_CycleCount;
    int      _FlashOverTheAir_Rq_AR_StartDelay;
    int      _FlashOverTheAir_Rq_AR_MinDelay;
    int      _FlashOverTheAir_Rq_AR_Cnt;
    int      _FlashOverTheAir_Rq_AR_SpontanFlag;
    int      _FlashOverTheAir_Rq_AR_DelayCnt;
    msTimer _tFlashOverTheAir_Rq_AR;

//  message   HEADUNIT_HMI_R1_AR ID: 772 --- Sendeart cyclicAndSpontanWithDelay --- 
    message   HEADUNIT_HMI_R1_AR _mHEADUNIT_HMI_R1_AR;
    int      _HEADUNIT_HMI_R1_AR_Timebase;
    int      _HEADUNIT_HMI_R1_AR_CycleCount;
    int      _HEADUNIT_HMI_R1_AR_StartDelay;
    int      _HEADUNIT_HMI_R1_AR_MinDelay;
    int      _HEADUNIT_HMI_R1_AR_Cnt;
    int      _HEADUNIT_HMI_R1_AR_SpontanFlag;
    int      _HEADUNIT_HMI_R1_AR_DelayCnt;
    msTimer _tHEADUNIT_HMI_R1_AR;

//  message   HU_Comf_Rq_AR ID: 1150 --- Sendeart 5 cyclicAndSpontanWithDelay --- 
    message   HU_Comf_Rq_AR _mHU_Comf_Rq_AR;
    int      _HU_Comf_Rq_AR_Timebase;
    int      _HU_Comf_Rq_AR_CycleCount;
    int      _HU_Comf_Rq_AR_StartDelay;
    int      _HU_Comf_Rq_AR_MinDelay;
    int      _HU_Comf_Rq_AR_Cnt;
    int      _HU_Comf_Rq_AR_SpontanFlag;
    int      _HU_Comf_Rq_AR_DelayCnt;
    msTimer _tHU_Comf_Rq_AR;

//  message   HU_DateTm_Rq_AR ID: 1019 --- Sendeart 5 cyclicAndSpontanWithDelay --- 
    message   HU_DateTm_Rq_AR _mHU_DateTm_Rq_AR;
    int      _HU_DateTm_Rq_AR_Timebase;
    int      _HU_DateTm_Rq_AR_CycleCount;
    int      _HU_DateTm_Rq_AR_StartDelay;
    int      _HU_DateTm_Rq_AR_MinDelay;
    int      _HU_DateTm_Rq_AR_Cnt;
    int      _HU_DateTm_Rq_AR_SpontanFlag;
    int      _HU_DateTm_Rq_AR_DelayCnt;
    msTimer _tHU_DateTm_Rq_AR;

//  message   HU_SDS_Rq_AR ID: 1126 --- Sendeart cyclicAndSpontanWithDelay --- 
    message   HU_SDS_Rq_AR _mHU_SDS_Rq_AR;
    int      _HU_SDS_Rq_AR_Timebase;
    int      _HU_SDS_Rq_AR_CycleCount;
    int      _HU_SDS_Rq_AR_StartDelay;
    int      _HU_SDS_Rq_AR_MinDelay;
    int      _HU_SDS_Rq_AR_Cnt;
    int      _HU_SDS_Rq_AR_SpontanFlag;
    int      _HU_SDS_Rq_AR_DelayCnt;
    msTimer _tHU_SDS_Rq_AR;

//  message   HU_State_AR ID: 993 --- Sendeart cyclicAndSpontanWithDelay --- 
    message   HU_State_AR _mHU_State_AR;
    int      _HU_State_AR_Timebase;
    int      _HU_State_AR_CycleCount;
    int      _HU_State_AR_StartDelay;
    int      _HU_State_AR_MinDelay;
    int      _HU_State_AR_Cnt;
    int      _HU_State_AR_SpontanFlag;
    int      _HU_State_AR_DelayCnt;
    msTimer _tHU_State_AR;

//  message   HU_TELEAID_CONF_AR ID: 693 --- Sendeart cyclicIfActiveFast --- 
    message   HU_TELEAID_CONF_AR _mHU_TELEAID_CONF_AR;
    int      _HU_TELEAID_CONF_AR_Timebase;
    int      _HU_TELEAID_CONF_AR_CycleCount;
    int      _HU_TELEAID_CONF_AR_StartDelay;
    int      _HU_TELEAID_CONF_AR_Cnt;
    int      _HU_TELEAID_CONF_AR_SigActivity;

    int      _HU_TELEAID_CONF_AR_HU_Teleaid_CO_A_LastState = 0;
    int      _HU_TELEAID_CONF_AR_HU_Teleaid_CO_ID_LastState = 0;
    int      _HU_TELEAID_CONF_AR_HU_Teleaid_CO_TID_LastState = 0;
    int      _HU_TELEAID_CONF_AR_INET_RQ_LastState = 0;
    msTimer _tHU_TELEAID_CONF_AR;

//  message   HU_TunerFreq_AR ID: 890 --- Sendeart cyclicX --- 
    message   HU_TunerFreq_AR _mHU_TunerFreq_AR;
    int      _HU_TunerFreq_AR_Timebase;
    int      _HU_TunerFreq_AR_CycleCount;
    int      _HU_TunerFreq_AR_StartDelay;
    int      _HU_TunerFreq_AR_Cnt;
    int      _HU_TunerFreq_AR_SpontanFlag;
    msTimer _tHU_TunerFreq_AR;

//  message   HVAC_Ft_Rq_HU_AR ID: 773 --- Sendeart 5 cyclicAndSpontanWithDelay --- 
    message   HVAC_Ft_Rq_HU_AR _mHVAC_Ft_Rq_HU_AR;
    int      _HVAC_Ft_Rq_HU_AR_Timebase;
    int      _HVAC_Ft_Rq_HU_AR_CycleCount;
    int      _HVAC_Ft_Rq_HU_AR_StartDelay;
    int      _HVAC_Ft_Rq_HU_AR_Cnt;
    int      _HVAC_Ft_Rq_HU_AR_SpontanFlag;
    msTimer _tHVAC_Ft_Rq_HU_AR;

//  message   HVAC_R_Rq_HU_AR ID: 1121 --- Sendeart 5 cyclicAndSpontanWithDelay --- 
    message   HVAC_R_Rq_HU_AR _mHVAC_R_Rq_HU_AR;
    int      _HVAC_R_Rq_HU_AR_Timebase;
    int      _HVAC_R_Rq_HU_AR_CycleCount;
    int      _HVAC_R_Rq_HU_AR_StartDelay;
    int      _HVAC_R_Rq_HU_AR_Cnt;
    int      _HVAC_R_Rq_HU_AR_SpontanFlag;
    msTimer _tHVAC_R_Rq_HU_AR;
	
//  message   HVAC_Z5_Rq_HU_AR ID: 1136 --- Sendeart 5 cyclicAndSpontanWithDelay --- 
    message   HVAC_Z5_Rq_HU_AR _mHVAC_Z5_Rq_HU_AR;
    int      _HVAC_Z5_Rq_HU_AR_Timebase;
    int      _HVAC_Z5_Rq_HU_AR_CycleCount;
    int      _HVAC_Z5_Rq_HU_AR_StartDelay;
    int      _HVAC_Z5_Rq_HU_AR_MinDelay;
    int      _HVAC_Z5_Rq_HU_AR_Cnt;
    int      _HVAC_Z5_Rq_HU_AR_SpontanFlag;
    int      _HVAC_Z5_Rq_HU_AR_DelayCnt;
    msTimer _tHVAC_Z5_Rq_HU_AR;

//  message   ICH_Rq_HU_AR ID: 995 --- Sendeart 5 cyclicAndSpontanWithDelay --- 
    message   ICH_Rq_HU_AR _mICH_Rq_HU_AR;
    int      _ICH_Rq_HU_AR_Timebase;
    int      _ICH_Rq_HU_AR_CycleCount;
    int      _ICH_Rq_HU_AR_StartDelay;
    int      _ICH_Rq_HU_AR_Cnt;
    int      _ICH_Rq_HU_AR_SpontanFlag;
    msTimer _tICH_Rq_HU_AR;

//  message   IL_AmbLgtCfg_Rq_AR ID: 844 --- Sendeart 5 cyclicAndSpontanWithDelay
    message   IL_AmbLgtCfg_Rq_AR _mIL_AmbLgtCfg_Rq_AR;
    int      _IL_AmbLgtCfg_Rq_AR_Timebase;
    int      _IL_AmbLgtCfg_Rq_AR_CycleCount;
    int      _IL_AmbLgtCfg_Rq_AR_StartDelay;
    int      _IL_AmbLgtCfg_Rq_AR_Cnt;
    int      _IL_AmbLgtCfg_Rq_AR_SpontanFlag;
    msTimer _tIL_AmbLgtCfg_Rq_AR;

//  message   IL_AmbLgtCfg_Rq2_AR ID: 852 --- Sendeart 5 cyclicAndSpontanWithDelay
    message   IL_AmbLgtCfg_Rq2_AR _mIL_AmbLgtCfg_Rq2_AR;
    int      _IL_AmbLgtCfg_Rq2_AR_Timebase;
    int      _IL_AmbLgtCfg_Rq2_AR_CycleCount;
    int      _IL_AmbLgtCfg_Rq2_AR_StartDelay;
    int      _IL_AmbLgtCfg_Rq2_AR_Cnt;
    int      _IL_AmbLgtCfg_Rq2_AR_SpontanFlag;
    msTimer _tIL_AmbLgtCfg_Rq2_AR;

//  message   MCMS_FL_Rq_AR ID: 765 --- Sendeart 5 cyclicAndSpontanWithDelay --- 
    message   MCMS_FL_Rq_AR _mMCMS_FL_Rq_AR;
    int      _MCMS_FL_Rq_AR_Timebase;
    int      _MCMS_FL_Rq_AR_CycleCount;
    int      _MCMS_FL_Rq_AR_StartDelay;
    int      _MCMS_FL_Rq_AR_Cnt;
    int      _MCMS_FL_Rq_AR_SpontanFlag;
    msTimer _tMCMS_FL_Rq_AR;

//  message   MCMS_FR_Rq_AR ID: 767 --- Sendeart 5 cyclicAndSpontanWithDelay --- 
    message   MCMS_FR_Rq_AR _mMCMS_FR_Rq_AR;
    int      _MCMS_FR_Rq_AR_Timebase;
    int      _MCMS_FR_Rq_AR_CycleCount;
    int      _MCMS_FR_Rq_AR_StartDelay;
    int      _MCMS_FR_Rq_AR_Cnt;
    int      _MCMS_FR_Rq_AR_SpontanFlag;
    msTimer _tMCMS_FR_Rq_AR;

//  message   MCMS_RL_Rq_AR ID: 769 --- Sendeart 5 cyclicAndSpontanWithDelay
    message   MCMS_RL_Rq_AR _mMCMS_RL_Rq_AR;
    int      _MCMS_RL_Rq_AR_Timebase;
    int      _MCMS_RL_Rq_AR_CycleCount;
    int      _MCMS_RL_Rq_AR_StartDelay;
    int      _MCMS_RL_Rq_AR_Cnt;
    int      _MCMS_RL_Rq_AR_SpontanFlag;
    msTimer _tMCMS_RL_Rq_AR;

//  message   MCMS_RR_Rq_AR ID: 1097 --- Sendeart 5 cyclicAndSpontanWithDelay --- 
    message   MCMS_RR_Rq_AR _mMCMS_RR_Rq_AR;
    int      _MCMS_RR_Rq_AR_Timebase;
    int      _MCMS_RR_Rq_AR_CycleCount;
    int      _MCMS_RR_Rq_AR_StartDelay;
    int      _MCMS_RR_Rq_AR_Cnt;
    int      _MCMS_RR_Rq_AR_SpontanFlag;
    msTimer _tMCMS_RR_Rq_AR;

//  message   NAVI_CurrData_AR ID: 826 --- Sendeart 5 cyclicAndSpontanWithDelay --- 
    message   NAVI_CurrData_AR _mNAVI_CurrData_AR;
    int      _NAVI_CurrData_AR_Timebase;
    int      _NAVI_CurrData_AR_CycleCount;
    int      _NAVI_CurrData_AR_StartDelay;
    int      _NAVI_CurrData_AR_MinDelay;
    int      _NAVI_CurrData_AR_Cnt;
    int      _NAVI_CurrData_AR_SpontanFlag;
    int      _NAVI_CurrData_AR_DelayCnt;
    msTimer _tNAVI_CurrData_AR;

//  message   NAVI_Dest_AR ID: 1003 --- Sendeart cyclicX --- 
    message   NAVI_Dest_AR _mNAVI_Dest_AR;
    int      _NAVI_Dest_AR_Timebase;
    int      _NAVI_Dest_AR_CycleCount;
    int      _NAVI_Dest_AR_StartDelay;
    int      _NAVI_Dest_AR_Cnt;
    msTimer _tNAVI_Dest_AR;

//  message   NAVI_Pos1_AR ID: 1003 --- Sendeart 0 cyclicX --- 
    message   NAVI_Pos1_AR _mNAVI_Pos1_AR;
    int      _NAVI_Pos1_AR_Timebase;
    int      _NAVI_Pos1_AR_CycleCount;
    int      _NAVI_Pos1_AR_StartDelay;
    int      _NAVI_Pos1_AR_Cnt;
    msTimer _tNAVI_Pos1_AR;

//  message   NAVI_Pos2_AR ID: 1005 --- Sendeart 0 cyclicX --- 
    message   NAVI_Pos2_AR _mNAVI_Pos2_AR;
    int      _NAVI_Pos2_AR_Timebase;
    int      _NAVI_Pos2_AR_CycleCount;
    int      _NAVI_Pos2_AR_StartDelay;
    int      _NAVI_Pos2_AR_Cnt;
    msTimer _tNAVI_Pos2_AR;

//  message   NAVI_Pos3_AR ID: 1007 --- Sendeart 0 cyclicX --- 
    message   NAVI_Pos3_AR _mNAVI_Pos3_AR;
    int      _NAVI_Pos3_AR_Timebase;
    int      _NAVI_Pos3_AR_CycleCount;
    int      _NAVI_Pos3_AR_StartDelay;
    int      _NAVI_Pos3_AR_Cnt;
    msTimer _tNAVI_Pos3_AR;

//  message   NAVI_Pos4_AR ID: 1009 --- Sendeart 0 cyclicX --- 
    message   NAVI_Pos4_AR _mNAVI_Pos4_AR;
    int      _NAVI_Pos4_AR_Timebase;
    int      _NAVI_Pos4_AR_CycleCount;
    int      _NAVI_Pos4_AR_StartDelay;
    int      _NAVI_Pos4_AR_Cnt;
    msTimer _tNAVI_Pos4_AR;

//  message   NAVI_Pos5_AR ID: 1011 --- Sendeart 0 cyclicX --- 
    message   NAVI_Pos5_AR _mNAVI_Pos5_AR;
    int      _NAVI_Pos5_AR_Timebase;
    int      _NAVI_Pos5_AR_CycleCount;
    int      _NAVI_Pos5_AR_StartDelay;
    int      _NAVI_Pos5_AR_Cnt;
    msTimer _tNAVI_Pos5_AR;

//  message   Pers_Stat_AR ID: 1153 --- Sendeart 5 cyclicAndSpontanWithDelay --- 
    message   Pers_Stat_AR _mPers_Stat_AR;
    int      _Pers_Stat_AR_Timebase;
    int      _Pers_Stat_AR_CycleCount;
    int      _Pers_Stat_AR_StartDelay;
    int      _Pers_Stat_AR_MinDelay;
    int      _Pers_Stat_AR_Cnt;
    int      _Pers_Stat_AR_SpontanFlag;
    int      _Pers_Stat_AR_DelayCnt;
    msTimer _tPers_Stat_AR;	
	
//  message   Pers_Rq_AR ID: 1080 --- Sendeart 5 cyclicAndSpontanWithDelay --- 
/*  message   Pers_Rq_AR _mPers_Rq_AR;
    int      _Pers_Rq_AR_Timebase;
    int      _Pers_Rq_AR_CycleCount;
    int      _Pers_Rq_AR_StartDelay;
    int      _Pers_Rq_AR_MinDelay;
    int      _Pers_Rq_AR_Cnt;
    int      _Pers_Rq_AR_SpontanFlag;
    int      _Pers_Rq_AR_DelayCnt;
    msTimer _tPers_Rq_AR;
*/

//  message   PnHt_Rq_HU_AR ID: 997 --- Sendeart 5 cyclicAndSpontanWithDelay --- 
    message   PnHt_Rq_HU_AR _mPnHt_Rq_HU_AR;
    int      _PnHt_Rq_HU_AR_Timebase;
    int      _PnHt_Rq_HU_AR_CycleCount;
    int      _PnHt_Rq_HU_AR_StartDelay;
    int      _PnHt_Rq_HU_AR_Cnt;
    int      _PnHt_Rq_HU_AR_SpontanFlag;
    msTimer _tPnHt_Rq_HU_AR;

//  message   PNHV_WeekDepTmTbl_Rq_HU_AR ID: 1153 --- Sendeart 5 cyclicAndSpontanWithDelay --- 
    message   PNHV_WeekDepTmTbl_Rq_HU_AR _mPNHV_WeekDepTmTbl_Rq_HU_AR;
    int      _PNHV_WeekDepTmTbl_Rq_HU_AR_Timebase;
    int      _PNHV_WeekDepTmTbl_Rq_HU_AR_CycleCount;
    int      _PNHV_WeekDepTmTbl_Rq_HU_AR_StartDelay;
    int      _PNHV_WeekDepTmTbl_Rq_HU_AR_MinDelay;
    int      _PNHV_WeekDepTmTbl_Rq_HU_AR_Cnt;
    int      _PNHV_WeekDepTmTbl_Rq_HU_AR_SpontanFlag;
    int      _PNHV_WeekDepTmTbl_Rq_HU_AR_DelayCnt;
    msTimer _tPNHV_WeekDepTmTbl_Rq_HU_AR;


	
//  message   RemDev_Touchscreen ID: 626 --- Sendeart 1 spontanX --- 
    message   RemDev_Touchscreen _mRemDev_Touchscreen;
    int      _RemDev_Touchscreen_Timebase;
    int      _RemDev_Touchscreen_SpontanFlag;
    msTimer _tRemDev_Touchscreen;	

//  message   ROE_CTRL_C ID: 2012 --- Sendeart 9 cyclicWithRepeatOnDemand --- 
    message   ROE_CTRL_C _mROE_CTRL_C;
    int      _ROE_CTRL_C_Timebase;
    int      _ROE_CTRL_C_CycleCount;
    int      _ROE_CTRL_C_StartDelay;
    int      _ROE_CTRL_C_Cnt;
    int      _ROE_CTRL_C_MsgRepetitions;

//  message   ROE_DISP_C ID: 2013 --- Sendeart 9 cyclicWithRepeatOnDemand --- 
    message   ROE_DISP_C _mROE_DISP_C;
    int      _ROE_DISP_C_Timebase;
    int      _ROE_DISP_C_CycleCount;
    int      _ROE_DISP_C_StartDelay;
    int      _ROE_DISP_C_Cnt;
    int      _ROE_DISP_C_MsgRepetitions;

//  message   ROE_DISP_RL ID: 2011 --- Sendeart 9 cyclicWithRepeatOnDemand --- 
    message   ROE_DISP_RL _mROE_DISP_RL;
    int      _ROE_DISP_RL_Timebase;
    int      _ROE_DISP_RL_CycleCount;
    int      _ROE_DISP_RL_StartDelay;
    int      _ROE_DISP_RL_Cnt;
    int      _ROE_DISP_RL_MsgRepetitions;

//  message   ROE_DISP_RR ID: 2010 --- Sendeart 9 cyclicWithRepeatOnDemand --- 
    message   ROE_DISP_RR _mROE_DISP_RR;
    int      _ROE_DISP_RR_Timebase;
    int      _ROE_DISP_RR_CycleCount;
    int      _ROE_DISP_RR_StartDelay;
    int      _ROE_DISP_RR_Cnt;
    int      _ROE_DISP_RR_MsgRepetitions;

//  message   ROE_FONDUNIT ID: 2007 --- Sendeart 9 cyclicWithRepeatOnDemand --- 
    message   ROE_FONDUNIT _mROE_FONDUNIT;
    int      _ROE_FONDUNIT_Timebase;
    int      _ROE_FONDUNIT_CycleCount;
    int      _ROE_FONDUNIT_StartDelay;
    int      _ROE_FONDUNIT_Cnt;
    int      _ROE_FONDUNIT_MsgRepetitions;

//  message   ROE_SOUND ID: 2008 --- Sendeart 9 cyclicWithRepeatOnDemand --- 
    message   ROE_SOUND _mROE_SOUND;
    int      _ROE_SOUND_Timebase;
    int      _ROE_SOUND_CycleCount;
    int      _ROE_SOUND_StartDelay;
    int      _ROE_SOUND_Cnt;
    int      _ROE_SOUND_MsgRepetitions;

//  message   ROE_TGW ID: 2014 --- Sendeart 9 cyclicWithRepeatOnDemand --- 
    message   ROE_TGW _mROE_TGW;
    int      _ROE_TGW_Timebase;
    int      _ROE_TGW_CycleCount;
    int      _ROE_TGW_StartDelay;
    int      _ROE_TGW_Cnt;
    int      _ROE_TGW_MsgRepetitions;

//  message   ROE_TPAD ID: 1981 --- Sendeart 9 cyclicWithRepeatOnDemand --- 
    message   ROE_TPAD _mROE_TPAD;
    int      _ROE_TPAD_Timebase;
    int      _ROE_TPAD_CycleCount;
    int      _ROE_TPAD_StartDelay;
    int      _ROE_TPAD_Cnt;
    int      _ROE_TPAD_MsgRepetitions;

//  message   ROE_TSCR_R ID: 2565812480 --- Sendeart 9 cyclicWithRepeatOnDemand --- 
    message   ROE_TSCR_R _mROE_TSCR_R;
    int      _ROE_TSCR_R_Timebase = 20;
    int      _ROE_TSCR_R_CycleCount = 3276;
    int      _ROE_TSCR_R_StartDelay;
    int      _ROE_TSCR_R_Cnt;
    int      _ROE_TSCR_R_MsgRepetitions;

//  message   ROE_TPM ID:  --- Sendeart 9 cyclicWithRepeatOnDemand --- 
    message   ROE_TPM _mROE_TPM;
    int      _ROE_TPM_Timebase = 20;
    int      _ROE_TPM_CycleCount = 3276;
    int      _ROE_TPM_StartDelay;
    int      _ROE_TPM_Cnt;
    int      _ROE_TPM_MsgRepetitions;

//  message   ROE_TUNER_DAB ID: 2005 --- Sendeart 9 cyclicWithRepeatOnDemand --- 
    message   ROE_TUNER_DAB _mROE_TUNER_DAB;
    int      _ROE_TUNER_DAB_Timebase;
    int      _ROE_TUNER_DAB_CycleCount;
    int      _ROE_TUNER_DAB_StartDelay;
    int      _ROE_TUNER_DAB_Cnt;
    int      _ROE_TUNER_DAB_MsgRepetitions;

//  message   ROE_TUNER_TV_SDARS ID: 2009 --- Sendeart 9 cyclicWithRepeatOnDemand --- 
    message   ROE_TUNER_TV_SDARS _mROE_TUNER_TV_SDARS;
    int      _ROE_TUNER_TV_SDARS_Timebase;
    int      _ROE_TUNER_TV_SDARS_CycleCount;
    int      _ROE_TUNER_TV_SDARS_StartDelay;
    int      _ROE_TUNER_TV_SDARS_Cnt;
    int      _ROE_TUNER_TV_SDARS_MsgRepetitions;

//  message   ROE_WMI ID: 2565816064 --- Sendeart cyclicWithRepeatOnDemand
    message   ROE_WMI _mROE_WMI;
    int      _ROE_WMI_Timebase;
    int      _ROE_WMI_CycleCount;
    int      _ROE_WMI_StartDelay;
    int      _ROE_WMI_Cnt;
    int      _ROE_WMI_MsgRepetitions;

//  message   SeatCM_D_Rq_HU_AR ID: 1138 --- Sendeart 5 cyclicAndSpontanWithDelay --- 
    message   SeatCM_D_Rq_HU_AR _mSeatCM_D_Rq_HU_AR;
    int      _SeatCM_D_Rq_HU_AR_Timebase;
    int      _SeatCM_D_Rq_HU_AR_CycleCount;
    int      _SeatCM_D_Rq_HU_AR_StartDelay;
    int      _SeatCM_D_Rq_HU_AR_MinDelay;
    int      _SeatCM_D_Rq_HU_AR_Cnt;
    int      _SeatCM_D_Rq_HU_AR_SpontanFlag;
    int      _SeatCM_D_Rq_HU_AR_DelayCnt;
    msTimer _tSeatCM_D_Rq_HU_AR;
	
//  message   SeatCM_P_Rq_HU_AR ID: 1142 --- Sendeart 5 cyclicAndSpontanWithDelay --- 
    message   SeatCM_P_Rq_HU_AR _mSeatCM_P_Rq_HU_AR;
    int      _SeatCM_P_Rq_HU_AR_Timebase;
    int      _SeatCM_P_Rq_HU_AR_CycleCount;
    int      _SeatCM_P_Rq_HU_AR_StartDelay;
    int      _SeatCM_P_Rq_HU_AR_MinDelay;
    int      _SeatCM_P_Rq_HU_AR_Cnt;
    int      _SeatCM_P_Rq_HU_AR_SpontanFlag;
    int      _SeatCM_P_Rq_HU_AR_DelayCnt;
    msTimer _tSeatCM_P_Rq_HU_AR;
	
//  message   SVS_Rq_HU_AR ID: 1029 --- Sendeart 5 cyclicAndSpontanWithDelay --- 
    message   SVS_Rq_HU_AR _mSVS_Rq_HU_AR;
    int      _SVS_Rq_HU_AR_Timebase;
    int      _SVS_Rq_HU_AR_CycleCount;
    int      _SVS_Rq_HU_AR_StartDelay;
    int      _SVS_Rq_HU_AR_Cnt;
    int      _SVS_Rq_HU_AR_SpontanFlag;
    msTimer _tSVS_Rq_HU_AR;

//  message   TGW_COM_Call_Disp_Rq_AR ID: 710 --- Sendeart 5 cyclicAndSpontanWithDelay --- 
    message   TGW_COM_Call_Disp_Rq_AR _mTGW_COM_Call_Disp_Rq_AR;
    int      _TGW_COM_Call_Disp_Rq_AR_Timebase = 20;
    int      _TGW_COM_Call_Disp_Rq_AR_CycleCount;
    int      _TGW_COM_Call_Disp_Rq_AR_StartDelay;
    int      _TGW_COM_Call_Disp_Rq_AR_MinDelay;
    int      _TGW_COM_Call_Disp_Rq_AR_Cnt;
    int      _TGW_COM_Call_Disp_Rq_AR_SpontanFlag;
    int      _TGW_COM_Call_Disp_Rq_AR_DelayCnt;
    msTimer _tTGW_COM_Call_Disp_Rq_AR;

//  message   TGW_DateTm_Stat_AR ID: 1243 --- Sendeart 5 cyclicAndSpontanWithDelay --- 
    message   TGW_DateTm_Stat_AR _mTGW_DateTm_Stat_AR;
    int      _TGW_DateTm_Stat_AR_Timebase;
    int      _TGW_DateTm_Stat_AR_CycleCount;
    int      _TGW_DateTm_Stat_AR_StartDelay;
    int      _TGW_DateTm_Stat_AR_MinDelay;
    int      _TGW_DateTm_Stat_AR_Cnt;
    int      _TGW_DateTm_Stat_AR_SpontanFlag;
    int      _TGW_DateTm_Stat_AR_DelayCnt;
    msTimer _tTGW_DateTm_Stat_AR;

//  message   TGW_DriveAssistSys_AR ID: 1013 --- Sendeart 5 cyclicAndSpontanWithDelay --- 
    message   TGW_DriveAssistSys_AR _mTGW_DriveAssistSys_AR;
    int      _TGW_DriveAssistSys_AR_Timebase;
    int      _TGW_DriveAssistSys_AR_CycleCount;
    int      _TGW_DriveAssistSys_AR_StartDelay;
    int      _TGW_DriveAssistSys_AR_Cnt;
    int      _TGW_DriveAssistSys_AR_SpontanFlag;
    msTimer _tTGW_DriveAssistSys_AR;

////  message   TP_TGW_COM_Adapt ID: 702 --- Sendeart 0 cyclicX --- 
//    message   TP_TGW_COM_Adapt _mTP_TGW_COM_Adapt;
//    int      _TP_TGW_COM_Adapt_Timebase;
//    int      _TP_TGW_COM_Adapt_SpontanFlag;
//    msTimer _tTP_TGW_COM_Adapt;

//  message   TP_TGW_IC_Aud ID: 731 --- Sendeart 0 cyclicX --- 
    message   TP_TGW_IC_Aud _mTP_TGW_IC_Aud;
    int      _TP_TGW_IC_Aud_Timebase;
    int      _TP_TGW_IC_Aud_SpontanFlag;
    msTimer _tTP_TGW_IC_Aud;

//  message   TP_TGW_IC_HUD ID: 672 --- Sendeart 0 cyclicX --- 
    message   TP_TGW_IC_HUD _mTP_TGW_IC_HUD;
    int      _TP_TGW_IC_HUD_Timebase;
    int      _TP_TGW_IC_HUD_SpontanFlag;
    msTimer _tTP_TGW_IC_HUD;

//  message   TP_TGW_IC_Nav ID: 703 --- Sendeart 0 cyclicX --- 
    message   TP_TGW_IC_Nav _mTP_TGW_IC_Nav;
    int      _TP_TGW_IC_Nav_Timebase;
    int      _TP_TGW_IC_Nav_SpontanFlag;
    msTimer _tTP_TGW_IC_Nav;

//  message   TP_TGW_IC_SCA ID: 751 --- Sendeart 0 cyclicX --- 
    message   TP_TGW_IC_SCA _mTP_TGW_IC_SCA;
    int      _TP_TGW_IC_SCA_Timebase;
    int      _TP_TGW_IC_SCA_SpontanFlag;
    msTimer _tTP_TGW_IC_SCA;

//  message   TP_TGW_IC_Tel ID: 707 --- Sendeart 0 cyclicX --- 
    message   TP_TGW_IC_Tel _mTP_TGW_IC_Tel;
    int      _TP_TGW_IC_Tel_Timebase;
    int      _TP_TGW_IC_Tel_SpontanFlag;
    msTimer _tTP_TGW_IC_Tel;

//  message   TP_TGW_MPM_Nav ID: 747 --- Sendeart 0 cyclicX --- 
    message   TP_TGW_MPM_Nav _mTP_TGW_MPM_Nav;
    int      _TP_TGW_MPM_Nav_Timebase;
    int      _TP_TGW_MPM_Nav_SpontanFlag;
    msTimer _tTP_TGW_MPM_Nav;

//  message   TP_TGW_PARK ID: 664 --- Sendeart 0 cyclicX --- 
    message   TP_TGW_PARK _mTP_TGW_PARK;
    int      _TP_TGW_PARK_Timebase;
    int      _TP_TGW_PARK_SpontanFlag;
    msTimer _tTP_TGW_PARK;

//  message   TP_TGW_TELEAID ID: 737 --- Sendeart 0 cyclicX --- 
    message   TP_TGW_TELEAID _mTP_TGW_TELEAID;
    int      _TP_TGW_TELEAID_Timebase;
    int      _TP_TGW_TELEAID_SpontanFlag;
    msTimer _tTP_TGW_TELEAID;

//  message   TP_TGW_WPT ID: 649 --- Sendeart 0 cyclicX --- 
    message   TP_TGW_WPT _mTP_TGW_WPT;
    int      _TP_TGW_WPT_Timebase;
    int      _TP_TGW_WPT_SpontanFlag;
    msTimer _tTP_TGW_WPT;

//  message   TrafficInfo_AR ID: 1145 --- Sendeart 0 cyclicX --- 
    message   TrafficInfo_AR _mTrafficInfo_AR;
    int      _TrafficInfo_AR_Timebase;
    int      _TrafficInfo_AR_CycleCount;
    int      _TrafficInfo_AR_StartDelay;
    int      _TrafficInfo_AR_Cnt;
    msTimer _tTrafficInfo_AR;

//  message   TrafficInfo_AR2 ID: 2395996160 --- Sendeart 0 cyclicX --- 
    message   TrafficInfo_AR2 _mTrafficInfo_AR2;
    int      _TrafficInfo_AR2_Timebase;
    int      _TrafficInfo_AR2_CycleCount;
    int      _TrafficInfo_AR2_StartDelay;
    int      _TrafficInfo_AR2_Cnt;
    msTimer _tTrafficInfo_AR2;

//  message  TSCR_R_Rq2_AR ID: 798 --- Sendeart 5 cyclicAndSpontanWithDelay --- 
    message   TSCR_R_Rq2_AR _mTSCR_R_Rq2_AR;
    int      _TSCR_R_Rq2_AR_Timebase;
    int      _TSCR_R_Rq2_AR_CycleCount;
    int      _TSCR_R_Rq2_AR_StartDelay;
    int      _TSCR_R_Rq2_AR_MinDelay;
    int      _TSCR_R_Rq2_AR_Cnt;
    int      _TSCR_R_Rq2_AR_DelayCnt;
    int      _TSCR_R_Rq2_AR_SpontanFlag;
    msTimer _tTSCR_R_Rq2_AR;

//  message  TSCR_R_Rq3_AR ID: 374 --- Sendeart 2 cyclicIfActiveX --- 
    message   TSCR_R_Rq3_AR _mTSCR_R_Rq3_AR;
    int      _TSCR_R_Rq3_AR_Timebase;
    int      _TSCR_R_Rq3_AR_CycleCount;
    int      _TSCR_R_Rq3_AR_StartDelay;
    int      _TSCR_R_Rq3_AR_Cnt;
    int      _TSCR_R_Rq3_AR_SigActivity;

    int      _TSCR_R_Rq3_AR_PW_Adj_RL_Dr_TSCR_R_LastState = 0;
    int      _TSCR_R_Rq3_AR_PW_Adj_RR_Dr_TSCR_R_LastState = 0;
    int      _TSCR_R_Rq3_AR_TSSR_Sw_Stat_TSCR_R_LastState = 0;
    
    int      _TSCR_R_Rq3_AR_PW_Adj_RL_Dr_TSCR_R_InactiveValue = 0;
    int      _TSCR_R_Rq3_AR_PW_Adj_RR_Dr_TSCR_R_InactiveValue = 0;
    int      _TSCR_R_Rq3_AR_TSSR_Sw_Stat_TSCR_R_InactiveValue = 0;

    msTimer _tTSCR_R_Rq3_AR;
//  message  TGW_Rq_AR2 ID: 2353004544 --- Sendeart 5 cyclicAndSpontanWithDelay --- 
    message   TGW_Rq_AR2 _mTGW_Rq_AR2;
    int      _TGW_Rq_AR2_Timebase;
    int      _TGW_Rq_AR2_CycleCount;
    int      _TGW_Rq_AR2_StartDelay;
    int      _TGW_Rq_AR2_MinDelay;
    int      _TGW_Rq_AR2_Cnt;
    int      _TGW_Rq_AR2_DelayCnt;
    int      _TGW_Rq_AR2_SpontanFlag;
    msTimer _tTGW_Rq_AR2;
	
//	message HU_State2_AR ID: 2346450944
	message	HU_State2_AR _mHU_State2_AR;
	int		_HU_State2_AR_Timebase;
	int		_HU_State2_AR_CycleCount;
	int		_HU_State2_AR_StartDelay;
	int		_HU_State2_AR_MinDelay;
	int		_HU_State2_AR_Cnt;
	int		_HU_State2_AR_DelayCnt;
	int		_HU_State2_AR_SpontanFlag;
	msTimer	_tHU_State2_AR;

// #VAR_DEF_END#

    Timer t_DoorNMCancelTimer;
    Timer t_KeyInLockNMCancelTimer;
    Timer t_StWhlButtonNMCancelTimer;
    Timer t_WakeWarningNMCancelTimer;
    Timer t_CarClosureNMCancelTimer;
    Timer t_EPKBWarningNMCancelTimer;
    Timer t_IlluNMCancelTimer;
    Timer t_GearIndNMCancelTimer;
    const byte c_NMCancelTimer_05sec = 5;
    const byte c_NMCancelTimer_30sec = 30;

    char buffer[1024], stringbuffer[512];
    int bActiveHelper;    // Hilfsvariable für "Aktive Signale"

//--------------------------------------- AUTOSAR NM ------------------------------------------------

    const byte cAUTO =   0;
    const byte cMANUAL = 1;

    msTimer t_NM_Transmit;
    long  NM_Transmit_Cycle;
    msTimer t_NM_Wait_Bus_Sleep_Time;
    const c_NM_Wait_Bus_Sleep_Time = 1500;
//    msTimer t_NM_Remote_Sleep_Ind_Time;
    const c_NM_Remote_Sleep_Ind_Time = 5000;
    msTimer t_NM_Repeat_Message_Time;
    const c_NM_Repeat_Message_Time = 6000;
    msTimer t_NM_Timeout_Time;
    const c_NM_Timeout_Time = 5000;

    byte NM_Mode = 0;
    const byte cNM_Mode_Init = 0;
    const byte cNM_Mode_Sleep = 1;
    const byte cNM_Mode_Prepare_Bus_Sleep = 2;
    const byte cNM_Mode_Ready_Sleep = 3;
    const byte cNM_Mode_Normal_Operation_State = 4;
    const byte cNM_Mode_RepeatMsg = 5;

    byte boCanNM_Rx_Indication = 0;
    byte boCanNM_Tx_Confirmation = 0;
    byte boCanNM_WaitBusSleep_Timer_Expired = 0;
    byte boCanNM_RepeatMessage_Timer_Expired = 0;
    byte boCanNM_NM_Timeout_Timer_Expired = 0;
    byte boCanNM_RepeatMessage_Requested = 0;

    const word cFLDoorNMRequest =       0x0001;
    const word cFRDoorNMRequest =       0x0002;
    const word cRLDoorNMRequest =       0x0004;
    const word cRRDoorNMRequest =       0x0008;
    const word cAllDoorNMRequest =      0x000F;
    const word cIgnitionNMRequest =     0x0010;
    const word cStWhlButtonNMRequest =  0x0020;
    const word cWakeWarningNMRequest =  0x0040;
    const word cEPKBWarningNMRequest =  0x0080;
    const word cIlluNMRequest =         0x0100;
    const word cCarClosureNMRequest =   0x0200;
    const word cGearIndNMRequest =      0x0400;

    const word cManualNMRequest =       0x8000;
    const word cAllNMRequest =          0xFFFF;

    const CanNmNodeId_Base =       1280; //  =  07h
    const CanNmNodeId_APM =          76; //  =  4Ch
    const CanNmNodeId_DRVU =         77; //  =  4Dh
    const CanNmNodeId_EIS =           7; //  =  07h
    const CanNmNodeId_HGW =          27; //  =  07h
    const CanNmNodeId_TGW =          56; //  =  38h
    const CanNmNodeId_RBTM_FR =      64; //  =  40h
    const CanNmNodeId_IC =           65; //  =  41h
    const CanNmNodeId_HUD =          66; //  =  42h
    const CanNmNodeId_NV =           67; //  =  43h
    const CanNmNodeId_RVC_SVS =      68; //  =  44h
    const CanNmNodeId_ORC =          69; //  =  45h
    const CanNmNodeId_RBTM_FL =      71; //  =  47h
    const CanNmNodeId_TPM =          82; //  =  52h

    const CanNmNodeDetectionEnabled          = 0; //false
    const CanNmNodeIdEnabled                 = 1; //true
    const CanNmUserDataEnabled               = 1; //true;
    const CanNmUserDataLentgh                = 7;
    const CanNmRepeatMsgIndEnabled           = 1; //true;
    const CanNmDevErrorDetect                = 0; //false
//    const CanNmUserDataEnabled             = 1; //true
    const CanNmRemoteSleepIndEnabled         = 0; //false
    const CanNmMsgReducedtime                = 80; //ms
    const CanNmPduRxIndicationEnabled        = 0; //false
    const CanNmStateChangeIndEnabled         = 0; //false
    const CanNmImmediateTxconfEnabled        = 0;// false
    const CanNmMsgTimeoutTime                = 5000; //ms
    const CanNmPduNidPosition                = 0; //CANNM_PDU_BYTE_0;
    const CanNmPduCbvPosition                = 0xFF; //ANNM_PDU_OFF;
    const CanNmPduLength                     = 8;
    const cCanNmPassiveModeEnabled           = 0; //false
    const CanNmBusSynchronizationEnabled     = 0; //false
    const CanNmBusLoadReductionEnabled       = 1; //true
//    const CanNmRemoteSleepIndEnabled       = 0; //false
//    const CanNmNodeDetectionEnabled        = 0; //false
    const CanNmComControlEnabled             = 1; //true    

    const NmAsrCanMsgStandardCycle =          2000;
    const NmAsrCanMsgCycleOffset_APM =          40;
    const NmAsrCanMsgReducedTime_APM =        1760;
    const NmAsrCanMsgCycleOffset_DRVU =         50;
    const NmAsrCanMsgReducedTime_DRVU =       1770;
    const NmAsrCanMsgCycleOffset_EIS =          70;
    const NmAsrCanMsgReducedTime_EIS =        1070;
    const NmAsrCanMsgCycleOffset_HGW =          30;
    const NmAsrCanMsgReducedTime_HGW =        1270;
    const NmAsrCanMsgCycleOffset_HUD =          20;
    const NmAsrCanMsgReducedTime_HUD =        1660;
    const NmAsrCanMsgCycleOffset_IC =           10;
    const NmAsrCanMsgReducedTime_IC =         1650;
    const NmAsrCanMsgCycleOffset_NV =           30;
    const NmAsrCanMsgReducedTime_NV =         1670;
    const NmAsrCanMsgCycleOffset_ORC =          50;
    const NmAsrCanMsgReducedTime_ORC =        1690;
    const NmAsrCanMsgCycleOffset_RBTM_FL =       0;
    const NmAsrCanMsgReducedTime_RBTM_FL =    1640;
    const NmAsrCanMsgCycleOffset_RBTM_FR =      70;
    const NmAsrCanMsgReducedTime_RBTM_FR =    1710;
    const NmAsrCanMsgCycleOffset_RVC =          40;
    const NmAsrCanMsgReducedTime_RVC =        1680;
    const NmAsrCanMsgCycleOffset_SVS =          40;
    const NmAsrCanMsgReducedTime_SVS =        1680;
    const NmAsrCanMsgCycleOffset_TGW =           0;
    const NmAsrCanMsgReducedTime_TGW =        1560;
    const NmAsrCanMsgCycleOffset_TPM =          20;
    const NmAsrCanMsgReducedTime_TPM =        1820;

    char gECU[12] = "HMI_TGW";

    byte CanNmNodeId            = CanNmNodeId_TGW;
    word NmNodeIdentifier       = CanNmNodeId_Base + CanNmNodeId_TGW;
    word NmAsrCanMsgCycleOffset = NmAsrCanMsgCycleOffset_TGW;
    word NmAsrCanMsgReducedTime = NmAsrCanMsgReducedTime_TGW;
    word NmAsrCanMsgCycleTime   = 2000;
    byte NM_Repeat_Message_State_Active = 0;
    byte NM_AutomaticModeActive = 0;

    // Botschaft NM_xxx_AR --- Sendeart cyclicX --- 
    message NM_TGW_AR _mNM_xxx_AR;
    byte _mNM_xxx_Transmit_Allowed = 1;

//--------------------------------------- AUTOSAR NM ------------------------------------------------

    byte  crctable[256] = {
        0x00, 0x1D, 0x3A, 0x27, 0x74, 0x69, 0x4E, 0x53, 0xE8, 0xF5, 0xD2, 0xCF, 0x9C, 0x81, 0xA6, 0xBB,
        0xCD, 0xD0, 0xF7, 0xEA, 0xB9, 0xA4, 0x83, 0x9E, 0x25, 0x38, 0x1F, 0x02, 0x51, 0x4C, 0x6B, 0x76,
        0x87, 0x9A, 0xBD, 0xA0, 0xF3, 0xEE, 0xC9, 0xD4, 0x6F, 0x72, 0x55, 0x48, 0x1B, 0x06, 0x21, 0x3C,
        0x4A, 0x57, 0x70, 0x6D, 0x3E, 0x23, 0x04, 0x19, 0xA2, 0xBF, 0x98, 0x85, 0xD6, 0xCB, 0xEC, 0xF1,
        0x13, 0x0E, 0x29, 0x34, 0x67, 0x7A, 0x5D, 0x40, 0xFB, 0xE6, 0xC1, 0xDC, 0x8F, 0x92, 0xB5, 0xA8,
        0xDE, 0xC3, 0xE4, 0xF9, 0xAA, 0xB7, 0x90, 0x8D, 0x36, 0x2B, 0x0C, 0x11, 0x42, 0x5F, 0x78, 0x65,
        0x94, 0x89, 0xAE, 0xB3, 0xE0, 0xFD, 0xDA, 0xC7, 0x7C, 0x61, 0x46, 0x5B, 0x08, 0x15, 0x32, 0x2F,
        0x59, 0x44, 0x63, 0x7E, 0x2D, 0x30, 0x17, 0x0A, 0xB1, 0xAC, 0x8B, 0x96, 0xC5, 0xD8, 0xFF, 0xE2,
        0x26, 0x3B, 0x1C, 0x01, 0x52, 0x4F, 0x68, 0x75, 0xCE, 0xD3, 0xF4, 0xE9, 0xBA, 0xA7, 0x80, 0x9D,
        0xEB, 0xF6, 0xD1, 0xCC, 0x9F, 0x82, 0xA5, 0xB8, 0x03, 0x1E, 0x39, 0x24, 0x77, 0x6A, 0x4D, 0x50,
        0xA1, 0xBC, 0x9B, 0x86, 0xD5, 0xC8, 0xEF, 0xF2, 0x49, 0x54, 0x73, 0x6E, 0x3D, 0x20, 0x07, 0x1A,
        0x6C, 0x71, 0x56, 0x4B, 0x18, 0x05, 0x22, 0x3F, 0x84, 0x99, 0xBE, 0xA3, 0xF0, 0xED, 0xCA, 0xD7,
        0x35, 0x28, 0x0F, 0x12, 0x41, 0x5C, 0x7B, 0x66, 0xDD, 0xC0, 0xE7, 0xFA, 0xA9, 0xB4, 0x93, 0x8E,
        0xF8, 0xE5, 0xC2, 0xDF, 0x8C, 0x91, 0xB6, 0xAB, 0x10, 0x0D, 0x2A, 0x37, 0x64, 0x79, 0x5E, 0x43,
        0xB2, 0xAF, 0x88, 0x95, 0xC6, 0xDB, 0xFC, 0xE1, 0x5A, 0x47, 0x60, 0x7D, 0x2E, 0x33, 0x14, 0x09,
        0x7F, 0x62, 0x45, 0x58, 0x0B, 0x16, 0x31, 0x2C, 0x97, 0x8A, 0xAD, 0xB0, 0xE3, 0xFE, 0xD9, 0xC4
    };

    byte  crctable_profile02[256] = {
        0x00, 0x2F, 0x5E, 0x71, 0xBC, 0x93, 0xE2, 0xCD, 0x57, 0x78, 0x09, 0x26, 0xEB, 0xC4, 0xB5, 0x9A,
        0xAE, 0x81, 0xF0, 0xDF, 0x12, 0x3D, 0x4C, 0x63, 0xF9, 0xD6, 0xA7, 0x88, 0x45, 0x6A, 0x1B, 0x34,
        0x73, 0x5C, 0x2D, 0x02, 0xCF, 0xE0, 0x91, 0xBE, 0x24, 0x0B, 0x7A, 0x55, 0x98, 0xB7, 0xC6, 0xE9,
        0xDD, 0xF2, 0x83, 0xAC, 0x61, 0x4E, 0x3F, 0x10, 0x8A, 0xA5, 0xD4, 0xFB, 0x36, 0x19, 0x68, 0x47,
        0xE6, 0xC9, 0xB8, 0x97, 0x5A, 0x75, 0x04, 0x2B, 0xB1, 0x9E, 0xEF, 0xC0, 0x0D, 0x22, 0x53, 0x7C,
        0x48, 0x67, 0x16, 0x39, 0xF4, 0xDB, 0xAA, 0x85, 0x1F, 0x30, 0x41, 0x6E, 0xA3, 0x8C, 0xFD, 0xD2,
        0x95, 0xBA, 0xCB, 0xE4, 0x29, 0x06, 0x77, 0x58, 0xC2, 0xED, 0x9C, 0xB3, 0x7E, 0x51, 0x20, 0x0F,
        0x3B, 0x14, 0x65, 0x4A, 0x87, 0xA8, 0xD9, 0xF6, 0x6C, 0x43, 0x32, 0x1D, 0xD0, 0xFF, 0x8E, 0xA1,
        0xE3, 0xCC, 0xBD, 0x92, 0x5F, 0x70, 0x01, 0x2E, 0xB4, 0x9B, 0xEA, 0xC5, 0x08, 0x27, 0x56, 0x79,
        0x4D, 0x62, 0x13, 0x3C, 0xF1, 0xDE, 0xAF, 0x80, 0x1A, 0x35, 0x44, 0x6B, 0xA6, 0x89, 0xF8, 0xD7,
        0x90, 0xBF, 0xCE, 0xE1, 0x2C, 0x03, 0x72, 0x5D, 0xC7, 0xE8, 0x99, 0xB6, 0x7B, 0x54, 0x25, 0x0A,
        0x3E, 0x11, 0x60, 0x4F, 0x82, 0xAD, 0xDC, 0xF3, 0x69, 0x46, 0x37, 0x18, 0xD5, 0xFA, 0x8B, 0xA4,
        0x05, 0x2A, 0x5B, 0x74, 0xB9, 0x96, 0xE7, 0xC8, 0x52, 0x7D, 0x0C, 0x23, 0xEE, 0xC1, 0xB0, 0x9F,
        0xAB, 0x84, 0xF5, 0xDA, 0x17, 0x38, 0x49, 0x66, 0xFC, 0xD3, 0xA2, 0x8D, 0x40, 0x6F, 0x1E, 0x31,
        0x76, 0x59, 0x28, 0x07, 0xCA, 0xE5, 0x94, 0xBB, 0x21, 0x0E, 0x7F, 0x50, 0x9D, 0xB2, 0xC3, 0xEC,
        0xD8, 0xF7, 0x86, 0xA9, 0x64, 0x4B, 0x3A, 0x15, 0x8F, 0xA0, 0xD1, 0xFE, 0x33, 0x1C, 0x6D, 0x42
    };
}

on start
{
    putValue( HMI__NM_TGW_NM_Request, 0 );  // reset all requests
    _NM_Switch_NM_Mode();
    
    __Init_Msg();
    __Startup_Delay();
   
    putValue( HMI__NM_TGW_AutomaticModeActive, 0 );
    putValue( HMI__NM_TGW_AutomaticModeActive, 1 );
	putValue( HMI_with_wo_HU, 0x00);
}

__Init_Msg()
{
// #START_INIT#
    if(getValue(HMI_with_wo_HU) == 0x01)
    {
          //Config_HU_AR_init();
          //Config_HU2_AR_init();
          ActvComf_Rq_AR_init();
          Config_HU3_AR_init();
          Config_HU4_AR_init();
          Config_HU5_AR_init();
          Config_HU6_AR_init();
		  Config_HU7_AR_init();
          Config_HU_Disp_Rq_AR_init();
          //Ctrl_C_Stat1_AR_init();
          HU_DateTm_Rq_AR_init();
          //TGW_COM_Call_Disp_Rq_AR_init();
          //TGW_DateTm_Stat_AR_init();
    }
    Adapt_Seat_D_Rq_AR_init();
    ADAS_CURRENT_ATTRIBUTES_AR_init();
    ADAS_POSITION_AR_init();
    ADAS_PREDICTION_AR_init();
    ADAS_PROFILE_LONG_AR_init();
    ADAS_PROFILE_SHORT_AR_init();
    ADASLR_POSITION_AR_init();
    ADASLR_PROFILE_LONG_AR_init();
    Car2X_Disp_Rq_AR_init();
    CCGW_Disp_Rq_AR_init();
	CCGW_Disp_Rq2_AR_init();
	CCGW_Disp_Rq3_AR_init();
	CC_Rq_ActvComf_AR_init();
//    COMM_WMI_EIS_AR_init();
//    COMM_TGW_EIS_AR_init();
    Ctrl_C_Stat2_AR_init();
    Ctrl_C_Stat3_AR_init();
    Ctrl_C_Stat4_AR_init();
    DISP_C_Stat_AR_init();
    DPC_IndMd_Rq_AR_init();
    DPC_MdSel_Rq_AR_init();
	DPC_Sw_HU_AMG_AR_init();
    FlashOverTheAir_Rq_AR_init();
    HEADUNIT_HMI_R1_AR_init();
    HU_Comf_Rq_AR_init();
    HU_SDS_Rq_AR_init();
    HU_State_AR_init();
    HU_TELEAID_CONF_AR_init();
    HU_TunerFreq_AR_init();
    HVAC_Ft_Rq_HU_AR_init();
    HVAC_R_Rq_HU_AR_init();
	  HVAC_Z5_Rq_HU_AR_init();
    ICH_Rq_HU_AR_init();
    IL_AmbLgtCfg_Rq_AR_init();
    IL_AmbLgtCfg_Rq2_AR_init();
    MCMS_FL_Rq_AR_init();
    MCMS_FR_Rq_AR_init();
    MCMS_RL_Rq_AR_init();
    MCMS_RR_Rq_AR_init();
    NAVI_CurrData_AR_init();
    NAVI_Dest_AR_init();
    NAVI_Pos1_AR_init();
    NAVI_Pos2_AR_init();
    NAVI_Pos3_AR_init();
    NAVI_Pos4_AR_init();
    NAVI_Pos5_AR_init();
//    Pers_Rq_AR_init();
	  Pers_Stat_AR_init();
    PnHt_Rq_HU_AR_init();
    PNHV_WeekDepTmTbl_Rq_HU_AR_init();
   
	  RemDev_Touchscreen_init();
    ROE_CTRL_C_init();
    ROE_DISP_C_init();
    ROE_DISP_RL_init();
    ROE_DISP_RR_init();
    ROE_FONDUNIT_init();
    ROE_SOUND_init();
    ROE_TGW_init();
    ROE_TPAD_init();
    ROE_TUNER_DAB_init();
    ROE_TUNER_TV_SDARS_init();
    ROE_WMI_init();
    SVS_Rq_HU_AR_init();
	  SeatCM_D_Rq_HU_AR_init();
	  SeatCM_P_Rq_HU_AR_init();
    TGW_DriveAssistSys_AR_init();
//    TP_TGW_COM_Adapt_init();
    TP_TGW_IC_Aud_init();
    TP_TGW_IC_HUD_init();
    TP_TGW_IC_Nav_init();
    TP_TGW_IC_SCA_init();
    TP_TGW_IC_Tel_init();
    TP_TGW_MPM_Nav_init();
    TP_TGW_PARK_init();
    TP_TGW_TELEAID_init();
    TP_TGW_WPT_init();
    TrafficInfo_AR_init();
	TrafficInfo_AR2_init();
    TSCR_R_Rq2_AR_init();
    TSCR_R_Rq3_AR_init();
	TGW_Rq_AR2_init();
	HU_State2_AR_init();
// #START_INIT_END#

    NM_xxx_AR_init();
}

on envVar HMI__STOP_All_MESSAGES_DEFAULT_STARTDELAY
{
    if( getValue( this ) )
    {
        __Init_Msg();
        __Startup_Delay();
    }
}

on envVar HMI__STOP_All_MESSAGES_SET_STARTDELAY
{
    if( getValue( this ) )
    {
        __Startup_Delay();
    }
}

__Startup_Delay()
{
//    write(" Message Startup Delay: ( TGW ) User Startup Delay set");

// #START_DELAY#
  if(getValue(HMI_with_wo_HU) == 0x01)
  {
    //_Config_HU_AR_Cnt  = getValue( HMI__STMSGSD_Config_HU_AR ) / _Config_HU_AR_Timebase;
    //_Config_HU2_AR_Cnt = getValue( HMI__STMSGSD_Config_HU2_AR ) / _Config_HU2_AR_Timebase;
    _ActvComf_Rq_AR_Cnt = getValue( HMI__STMSGSD_ActvComf_Rq_AR ) / _ActvComf_Rq_AR_Timebase;
    _Config_HU3_AR_Cnt = getValue( HMI__STMSGSD_Config_HU3_AR ) / _Config_HU3_AR_Timebase;
    _Config_HU4_AR_Cnt = getValue( HMI__STMSGSD_Config_HU4_AR ) / _Config_HU4_AR_Timebase;
    _Config_HU5_AR_Cnt = getValue( HMI__STMSGSD_Config_HU5_AR ) / _Config_HU5_AR_Timebase;
  	_Config_HU6_AR_Cnt = getValue( HMI__STMSGSD_Config_HU6_AR ) / _Config_HU6_AR_Timebase;
    _Config_HU7_AR_Cnt = getValue( HMI__STMSGSD_Config_HU7_AR ) / _Config_HU7_AR_Timebase;
    _Config_HU_Disp_Rq_AR_Cnt = getValue( HMI__STMSGSD_Config_HU_Disp_Rq_AR ) / _Config_HU_Disp_Rq_AR_Timebase;
    //_Ctrl_C_Stat1_AR_Cnt = getValue( HMI__STMSGSD_Ctrl_C_Stat1_AR ) / _Ctrl_C_Stat1_AR_Timebase;
    _HU_DateTm_Rq_AR_Cnt = getValue( HMI__STMSGSD_HU_DateTm_Rq_AR ) / _HU_DateTm_Rq_AR_Timebase;
    //_TGW_COM_Call_Disp_Rq_AR_Cnt = getValue( HMI__STMSGSD_TGW_COM_Call_Disp_Rq_AR ) / _TGW_COM_Call_Disp_Rq_AR_Timebase;
    //_TGW_DateTm_Stat_AR_Cnt = getValue( HMI__STMSGSD_TGW_DateTm_Stat_AR ) / _TGW_DateTm_Stat_AR_Timebase;
  }
  
    _Adapt_Seat_D_Rq_AR_Cnt = getValue( HMI__STMSGSD_Adapt_Seat_D_Rq_AR ) / _Adapt_Seat_D_Rq_AR_Timebase;
    _ADAS_CURRENT_ATTRIBUTES_AR_Cnt = getValue( HMI__STMSGSD_ADAS_CURRENT_ATTRIBUTES_AR ) / _ADAS_CURRENT_ATTRIBUTES_AR_Timebase;
    _ADAS_POSITION_AR_Cnt = getValue( HMI__STMSGSD_ADAS_POSITION_AR ) / _ADAS_POSITION_AR_Timebase;
    _ADAS_PREDICTION_AR_Cnt = getValue( HMI__STMSGSD_ADAS_PREDICTION_AR ) / _ADAS_PREDICTION_AR_Timebase;
    _ADAS_PROFILE_LONG_AR_Cnt = getValue( HMI__STMSGSD_ADAS_PROFILE_LONG_AR ) / _ADAS_PROFILE_LONG_AR_Timebase;
    _ADAS_PROFILE_SHORT_AR_Cnt = getValue( HMI__STMSGSD_ADAS_PROFILE_SHORT_AR ) / _ADAS_PROFILE_SHORT_AR_Timebase;
    _ADASLR_POSITION_AR_Cnt = getValue( HMI__STMSGSD_ADASLR_POSITION_AR ) / _ADASLR_POSITION_AR_Timebase;
    _ADASLR_PROFILE_LONG_AR_Cnt = getValue( HMI__STMSGSD_ADASLR_PROFILE_LONG_AR ) / _ADASLR_PROFILE_LONG_AR_Timebase;
    _Car2X_Disp_Rq_AR_Cnt = getValue( HMI__STMSGSD_Car2X_Disp_Rq_AR ) / _Car2X_Disp_Rq_AR_Timebase;
    _CCGW_Disp_Rq_AR_Cnt = getValue( HMI__STMSGSD_CCGW_Disp_Rq_AR ) / _CCGW_Disp_Rq_AR_Timebase;
	_CCGW_Disp_Rq2_AR_Cnt = getValue( HMI__STMSGSD_CCGW_Disp_Rq2_AR ) / _CCGW_Disp_Rq2_AR_Timebase;
	_CCGW_Disp_Rq3_AR_Cnt = getValue( HMI__STMSGSD_CCGW_Disp_Rq3_AR ) / _CCGW_Disp_Rq3_AR_Timebase;
    _CC_Rq_ActvComf_AR_Cnt = getValue( HMI__STMSGSD_CC_Rq_ActvComf_AR ) / _CC_Rq_ActvComf_AR_Timebase;
    //_COMM_WMI_EIS_AR_Cnt = getValue( HMI__STMSGSD_COMM_WMI_EIS_AR ) / _COMM_WMI_EIS_AR_Timebase;
    //_COMM_TGW_EIS_AR_Cnt = getValue( HMI__STMSGSD_COMM_TGW_EIS_AR ) / _COMM_TGW_EIS_AR_Timebase;
    _Ctrl_C_Stat2_AR_Cnt = getValue( HMI__STMSGSD_Ctrl_C_Stat2_AR ) / _Ctrl_C_Stat2_AR_Timebase;
    _Ctrl_C_Stat3_AR_Cnt = getValue( HMI__STMSGSD_Ctrl_C_Stat3_AR ) / _Ctrl_C_Stat3_AR_Timebase;
    _Ctrl_C_Stat4_AR_Cnt = getValue( HMI__STMSGSD_Ctrl_C_Stat4_AR ) / _Ctrl_C_Stat4_AR_Timebase;
    _DISP_C_Stat_AR_Cnt = getValue( HMI__STMSGSD_DISP_C_Stat_AR ) / _DISP_C_Stat_AR_Timebase;
    _DPC_IndMd_Rq_AR_Cnt = getValue( HMI__STMSGSD_DPC_IndMd_Rq_AR ) / _DPC_IndMd_Rq_AR_Timebase;
    _DPC_MdSel_Rq_AR_Cnt = getValue( HMI__STMSGSD_DPC_MdSel_Rq_AR ) / _DPC_MdSel_Rq_AR_Timebase;
	_DPC_Sw_HU_AMG_AR_Cnt = getValue( HMI__STMSGSD_DPC_Sw_HU_AMG_AR ) / _DPC_Sw_HU_AMG_AR_Timebase;
    _FlashOverTheAir_Rq_AR_Cnt = getValue( HMI__STMSGSD_FlashOverTheAir_Rq_AR ) / _FlashOverTheAir_Rq_AR_Timebase;
    _DPC_IndMd_Rq_AR_Cnt = getValue( HMI__STMSGSD_DPC_IndMd_Rq_AR ) / _DPC_IndMd_Rq_AR_Timebase;
    _HEADUNIT_HMI_R1_AR_Cnt = getValue( HMI__STMSGSD_HEADUNIT_HMI_R1_AR ) / _HEADUNIT_HMI_R1_AR_Timebase;
    _HU_Comf_Rq_AR_Cnt = getValue( HMI__STMSGSD_HU_Comf_Rq_AR ) / _HU_Comf_Rq_AR_Timebase;
    _HU_SDS_Rq_AR_Cnt = getValue( HMI__STMSGSD_HU_SDS_Rq_AR ) / _HU_SDS_Rq_AR_Timebase;
    _HU_State_AR_Cnt = getValue( HMI__STMSGSD_HU_State_AR ) / _HU_State_AR_Timebase;
    _HU_TELEAID_CONF_AR_Cnt = getValue( HMI__STMSGSD_HU_TELEAID_CONF_AR ) / _HU_TELEAID_CONF_AR_Timebase;
    _HU_TunerFreq_AR_Cnt = getValue( HMI__STMSGSD_HU_TunerFreq_AR ) / _HU_TunerFreq_AR_Timebase;
    _HVAC_Ft_Rq_HU_AR_Cnt = getValue( HMI__STMSGSD_HVAC_Ft_Rq_HU_AR ) / _HVAC_Ft_Rq_HU_AR_Timebase;
    _HVAC_R_Rq_HU_AR_Cnt = getValue( HMI__STMSGSD_HVAC_R_Rq_HU_AR ) / _HVAC_R_Rq_HU_AR_Timebase;
	  _HVAC_Z5_Rq_HU_AR_Cnt = getValue( HMI__STMSGSD_HVAC_Z5_Rq_HU_AR ) / _HVAC_Z5_Rq_HU_AR_Timebase;
    _ICH_Rq_HU_AR_Cnt = getValue( HMI__STMSGSD_ICH_Rq_HU_AR ) / _ICH_Rq_HU_AR_Timebase;
    _IL_AmbLgtCfg_Rq_AR_Cnt = getValue( HMI__STMSGSD_IL_AmbLgtCfg_Rq_AR ) / _IL_AmbLgtCfg_Rq_AR_Timebase;
    _IL_AmbLgtCfg_Rq2_AR_Cnt = getValue( HMI__STMSGSD_IL_AmbLgtCfg_Rq2_AR ) / _IL_AmbLgtCfg_Rq2_AR_Timebase;
    _MCMS_FL_Rq_AR_Cnt = getValue( HMI__STMSGSD_MCMS_FL_Rq_AR ) / _MCMS_FL_Rq_AR_Timebase;
    _MCMS_FR_Rq_AR_Cnt = getValue( HMI__STMSGSD_MCMS_FR_Rq_AR ) / _MCMS_FR_Rq_AR_Timebase;
    _MCMS_RL_Rq_AR_Cnt = getValue( HMI__STMSGSD_MCMS_RL_Rq_AR ) / _MCMS_RL_Rq_AR_Timebase;
    _MCMS_RR_Rq_AR_Cnt = getValue( HMI__STMSGSD_MCMS_RR_Rq_AR ) / _MCMS_RR_Rq_AR_Timebase;
    _NAVI_CurrData_AR_Cnt = getValue( HMI__STMSGSD_NAVI_CurrData_AR ) / _NAVI_CurrData_AR_Timebase;
    _NAVI_Dest_AR_Cnt = getValue( HMI__STMSGSD_NAVI_Dest_AR ) / _NAVI_Dest_AR_Timebase;
    _NAVI_Pos1_AR_Cnt = getValue( HMI__STMSGSD_NAVI_Pos1_AR ) / _NAVI_Pos1_AR_Timebase;
    _NAVI_Pos2_AR_Cnt = getValue( HMI__STMSGSD_NAVI_Pos2_AR ) / _NAVI_Pos2_AR_Timebase;
    _NAVI_Pos3_AR_Cnt = getValue( HMI__STMSGSD_NAVI_Pos3_AR ) / _NAVI_Pos3_AR_Timebase;
    _NAVI_Pos4_AR_Cnt = getValue( HMI__STMSGSD_NAVI_Pos4_AR ) / _NAVI_Pos4_AR_Timebase;
    _NAVI_Pos5_AR_Cnt = getValue( HMI__STMSGSD_NAVI_Pos5_AR ) / _NAVI_Pos5_AR_Timebase;
    //_Pers_Rq_AR_Cnt = getValue( HMI__STMSGSD_Pers_Rq_AR ) / _Pers_Rq_AR_Timebase;
	  _Pers_Stat_AR_Cnt = getValue( HMI__STMSGSD_Pers_Stat_AR ) / _Pers_Stat_AR_Timebase;
    _PnHt_Rq_HU_AR_Cnt = getValue( HMI__STMSGSD_PnHt_Rq_HU_AR ) / _PnHt_Rq_HU_AR_Timebase;
    _PNHV_WeekDepTmTbl_Rq_HU_AR_Cnt = getValue( HMI__STMSGSD_PNHV_WeekDepTmTbl_Rq_HU_AR ) / _PNHV_WeekDepTmTbl_Rq_HU_AR_Timebase;
  
    //_RemDev_Touchscreen_Cnt = getValue( HMI__STMSGSD_RemDev_Touchscreen ) / _RemDev_Touchscreen_Timebase;
    _ROE_CTRL_C_Cnt = getValue( HMI__STMSGSD_ROE_CTRL_C ) / _ROE_CTRL_C_Timebase;
    _ROE_DISP_C_Cnt = getValue( HMI__STMSGSD_ROE_DISP_C ) / _ROE_DISP_C_Timebase;
    _ROE_DISP_RL_Cnt = getValue( HMI__STMSGSD_ROE_DISP_RL ) / _ROE_DISP_RL_Timebase;
    _ROE_DISP_RR_Cnt = getValue( HMI__STMSGSD_ROE_DISP_RR ) / _ROE_DISP_RR_Timebase;
    _ROE_FONDUNIT_Cnt = getValue( HMI__STMSGSD_ROE_FONDUNIT ) / _ROE_FONDUNIT_Timebase;
    _ROE_SOUND_Cnt = getValue( HMI__STMSGSD_ROE_SOUND ) / _ROE_SOUND_Timebase;
    _ROE_TGW_Cnt = getValue( HMI__STMSGSD_ROE_TGW ) / _ROE_TGW_Timebase;
    _ROE_TPAD_Cnt = getValue( HMI__STMSGSD_ROE_TPAD ) / _ROE_TPAD_Timebase;
    _ROE_TUNER_DAB_Cnt = getValue( HMI__STMSGSD_ROE_TUNER_DAB ) / _ROE_TUNER_DAB_Timebase;
    _ROE_TUNER_TV_SDARS_Cnt = getValue( HMI__STMSGSD_ROE_TUNER_TV_SDARS ) / _ROE_TUNER_TV_SDARS_Timebase;
    _ROE_WMI_Cnt = getValue( HMI__STMSGSD_ROE_WMI ) / _ROE_WMI_Timebase;
    _SVS_Rq_HU_AR_Cnt = getValue( HMI__STMSGSD_SVS_Rq_HU_AR ) / _SVS_Rq_HU_AR_Timebase;
	  _SeatCM_D_Rq_HU_AR_Cnt = getValue( HMI__STMSGSD_SeatCM_D_Rq_HU_AR ) / _SeatCM_D_Rq_HU_AR_Timebase;
	  _SeatCM_P_Rq_HU_AR_Cnt = getValue( HMI__STMSGSD_SeatCM_P_Rq_HU_AR ) / _SeatCM_P_Rq_HU_AR_Timebase;
    _TGW_DriveAssistSys_AR_Cnt = getValue( HMI__STMSGSD_TGW_DriveAssistSys_AR ) / _TGW_DriveAssistSys_AR_Timebase;
//    _TP_TGW_COM_Adapt_Cnt = getValue( HMI__STMSGSD_TP_TGW_COM_Adapt ) / _TP_TGW_COM_Adapt_Timebase;
//    _TP_TGW_IC_Aud_Cnt = getValue( HMI__STMSGSD_TP_TGW_IC_Aud ) / _TP_TGW_IC_Aud_Timebase;
//    _TP_TGW_IC_HUD_Cnt = getValue( HMI__STMSGSD_TP_TGW_IC_HUD ) / _TP_TGW_IC_HUD_Timebase;
//    _TP_TGW_IC_Nav_Cnt = getValue( HMI__STMSGSD_TP_TGW_IC_Nav ) / _TP_TGW_IC_Nav_Timebase;
//    _TP_TGW_IC_SCA_Cnt = getValue( HMI__STMSGSD_TP_TGW_IC_SCA ) / _TP_TGW_IC_SCA_Timebase;
//    _TP_TGW_IC_Tel_Cnt = getValue( HMI__STMSGSD_TP_TGW_IC_Tel ) / _TP_TGW_IC_Tel_Timebase;
//    _TP_TGW_MPM_Nav_Cnt = getValue( HMI__STMSGSD_TP_TGW_MPM_Nav ) / _TP_TGW_MPM_Nav_Timebase;
//    _TP_TGW_PARK_Cnt = getValue( HMI__STMSGSD_TP_TGW_PARK ) / _TP_TGW_PARK_Timebase;
//    _TP_TGW_TELEAID_Cnt = getValue( HMI__STMSGSD_TP_TGW_TELEAID ) / _TP_TGW_TELEAID_Timebase;
//    _TP_TGW_WPT_Cnt = getValue( HMI__STMSGSD_TP_TGW_WPT ) / _TP_TGW_WPT_Timebase;
    _TrafficInfo_AR_Cnt = getValue( HMI__STMSGSD_TrafficInfo_AR ) / _TrafficInfo_AR_Timebase;
	_TrafficInfo_AR2_Cnt = getValue( HMI__STMSGSD_TrafficInfo_AR2 ) / _TrafficInfo_AR2_Timebase;
    _TSCR_R_Rq2_AR_Cnt = getValue( HMI__STMSGSD_TSCR_R_Rq2_AR ) / _TSCR_R_Rq2_AR_Timebase;
    _TSCR_R_Rq3_AR_Cnt = getValue( HMI__STMSGSD_TSCR_R_Rq3_AR ) / _TSCR_R_Rq3_AR_Timebase;
   _TGW_Rq_AR2_Cnt = getValue( HMI__STMSGSD_TGW_Rq_AR2 ) / _TGW_Rq_AR2_Timebase;
   _HU_State2_AR_Cnt = getValue( HMI__STMSGSD_HU_State2_AR )	/ _HU_State2_AR_Timebase;
// #START_DELAY_END#
}

on Timer t_DBKomTimer_5ms
{
// *** DBKom-Sendefunktion ***
    // timer aufziehen für nächsten Zyklus
    if( getValue( HMI__NM_TGW_CommActive    ) |
        getValue( HMI__NM_TGW_RequestBusCom )   )
    {
        setTimer( t_DBKomTimer_5ms, c_tDBKomTimer_5ms );
    }

// #CYC_TIMER_5_MS#
    COMM_WMI_EIS_AR_check_output();
	  COMM_TGW_EIS_AR_check_output();
//    TP_TGW_COM_Adapt_check_output();
    TP_TGW_MPM_Nav_check_output();
    TP_TGW_PARK_check_output();
    TP_TGW_TELEAID_check_output();
    TP_TGW_WPT_check_output();
// #CYC_TIMER_5_MS_END#
//    TP_TGW_IC_Aud_check_output(); ADC-module will send this frames
//    TP_TGW_IC_HUD_check_output(); ADC-module will send this frames
//    TP_TGW_IC_Nav_check_output(); ADC-module will send this frames
//    TP_TGW_IC_SCA_check_output(); ADC-module will send this frames
//    TP_TGW_IC_Tel_check_output(); ADC-module will send this frames
}

on Timer t_DBKomTimer_20ms
{
// *** DBKom-Sendefunktion ***
    // timer aufziehen für nächsten Zyklus
    if( getValue( HMI__NM_TGW_CommActive    ) |
        getValue( HMI__NM_TGW_RequestBusCom )   )
    {
        setTimer( t_DBKomTimer_20ms, c_tDBKomTimer_20ms );
    }
    if(getValue(HMI_with_wo_HU) == 0x01)
    {
		ActvComf_Rq_AR_check_output();
        Config_HU_AR_check_output();
        //Config_HU2_AR_check_output();
        Config_HU3_AR_check_output();
        Config_HU4_AR_check_output();
        Config_HU5_AR_check_output();      
	    Config_HU6_AR_check_output();
      Config_HU7_AR_check_output();
        Config_HU_Disp_Rq_AR_check_output();
        //Ctrl_C_Stat1_AR_check_output();
        HU_DateTm_Rq_AR_check_output();
        TGW_COM_Call_Disp_Rq_AR_check_output();
        TGW_DateTm_Stat_AR_check_output();
    }
    
// #CYC_TIMER_20_MS#
    
    Adapt_Seat_D_Rq_AR_check_output();
    ADAS_CURRENT_ATTRIBUTES_AR_check_output();
    ADAS_POSITION_AR_check_output();
    ADAS_PREDICTION_AR_check_output();
    ADAS_PROFILE_LONG_AR_check_output();
    ADAS_PROFILE_SHORT_AR_check_output();
    ADASLR_POSITION_AR_check_output();
    ADASLR_PROFILE_LONG_AR_check_output();
    Car2X_Disp_Rq_AR_check_output();
    CCGW_Disp_Rq_AR_check_output();
    CCGW_Disp_Rq2_AR_check_output();
	CCGW_Disp_Rq3_AR_check_output();
    CC_Rq_ActvComf_AR_check_output();
// 5ms   COMM_WMI_EIS_AR_check_output();
    Ctrl_C_Stat2_AR_check_output();
    Ctrl_C_Stat3_AR_check_output();
    Ctrl_C_Stat4_AR_check_output();
    DISP_C_Stat_AR_check_output();
    DPC_IndMd_Rq_AR_check_output();
    DPC_MdSel_Rq_AR_check_output();
	DPC_Sw_HU_AMG_AR_check_output();
    FlashOverTheAir_Rq_AR_check_output();
    HEADUNIT_HMI_R1_AR_check_output();
    HU_Comf_Rq_AR_check_output();
    HU_SDS_Rq_AR_check_output();
    HU_State_AR_check_output();
    HU_TELEAID_CONF_AR_check_output();
    HU_TunerFreq_AR_check_output();
    HVAC_Ft_Rq_HU_AR_check_output();
    HVAC_R_Rq_HU_AR_check_output();
	  HVAC_Z5_Rq_HU_AR_check_output();
    ICH_Rq_HU_AR_check_output();
    IL_AmbLgtCfg_Rq_AR_check_output();
    IL_AmbLgtCfg_Rq2_AR_check_output();
    MCMS_FL_Rq_AR_check_output();
    MCMS_FR_Rq_AR_check_output();
    MCMS_RL_Rq_AR_check_output();
    MCMS_RR_Rq_AR_check_output();
    NAVI_CurrData_AR_check_output();
    NAVI_Dest_AR_check_output();
    NAVI_Pos1_AR_check_output();
    NAVI_Pos2_AR_check_output();
    NAVI_Pos3_AR_check_output();
    NAVI_Pos4_AR_check_output();
    NAVI_Pos5_AR_check_output();
//    Pers_Rq_AR_check_output();
	  Pers_Stat_AR_check_output();
    PnHt_Rq_HU_AR_check_output();
    PNHV_WeekDepTmTbl_Rq_HU_AR_check_output();

	  RemDev_Touchscreen_check_output();
    ROE_CTRL_C_check_output();
    ROE_DISP_C_check_output();
    ROE_DISP_RL_check_output();
    ROE_DISP_RR_check_output();
//    ROE_FONDUNIT_check_output();
    ROE_SOUND_check_output();
    ROE_TGW_check_output();
//    ROE_TPAD_check_output();
//    ROE_TUNER_DAB_check_output();
//    ROE_TUNER_TV_SDARS_check_output();
//    ROE_WMI_check_output();
    SVS_Rq_HU_AR_check_output();
	  SeatCM_D_Rq_HU_AR_check_output();
	  SeatCM_P_Rq_HU_AR_check_output();
    TGW_DriveAssistSys_AR_check_output();
// 5ms   TP_TGW_COM_Adapt_check_output();
// 5ms   TP_TGW_IC_Aud_check_output();
// 5ms   TP_TGW_IC_HUD_check_output();
// 5ms   TP_TGW_IC_Nav_check_output();
// 5ms   TP_TGW_IC_SCA_check_output();
// 5ms   TP_TGW_IC_Tel_check_output();
// 5ms   TP_TGW_MPM_Nav_check_output();
// 5ms   TP_TGW_PARK_check_output();
// 5ms   TP_TGW_TELEAID_check_output();
// 5ms   TP_TGW_WPT_check_output();
    TrafficInfo_AR_check_output();
	TrafficInfo_AR2_check_output();
    TSCR_R_Rq2_AR_check_output();
    TSCR_R_Rq3_AR_check_output();
	TGW_Rq_AR2_check_output();
	HU_State2_AR_check_output();
	
// #CYC_TIMER_20_MS_END#

//    NM_TGW_AR_check_output();
}

on EnvVar HMI__SAVE_PANEL_CONFIG_TGW
{
    dword hFile;

    if( getValue(this) )
    {
        write("Saving HMI Panel Variables ...");

        hFile = openFileWrite( "CONFIG\\HMI_PRESETS.ASC", 0 );
        filePutString( "base hex timestamps absolute\n", 31, hFile );
      
        if(getValue(HMI_with_wo_HU) == 0x01)
        {
		  ActvComf_Rq_AR_saveEnvVars( hFile );
          Config_HU_AR_saveEnvVars( hFile );
          //Config_HU2_AR_saveEnvVars( hFile );
          Config_HU3_AR_saveEnvVars( hFile );
          Config_HU4_AR_saveEnvVars( hFile );
		      Config_HU5_AR_saveEnvVars( hFile );
          Config_HU6_AR_saveEnvVars( hFile );
          Config_HU7_AR_saveEnvVars( hFile );
          Config_HU_Disp_Rq_AR_saveEnvVars( hFile );
          //Ctrl_C_Stat1_AR_saveEnvVars( hFile );
          HU_DateTm_Rq_AR_saveEnvVars( hFile );
          TGW_COM_Call_Disp_Rq_AR_saveEnvVars( hFile );
          TGW_DateTm_Stat_AR_saveEnvVars( hFile );
        }

// #MSG_SAVEENVVAR#
        Adapt_Seat_D_Rq_AR_saveEnvVars( hFile );
        ADAS_CURRENT_ATTRIBUTES_AR_saveEnvVars( hFile );
        ADAS_POSITION_AR_saveEnvVars( hFile );
        ADAS_PREDICTION_AR_saveEnvVars( hFile );
        ADAS_PROFILE_LONG_AR_saveEnvVars( hFile );
        ADAS_PROFILE_SHORT_AR_saveEnvVars( hFile );
        ADASLR_POSITION_AR_saveEnvVars( hFile );
        ADASLR_PROFILE_LONG_AR_saveEnvVars( hFile );
        Car2X_Disp_Rq_AR_saveEnvVars( hFile );
        CC_Rq_ActvComf_AR_saveEnvVars( hFile );
        COMM_WMI_EIS_AR_saveEnvVars( hFile );
		    COMM_TGW_EIS_AR_saveEnvVars( hFile );
        Ctrl_C_Stat2_AR_saveEnvVars( hFile );
        Ctrl_C_Stat3_AR_saveEnvVars( hFile );
        Ctrl_C_Stat4_AR_saveEnvVars( hFile );
        DISP_C_Stat_AR_saveEnvVars( hFile );
        DPC_IndMd_Rq_AR_saveEnvVars( hFile );
        DPC_MdSel_Rq_AR_saveEnvVars( hFile );
		DPC_Sw_HU_AMG_AR_saveEnvVars( hFile );
        FlashOverTheAir_Rq_AR_saveEnvVars( hFile );
        HEADUNIT_HMI_R1_AR_saveEnvVars( hFile );
        HU_Comf_Rq_AR_saveEnvVars( hFile );
        HU_SDS_Rq_AR_saveEnvVars( hFile );
        HU_State_AR_saveEnvVars( hFile );
        HU_TELEAID_CONF_AR_saveEnvVars( hFile );
        HU_TunerFreq_AR_saveEnvVars( hFile );
        HVAC_Ft_Rq_HU_AR_saveEnvVars( hFile );
        HVAC_R_Rq_HU_AR_saveEnvVars( hFile );
		    HVAC_Z5_Rq_HU_AR_saveEnvVars( hFile );
        ICH_Rq_HU_AR_saveEnvVars( hFile );
        IL_AmbLgtCfg_Rq_AR_saveEnvVars( hFile );
        IL_AmbLgtCfg_Rq2_AR_saveEnvVars( hFile );
        MCMS_FL_Rq_AR_saveEnvVars( hFile );
        MCMS_FR_Rq_AR_saveEnvVars( hFile );
        MCMS_RL_Rq_AR_saveEnvVars( hFile );
        MCMS_RR_Rq_AR_saveEnvVars( hFile );
        NAVI_CurrData_AR_saveEnvVars( hFile );
        NAVI_Dest_AR_saveEnvVars( hFile );
        NAVI_Pos1_AR_saveEnvVars( hFile );
        NAVI_Pos2_AR_saveEnvVars( hFile );
        NAVI_Pos3_AR_saveEnvVars( hFile );
        NAVI_Pos4_AR_saveEnvVars( hFile );
        NAVI_Pos5_AR_saveEnvVars( hFile );
//        Pers_Rq_AR_saveEnvVars( hFile );
		Pers_Stat_AR_saveEnvVars( hFile );	
        PnHt_Rq_HU_AR_saveEnvVars( hFile );
        PNHV_WeekDepTmTbl_Rq_HU_AR_saveEnvVars( hFile );
        //PreCond_Rq_HU_AR_saveEnvVars( hFile );
		RemDev_Touchscreen_saveEnvVars( hFile );
        ROE_CTRL_C_saveEnvVars( hFile );
        ROE_DISP_C_saveEnvVars( hFile );
        ROE_DISP_RL_saveEnvVars( hFile );
        ROE_DISP_RR_saveEnvVars( hFile );
//        ROE_FONDUNIT_saveEnvVars( hFile );
//        ROE_SOUND_saveEnvVars( hFile );
//        ROE_TGW_saveEnvVars( hFile );
//        ROE_TPAD_saveEnvVars( hFile );
//        ROE_TUNER_DAB_saveEnvVars( hFile );
//        ROE_TUNER_TV_SDARS_saveEnvVars( hFile );
//        ROE_WMI_saveEnvVars( hFile );
        SVS_Rq_HU_AR_saveEnvVars( hFile );
		SeatCM_D_Rq_HU_AR_saveEnvVars( hFile );
		SeatCM_P_Rq_HU_AR_saveEnvVars( hFile );
        TGW_DriveAssistSys_AR_saveEnvVars( hFile );
//        TP_TGW_COM_Adapt_saveEnvVars( hFile );
        TP_TGW_IC_Aud_saveEnvVars( hFile );
//        TP_TGW_IC_HUD_saveEnvVars( hFile );
        TP_TGW_IC_Nav_saveEnvVars( hFile );
//        TP_TGW_IC_SCA_saveEnvVars( hFile );
        TP_TGW_IC_Tel_saveEnvVars( hFile );
        TP_TGW_MPM_Nav_saveEnvVars( hFile );
//        TP_TGW_PARK_saveEnvVars( hFile );
        TP_TGW_TELEAID_saveEnvVars( hFile );
        TP_TGW_WPT_saveEnvVars( hFile );
        TrafficInfo_AR_saveEnvVars( hFile );
		TrafficInfo_AR2_saveEnvVars( hFile );
        TSCR_R_Rq2_AR_saveEnvVars( hFile );
        TSCR_R_Rq3_AR_saveEnvVars( hFile );
		TGW_Rq_AR2_saveEnvVars( hFile );
		HU_State2_AR_saveEnvVars( hFile );
// #MSG_SAVEENVVAR_END#

        NM_xxx_AR_saveEnvVars( hFile );

        fileClose(hFile );
    }
}

on EnvVar HMI__STOP_TGW_MESSAGES_OFF
{
    if( getValue(this) )
    {
        if( getValue( HMI__NM_EIS_AutomaticModeActive ) == 1 )
        {
            _ReleaseCommRequest( cIgnitionNMRequest );
//                Nm_NetworkRelease();
        } 
// #MSG_OFF#
        if(getValue(HMI_with_wo_HU) == 0x01)
        {
		  putValue( HMI__STMSG_ActvComf_Rq_AR, 1 );
          putValue( HMI__STMSG_ActvComf_Rq_AR, 1 );
          putValue( HMI__STMSG_Config_HU_AR, 1 );
          //putValue( HMI__STMSG_Config_HU2_AR, 1 );
          putValue( HMI__STMSG_Config_HU3_AR, 1 );
          putValue( HMI__STMSG_Config_HU4_AR, 1 );
          putValue( HMI__STMSG_Config_HU5_AR, 1 );
		      putValue( HMI__STMSG_Config_HU6_AR, 1 );
          putValue( HMI__STMSG_Config_HU7_AR, 1 );
          //putValue( HMI__STMSG_Ctrl_C_Stat1_AR, 1 );
          putValue( HMI__STMSG_HU_DateTm_Rq_AR, 1 );
          putValue( HMI__STMSG_TGW_COM_Call_Disp_Rq_AR, 1 );
          putValue( HMI__STMSG_TGW_DateTm_Stat_AR, 1 );
          putValue( HMI__STMSG_Config_HU_Disp_Rq_AR, 1 );
        }
        
        putValue( HMI__STMSG_Adapt_Seat_D_Rq_AR, 1 );
        putValue( HMI__STMSG_ADAS_CURRENT_ATTRIBUTES_AR, 1 );
        putValue( HMI__STMSG_ADAS_POSITION_AR, 1 );
        putValue( HMI__STMSG_ADAS_PREDICTION_AR, 1 );
        putValue( HMI__STMSG_ADAS_PROFILE_LONG_AR, 1 );
        putValue( HMI__STMSG_ADAS_PROFILE_SHORT_AR, 1 );
        putValue( HMI__STMSG_ADASLR_POSITION_AR, 1 );
        putValue( HMI__STMSG_ADASLR_PROFILE_LONG_AR, 1 );
        putValue( HMI__STMSG_Car2X_Disp_Rq_AR, 1 );
        putValue( HMI__STMSG_CCGW_Disp_Rq_AR, 1 );
		putValue( HMI__STMSG_CCGW_Disp_Rq2_AR, 1 );
		putValue( HMI__STMSG_CCGW_Disp_Rq3_AR, 1 );
        putValue( HMI__STMSG_CC_Rq_ActvComf_AR, 1 );
        putValue( HMI__STMSG_COMM_WMI_EIS_AR, 1 );
		    putValue( HMI__STMSG_COMM_TGW_EIS_AR, 1 );
        putValue( HMI__STMSG_Ctrl_C_Stat2_AR, 1 );
        putValue( HMI__STMSG_Ctrl_C_Stat3_AR, 1 );
        putValue( HMI__STMSG_Ctrl_C_Stat4_AR, 1 );
        putValue( HMI__STMSG_DISP_C_Stat_AR, 1 );
        putValue( HMI__STMSG_DPC_IndMd_Rq_AR, 1 );
        putValue( HMI__STMSG_DPC_MdSel_Rq_AR, 1 );
		putValue( HMI__STMSG_DPC_Sw_HU_AMG_AR, 1 );
        putValue( HMI__STMSG_FlashOverTheAir_Rq_AR, 1 );
        putValue( HMI__STMSG_HEADUNIT_HMI_R1_AR, 1 );
        putValue( HMI__STMSG_HU_Comf_Rq_AR, 1 );
        putValue( HMI__STMSG_HU_SDS_Rq_AR, 1 );
        putValue( HMI__STMSG_HU_State_AR, 1 );
        putValue( HMI__STMSG_HU_TELEAID_CONF_AR, 1 );
        putValue( HMI__STMSG_HU_TunerFreq_AR, 1 );
        putValue( HMI__STMSG_HVAC_Ft_Rq_HU_AR, 1 );
        putValue( HMI__STMSG_HVAC_R_Rq_HU_AR, 1 );
		    putValue( HMI__STMSG_HVAC_Z5_Rq_HU_AR, 1 );
        putValue( HMI__STMSG_ICH_Rq_HU_AR, 1 );
        putValue( HMI__STMSG_IL_AmbLgtCfg_Rq_AR, 1 );
        putValue( HMI__STMSG_IL_AmbLgtCfg_Rq2_AR, 1 );
        putValue( HMI__STMSG_MCMS_FL_Rq_AR, 1 );
        putValue( HMI__STMSG_MCMS_FR_Rq_AR, 1 );
        putValue( HMI__STMSG_MCMS_RL_Rq_AR, 1 );
        putValue( HMI__STMSG_MCMS_RR_Rq_AR, 1 );
        putValue( HMI__STMSG_NAVI_CurrData_AR, 1 );
        putValue( HMI__STMSG_NAVI_Dest_AR, 1 );
        putValue( HMI__STMSG_NAVI_Pos1_AR, 1 );
        putValue( HMI__STMSG_NAVI_Pos2_AR, 1 );
        putValue( HMI__STMSG_NAVI_Pos3_AR, 1 );
        putValue( HMI__STMSG_NAVI_Pos4_AR, 1 );
        putValue( HMI__STMSG_NAVI_Pos5_AR, 1 );
//        putValue( HMI__STMSG_Pers_Rq_AR, 1 );
		    putValue( HMI__STMSG_Pers_Stat_AR, 1 );
        putValue( HMI__STMSG_PnHt_Rq_HU_AR, 1 );
        putValue( HMI__STMSG_PNHV_WeekDepTmTbl_Rq_HU_AR, 1 );
        putValue( HMI__STMSG_PreCond_Rq_HU_AR, 1 );
		    putValue( HMI__STMSG_RemDev_Touchscreen, 1 );
        putValue( HMI__STMSG_ROE_CTRL_C, 1 );
        putValue( HMI__STMSG_ROE_DISP_C, 1 );
        putValue( HMI__STMSG_ROE_DISP_RL, 1 );
        putValue( HMI__STMSG_ROE_DISP_RR, 1 );
        putValue( HMI__STMSG_ROE_FONDUNIT, 1 );
        putValue( HMI__STMSG_ROE_SOUND, 1 );
        putValue( HMI__STMSG_ROE_TGW, 1 );
        putValue( HMI__STMSG_ROE_TPAD, 1 );
        putValue( HMI__STMSG_ROE_TUNER_DAB, 1 );
        putValue( HMI__STMSG_ROE_TUNER_TV_SDARS, 1 );
        putValue( HMI__STMSG_ROE_WMI, 1 );
        putValue( HMI__STMSG_SVS_Rq_HU_AR, 1 );
		    putValue( HMI__STMSG_SeatCM_D_Rq_HU_AR, 1 );
		    putValue( HMI__STMSG_SeatCM_P_Rq_HU_AR, 1 );
        putValue( HMI__STMSG_TGW_DriveAssistSys_AR, 1 );
//        putValue( HMI__STMSG_TP_TGW_COM_Adapt, 1 );
        putValue( HMI__STMSG_TP_TGW_IC_Aud, 1 );
        putValue( HMI__STMSG_TP_TGW_IC_HUD, 1 );
        putValue( HMI__STMSG_TP_TGW_IC_Nav, 1 );
        putValue( HMI__STMSG_TP_TGW_IC_SCA, 1 );
        putValue( HMI__STMSG_TP_TGW_IC_Tel, 1 );
        putValue( HMI__STMSG_TP_TGW_MPM_Nav, 1 );
        putValue( HMI__STMSG_TP_TGW_PARK, 1 );
        putValue( HMI__STMSG_TP_TGW_TELEAID, 1 );
        putValue( HMI__STMSG_TP_TGW_WPT, 1 );
        putValue( HMI__STMSG_TrafficInfo_AR, 1 );
		putValue( HMI__STMSG_TrafficInfo_AR2, 1 );
        putValue( HMI__STMSG_TSCR_R_Rq2_AR, 1 );
        putValue( HMI__STMSG_TSCR_R_Rq3_AR, 1 );
		putValue( HMI__STMSG_TGW_Rq_AR2, 1 );
		putValue( HMI__STMSG_HU_State2_AR, 1 );
// #MSG_OFF_END#

        putValue( HMI__STMSG_NM_TGW_AR, 1 );
    }
}

on envVar HMI__STOP_TGW_MESSAGES_ON
{
    if( getValue(this) )
    {
        if( getValue( HMI_ISw_Stat ) > 1 ) // Ign On by EIS
        {
            if( getValue( HMI__NM_EIS_AutomaticModeActive ) == 1 )
            {
                _SetCommRequest( cIgnitionNMRequest );
//                Nm_NetworkRequest();
            }
        }
        if(getValue(HMI_with_wo_HU) == 0x01)
        {
		putValue( HMI__STMSG_ActvComf_Rq_AR, 0 );
          putValue( HMI__STMSG_ActvComf_Rq_AR, 0 );
          putValue( HMI__STMSG_Config_HU_AR, 0 );
          //putValue( HMI__STMSG_Config_HU2_AR, 0 );
          putValue( HMI__STMSG_Config_HU3_AR, 0 );
          putValue( HMI__STMSG_Config_HU4_AR, 0 );
          putValue( HMI__STMSG_Config_HU5_AR, 0 );
		      putValue( HMI__STMSG_Config_HU6_AR, 0 );
          putValue( HMI__STMSG_Config_HU7_AR, 0 );
          putValue( HMI__STMSG_Config_HU_Disp_Rq_AR, 0 );
          //putValue( HMI__STMSG_Ctrl_C_Stat1_AR, 0 );
          putValue( HMI__STMSG_HU_DateTm_Rq_AR, 0 );
          putValue( HMI__STMSG_TGW_COM_Call_Disp_Rq_AR, 0 );
          putValue( HMI__STMSG_TGW_DateTm_Stat_AR, 0 );
        }
// #MSG_ON#

        putValue( HMI__STMSG_Adapt_Seat_D_Rq_AR, 0 );
        putValue( HMI__STMSG_ADAS_CURRENT_ATTRIBUTES_AR, 0 );
        putValue( HMI__STMSG_ADAS_POSITION_AR, 0 );
        putValue( HMI__STMSG_ADAS_PREDICTION_AR, 0 );
        putValue( HMI__STMSG_ADAS_PROFILE_LONG_AR, 0 );
        putValue( HMI__STMSG_ADAS_PROFILE_SHORT_AR, 0 );
        putValue( HMI__STMSG_ADASLR_POSITION_AR, 0 );
        putValue( HMI__STMSG_ADASLR_PROFILE_LONG_AR, 0 );
        putValue( HMI__STMSG_Car2X_Disp_Rq_AR, 0 );
        putValue( HMI__STMSG_CCGW_Disp_Rq_AR, 0 );
		putValue( HMI__STMSG_CCGW_Disp_Rq2_AR, 0 );
		putValue( HMI__STMSG_CCGW_Disp_Rq3_AR, 0 );
        putValue( HMI__STMSG_CC_Rq_ActvComf_AR, 0 );
        putValue( HMI__STMSG_COMM_WMI_EIS_AR, 0 );
		    putValue( HMI__STMSG_COMM_TGW_EIS_AR, 0 );
        putValue( HMI__STMSG_Ctrl_C_Stat2_AR, 0 );
        putValue( HMI__STMSG_Ctrl_C_Stat3_AR, 0 );
        putValue( HMI__STMSG_Ctrl_C_Stat4_AR, 0 );
        putValue( HMI__STMSG_DISP_C_Stat_AR, 0 );
        putValue( HMI__STMSG_DPC_IndMd_Rq_AR, 0 );
        putValue( HMI__STMSG_DPC_MdSel_Rq_AR, 0 );
		putValue( HMI__STMSG_DPC_Sw_HU_AMG_AR, 0 );
        putValue( HMI__STMSG_FlashOverTheAir_Rq_AR, 0 );
        putValue( HMI__STMSG_HEADUNIT_HMI_R1_AR, 0 );
        putValue( HMI__STMSG_HU_Comf_Rq_AR, 0 );
        putValue( HMI__STMSG_HU_SDS_Rq_AR, 0 );
        putValue( HMI__STMSG_HU_State_AR, 0 );
        putValue( HMI__STMSG_HU_TELEAID_CONF_AR, 0 );
        putValue( HMI__STMSG_HU_TunerFreq_AR, 0 );
        putValue( HMI__STMSG_HVAC_Ft_Rq_HU_AR, 0 );
        putValue( HMI__STMSG_HVAC_R_Rq_HU_AR, 0 );
		    putValue( HMI__STMSG_HVAC_Z5_Rq_HU_AR, 0 );
        putValue( HMI__STMSG_ICH_Rq_HU_AR, 0 );
        putValue( HMI__STMSG_IL_AmbLgtCfg_Rq_AR, 0 );
        putValue( HMI__STMSG_IL_AmbLgtCfg_Rq2_AR, 0 );
        putValue( HMI__STMSG_MCMS_FL_Rq_AR, 0 );
        putValue( HMI__STMSG_MCMS_FR_Rq_AR, 0 );
        putValue( HMI__STMSG_MCMS_RL_Rq_AR, 0 );
        putValue( HMI__STMSG_MCMS_RR_Rq_AR, 0 );
        putValue( HMI__STMSG_NAVI_CurrData_AR, 0 );
        putValue( HMI__STMSG_NAVI_Dest_AR, 0 );
        putValue( HMI__STMSG_NAVI_Pos1_AR, 0 );
        putValue( HMI__STMSG_NAVI_Pos2_AR, 0 );
        putValue( HMI__STMSG_NAVI_Pos3_AR, 0 );
        putValue( HMI__STMSG_NAVI_Pos4_AR, 0 );
        putValue( HMI__STMSG_NAVI_Pos5_AR, 0 );
//      putValue( HMI__STMSG_Pers_Rq_AR, 0 );
		    putValue( HMI__STMSG_Pers_Stat_AR, 0 );
        putValue( HMI__STMSG_PnHt_Rq_HU_AR, 0 );
        putValue( HMI__STMSG_PNHV_WeekDepTmTbl_Rq_HU_AR, 0 );
   
		    putValue( HMI__STMSG_RemDev_Touchscreen, 0 );
        putValue( HMI__STMSG_ROE_CTRL_C, 0 );
        putValue( HMI__STMSG_ROE_DISP_C, 0 );
        putValue( HMI__STMSG_ROE_DISP_RL, 0 );
        putValue( HMI__STMSG_ROE_DISP_RR, 0 );
        putValue( HMI__STMSG_ROE_FONDUNIT, 0 );
        putValue( HMI__STMSG_ROE_SOUND, 0 );
        putValue( HMI__STMSG_ROE_TGW, 0 );
        putValue( HMI__STMSG_ROE_TPAD, 0 );
        putValue( HMI__STMSG_ROE_TUNER_DAB, 0 );
        putValue( HMI__STMSG_ROE_TUNER_TV_SDARS, 0 );
        putValue( HMI__STMSG_ROE_WMI, 0 );
        putValue( HMI__STMSG_SVS_Rq_HU_AR, 0 );
		putValue( HMI__STMSG_SeatCM_D_Rq_HU_AR, 0 );
		putValue( HMI__STMSG_SeatCM_P_Rq_HU_AR, 0 );

        putValue( HMI__STMSG_TGW_DriveAssistSys_AR, 0 );
//        putValue( HMI__STMSG_TP_TGW_COM_Adapt, 0 );
        putValue( HMI__STMSG_TP_TGW_IC_Aud, 0 );
        putValue( HMI__STMSG_TP_TGW_IC_HUD, 0 );
        putValue( HMI__STMSG_TP_TGW_IC_Nav, 0 );
        putValue( HMI__STMSG_TP_TGW_IC_SCA, 0 );
        putValue( HMI__STMSG_TP_TGW_IC_Tel, 0);
        putValue( HMI__STMSG_TP_TGW_MPM_Nav, 0 );
        putValue( HMI__STMSG_TP_TGW_PARK, 0 );
        putValue( HMI__STMSG_TP_TGW_TELEAID, 0 );
        putValue( HMI__STMSG_TP_TGW_WPT, 0 );
        putValue( HMI__STMSG_TrafficInfo_AR, 0 );
		putValue( HMI__STMSG_TrafficInfo_AR2, 0 );
        putValue( HMI__STMSG_TSCR_R_Rq2_AR, 0 );
        putValue( HMI__STMSG_TSCR_R_Rq3_AR, 0 );
		putValue( HMI__STMSG_TGW_Rq_AR2, 0 );
		putValue( HMI__STMSG_HU_State2_AR, 0 );
// #MSG_ON_END#

        putValue( HMI__STMSG_NM_TGW_AR, 0 );
    }
}

on busOff
{
    resetCan();
    write("CAN has been resetted due to BUSOFF    ( coded version )");
}

on message 0x500-0x57F
{
    byte Identifier;

    Identifier = this.byte( 1 );

    if( this.byte( 1 ) == CanNmNodeId )    // check, wether the received NM-Frame is an own one
    {
        boCanNM_Tx_Confirmation = TRUE;    // so it is a TX-confirmation
    }
    else
    {
        boCanNM_Rx_Indication = TRUE;     // else it is a NM-Frame from another ECU
    }
    _NM_Switch_NM_Mode();     // inform the state-mashine
}

on timer t_DoorNMCancelTimer
{
    if( getValue( HMI__NM_EIS_AutomaticModeActive ) == 1 )
    {
        _ReleaseCommRequest( 15 );  // all doors reset their requests
    }
}

on timer t_KeyInLockNMCancelTimer
{
    if( getValue( HMI__NM_EIS_AutomaticModeActive ) == 1 )
    {
        _ReleaseCommRequest( cIgnitionNMRequest );
    }
}

on timer t_StWhlButtonNMCancelTimer
{
    if( getValue( HMI__NM_EIS_AutomaticModeActive ) == 1 )
    {
        _ReleaseCommRequest( cStWhlButtonNMRequest );  // all keys reset their requests
    }
}

on timer t_WakeWarningNMCancelTimer
{
    if( getValue( HMI__NM_EIS_AutomaticModeActive ) == 1 )
    {
        _ReleaseCommRequest( cWakeWarningNMRequest );  // all keys reset their requests
    }
}

on timer t_EPKBWarningNMCancelTimer
{
    if( getValue( HMI__NM_EIS_AutomaticModeActive ) == 1 )
    {
        _ReleaseCommRequest( cEPKBWarningNMRequest );  // all keys reset their requests
    }
}

on timer t_IlluNMCancelTimer
{
    if( getValue( HMI__NM_EIS_AutomaticModeActive ) == 1 )
    {
        _ReleaseCommRequest( cIlluNMRequest );  // all keys reset their requests
    }
}

on timer t_CarClosureNMCancelTimer
{
    if( getValue( HMI__NM_EIS_AutomaticModeActive ) == 1 )
    {
        _ReleaseCommRequest( cCarClosureNMRequest );  // all keys reset their requests
    }
}

on timer t_GearIndNMCancelTimer
{
    if( getValue( HMI__NM_EIS_AutomaticModeActive ) == 1 )
    {
        _ReleaseCommRequest( cGearIndNMRequest );  // all keys reset their requests
    }
}

on timer t_NM_Repeat_Message_Time
{
    boCanNM_RepeatMessage_Timer_Expired = TRUE;
    _NM_Switch_NM_Mode();     // inform the state-mashine
}

on timer t_NM_Timeout_Time
{
    boCanNM_NM_Timeout_Timer_Expired = TRUE;
    _NM_Switch_NM_Mode();     // inform the state-mashine
}

on timer t_NM_Transmit
{
    setTimer( t_NM_Transmit, NM_Transmit_Cycle );
    _mNM_xxx_AR.byte( 1 ) = CanNmNodeId;
    if( _mNM_xxx_Transmit_Allowed )
        output( _mNM_xxx_AR );
}

on timer t_NM_Wait_Bus_Sleep_Time
{
    boCanNM_WaitBusSleep_Timer_Expired = TRUE;
    _NM_Switch_NM_Mode();     // inform the state-mashine
}

NM_xxx_AR_init()
{
    _mNM_xxx_AR.Awake_DataExchg_Actv.phys = getValue(HMI_Awake_DataExchg_Actv_TGW );
    _mNM_xxx_AR.Awake_Diag_Actv.phys = getValue(HMI_Awake_Diag_Actv_TGW );
    _mNM_xxx_AR.Awake_IgnitionAccessory_On.phys = getValue(HMI_Awake_IgnitionAccessory_On_TGW );
//    _mNM_xxx_AR.Awake_Internet_Active.phys = getValue(HMI_Awake_Internet_Active_TGW );
    _mNM_xxx_AR.Awake_TGW_Actv.phys = getValue(HMI_Awake_TGW_Actv );
    _mNM_xxx_AR.WakeupRsn_TGW.phys = getValue(HMI_WakeupRsn_TGW );
    _mNM_xxx_AR.Awake_HU_On.phys = getValue(HMI_Awake_HU_On_TGW );
}

NM_xxx_AR_saveEnvVars( dword hFile )
{
    filePutString("\n// Knoten NM_TGW_AR\n", 33, hFile );
    snprintf(buffer, elcount(buffer), "0.0000 HMI__STMSG_NM_TGW_AR := %X\n", getValue(HMI__STMSG_NM_TGW_AR ));			filePutString (buffer, elcount(buffer), hFile);
    snprintf(buffer, elcount(buffer), "0.0000 HMI__STMSGT_NM_TGW_AR := %X\n", getValue(HMI__STMSGT_NM_TGW_AR ));		filePutString (buffer, elcount(buffer), hFile);
    snprintf(buffer, elcount(buffer), "0.0000 HMI_Awake_DataExchg_Actv_TGW := %X\n", getValue( HMI_Awake_DataExchg_Actv_TGW ) );		filePutString (buffer, elcount(buffer), hFile);
    snprintf(buffer, elcount(buffer), "0.0000 HMI_Awake_Diag_Actv_TGW := %X\n", getValue( HMI_Awake_Diag_Actv_TGW ) );		filePutString (buffer, elcount(buffer), hFile);
    snprintf(buffer, elcount(buffer), "0.0000 HMI_Awake_IgnitionAccessory_On_TGW := %X\n", getValue( HMI_Awake_IgnitionAccessory_On_TGW ) );		filePutString (buffer, elcount(buffer), hFile);
    snprintf(buffer, elcount(buffer), "0.0000 HMI_Awake_Internet_Active_TGW := %X\n", getValue( HMI_Awake_Internet_Active_TGW ) );		filePutString (buffer, elcount(buffer), hFile);
    snprintf(buffer, elcount(buffer), "0.0000 HMI_Awake_TGW_Actv := %X\n", getValue( HMI_Awake_TGW_Actv ) );		filePutString (buffer, elcount(buffer), hFile);
    snprintf(buffer, elcount(buffer), "0.0000 HMI_WakeupRsn_TGW := %X\n", getValue( HMI_WakeupRsn_TGW ) );		filePutString (buffer, elcount(buffer), hFile);
    snprintf(buffer, elcount(buffer), "0.0000 HMI_Awake_HU_On_TGW := %X\n", getValue( HMI_Awake_HU_On_TGW ) );		filePutString (buffer, elcount(buffer), hFile);
}

on envVar HMI__STMSG_NM_TGW_AR
{
    if( getValue( this ) == 0 )
        _mNM_xxx_Transmit_Allowed = 1;
    else
        _mNM_xxx_Transmit_Allowed = 0;    
}

on EnvVar HMI_Awake_DataExchg_Actv_TGW
{
    _mNM_xxx_AR.Awake_DataExchg_Actv = getValue(this);
}

on EnvVar HMI_Awake_Diag_Actv_TGW
{
    _mNM_xxx_AR.Awake_Diag_Actv = getValue(this);
}

on EnvVar HMI_Awake_IgnitionAccessory_On_TGW
{
    _mNM_xxx_AR.Awake_IgnitionAccessory_On = getValue(this);
}

//on EnvVar HMI_Awake_Internet_Active_TGW
//{
//    _mNM_xxx_AR.Awake_Internet_Active = getValue(this);
//}

on EnvVar HMI_Awake_TGW_Actv
{
    _mNM_xxx_AR.Awake_TGW_Actv = getValue(this);
}

on EnvVar HMI_WakeupRsn_TGW
{
    _mNM_xxx_AR.WakeupRsn_TGW = getValue(this);
}

on EnvVar HMI_Awake_HU_On_TGW
{
    _mNM_xxx_AR.Awake_HU_On.phys = getValue(this);
}

on envVar HMI__NM_EIS_AutomaticModeActive
{
    byte temp; // actual NM request status

    if( getValue( this ) )
    {
        _ReleaseCommRequest( 0xFF );  // release all requests
    }
    else
    {
        _ReleaseCommRequest( 0xFF );  // release all requests
    }
    NM_AutomaticModeActive = getValue( this );
}

_NM_Switch_NM_Mode()
{
    byte bOld_NM_Mode;
    word NM_Request_State;

    bOld_NM_Mode = NM_Mode;
    NM_Request_State = getValue( HMI__NM_TGW_NM_Request );
    switch( NM_Mode )
    {
        case cNM_Mode_Init:                   _NM_Init();
                                              NM_Mode = cNM_Mode_Sleep;
                                              break;
        case cNM_Mode_Sleep:                  if( boCanNM_Rx_Indication == TRUE )
                                              {
                                                  // _NM_NetworkStartIndication();   nothing to do
                                                  // _NM_PassiveStartUp();    is content of _NM_NetworkMode();
                                                  setTimer( t_NM_Transmit, NmAsrCanMsgCycleOffset );    // send NM-Frame delayed
                                                  boCanNM_Rx_Indication = FALSE;
                                                  cancelTimer( t_NM_Timeout_Time );
                                                  setTimer( t_NM_Timeout_Time, c_NM_Timeout_Time );
                                                  setTimer( t_NM_Repeat_Message_Time, c_NM_Repeat_Message_Time );
                                                  NM_Transmit_Cycle = NmAsrCanMsgStandardCycle;
                                                  _NM_NetworkMode();
                                                  NM_Mode = cNM_Mode_RepeatMsg;
                                              }
                                              if( NM_Request_State )
                                              {
                                                  setTimer( t_NM_Transmit, 1 );    //send NM-Franme immediately
                                                  NM_Transmit_Cycle = NmAsrCanMsgStandardCycle;
                                                  cancelTimer( t_NM_Timeout_Time );
                                                  setTimer( t_NM_Timeout_Time, c_NM_Timeout_Time );
                                                  setTimer( t_NM_Repeat_Message_Time, c_NM_Repeat_Message_Time );
                                                  NM_Transmit_Cycle = NmAsrCanMsgStandardCycle;
                                                  _NM_NetworkMode();
                                                  NM_Mode = cNM_Mode_RepeatMsg;
                                              }
                                              break;
        case cNM_Mode_Prepare_Bus_Sleep:      if( boCanNM_WaitBusSleep_Timer_Expired == TRUE )
                                              {
                                                  _NM_BusSleepModeInd();   // no action to be taken
                                                  NM_Mode = cNM_Mode_Sleep;
                                                  boCanNM_WaitBusSleep_Timer_Expired = FALSE;
                                              }
                                              if( boCanNM_NM_Timeout_Timer_Expired == TRUE )
                                                  boCanNM_NM_Timeout_Timer_Expired = FALSE;
                                              if( ( boCanNM_Rx_Indication == TRUE ) ||  NM_Request_State )
                                              {
                                                  boCanNM_Rx_Indication = FALSE;
                                                  if( NM_Request_State )
                                                  {
                                                      setTimer( t_NM_Transmit, 1 );    //send NM-Franme immediately
                                                  }
                                                  cancelTimer( t_NM_Timeout_Time );
                                                  setTimer( t_NM_Timeout_Time, c_NM_Timeout_Time );
                                                  setTimer( t_NM_Repeat_Message_Time, c_NM_Repeat_Message_Time );
                                                  _NM_NetworkMode();
                                                  NM_Transmit_Cycle = NmAsrCanMsgStandardCycle;
                                                  NM_Mode = cNM_Mode_RepeatMsg;
                                              }
                                              break;
        case cNM_Mode_Ready_Sleep:            if( boCanNM_Rx_Indication == TRUE )
                                              {
                                                  cancelTimer( t_NM_Timeout_Time );
                                                  setTimer( t_NM_Timeout_Time, c_NM_Timeout_Time );
                                                  boCanNM_Rx_Indication = FALSE;
                                              }
                                              if( boCanNM_Tx_Confirmation == TRUE )
                                              {
                                                  cancelTimer( t_NM_Timeout_Time );
                                                  setTimer( t_NM_Timeout_Time, c_NM_Timeout_Time );
                                                  boCanNM_Tx_Confirmation = FALSE;
                                              }
                                              if( NM_Request_State )
                                              {
                                                  setTimer( t_NM_Transmit, 1 );    //send NM-Franme immediately
                                                  cancelTimer( t_NM_Timeout_Time );
                                                  setTimer( t_NM_Timeout_Time, c_NM_Timeout_Time );
                                                  NM_Transmit_Cycle = NmAsrCanMsgReducedTime;
                                                  NM_Mode = cNM_Mode_Normal_Operation_State;
                                              }
                                              if( boCanNM_RepeatMessage_Requested == TRUE )
                                              {
                                                  setTimer( t_NM_Transmit, NmAsrCanMsgCycleOffset );    // send NM-Frame delayed
                                                  cancelTimer( t_NM_Timeout_Time );
                                                  setTimer( t_NM_Timeout_Time, c_NM_Timeout_Time );
                                                  setTimer( t_NM_Repeat_Message_Time, c_NM_Repeat_Message_Time );
                                                  NM_Transmit_Cycle = NmAsrCanMsgStandardCycle;
                                                  boCanNM_RepeatMessage_Requested = FALSE;
                                                  NM_Mode = cNM_Mode_RepeatMsg;
                                              }
                                              if( boCanNM_NM_Timeout_Timer_Expired == TRUE )
                                              {
                                                  setTimer( t_NM_Wait_Bus_Sleep_Time, c_NM_Wait_Bus_Sleep_Time );
                                                  _NM_PrepareBusSleepModeInd();    // here t_DBKonTimer is stopped
                                                  NM_Mode = cNM_Mode_Prepare_Bus_Sleep;
                                                  boCanNM_NM_Timeout_Timer_Expired = FALSE;
                                              }
                                              break;
        case cNM_Mode_Normal_Operation_State: if( boCanNM_NM_Timeout_Timer_Expired == TRUE )
                                              {
                                                  setTimer( t_NM_Timeout_Time, c_NM_Timeout_Time );
                                                  // _NM_TimeoutExeption();    // no action to be done
                                                  boCanNM_NM_Timeout_Timer_Expired = FALSE;
                                              }
                                              if( boCanNM_Rx_Indication == TRUE )
                                              {
                                                  cancelTimer( t_NM_Timeout_Time );
                                                  setTimer( t_NM_Timeout_Time, c_NM_Timeout_Time );
                                                  cancelTimer( t_NM_Transmit );
                                                  setTimer( t_NM_Transmit, NmAsrCanMsgReducedTime );
                                                  boCanNM_Rx_Indication = FALSE;
                                              }
                                              if( boCanNM_Tx_Confirmation == TRUE )
                                              {
                                                  cancelTimer( t_NM_Timeout_Time );
                                                  setTimer( t_NM_Timeout_Time, c_NM_Timeout_Time );
                                                  cancelTimer( t_NM_Transmit );
                                                  setTimer( t_NM_Transmit, NmAsrCanMsgStandardCycle );
                                                  boCanNM_Tx_Confirmation = FALSE;
                                              }
                                              if( NM_Request_State == 0 )    //no network requested
                                              {
                                                  cancelTimer( t_NM_Transmit );    // stop NM-Franme immediately
                                                  NM_Mode = cNM_Mode_Ready_Sleep;
                                              }
                                              if( boCanNM_RepeatMessage_Requested == TRUE )
                                              {
                                                  setTimer( t_NM_Transmit, NmAsrCanMsgCycleOffset );    // send NM-Frame delayed
                                                  cancelTimer( t_NM_Timeout_Time );
                                                  setTimer( t_NM_Timeout_Time, c_NM_Timeout_Time );
                                                  setTimer( t_NM_Repeat_Message_Time, c_NM_Repeat_Message_Time );
                                                  boCanNM_RepeatMessage_Requested = FALSE;
                                                  NM_Transmit_Cycle = NmAsrCanMsgStandardCycle;
                                                  NM_Mode = cNM_Mode_RepeatMsg;
                                              }
                                              break;
        case cNM_Mode_RepeatMsg:              if( boCanNM_NM_Timeout_Timer_Expired == TRUE )
                                              {
                                                  setTimer( t_NM_Timeout_Time, c_NM_Timeout_Time );
                                                  boCanNM_NM_Timeout_Timer_Expired = FALSE;
                                              }
                                              if( boCanNM_Rx_Indication == TRUE )
                                              {
                                                  cancelTimer( t_NM_Timeout_Time );
                                                  setTimer( t_NM_Timeout_Time, c_NM_Timeout_Time );
                                                  boCanNM_Rx_Indication = FALSE;
                                              }
                                              if( boCanNM_Tx_Confirmation == TRUE )
                                              {
                                                  cancelTimer( t_NM_Timeout_Time );
                                                  setTimer( t_NM_Timeout_Time, c_NM_Timeout_Time );
                                                  boCanNM_Tx_Confirmation = FALSE;
                                              }
                                              if( boCanNM_RepeatMessage_Timer_Expired == TRUE )
                                              {
                                                  boCanNM_RepeatMessage_Timer_Expired = FALSE;
                                                  if( NM_Request_State )
                                                  {
                                                      NM_Mode = cNM_Mode_Normal_Operation_State;
                                                      NM_Transmit_Cycle = NmAsrCanMsgReducedTime;
                                                  }
                                                  else
                                                  {
                                                      cancelTimer( t_NM_Transmit );    // stop NM-Franme immediately
                                                      NM_Mode = cNM_Mode_Ready_Sleep;
                                                  }
                                              }
                                              break;
    }
    if( bOld_NM_Mode != NM_Mode )
    {
        _Nm_StateChangeNotification( bOld_NM_Mode, NM_Mode );    // does the Trace
        putValue( HMI__NM_TGW_ActualState, NM_Mode );
    }
}

_NM_Init()
{
    NM_Transmit_Cycle = NmAsrCanMsgStandardCycle;
}

_NM_NetworkMode()
{
    setTimer( t_DBKomTimer_5ms, 1 ); //  ms     start CAN-communication immediately
    setTimer( t_DBKomTimer_20ms, 2 ); //  ms     start CAN-communication immediately
    putValue( HMI__NM_TGW_CommActive, 1 );
}

_Nm_BusSleepModeInd()
{
//    _Trace( "_Nm_BusSleepModeInd", "Sleep Mode active");
    __Startup_Delay();
    if( !getValue( Env_HU_Config_AutoSync ) )
        putValue( Env_HU_Config_AutoSync_Trigger, 1 );
}

void _Nm_PrepareBusSleepModeInd()
{
//    _Trace( "Nm_PrepareBusSleepModeInd", "Prepare Sleep Mode active");
    putValue( HMI__NM_TGW_CommActive, 0 );
    cancelTimer( t_DBKomTimer_5ms );
    cancelTimer( t_DBKomTimer_20ms );
}

_Nm_StateChangeNotification( byte previousState, byte currentState )
{
/*
    char line[50];

    snprintf( line, elcount(line ), "Transition from %d to %d", previousState, currentState );
    _Trace( "Nm_StateChangeNotification", "", line );
*/
}

_ReleaseCommRequest( word RequestID )
{
    word temp; // actual NM request status

    temp = getValue( HMI__NM_TGW_NM_Request );
    temp &= ~RequestID; // reset NM request 
    putValue( HMI__NM_TGW_NM_Request, temp );
    _NM_Switch_NM_Mode();
}

_SetCommRequest( word RequestID )
{
    word temp; // actual NM request status

    temp = getValue( HMI__NM_TGW_NM_Request );
    temp |= RequestID; // set NM request 
    putValue( HMI__NM_TGW_NM_Request, temp );
    _NM_Switch_NM_Mode();
}

void _TraceCall( char functionName[], long callResult )
{
    char line[100];

    if( callResult == 1 )
        snprintf( line, elcount(line ), "calling %s", functionName );
    else
        snprintf( line, elcount(line ), "call to %s failed - wrong state?", functionName );
    _Trace( "", "", line );
}

void _Trace( char functionName[], char info[])
{
    _Trace( functionName, info, "");
}

void _Trace( char functionName[], char info[], char verbose[], long argument )
{
    char line[100];

    snprintf( line, elcount(line ), verbose, argument );
    _Trace( functionName, info, line );
}

void _Trace( char functionName[], char info[], char verbose[])
{
  char sep[2] = "/";
  sep[0] = functionName[0] ? '/' : 0;
  if( verbose[0])
  {
    write( "[%.3f]%s%s%s: %s", timeNow()/100000.0, gECU
           , sep
           , functionName
           , verbose
           );
  } else
  {
    write( "[%.3f]%s%s%s: %s", timeNow()/100000.0, gECU
           , sep
           , functionName
           , info
           );
  }
}

on envVar HMI_ISw_Stat
{
    byte temp; // actual NM request status

    temp = getValue( HMI__NM_TGW_NM_Request );
    if( getValue(this) > 1 ) // Ign On by EIS
    {
        if( getValue( HMI__NM_EIS_AutomaticModeActive ) == 1 )
        {
            _SetCommRequest( cIgnitionNMRequest );
//            Nm_NetworkRequest();
//            Trace( "Nm_NetworkRequest TGW, EIS ISw_Stat > 0", "");
//            putValue( HMI__NM_TGW_CommActive, 1 );
//            putValue( Env___start_Stop_DBKom_Timer, 1 );
//            setTimer(t_DBKomTimer, 5); //  ms
            temp |= cIgnitionNMRequest; // set NM request 
            putValue( HMI__NM_TGW_NM_Request, temp );
        }
    }
    else
    {
        if( getValue( HMI__NM_EIS_AutomaticModeActive ) == 1 )
        {
            temp &= ~cIgnitionNMRequest; // clear NM request
            putValue( HMI__NM_TGW_NM_Request, temp );
        }
        else
        {
            putValue( HMI__NM_TGW_NM_Request, 0 );
        }
    }
    if( temp == 0 ) // no reason for keeping NM alive => shut down NM
    {
        if( getValue( HMI__NM_EIS_AutomaticModeActive ) == 1 )
        {
            _ReleaseCommRequest( cIgnitionNMRequest );
//        Nm_NetworkRelease(); // this was the last reason to keep NM alive
//        Trace( "Nm_NetworkRequest TGW, EIS ISw_Stat = Lock", ""); // this was the last reason to keep NM alive
        }
    } 
}

___Template_Header()
{
// #FUNCTIONS#
// #FUNCTIONS_END#
// #TIMERS#
// #TIMERS_END#
// #ENVVARS#
// #ENVVARS_END#
}

ActvComf_Rq_AR_check_output()
{
    if( !getValue( HMI__STMSG_ActvComf_Rq_AR ) )
    {
        // Botschaft ActvComf_Rq_AR --- Sendeart 5 cyclicAndSpontanWithDelay
        if( _ActvComf_Rq_AR_DelayCnt > 0) _ActvComf_Rq_AR_DelayCnt--; // Mindestsendeabstand
        _ActvComf_Rq_AR_Cnt--;
        if( _ActvComf_Rq_AR_Cnt < 1 )
        {
            if( _ActvComf_Rq_AR_DelayCnt < 1 )
            {
                // Nachricht wg. abgelaufenem Zyklus ausgeben (Mindestsendeabstand eingehalten)
                ActvComf_Rq_AR_output();
                 _ActvComf_Rq_AR_SpontanFlag = 0; // Spontan-Flag zurücksetzen
                _ActvComf_Rq_AR_DelayCnt = _ActvComf_Rq_AR_MinDelay;
            }
            else
            {
                // Spontanflag setzen damit nach Ablauf Mindestsendeabstand gesendet wird
                 _ActvComf_Rq_AR_SpontanFlag = 1;
            }
            _ActvComf_Rq_AR_Cnt = _ActvComf_Rq_AR_CycleCount; // Zyklus-Zähler zurücksetzen
        }
        else if( _ActvComf_Rq_AR_SpontanFlag)
        {
            if( _ActvComf_Rq_AR_DelayCnt < 1 )
            {
                // Nachricht wg. spontaner Änderung ausgeben (Mindestsendeabstand eingehalten)
                ActvComf_Rq_AR_output();
                _ActvComf_Rq_AR_SpontanFlag = 0; // Spontan-Flag zurücksetzen
                _ActvComf_Rq_AR_DelayCnt = _ActvComf_Rq_AR_MinDelay;
            }
        }
    }
}

ActvComf_Rq_AR_init()
{
    /* Botschaft ActvComf_Rq_AR ID: 850 ---- Sendeart 5 cyclicAndSpontanWithDelay
BA_ "ApplMessage" BO_ 850 0;
BA_ "NmAsrMessage" BO_ 850 0;
BA_ "GenMsgMinAcceptLength" BO_ 850 8;
BA_ "GenMsgILSupport" BO_ 850 1;
BA_ "DiagState" BO_ 850 0;
BA_ "DiagRequest" BO_ 850 0;
BA_ "DiagResponse" BO_ 850 0;
BA_ "GenMsgStartValue" BO_ 850 "0";
BA_ "GenMsgStartDelayTime" BO_ 850 170;
BA_ "GenMsgDelayTime" BO_ 850 200;
BA_ "GenMsgNrOfRepetitions" BO_ 850 0;
BA_ "GenMsgCycleTime" BO_ 850 1000;
BA_ "GenMsgSendType" BO_ 850 5;
    */
    _ActvComf_Rq_AR_Timebase =            c_tDBKomTimer_20ms;
    _ActvComf_Rq_AR_CycleCount =       1000 / _ActvComf_Rq_AR_Timebase;
    _ActvComf_Rq_AR_StartDelay =        170 / _ActvComf_Rq_AR_Timebase;
    _ActvComf_Rq_AR_MinDelay =          200 / _ActvComf_Rq_AR_Timebase;
    _ActvComf_Rq_AR_Cnt = _ActvComf_Rq_AR_StartDelay;
    _ActvComf_Rq_AR_SpontanFlag = 0;
    _ActvComf_Rq_AR_DelayCnt = 0;

    putValue( HMI__STMSGSD_ActvComf_Rq_AR, _ActvComf_Rq_AR_StartDelay * _ActvComf_Rq_AR_Timebase );
    putValue( HMI__STMSGT_ActvComf_Rq_AR, _ActvComf_Rq_AR_CycleCount * _ActvComf_Rq_AR_Timebase );

    _mActvComf_Rq_AR.CLkS_ActvComf_Rq.phys = getValue( HMI_CLkS_ActvComf_Rq );
    _mActvComf_Rq_AR.DrowDtct_ActvComf_Prog_Stat.phys = getValue( HMI_DrowDtct_ActvComf_Prog_Stat );
    _mActvComf_Rq_AR.HVAC_FanLvlLimit_ActvComf_Rq.phys = getValue( HMI_HVAC_FanLvlLimit_ActvComf_Rq );
    _mActvComf_Rq_AR.HVAC_Ionzr_ActvComf_Rq.phys = getValue( HMI_HVAC_Ionzr_ActvComf_Rq );
    _mActvComf_Rq_AR.HVAC_Pulsation_ActvComf_Rq.phys = getValue( HMI_HVAC_Pulsation_ActvComf_Rq );
    _mActvComf_Rq_AR.HVAC_RHU_ActvComf_Rq.phys = getValue( HMI_HVAC_RHU_ActvComf_Rq );
    _mActvComf_Rq_AR.HVAC_SGEN_ActvComf_Rq.phys = getValue( HMI_HVAC_SGEN_ActvComf_Rq );
    _mActvComf_Rq_AR.HVAC_TempDelta_ActvComf_Rq.phys = getValue( HMI_HVAC_TempDelta_ActvComf_Rq );
    _mActvComf_Rq_AR.HVAC_TempDir_ActvComf_Rq.phys = getValue( HMI_HVAC_TempDir_ActvComf_Rq );
    _mActvComf_Rq_AR.ICH_HtVn_ActvComf_Rq.phys = getValue( HMI_ICH_HtVn_ActvComf_Rq );
    _mActvComf_Rq_AR.IL_ActvComf_On_Rq.phys = getValue( HMI_IL_ActvComf_On_Rq );
    _mActvComf_Rq_AR.IL_ActvComf_Prog_Rq.phys = getValue( HMI_IL_ActvComf_Prog_Rq );
    _mActvComf_Rq_AR.MCMS_ActvComf_FL_Rq.phys = getValue( HMI_MCMS_ActvComf_FL_Rq );
    _mActvComf_Rq_AR.MCMS_ActvComf_FR_Rq.phys = getValue( HMI_MCMS_ActvComf_FR_Rq );
    _mActvComf_Rq_AR.MCMS_ActvComf_RL_Rq.phys = getValue( HMI_MCMS_ActvComf_RL_Rq );
    _mActvComf_Rq_AR.MCMS_ActvComf_RR_Rq.phys = getValue( HMI_MCMS_ActvComf_RR_Rq );
    _mActvComf_Rq_AR.MCMS_ActvComfProg_Rq.phys = getValue( HMI_MCMS_ActvComfProg_Rq );
    _mActvComf_Rq_AR.PkBrk_ActvComf_Rq.phys = getValue( HMI_PkBrk_ActvComf_Rq );
    _mActvComf_Rq_AR.SeatCond_ActvComf_Seat_FL_Rq.phys = getValue( HMI_SeatCond_ActvComf_Seat_FL_Rq );
    _mActvComf_Rq_AR.SeatCond_ActvComf_Seat_FR_Rq.phys = getValue( HMI_SeatCond_ActvComf_Seat_FR_Rq );
    _mActvComf_Rq_AR.SeatCond_ActvComf_Seat_RL_Rq.phys = getValue( HMI_SeatCond_ActvComf_Seat_RL_Rq );
    _mActvComf_Rq_AR.SeatCond_ActvComf_Seat_RR_Rq.phys = getValue( HMI_SeatCond_ActvComf_Seat_RR_Rq );
    _mActvComf_Rq_AR.SeatCond_ActvComfProg_Rq.phys = getValue( HMI_SeatCond_ActvComfProg_Rq );
    _mActvComf_Rq_AR.StWhlHeat_ActvComf_Rq.phys = getValue( HMI_StWhlHeat_ActvComf_Rq );
    _mActvComf_Rq_AR.SwIllLvl_ActvComf_Rq.phys = getValue( HMI_SwIllLvl_ActvComf_Rq );
}

ActvComf_Rq_AR_output()
{
    output( _mActvComf_Rq_AR );
}

ActvComf_Rq_AR_saveEnvVars( dword hFile )
{
    filePutString("\n// Knoten TGW: ActvComf_Rq_AR\n", 25, hFile);
    snprintf( buffer, elcount(buffer), "0.0000 HMI__STMSG_ActvComf_Rq_AR := %X\n", getValue( HMI__STMSG_ActvComf_Rq_AR ));        filePutString( buffer, elcount(buffer), hFile);
    snprintf( buffer, elcount(buffer), "0.0000 HMI__STMSGT_ActvComf_Rq_AR := %X\n", getValue( HMI__STMSGT_ActvComf_Rq_AR ));        filePutString( buffer, elcount(buffer), hFile);
    snprintf( buffer, elcount(buffer), "0.0000 HMI_CLkS_ActvComf_Rq := %X\n", getValue( HMI_CLkS_ActvComf_Rq ) );        filePutString( buffer, elcount(buffer), hFile);
    snprintf( buffer, elcount(buffer), "0.0000 HMI_DrowDtct_ActvComf_Prog_Stat := %X\n", getValue( HMI_DrowDtct_ActvComf_Prog_Stat ) );        filePutString( buffer, elcount(buffer), hFile);
    snprintf( buffer, elcount(buffer), "0.0000 HMI_HVAC_FanLvlLimit_ActvComf_Rq := %X\n", getValue( HMI_HVAC_FanLvlLimit_ActvComf_Rq ) );        filePutString( buffer, elcount(buffer), hFile);
    snprintf( buffer, elcount(buffer), "0.0000 HMI_HVAC_Ionzr_ActvComf_Rq := %X\n", getValue( HMI_HVAC_Ionzr_ActvComf_Rq ) );        filePutString( buffer, elcount(buffer), hFile);
    snprintf( buffer, elcount(buffer), "0.0000 HMI_HVAC_Pulsation_ActvComf_Rq := %X\n", getValue( HMI_HVAC_Pulsation_ActvComf_Rq ) );        filePutString( buffer, elcount(buffer), hFile);
    snprintf( buffer, elcount(buffer), "0.0000 HMI_HVAC_RHU_ActvComf_Rq := %X\n", getValue( HMI_HVAC_RHU_ActvComf_Rq ) );        filePutString( buffer, elcount(buffer), hFile);
    snprintf( buffer, elcount(buffer), "0.0000 HMI_HVAC_SGEN_ActvComf_Rq := %X\n", getValue( HMI_HVAC_SGEN_ActvComf_Rq ) );        filePutString( buffer, elcount(buffer), hFile);
    snprintf( buffer, elcount(buffer), "0.0000 HMI_HVAC_TempDelta_ActvComf_Rq := %X\n", getValue( HMI_HVAC_TempDelta_ActvComf_Rq ) );        filePutString( buffer, elcount(buffer), hFile);
    snprintf( buffer, elcount(buffer), "0.0000 HMI_HVAC_TempDir_ActvComf_Rq := %X\n", getValue( HMI_HVAC_TempDir_ActvComf_Rq ) );        filePutString( buffer, elcount(buffer), hFile);
    snprintf( buffer, elcount(buffer), "0.0000 HMI_ICH_HtVn_ActvComf_Rq := %X\n", getValue( HMI_ICH_HtVn_ActvComf_Rq ) );        filePutString( buffer, elcount(buffer), hFile);
    snprintf( buffer, elcount(buffer), "0.0000 HMI_IL_ActvComf_On_Rq := %X\n", getValue( HMI_IL_ActvComf_On_Rq ) );        filePutString( buffer, elcount(buffer), hFile);
    snprintf( buffer, elcount(buffer), "0.0000 HMI_IL_ActvComf_Prog_Rq := %X\n", getValue( HMI_IL_ActvComf_Prog_Rq ) );        filePutString( buffer, elcount(buffer), hFile);
    snprintf( buffer, elcount(buffer), "0.0000 HMI_MCMS_ActvComf_FL_Rq := %X\n", getValue( HMI_MCMS_ActvComf_FL_Rq ) );        filePutString( buffer, elcount(buffer), hFile);
    snprintf( buffer, elcount(buffer), "0.0000 HMI_MCMS_ActvComf_FR_Rq := %X\n", getValue( HMI_MCMS_ActvComf_FR_Rq ) );        filePutString( buffer, elcount(buffer), hFile);
    snprintf( buffer, elcount(buffer), "0.0000 HMI_MCMS_ActvComf_RL_Rq := %X\n", getValue( HMI_MCMS_ActvComf_RL_Rq ) );        filePutString( buffer, elcount(buffer), hFile);
    snprintf( buffer, elcount(buffer), "0.0000 HMI_MCMS_ActvComf_RR_Rq := %X\n", getValue( HMI_MCMS_ActvComf_RR_Rq ) );        filePutString( buffer, elcount(buffer), hFile);
    snprintf( buffer, elcount(buffer), "0.0000 HMI_MCMS_ActvComfProg_Rq := %X\n", getValue( HMI_MCMS_ActvComfProg_Rq ) );        filePutString( buffer, elcount(buffer), hFile);
    snprintf( buffer, elcount(buffer), "0.0000 HMI_PkBrk_ActvComf_Rq := %X\n", getValue( HMI_PkBrk_ActvComf_Rq ) );        filePutString( buffer, elcount(buffer), hFile);
    snprintf( buffer, elcount(buffer), "0.0000 HMI_SeatCond_ActvComf_Seat_FL_Rq := %X\n", getValue( HMI_SeatCond_ActvComf_Seat_FL_Rq ) );        filePutString( buffer, elcount(buffer), hFile);
    snprintf( buffer, elcount(buffer), "0.0000 HMI_SeatCond_ActvComf_Seat_FR_Rq := %X\n", getValue( HMI_SeatCond_ActvComf_Seat_FR_Rq ) );        filePutString( buffer, elcount(buffer), hFile);
    snprintf( buffer, elcount(buffer), "0.0000 HMI_SeatCond_ActvComf_Seat_RL_Rq := %X\n", getValue( HMI_SeatCond_ActvComf_Seat_RL_Rq ) );        filePutString( buffer, elcount(buffer), hFile);
    snprintf( buffer, elcount(buffer), "0.0000 HMI_SeatCond_ActvComf_Seat_RR_Rq := %X\n", getValue( HMI_SeatCond_ActvComf_Seat_RR_Rq ) );        filePutString( buffer, elcount(buffer), hFile);
    snprintf( buffer, elcount(buffer), "0.0000 HMI_SeatCond_ActvComfProg_Rq := %X\n", getValue( HMI_SeatCond_ActvComfProg_Rq ) );        filePutString( buffer, elcount(buffer), hFile);
    snprintf( buffer, elcount(buffer), "0.0000 HMI_StWhlHeat_ActvComf_Rq := %X\n", getValue( HMI_StWhlHeat_ActvComf_Rq ) );        filePutString( buffer, elcount(buffer), hFile);
    snprintf( buffer, elcount(buffer), "0.0000 HMI_SwIllLvl_ActvComf_Rq := %X\n", getValue( HMI_SwIllLvl_ActvComf_Rq ) );        filePutString( buffer, elcount(buffer), hFile);
}

on timer _tActvComf_Rq_AR
{
    putValue( HMI__STMSG_ActvComf_Rq_AR, 0 );
}

on EnvVar HMI__STMSG_ActvComf_Rq_AR
{
    long tDelay;
    if( getValue( this ) == 2 )
    {
        tDelay = getValue( HMI__STMSGT_ActvComf_Rq_AR );
        if( tDelay > 0 )    
            setTimer( _tActvComf_Rq_AR, tDelay );
        else
            putValue( HMI__STMSG_ActvComf_Rq_AR, 0 );
    }
}

on envVar HMI__STMSG_PO_ActvComf_Rq_AR
{
    if( getValue( this ) )
        openPanel("ActvComf_Rq_AR");
}

on EnvVar HMI_CLkS_ActvComf_Rq
{
    _mActvComf_Rq_AR.CLkS_ActvComf_Rq.phys = getValue(this);
    _ActvComf_Rq_AR_SpontanFlag = 1;
}

on EnvVar HMI_DrowDtct_ActvComf_Prog_Stat
{
    _mActvComf_Rq_AR.DrowDtct_ActvComf_Prog_Stat.phys = getValue(this);
    _ActvComf_Rq_AR_SpontanFlag = 1;
}

on EnvVar HMI_HVAC_FanLvlLimit_ActvComf_Rq
{
    _mActvComf_Rq_AR.HVAC_FanLvlLimit_ActvComf_Rq.phys = getValue(this);
    _ActvComf_Rq_AR_SpontanFlag = 1;
}

on EnvVar HMI_HVAC_Ionzr_ActvComf_Rq
{
    _mActvComf_Rq_AR.HVAC_Ionzr_ActvComf_Rq.phys = getValue(this);
    _ActvComf_Rq_AR_SpontanFlag = 1;
}

on EnvVar HMI_HVAC_Pulsation_ActvComf_Rq
{
    _mActvComf_Rq_AR.HVAC_Pulsation_ActvComf_Rq.phys = getValue(this);
    _ActvComf_Rq_AR_SpontanFlag = 1;
}

on EnvVar HMI_HVAC_RHU_ActvComf_Rq
{
    _mActvComf_Rq_AR.HVAC_RHU_ActvComf_Rq.phys = getValue(this);
    _ActvComf_Rq_AR_SpontanFlag = 1;
}

on EnvVar HMI_HVAC_SGEN_ActvComf_Rq
{
    _mActvComf_Rq_AR.HVAC_SGEN_ActvComf_Rq.phys = getValue(this);
    _ActvComf_Rq_AR_SpontanFlag = 1;
}

on EnvVar HMI_HVAC_TempDelta_ActvComf_Rq
{
    _mActvComf_Rq_AR.HVAC_TempDelta_ActvComf_Rq.phys = getValue(this);
    _ActvComf_Rq_AR_SpontanFlag = 1;
}

on EnvVar HMI_HVAC_TempDir_ActvComf_Rq
{
    _mActvComf_Rq_AR.HVAC_TempDir_ActvComf_Rq.phys = getValue(this);
    _ActvComf_Rq_AR_SpontanFlag = 1;
}

on EnvVar HMI_ICH_HtVn_ActvComf_Rq
{
    _mActvComf_Rq_AR.ICH_HtVn_ActvComf_Rq.phys = getValue(this);
    _ActvComf_Rq_AR_SpontanFlag = 1;
}

on EnvVar HMI_IL_ActvComf_On_Rq
{
    _mActvComf_Rq_AR.IL_ActvComf_On_Rq.phys = getValue(this);
    _ActvComf_Rq_AR_SpontanFlag = 1;
}

on EnvVar HMI_IL_ActvComf_Prog_Rq
{
    _mActvComf_Rq_AR.IL_ActvComf_Prog_Rq.phys = getValue(this);
    _ActvComf_Rq_AR_SpontanFlag = 1;
}

on EnvVar HMI_MCMS_ActvComf_FL_Rq
{
    _mActvComf_Rq_AR.MCMS_ActvComf_FL_Rq.phys = getValue(this);
    _ActvComf_Rq_AR_SpontanFlag = 1;
}

on EnvVar HMI_MCMS_ActvComf_FR_Rq
{
    _mActvComf_Rq_AR.MCMS_ActvComf_FR_Rq.phys = getValue(this);
    _ActvComf_Rq_AR_SpontanFlag = 1;
}

on EnvVar HMI_MCMS_ActvComf_RL_Rq
{
    _mActvComf_Rq_AR.MCMS_ActvComf_RL_Rq.phys = getValue(this);
    _ActvComf_Rq_AR_SpontanFlag = 1;
}

on EnvVar HMI_MCMS_ActvComf_RR_Rq
{
    _mActvComf_Rq_AR.MCMS_ActvComf_RR_Rq.phys = getValue(this);
    _ActvComf_Rq_AR_SpontanFlag = 1;
}

on EnvVar HMI_MCMS_ActvComfProg_Rq
{
    _mActvComf_Rq_AR.MCMS_ActvComfProg_Rq.phys = getValue(this);
    _ActvComf_Rq_AR_SpontanFlag = 1;
}

on EnvVar HMI_PkBrk_ActvComf_Rq
{
    _mActvComf_Rq_AR.PkBrk_ActvComf_Rq.phys = getValue(this);
    _ActvComf_Rq_AR_SpontanFlag = 1;
}

on EnvVar HMI_SeatCond_ActvComf_Seat_FL_Rq
{
    _mActvComf_Rq_AR.SeatCond_ActvComf_Seat_FL_Rq.phys = getValue(this);
    _ActvComf_Rq_AR_SpontanFlag = 1;
}

on EnvVar HMI_SeatCond_ActvComf_Seat_FR_Rq
{
    _mActvComf_Rq_AR.SeatCond_ActvComf_Seat_FR_Rq.phys = getValue(this);
    _ActvComf_Rq_AR_SpontanFlag = 1;
}

on EnvVar HMI_SeatCond_ActvComf_Seat_RL_Rq
{
    _mActvComf_Rq_AR.SeatCond_ActvComf_Seat_RL_Rq.phys = getValue(this);
    _ActvComf_Rq_AR_SpontanFlag = 1;
}

on EnvVar HMI_SeatCond_ActvComf_Seat_RR_Rq
{
    _mActvComf_Rq_AR.SeatCond_ActvComf_Seat_RR_Rq.phys = getValue(this);
    _ActvComf_Rq_AR_SpontanFlag = 1;
}

on EnvVar HMI_SeatCond_ActvComfProg_Rq
{
    _mActvComf_Rq_AR.SeatCond_ActvComfProg_Rq.phys = getValue(this);
    _ActvComf_Rq_AR_SpontanFlag = 1;
}

on EnvVar HMI_StWhlHeat_ActvComf_Rq
{
    _mActvComf_Rq_AR.StWhlHeat_ActvComf_Rq.phys = getValue(this);
    _ActvComf_Rq_AR_SpontanFlag = 1;
}

on EnvVar HMI_SwIllLvl_ActvComf_Rq
{
    _mActvComf_Rq_AR.SwIllLvl_ActvComf_Rq.phys = getValue(this);
    _ActvComf_Rq_AR_SpontanFlag = 1;
}

ActvComf_Rq2_AR_check_output()
{
    if( !getValue( HMI__STMSG_ActvComf_Rq2_AR ) )
    {
    //  message   ActvComf_Rq2_AR ID: 819 --- Sendeart 5 cyclicAndSpontanWithDelay --- 
        if( _ActvComf_Rq2_AR_DelayCnt > 0) _ActvComf_Rq2_AR_DelayCnt--; // Mindestsendeabstand
        _ActvComf_Rq2_AR_Cnt--;
        if( _ActvComf_Rq2_AR_Cnt < 1 )
        {
            if( _ActvComf_Rq2_AR_DelayCnt < 1 )
            {
                // Nachricht wg. abgelaufenem Zyklus ausgeben (Mindestsendeabstand eingehalten)
                ActvComf_Rq2_AR_output();
                 _ActvComf_Rq2_AR_SpontanFlag = 0; // Spontan-Flag zurücksetzen
                _ActvComf_Rq2_AR_DelayCnt = _ActvComf_Rq2_AR_MinDelay;
            }
            else
            {
                // Spontanflag setzen damit nach Ablauf Mindestsendeabstand gesendet wird
                 _ActvComf_Rq2_AR_SpontanFlag = 1;
            }
            _ActvComf_Rq2_AR_Cnt = ( getValue( HMI__MSGCyc_ActvComf_Rq2_AR ) / _ActvComf_Rq2_AR_Timebase ); //_ActvComf_Rq2_AR_CycleCount; // Zyklus-Zähler zurücksetzen
        }
        else if( _ActvComf_Rq2_AR_SpontanFlag)
        {
            if( _ActvComf_Rq2_AR_DelayCnt < 1 )
            {
                // Nachricht wg. spontaner Änderung ausgeben (Mindestsendeabstand eingehalten)
                ActvComf_Rq2_AR_output();
                _ActvComf_Rq2_AR_SpontanFlag = 0; // Spontan-Flag zurücksetzen
                _ActvComf_Rq2_AR_DelayCnt = _ActvComf_Rq2_AR_MinDelay;
            }
        }
    }
}

ActvComf_Rq2_AR_init()
{   /* Botschaft ActvComf_Rq2_AR ID: 1106 --- Sendeart 5 cyclicAndSpontanWithDelay --- 
BA_ "ApplMessage" BO_ 1106 0;
BA_ "NmAsrMessage" BO_ 1106 0;
BA_ "GenMsgMinAcceptLength" BO_ 1106 8;
BA_ "GenMsgILSupport" BO_ 1106 1;
BA_ "DiagState" BO_ 1106 0;
BA_ "DiagRequest" BO_ 1106 0;
BA_ "DiagResponse" BO_ 1106 0;
BA_ "GenMsgStartValue" BO_ 1106 "0";
BA_ "GenMsgStartDelayTime" BO_ 1106 125;
BA_ "GenMsgDelayTime" BO_ 1106 200;
BA_ "GenMsgNrOfRepetition" BO_ 1106 0;
BA_ "GenMsgCycleTime" BO_ 1106 1000;
BA_ "GenMsgSendType" BO_ 1106 5;
    */
    _ActvComf_Rq2_AR_Timebase =             c_tDBKomTimer_20ms;
    _ActvComf_Rq2_AR_CycleCount =          1000 / _ActvComf_Rq2_AR_Timebase;
    _ActvComf_Rq2_AR_StartDelay =            200 / _ActvComf_Rq2_AR_Timebase;
    _ActvComf_Rq2_AR_MinDelay =              125 / _ActvComf_Rq2_AR_Timebase;
    _ActvComf_Rq2_AR_Cnt = _ActvComf_Rq2_AR_StartDelay;
    _ActvComf_Rq2_AR_SpontanFlag = 0;
    _ActvComf_Rq2_AR_DelayCnt = 0;

    putValue( HMI__STMSGSD_ActvComf_Rq2_AR, _ActvComf_Rq2_AR_StartDelay * _ActvComf_Rq2_AR_Timebase );
    
    _mActvComf_Rq2_AR.HVAC_ActvComf_FL_Rq.phys = getValue( HMI_HVAC_ActvComf_FL_Rq );
    _mActvComf_Rq2_AR.HVAC_ActvComf_FR_Rq.phys = getValue( HMI_HVAC_ActvComf_FR_Rq );
    _mActvComf_Rq2_AR.HVAC_ActvComf_RL_Rq.phys = getValue( HMI_HVAC_ActvComf_RL_Rq );
    _mActvComf_Rq2_AR.HVAC_ActvComf_RR_Rq.phys = getValue( HMI_HVAC_ActvComf_RR_Rq );
    
}

void ActvComf_Rq2_AR_output(void)
{
    output( _mActvComf_Rq2_AR );
}

ActvComf_Rq2_AR_saveEnvVars( dword hFile )
{
    filePutString("\n// Knoten EIS: ActvComf_Rq2_AR\n", 28, hFile );
    snprintf( buffer, elcount( buffer ), "0.0000 HMI__STMSG_ActvComf_Rq2_AR := %X\n", getValue( HMI__STMSG_ActvComf_Rq2_AR ) );            filePutString ( buffer, elcount( buffer ), hFile );
    snprintf( buffer, elcount( buffer ), "0.0000 HMI__STMSGT_ActvComf_Rq2_AR := %X\n", getValue( HMI__STMSGT_ActvComf_Rq2_AR ) );        filePutString ( buffer, elcount( buffer ), hFile );
    snprintf( buffer, elcount( buffer ), "0.0000 HMI_HVAC_ActvComf_FL_Rq := %X\n", getValue( HMI_HVAC_ActvComf_FL_Rq ) );    filePutString ( buffer, elcount( buffer ), hFile );
    snprintf( buffer, elcount( buffer ), "0.0000 HMI_HVAC_ActvComf_FR_Rq := %X\n", getValue( HMI_HVAC_ActvComf_FR_Rq ) );    filePutString ( buffer, elcount( buffer ), hFile );
    snprintf( buffer, elcount( buffer ), "0.0000 HMI_HVAC_ActvComf_RL_Rq := %X\n", getValue( HMI_HVAC_ActvComf_RL_Rq ) );    filePutString ( buffer, elcount( buffer ), hFile );
    snprintf( buffer, elcount( buffer ), "0.0000 HMI_HVAC_ActvComf_RR_Rq := %X\n", getValue( HMI_HVAC_ActvComf_RR_Rq ) );    filePutString ( buffer, elcount( buffer ), hFile );
	
}

on envVar HMI__MSGCyc_ActvComf_Rq2_AR
{
       _ActvComf_Rq2_AR_SpontanFlag = 1;
}

on timer _tActvComf_Rq2_AR
{
    putValue( HMI__STMSG_ActvComf_Rq2_AR, 0 );
}

on EnvVar HMI__STMSG_ActvComf_Rq2_AR
{
    long tDelay;
    if( getValue( this ) == 2 )
    {
        tDelay = getValue( HMI__STMSGT_ActvComf_Rq2_AR );
        if( tDelay > 0 )
            setTimer( _tActvComf_Rq2_AR, tDelay );
        else
            putValue( HMI__STMSG_ActvComf_Rq2_AR, 0 );
    }
}

on envVar HMI__STMSG_PO_ActvComf_Rq2_AR
{
    if( getValue( this ) )
        openPanel("ActvComf_Rq2_AR");
}

on EnvVar HMI_HVAC_ActvComf_FL_Rq
{

   _mActvComf_Rq2_AR.HVAC_ActvComf_FL_Rq.phys = getValue(this);
    _ActvComf_Rq2_AR_SpontanFlag = 1;
}

on EnvVar HMI_HVAC_ActvComf_FR_Rq
{

   _mActvComf_Rq2_AR.HVAC_ActvComf_FR_Rq.phys = getValue(this);
    _ActvComf_Rq2_AR_SpontanFlag = 1;
}

on EnvVar HMI_HVAC_ActvComf_RL_Rq
{

   _mActvComf_Rq2_AR.HVAC_ActvComf_RL_Rq.phys = getValue(this);
    _ActvComf_Rq2_AR_SpontanFlag = 1;
}

on EnvVar HMI_HVAC_ActvComf_RR_Rq
{

   _mActvComf_Rq2_AR.HVAC_ActvComf_RR_Rq.phys = getValue(this);
    _ActvComf_Rq2_AR_SpontanFlag = 1;
}

Adapt_Seat_D_Rq_AR_check_output()
{
    if( !getValue( HMI__STMSG_Adapt_Seat_D_Rq_AR ))
    {
        // Botschaft Adapt_Seat_D_Rq_AR --- Sendeart cyclicWithRepeatOnDemand
        if( _Adapt_Seat_D_Rq_AR_Cnt > 0 )
        {
            _Adapt_Seat_D_Rq_AR_Cnt--;
            if( _Adapt_Seat_D_Rq_AR_Cnt < 1 )
            {
                // Nachricht wg. abgelaufenem Zyklus ausgeben
                Adapt_Seat_D_Rq_AR_check_output();
                _Adapt_Seat_D_Rq_AR_MsgRepetitions--;
                if( _Adapt_Seat_D_Rq_AR_MsgRepetitions > 0 ) _Adapt_Seat_D_Rq_AR_Cnt = _Adapt_Seat_D_Rq_AR_CycleCount;
            }
        }
    }
}

Adapt_Seat_D_Rq_AR_init()
{
    /* Botschaft Adapt_Seat_D_Rq_AR ID: 1202 ---- Sendeart 9 cyclicWithRepeatOnDemand
BA_ "ApplMessage" BO_ 1202 0;
BA_ "NmAsrMessage" BO_ 1202 0;
BA_ "GenMsgMinAcceptLength" BO_ 1202 8;
BA_ "GenMsgILSupport" BO_ 1202 1;
BA_ "DiagState" BO_ 1202 0;
BA_ "DiagRequest" BO_ 1202 0;
BA_ "DiagResponse" BO_ 1202 0;
BA_ "GenMsgStartValue" BO_ 1202 "0";
BA_ "GenMsgDelayTime" BO_ 1202 5;
BA_ "GenMsgNrOfRepetitions" BO_ 1202 4;
BA_ "GenMsgCycleTime" BO_ 1202 1000;
BA_ "GenMsgSendType" BO_ 1202 9;
    */
    _Adapt_Seat_D_Rq_AR_Timebase =          c_tDBKomTimer_20ms;
    _Adapt_Seat_D_Rq_AR_CycleCount =      1000 / _Adapt_Seat_D_Rq_AR_Timebase;
    _Adapt_Seat_D_Rq_AR_StartDelay =         0 / _Adapt_Seat_D_Rq_AR_Timebase;
    _Adapt_Seat_D_Rq_AR_Cnt = _Adapt_Seat_D_Rq_AR_StartDelay;
    _Adapt_Seat_D_Rq_AR_MsgRepetitions = 4;
    
    putValue( HMI__STMSGSD_Adapt_Seat_D_Rq_AR, _Adapt_Seat_D_Rq_AR_StartDelay * _Adapt_Seat_D_Rq_AR_Timebase );

//    _mAdapt_Seat_D_Rq_AR.Adapt_Seat_D_Forearm.phys = getValue(HMI_Adapt_Seat_D_Forearm );
//    _mAdapt_Seat_D_Rq_AR.Adapt_Seat_D_Gender.phys = getValue(HMI_Adapt_Seat_D_Gender );
    _mAdapt_Seat_D_Rq_AR.Adapt_Seat_D_Height.phys = getValue(HMI_Adapt_Seat_D_Height );
    _mAdapt_Seat_D_Rq_AR.Adapt_Seat_D_Md.phys = getValue(HMI_Adapt_Seat_D_Md );
//    _mAdapt_Seat_D_Rq_AR.Adapt_Seat_D_MemPos.phys = getValue(HMI_Adapt_Seat_D_MemPos );
//    _mAdapt_Seat_D_Rq_AR.Adapt_Seat_D_Thigh.phys = getValue(HMI_Adapt_Seat_D_Thigh );
//    _mAdapt_Seat_D_Rq_AR.Adapt_Seat_D_Upperbody.phys = getValue(HMI_Adapt_Seat_D_Upperbody );
//    _mAdapt_Seat_D_Rq_AR.Adapt_Seat_D_Weight.phys = getValue(HMI_Adapt_Seat_D_Weight );
}

Adapt_Seat_D_Rq_AR_output()
{
    output( _mAdapt_Seat_D_Rq_AR );
}

Adapt_Seat_D_Rq_AR_restart(int nNumRepetitions)
{
    if( nNumRepetitions > _Adapt_Seat_D_Rq_AR_MsgRepetitions )
    {
        if( _Adapt_Seat_D_Rq_AR_MsgRepetitions < 1 )
            _Adapt_Seat_D_Rq_AR_Cnt = 1;
        _Adapt_Seat_D_Rq_AR_MsgRepetitions = nNumRepetitions;
    }
}

Adapt_Seat_D_Rq_AR_saveEnvVars( dword hFile )
{
    filePutString("\n// Knoten TGW: Adapt_Seat_D_Rq_AR\n", 25, hFile);
    snprintf( buffer, elcount(buffer), "0.0000 HMI__STMSG_Adapt_Seat_D_Rq_AR := %X\n", getValue( HMI__STMSG_Adapt_Seat_D_Rq_AR ));        filePutString( buffer, elcount(buffer), hFile);
    snprintf( buffer, elcount(buffer), "0.0000 HMI__STMSGT_Adapt_Seat_D_Rq_AR := %X\n", getValue( HMI__STMSGT_Adapt_Seat_D_Rq_AR ));        filePutString( buffer, elcount(buffer), hFile);
//    snprintf( buffer, elcount(buffer), "0.0000 HMI_Adapt_Seat_D_Forearm := %X\n", getValue( HMI_Adapt_Seat_D_Forearm ) );        filePutString( buffer, elcount(buffer), hFile);
//    snprintf( buffer, elcount(buffer), "0.0000 HMI_Adapt_Seat_D_Gender := %X\n", getValue( HMI_Adapt_Seat_D_Gender ) );        filePutString( buffer, elcount(buffer), hFile);
    snprintf( buffer, elcount(buffer), "0.0000 HMI_Adapt_Seat_D_Height := %X\n", getValue( HMI_Adapt_Seat_D_Height ) );        filePutString( buffer, elcount(buffer), hFile);
    snprintf( buffer, elcount(buffer), "0.0000 HMI_Adapt_Seat_D_Md := %X\n", getValue( HMI_Adapt_Seat_D_Md ) );        filePutString( buffer, elcount(buffer), hFile);
//    snprintf( buffer, elcount(buffer), "0.0000 HMI_Adapt_Seat_D_MemPos := %X\n", getValue( HMI_Adapt_Seat_D_MemPos ) );        filePutString( buffer, elcount(buffer), hFile);
//    snprintf( buffer, elcount(buffer), "0.0000 HMI_Adapt_Seat_D_Thigh := %X\n", getValue( HMI_Adapt_Seat_D_Thigh ) );        filePutString( buffer, elcount(buffer), hFile);
//    snprintf( buffer, elcount(buffer), "0.0000 HMI_Adapt_Seat_D_Upperbody := %X\n", getValue( HMI_Adapt_Seat_D_Upperbody ) );        filePutString( buffer, elcount(buffer), hFile);
//    snprintf( buffer, elcount(buffer), "0.0000 HMI_Adapt_Seat_D_Weight := %X\n", getValue( HMI_Adapt_Seat_D_Weight ) );        filePutString( buffer, elcount(buffer), hFile);
}

on timer _tAdapt_Seat_D_Rq_AR
{
    putValue( HMI__STMSG_Adapt_Seat_D_Rq_AR, 0 );
}

on EnvVar HMI__STMSG_Adapt_Seat_D_Rq_AR
{
    long tDelay;
    if( getValue( this ) == 2 )
    {
        tDelay = getValue( HMI__STMSGT_Adapt_Seat_D_Rq_AR );
        if( tDelay > 0 )    
            setTimer( _tAdapt_Seat_D_Rq_AR, tDelay );
        else
            putValue( HMI__STMSG_Adapt_Seat_D_Rq_AR, 0 );
    }
}

on envVar HMI__STMSG_PO_Adapt_Seat_D_Rq_AR
{
    if( getValue( this ) )
        openPanel("Adapt_Seat_D_Rq_AR");
}

//on EnvVar HMI_Adapt_Seat_D_Forearm
//{
//    _mAdapt_Seat_D_Rq_AR.Adapt_Seat_D_Forearm.phys = getValue(this);
//    Adapt_Seat_D_Rq_AR_restart( 1 );
//}
//
//on EnvVar HMI_Adapt_Seat_D_Gender
//{
//    _mAdapt_Seat_D_Rq_AR.Adapt_Seat_D_Gender.phys = getValue(this);
//    Adapt_Seat_D_Rq_AR_restart( 1 );
//}

on EnvVar HMI_Adapt_Seat_D_Height
{
    _mAdapt_Seat_D_Rq_AR.Adapt_Seat_D_Height.phys = getValue(this);
    Adapt_Seat_D_Rq_AR_restart( 1 );
}

on EnvVar HMI_Adapt_Seat_D_Md
{
    _mAdapt_Seat_D_Rq_AR.Adapt_Seat_D_Md.phys = getValue(this);
    Adapt_Seat_D_Rq_AR_restart( 1 );
}

//on EnvVar HMI_Adapt_Seat_D_MemPos
//{
//    _mAdapt_Seat_D_Rq_AR.Adapt_Seat_D_MemPos.phys = getValue(this);
//    Adapt_Seat_D_Rq_AR_restart( 1 );
//}
//
//on EnvVar HMI_Adapt_Seat_D_Thigh
//{
//    _mAdapt_Seat_D_Rq_AR.Adapt_Seat_D_Thigh.phys = getValue(this);
//    Adapt_Seat_D_Rq_AR_restart( 1 );
//}
//
//on EnvVar HMI_Adapt_Seat_D_Upperbody
//{
//    _mAdapt_Seat_D_Rq_AR.Adapt_Seat_D_Upperbody.phys = getValue(this);
//    Adapt_Seat_D_Rq_AR_restart( 1 );
//}
//
//on EnvVar HMI_Adapt_Seat_D_Weight
//{
//    _mAdapt_Seat_D_Rq_AR.Adapt_Seat_D_Weight.phys = getValue(this);
//    Adapt_Seat_D_Rq_AR_restart( 1 );
//}

ADAS_CURRENT_ATTRIBUTES_AR_check_output()
{
    if( !getValue( HMI__STMSG_ADAS_CURRENT_ATTRIBUTES_AR))
    {
        // Botschaft ADAS_CURRENT_ATTRIBUTES_AR ID: 987 --- Sendeart 0 cyclicX --- 
        _ADAS_CURRENT_ATTRIBUTES_AR_Cnt--;
        if( _ADAS_CURRENT_ATTRIBUTES_AR_Cnt < 1 )
        {
            ADAS_CURRENT_ATTRIBUTES_AR_output(); // Nachricht wg. abgelaufenem Zyklus ausgeben
            _ADAS_CURRENT_ATTRIBUTES_AR_Cnt = _ADAS_CURRENT_ATTRIBUTES_AR_CycleCount; // Zyklus-Zähler zurücksetzen
        }
    }
}

ADAS_CURRENT_ATTRIBUTES_AR_init()
{   /* Botschaft ADAS_CURRENT_ATTRIBUTES_AR ID: 987 --- Sendeart 0 cyclicX --- 
BA_ "ApplMessage" BO_ 987 0;
BA_ "NmAsrMessage" BO_ 987 0;
BA_ "GenMsgMinAcceptLength" BO_ 987 8;
BA_ "GenMsgILSupport" BO_ 987 1;
BA_ "DiagState" BO_ 987 0;
BA_ "DiagRequest" BO_ 987 0;
BA_ "DiagResponse" BO_ 987 0;
BA_ "GenMsgStartValue" BO_ 987 "0";
BA_ "GenMsgStartDelayTime" BO_ 987 225;
BA_ "GenMsgCycleTime" BO_ 987 1000;
BA_ "GenMsgSendType" BO_ 987 0;
    */
    _ADAS_CURRENT_ATTRIBUTES_AR_Timebase =            c_tDBKomTimer_20ms;
    _ADAS_CURRENT_ATTRIBUTES_AR_CycleCount =    1000 / _ADAS_CURRENT_ATTRIBUTES_AR_Timebase;
    _ADAS_CURRENT_ATTRIBUTES_AR_StartDelay =     255 / _ADAS_CURRENT_ATTRIBUTES_AR_Timebase;
    _ADAS_CURRENT_ATTRIBUTES_AR_Cnt = _ADAS_CURRENT_ATTRIBUTES_AR_StartDelay;

    putValue( HMI__STMSGSD_ADAS_CURRENT_ATTRIBUTES_AR, _ADAS_CURRENT_ATTRIBUTES_AR_StartDelay * _ADAS_CURRENT_ATTRIBUTES_AR_Timebase );

    _mADAS_CURRENT_ATTRIBUTES_AR.ADAS_CuA_AreaBuildUp.phys = getValue( HMI_ADAS_CuA_AreaBuildUp );
    _mADAS_CURRENT_ATTRIBUTES_AR.ADAS_CuA_Bridge.phys = getValue( HMI_ADAS_CuA_Bridge );
    _mADAS_CURRENT_ATTRIBUTES_AR.ADAS_CuA_CmpxInsct.phys = getValue( HMI_ADAS_CuA_CmpxInsct );
    _mADAS_CURRENT_ATTRIBUTES_AR.ADAS_CuA_CycCnt.phys = getValue( HMI_ADAS_CuA_CycCnt );
    _mADAS_CURRENT_ATTRIBUTES_AR.ADAS_CuA_EffSpdLmt.phys = getValue( HMI_ADAS_CuA_EffSpdLmt );
    _mADAS_CURRENT_ATTRIBUTES_AR.ADAS_CuA_EffSpdLmtType.phys = getValue( HMI_ADAS_CuA_EffSpdLmtType );
    _mADAS_CURRENT_ATTRIBUTES_AR.ADAS_CuA_FuncRoadClass.phys = getValue( HMI_ADAS_CuA_FuncRoadClass );
    _mADAS_CURRENT_ATTRIBUTES_AR.ADAS_CuA_MsgTyp.phys = getValue( HMI_ADAS_CuA_MsgTyp );
    _mADAS_CURRENT_ATTRIBUTES_AR.ADAS_CuA_NumOfLaneDrvDir.phys = getValue( HMI_ADAS_CuA_NumOfLaneDrvDir );
    _mADAS_CURRENT_ATTRIBUTES_AR.ADAS_CuA_NumOfLaneOppDir.phys = getValue( HMI_ADAS_CuA_NumOfLaneOppDir );
    _mADAS_CURRENT_ATTRIBUTES_AR.ADAS_CuA_Offset.phys = getValue( HMI_ADAS_CuA_Offset );
    _mADAS_CURRENT_ATTRIBUTES_AR.ADAS_CuA_PartRoute.phys = getValue( HMI_ADAS_CuA_PartRoute );
    _mADAS_CURRENT_ATTRIBUTES_AR.ADAS_CuA_PathIdx.phys = getValue( HMI_ADAS_CuA_PathIdx );
    _mADAS_CURRENT_ATTRIBUTES_AR.ADAS_CuA_RelProbb.phys = getValue( HMI_ADAS_CuA_RelProbb );
    _mADAS_CURRENT_ATTRIBUTES_AR.ADAS_CuA_ReTr.phys = getValue( HMI_ADAS_CuA_ReTr );
    _mADAS_CURRENT_ATTRIBUTES_AR.ADAS_CuA_RoadDivd.phys = getValue( HMI_ADAS_CuA_RoadDivd );
    _mADAS_CURRENT_ATTRIBUTES_AR.ADAS_CuA_Tunnel.phys = getValue( HMI_ADAS_CuA_Tunnel );
    _mADAS_CURRENT_ATTRIBUTES_AR.ADAS_CuA_Updt.phys = getValue( HMI_ADAS_CuA_Updt );
    _mADAS_CURRENT_ATTRIBUTES_AR.ADAS_CuA_WayForm.phys = getValue( HMI_ADAS_CuA_WayForm );
}

ADAS_CURRENT_ATTRIBUTES_AR_output()
{
    output( _mADAS_CURRENT_ATTRIBUTES_AR );
}

ADAS_CURRENT_ATTRIBUTES_AR_saveEnvVars( dword hFile )
{
    filePutString("\n// Knoten TGW: ADAS_CURRENT_ATTRIBUTES_AR\n", 43, hFile);
    snprintf( buffer, elcount(buffer), "0.0000 HMI__STMSG_ADAS_CURRENT_ATTRIBUTES_AR := %X\n", getValue( HMI__STMSG_ADAS_CURRENT_ATTRIBUTES_AR ) );        filePutString( buffer, elcount(buffer), hFile);
    snprintf( buffer, elcount(buffer), "0.0000 HMI__STMSGT_ADAS_CURRENT_ATTRIBUTES_AR := %X\n", getValue( HMI__STMSGT_ADAS_CURRENT_ATTRIBUTES_AR ) );        filePutString( buffer, elcount(buffer), hFile);
    snprintf( buffer, elcount(buffer), "0.0000 HMI_ADAS_CuA_AreaBuildUp := %X\n", getValue( HMI_ADAS_CuA_AreaBuildUp ) );        filePutString( buffer, elcount(buffer), hFile);
    snprintf( buffer, elcount(buffer), "0.0000 HMI_ADAS_CuA_Bridge := %X\n", getValue( HMI_ADAS_CuA_Bridge ) );        filePutString( buffer, elcount(buffer), hFile);
    snprintf( buffer, elcount(buffer), "0.0000 HMI_ADAS_CuA_CmpxInsct := %X\n", getValue( HMI_ADAS_CuA_CmpxInsct ) );        filePutString( buffer, elcount(buffer), hFile);
    snprintf( buffer, elcount(buffer), "0.0000 HMI_ADAS_CuA_CycCnt := %X\n", getValue( HMI_ADAS_CuA_CycCnt ) );        filePutString( buffer, elcount(buffer), hFile);
    snprintf( buffer, elcount(buffer), "0.0000 HMI_ADAS_CuA_EffSpdLmt := %X\n", getValue( HMI_ADAS_CuA_EffSpdLmt ) );        filePutString( buffer, elcount(buffer), hFile);
    snprintf( buffer, elcount(buffer), "0.0000 HMI_ADAS_CuA_EffSpdLmtType := %X\n", getValue( HMI_ADAS_CuA_EffSpdLmtType ) );        filePutString( buffer, elcount(buffer), hFile);
    snprintf( buffer, elcount(buffer), "0.0000 HMI_ADAS_CuA_FuncRoadClass := %X\n", getValue( HMI_ADAS_CuA_FuncRoadClass ) );        filePutString( buffer, elcount(buffer), hFile);
    snprintf( buffer, elcount(buffer), "0.0000 HMI_ADAS_CuA_MsgTyp := %X\n", getValue( HMI_ADAS_CuA_MsgTyp ) );        filePutString( buffer, elcount(buffer), hFile);
    snprintf( buffer, elcount(buffer), "0.0000 HMI_ADAS_CuA_NumOfLaneDrvDir := %X\n", getValue( HMI_ADAS_CuA_NumOfLaneDrvDir ) );        filePutString( buffer, elcount(buffer), hFile);
    snprintf( buffer, elcount(buffer), "0.0000 HMI_ADAS_CuA_NumOfLaneOppDir := %X\n", getValue( HMI_ADAS_CuA_NumOfLaneOppDir ) );        filePutString( buffer, elcount(buffer), hFile);
    snprintf( buffer, elcount(buffer), "0.0000 HMI_ADAS_CuA_Offset := %X\n", getValue( HMI_ADAS_CuA_Offset ) );        filePutString( buffer, elcount(buffer), hFile);
    snprintf( buffer, elcount(buffer), "0.0000 HMI_ADAS_CuA_PartRoute := %X\n", getValue( HMI_ADAS_CuA_PartRoute ) );        filePutString( buffer, elcount(buffer), hFile);
    snprintf( buffer, elcount(buffer), "0.0000 HMI_ADAS_CuA_PathIdx := %X\n", getValue( HMI_ADAS_CuA_PathIdx ) );        filePutString( buffer, elcount(buffer), hFile);
    snprintf( buffer, elcount(buffer), "0.0000 HMI_ADAS_CuA_RelProbb := %X\n", getValue( HMI_ADAS_CuA_RelProbb ) );        filePutString( buffer, elcount(buffer), hFile);
    snprintf( buffer, elcount(buffer), "0.0000 HMI_ADAS_CuA_ReTr := %X\n", getValue( HMI_ADAS_CuA_ReTr ) );        filePutString( buffer, elcount(buffer), hFile);
    snprintf( buffer, elcount(buffer), "0.0000 HMI_ADAS_CuA_RoadDivd := %X\n", getValue( HMI_ADAS_CuA_RoadDivd ) );        filePutString( buffer, elcount(buffer), hFile);
    snprintf( buffer, elcount(buffer), "0.0000 HMI_ADAS_CuA_Tunnel := %X\n", getValue( HMI_ADAS_CuA_Tunnel ) );        filePutString( buffer, elcount(buffer), hFile);
    snprintf( buffer, elcount(buffer), "0.0000 HMI_ADAS_CuA_Updt := %X\n", getValue( HMI_ADAS_CuA_Updt ) );        filePutString( buffer, elcount(buffer), hFile);
    snprintf( buffer, elcount(buffer), "0.0000 HMI_ADAS_CuA_WayForm := %X\n", getValue( HMI_ADAS_CuA_WayForm ) );        filePutString( buffer, elcount(buffer), hFile);
}

on timer _tADAS_CURRENT_ATTRIBUTES_AR
{
    putValue( HMI__STMSG_ADAS_CURRENT_ATTRIBUTES_AR, 0 );
}

on EnvVar HMI__STMSG_ADAS_CURRENT_ATTRIBUTES_AR
{
    long tDelay;
    if( getValue( this ) == 2 )
    {
        tDelay = getValue( HMI__STMSGT_ADAS_CURRENT_ATTRIBUTES_AR );
        if( tDelay > 0 )    
            setTimer( _tADAS_CURRENT_ATTRIBUTES_AR, tDelay );
        else
            putValue( HMI__STMSG_ADAS_CURRENT_ATTRIBUTES_AR, 0 );
    }
}

on envVar HMI__STMSG_PO_ADAS_CURRENT_ATTRIBUTES_AR
{
    if( getValue( this ) )
        openPanel("ADAS_CURRENT_ATTRIBUTES_AR");
}

on EnvVar HMI_ADAS_CuA_AreaBuildUp
{
    _mADAS_CURRENT_ATTRIBUTES_AR.ADAS_CuA_AreaBuildUp.phys = getValue(this);
}

on EnvVar HMI_ADAS_CuA_Bridge
{
    _mADAS_CURRENT_ATTRIBUTES_AR.ADAS_CuA_Bridge.phys = getValue(this);
}

on EnvVar HMI_ADAS_CuA_CmpxInsct
{
    _mADAS_CURRENT_ATTRIBUTES_AR.ADAS_CuA_CmpxInsct.phys = getValue(this);
}

on EnvVar HMI_ADAS_CuA_CycCnt
{
    _mADAS_CURRENT_ATTRIBUTES_AR.ADAS_CuA_CycCnt.phys = getValue(this);
}

on EnvVar HMI_ADAS_CuA_EffSpdLmt
{
    _mADAS_CURRENT_ATTRIBUTES_AR.ADAS_CuA_EffSpdLmt.phys = getValue(this);
}

on EnvVar HMI_ADAS_CuA_EffSpdLmtType
{
    _mADAS_CURRENT_ATTRIBUTES_AR.ADAS_CuA_EffSpdLmtType.phys = getValue(this);
}

on EnvVar HMI_ADAS_CuA_FuncRoadClass
{
    _mADAS_CURRENT_ATTRIBUTES_AR.ADAS_CuA_FuncRoadClass.phys = getValue(this);
}

on EnvVar HMI_ADAS_CuA_MsgTyp
{
    _mADAS_CURRENT_ATTRIBUTES_AR.ADAS_CuA_MsgTyp.phys = getValue(this);
}

on EnvVar HMI_ADAS_CuA_NumOfLaneDrvDir
{
    _mADAS_CURRENT_ATTRIBUTES_AR.ADAS_CuA_NumOfLaneDrvDir.phys = getValue(this);
}

on EnvVar HMI_ADAS_CuA_NumOfLaneOppDir
{
    _mADAS_CURRENT_ATTRIBUTES_AR.ADAS_CuA_NumOfLaneOppDir.phys = getValue(this);
}

on EnvVar HMI_ADAS_CuA_Offset
{
    _mADAS_CURRENT_ATTRIBUTES_AR.ADAS_CuA_Offset.phys = getValue(this);
}

on EnvVar HMI_ADAS_CuA_PartRoute
{
    _mADAS_CURRENT_ATTRIBUTES_AR.ADAS_CuA_PartRoute.phys = getValue(this);
}

on EnvVar HMI_ADAS_CuA_PathIdx
{
    _mADAS_CURRENT_ATTRIBUTES_AR.ADAS_CuA_PathIdx.phys = getValue(this);
}

on EnvVar HMI_ADAS_CuA_RelProbb
{
    _mADAS_CURRENT_ATTRIBUTES_AR.ADAS_CuA_RelProbb.phys = getValue(this);
}

on EnvVar HMI_ADAS_CuA_ReTr
{
    _mADAS_CURRENT_ATTRIBUTES_AR.ADAS_CuA_ReTr.phys = getValue(this);
}

on EnvVar HMI_ADAS_CuA_RoadDivd
{
    _mADAS_CURRENT_ATTRIBUTES_AR.ADAS_CuA_RoadDivd.phys = getValue(this);
}

on EnvVar HMI_ADAS_CuA_Tunnel
{
    _mADAS_CURRENT_ATTRIBUTES_AR.ADAS_CuA_Tunnel.phys = getValue(this);
}

on EnvVar HMI_ADAS_CuA_Updt
{
    _mADAS_CURRENT_ATTRIBUTES_AR.ADAS_CuA_Updt.phys = getValue(this);
}

on EnvVar HMI_ADAS_CuA_WayForm
{
    _mADAS_CURRENT_ATTRIBUTES_AR.ADAS_CuA_WayForm.phys = getValue(this);
}

ADAS_POSITION_AR_check_output()
{
    if( !getValue( HMI__STMSG_ADAS_POSITION_AR))
    {
        // Botschaft ADAS_POSITION_AR ID: 989 --- Sendeart cyclicX --- 
        _ADAS_POSITION_AR_Cnt--;
        if( _ADAS_POSITION_AR_Cnt < 1 )
        {
            output( _mADAS_POSITION_AR ); // Nachricht wg. abgelaufenem Zyklus ausgeben
            _ADAS_POSITION_AR_Cnt = _ADAS_POSITION_AR_CycleCount; // Zyklus-Zähler zurücksetzen
        }
    }
}

ADAS_POSITION_AR_init()
{   /* Botschaft ADAS_POSITION_AR ID: 989 --- Sendeart cyclicX --- 
BA_ "ApplMessage" BO_ 989 0;
BA_ "NmAsrMessage" BO_ 989 0;
BA_ "GenMsgMinAcceptLength" BO_ 989 8;
BA_ "GenMsgILSupport" BO_ 989 1;
BA_ "DiagState" BO_ 989 0;
BA_ "DiagRequest" BO_ 989 0;
BA_ "DiagResponse" BO_ 989 0;
BA_ "GenMsgStartValue" BO_ 989 "0";
BA_ "GenMsgStartDelayTime" BO_ 989 10;
BA_ "GenMsgCycleTime" BO_ 989 500;
BA_ "GenMsgSendType" BO_ 989 0;
    */
    _ADAS_POSITION_AR_Timebase =             c_tDBKomTimer_20ms;
    _ADAS_POSITION_AR_CycleCount =         500 / _ADAS_POSITION_AR_Timebase;
    _ADAS_POSITION_AR_StartDelay =          10 / _ADAS_POSITION_AR_Timebase;
    _ADAS_POSITION_AR_Cnt = _ADAS_POSITION_AR_StartDelay;

    putValue( HMI__STMSGSD_ADAS_POSITION_AR, _ADAS_POSITION_AR_StartDelay * _ADAS_POSITION_AR_Timebase );

    _mADAS_POSITION_AR.ADAS_Posn_Age.phys = getValue( HMI_ADAS_Posn_Age );
    _mADAS_POSITION_AR.ADAS_Posn_CurLane.phys = getValue( HMI_ADAS_Posn_CurLane );
    _mADAS_POSITION_AR.ADAS_Posn_CycCnt.phys = getValue( HMI_ADAS_Posn_CycCnt );
    _mADAS_POSITION_AR.ADAS_Posn_Idx.phys = getValue( HMI_ADAS_Posn_Idx );
    _mADAS_POSITION_AR.ADAS_Posn_MsgTyp.phys = getValue( HMI_ADAS_Posn_MsgTyp );
    _mADAS_POSITION_AR.ADAS_Posn_Offset.phys = getValue( HMI_ADAS_Posn_Offset );
    _mADAS_POSITION_AR.ADAS_Posn_PathIdx.phys = getValue( HMI_ADAS_Posn_PathIdx );
    _mADAS_POSITION_AR.ADAS_Posn_PosConfdc.phys = getValue( HMI_ADAS_Posn_PosConfdc );
    _mADAS_POSITION_AR.ADAS_Posn_PosProbb.phys = getValue( HMI_ADAS_Posn_PosProbb );
    _mADAS_POSITION_AR.ADAS_Posn_RelHead.phys = getValue( HMI_ADAS_Posn_RelHead );
    _mADAS_POSITION_AR.ADAS_Posn_Spd.phys = getValue( HMI_ADAS_Posn_Spd );
}

ADAS_POSITION_AR_output()
{
    ADAS_POSITION_AR_output();
}

ADAS_POSITION_AR_saveEnvVars( dword hFile )
{
    filePutString("\n// Knoten TGW: ADAS_POSITION_AR\n", 33, hFile);
    snprintf( buffer, elcount(buffer), "0.0000 HMI__STMSG_ADAS_POSITION_AR := %X\n", getValue( HMI__STMSG_ADAS_POSITION_AR ) );        filePutString( buffer, elcount(buffer), hFile);
    snprintf( buffer, elcount(buffer), "0.0000 HMI__STMSGT_ADAS_POSITION_AR := %X\n", getValue( HMI__STMSGT_ADAS_POSITION_AR ) );        filePutString( buffer, elcount(buffer), hFile);
    snprintf( buffer, elcount(buffer), "0.0000 HMI_ADAS_Posn_Age := %f\n", getValue( HMI_ADAS_Posn_Age ) );        filePutString( buffer, elcount(buffer), hFile);
    snprintf( buffer, elcount(buffer), "0.0000 HMI_ADAS_Posn_CurLane := %f\n", getValue( HMI_ADAS_Posn_CurLane ) );        filePutString( buffer, elcount(buffer), hFile);
    snprintf( buffer, elcount(buffer), "0.0000 HMI_ADAS_Posn_CycCnt := %f\n", getValue( HMI_ADAS_Posn_CycCnt ) );        filePutString( buffer, elcount(buffer), hFile);
    snprintf( buffer, elcount(buffer), "0.0000 HMI_ADAS_Posn_Idx := %f\n", getValue( HMI_ADAS_Posn_Idx ) );        filePutString( buffer, elcount(buffer), hFile);
    snprintf( buffer, elcount(buffer), "0.0000 HMI_ADAS_Posn_MsgTyp := %f\n", getValue( HMI_ADAS_Posn_MsgTyp ) );        filePutString( buffer, elcount(buffer), hFile);
    snprintf( buffer, elcount(buffer), "0.0000 HMI_ADAS_Posn_Offset := %f\n", getValue( HMI_ADAS_Posn_Offset ) );        filePutString( buffer, elcount(buffer), hFile);
    snprintf( buffer, elcount(buffer), "0.0000 HMI_ADAS_Posn_PathIdx := %f\n", getValue( HMI_ADAS_Posn_PathIdx ) );        filePutString( buffer, elcount(buffer), hFile);
    snprintf( buffer, elcount(buffer), "0.0000 HMI_ADAS_Posn_PosConfdc := %f\n", getValue( HMI_ADAS_Posn_PosConfdc ) );        filePutString( buffer, elcount(buffer), hFile);
    snprintf( buffer, elcount(buffer), "0.0000 HMI_ADAS_Posn_PosProbb := %f\n", getValue( HMI_ADAS_Posn_PosProbb ) );        filePutString( buffer, elcount(buffer), hFile);
    snprintf( buffer, elcount(buffer), "0.0000 HMI_ADAS_Posn_RelHead := %f\n", getValue( HMI_ADAS_Posn_RelHead ) );        filePutString( buffer, elcount(buffer), hFile);
    snprintf( buffer, elcount(buffer), "0.0000 HMI_ADAS_Posn_Spd := %f\n", getValue( HMI_ADAS_Posn_Spd ) );        filePutString( buffer, elcount(buffer), hFile);
}

on timer _tADAS_POSITION_AR
{
    putValue( HMI__STMSG_ADAS_POSITION_AR, 0 );
}

on EnvVar HMI__STMSG_ADAS_POSITION_AR
{
    long tDelay;
    if( getValue( this ) == 2 )
    {
        tDelay = getValue( HMI__STMSGT_ADAS_POSITION_AR );
        if( tDelay > 0 )    
            setTimer( _tADAS_POSITION_AR, tDelay );
        else
            putValue( HMI__STMSG_ADAS_POSITION_AR, 0 );
    }
}

on envVar HMI__STMSG_PO_ADAS_POSITION_AR
{
    if( getValue( this ) )
        openPanel("ADAS_POSITION_AR");
}

on EnvVar HMI_ADAS_Posn_Age
{
    _mADAS_POSITION_AR.ADAS_Posn_Age.phys = getValue(this);
}

on EnvVar HMI_ADAS_Posn_CurLane
{
    _mADAS_POSITION_AR.ADAS_Posn_CurLane.phys = getValue(this);
}

on EnvVar HMI_ADAS_Posn_CycCnt
{
    _mADAS_POSITION_AR.ADAS_Posn_CycCnt.phys = getValue(this);
}

on EnvVar HMI_ADAS_Posn_Idx
{
    _mADAS_POSITION_AR.ADAS_Posn_Idx.phys = getValue(this);
}

on EnvVar HMI_ADAS_Posn_MsgTyp
{
    _mADAS_POSITION_AR.ADAS_Posn_MsgTyp.phys = getValue(this);
}

on EnvVar HMI_ADAS_Posn_Offset
{
    _mADAS_POSITION_AR.ADAS_Posn_Offset.phys = getValue(this);
}

on EnvVar HMI_ADAS_Posn_PathIdx
{
    _mADAS_POSITION_AR.ADAS_Posn_PathIdx.phys = getValue(this);
}

on EnvVar HMI_ADAS_Posn_PosConfdc
{
    _mADAS_POSITION_AR.ADAS_Posn_PosConfdc.phys = getValue(this);
}

on EnvVar HMI_ADAS_Posn_PosProbb
{
    _mADAS_POSITION_AR.ADAS_Posn_PosProbb.phys = getValue(this);
}

on EnvVar HMI_ADAS_Posn_RelHead
{
    _mADAS_POSITION_AR.ADAS_Posn_RelHead.phys = getValue(this);
}

on EnvVar HMI_ADAS_Posn_Spd
{
    _mADAS_POSITION_AR.ADAS_Posn_Spd.phys = getValue(this);
}

ADAS_PREDICTION_AR_check_output()
{
    if( !getValue( HMI__STMSG_ADAS_PREDICTION_AR))
    {
        // Botschaft ADAS_PREDICTION_AR ID: 521 --- Sendeart cyclicX --- 
        _ADAS_PREDICTION_AR_Cnt--;
        if( _ADAS_PREDICTION_AR_Cnt < 1 )
        {
            // Zyklus abgelaufen, Nachricht senden
            output( _mADAS_PREDICTION_AR );
            // Zyklus-Zähler zurücksetzen
            _ADAS_PREDICTION_AR_Cnt = _ADAS_PREDICTION_AR_CycleCount;
        }
    }
}

ADAS_PREDICTION_AR_init()
{   /* Botschaft ADAS_PREDICTION_AR ID: 521 --- Sendeart cyclicX --- 
BA_ "ApplMessage" BO_ 521 0;
BA_ "NmAsrMessage" BO_ 521 0;
BA_ "GenMsgMinAcceptLength" BO_ 521 8;
BA_ "GenMsgILSupport" BO_ 521 0;
BA_ "DiagState" BO_ 521 0;
BA_ "DiagRequest" BO_ 521 0;
BA_ "DiagResponse" BO_ 521 0;
BA_ "GenMsgStartValue" BO_ 521 "0";
BA_ "GenMsgStartDelayTime" BO_ 521 0;
BA_ "GenMsgCycleTime" BO_ 521 100;
BA_ "GenMsgSendType" BO_ 521 0;
    */
    _ADAS_PREDICTION_AR_Timebase =            c_tDBKomTimer_20ms;
    _ADAS_PREDICTION_AR_CycleCount =        100 / _ADAS_PREDICTION_AR_Timebase;
    _ADAS_PREDICTION_AR_StartDelay =          0 / _ADAS_PREDICTION_AR_Timebase;
    _ADAS_PREDICTION_AR_Cnt = _ADAS_PREDICTION_AR_StartDelay;

    putValue( HMI__STMSGSD_ADAS_PREDICTION_AR, _ADAS_PREDICTION_AR_StartDelay * _ADAS_PREDICTION_AR_Timebase );

    _mADAS_PREDICTION_AR.ADAS_Seg_RelProbb.phys = getValue( HMI_ADAS_Seg_RelProbb );
    _mADAS_PREDICTION_AR.ADAS_Seg_PathIdx.phys = getValue( HMI_ADAS_Seg_PathIdx );
    _mADAS_PREDICTION_AR.ADAS_Seg_CmpxInsct.phys = getValue( HMI_ADAS_Seg_CmpxInsct );
    _mADAS_PREDICTION_AR.ADAS_Seg_NumOfLaneOppDir.phys = getValue( HMI_ADAS_Seg_NumOfLaneOppDir );
    _mADAS_PREDICTION_AR.ADAS_Seg_WayForm.phys = getValue( HMI_ADAS_Seg_WayForm );
    _mADAS_PREDICTION_AR.ADAS_Seg_RoadDivd.phys = getValue( HMI_ADAS_Seg_RoadDivd );
    _mADAS_PREDICTION_AR.ADAS_Seg_ReTr.phys = getValue( HMI_ADAS_Seg_ReTr );
    _mADAS_PREDICTION_AR.ADAS_Seg_Tunnel.phys = getValue( HMI_ADAS_Seg_Tunnel );
    _mADAS_PREDICTION_AR.ADAS_Seg_Updt.phys = getValue( HMI_ADAS_Seg_Updt );
    _mADAS_PREDICTION_AR.ADAS_Seg_FuncRoadClass.phys = getValue( HMI_ADAS_Seg_FuncRoadClass );
    _mADAS_PREDICTION_AR.ADAS_Seg_Offset.phys = getValue( HMI_ADAS_Seg_Offset );
    _mADAS_PREDICTION_AR.ADAS_Seg_AreaBuildUp.phys = getValue( HMI_ADAS_Seg_AreaBuildUp );
    _mADAS_PREDICTION_AR.ADAS_Seg_Bridge.phys = getValue( HMI_ADAS_Seg_Bridge );
    _mADAS_PREDICTION_AR.ADAS_Seg_EffSpdLmtType.phys = getValue( HMI_ADAS_Seg_EffSpdLmtType );
    _mADAS_PREDICTION_AR.ADAS_Seg_NumOfLaneDrvDir.phys = getValue( HMI_ADAS_Seg_NumOfLaneDrvDir );
    _mADAS_PREDICTION_AR.ADAS_Seg_EffSpdLmt.phys = getValue( HMI_ADAS_Seg_EffSpdLmt );
    _mADAS_PREDICTION_AR.ADAS_Seg_PartRoute.phys = getValue( HMI_ADAS_Seg_PartRoute );
    _mADAS_PREDICTION_AR.ADAS_Seg_CycCnt.phys = getValue( HMI_ADAS_Seg_CycCnt );
    _mADAS_PREDICTION_AR.ADAS_Prediction_MsgTyp.phys = getValue( HMI_ADAS_Prediction_MsgTyp );
    _mADAS_PREDICTION_AR.ADAS_Stub_LastStub.phys = getValue( HMI_ADAS_Stub_LastStub );
    _mADAS_PREDICTION_AR.ADAS_Stub_PartRoute.phys = getValue( HMI_ADAS_Stub_PartRoute );
    _mADAS_PREDICTION_AR.ADAS_Stub_FuncRoadClass.phys = getValue( HMI_ADAS_Stub_FuncRoadClass );
    _mADAS_PREDICTION_AR.ADAS_Stub_Updt.phys = getValue( HMI_ADAS_Stub_Updt );
    _mADAS_PREDICTION_AR.ADAS_Stub_WayForm.phys = getValue( HMI_ADAS_Stub_WayForm );
    _mADAS_PREDICTION_AR.ADAS_Stub_WayRt.phys = getValue( HMI_ADAS_Stub_WayRt );
    _mADAS_PREDICTION_AR.ADAS_Stub_TurnAngl.phys = getValue( HMI_ADAS_Stub_TurnAngl );
    _mADAS_PREDICTION_AR.ADAS_Stub_SubPathIdx.phys = getValue( HMI_ADAS_Stub_SubPathIdx );
    _mADAS_PREDICTION_AR.ADAS_Stub_ReTr.phys = getValue( HMI_ADAS_Stub_ReTr );
    _mADAS_PREDICTION_AR.ADAS_Stub_NumOfLaneDrvDir.phys = getValue( HMI_ADAS_Stub_NumOfLaneDrvDir );
    _mADAS_PREDICTION_AR.ADAS_Stub_CmpxInsct.phys = getValue( HMI_ADAS_Stub_CmpxInsct );
    _mADAS_PREDICTION_AR.ADAS_Stub_CycCnt.phys = getValue( HMI_ADAS_Stub_CycCnt );
    _mADAS_PREDICTION_AR.ADAS_Stub_PathIdx.phys = getValue( HMI_ADAS_Stub_PathIdx );
    _mADAS_PREDICTION_AR.ADAS_Stub_Offset.phys = getValue( HMI_ADAS_Stub_Offset );
    _mADAS_PREDICTION_AR.ADAS_Stub_RelProbb.phys = getValue( HMI_ADAS_Stub_RelProbb );
    _mADAS_PREDICTION_AR.ADAS_Stub_NumOfLaneOppDir.phys = getValue( HMI_ADAS_Stub_NumOfLaneOppDir );
    _mADAS_PREDICTION_AR.ADAS_Meta_ProtVer_MinorSub.phys = getValue( HMI_ADAS_Meta_ProtVer_MinorSub );
    _mADAS_PREDICTION_AR.ADAS_Meta_CountryCode.phys = getValue( HMI_ADAS_Meta_CountryCode );
    _mADAS_PREDICTION_AR.ADAS_Meta_HwVer.phys = getValue( HMI_ADAS_Meta_HwVer );
    _mADAS_PREDICTION_AR.ADAS_Meta_MapProvid.phys = getValue( HMI_ADAS_Meta_MapProvid );
    _mADAS_PREDICTION_AR.ADAS_Meta_MapVerQuar.phys = getValue( HMI_ADAS_Meta_MapVerQuar );
    _mADAS_PREDICTION_AR.ADAS_Meta_MapVerYear.phys = getValue( HMI_ADAS_Meta_MapVerYear );
    _mADAS_PREDICTION_AR.ADAS_Meta_SpdUnits.phys = getValue( HMI_ADAS_Meta_SpdUnits );
    _mADAS_PREDICTION_AR.ADAS_Meta_ProtVer_Major.phys = getValue( HMI_ADAS_Meta_ProtVer_Major );
    _mADAS_PREDICTION_AR.ADAS_Meta_ProtVer_Minor.phys = getValue( HMI_ADAS_Meta_ProtVer_Minor );
    _mADAS_PREDICTION_AR.ADAS_Meta_RegionCode.phys = getValue( HMI_ADAS_Meta_RegionCode );
    _mADAS_PREDICTION_AR.ADAS_Meta_CycCnt.phys = getValue( HMI_ADAS_Meta_CycCnt );
    _mADAS_PREDICTION_AR.ADAS_Meta_DrvSide.phys = getValue( HMI_ADAS_Meta_DrvSide );
}

ADAS_PREDICTION_AR_saveEnvVars( dword hFile )
{
    filePutString("\n// Knoten TGW: ADAS_PREDICTION_AR\n", 35, hFile);
    snprintf( buffer, elcount(buffer), "0.0000 HMI__STMSG_ADAS_PREDICTION_AR := %X\n", getValue( HMI__STMSG_ADAS_PREDICTION_AR ) );        filePutString( buffer, elcount(buffer), hFile);
    snprintf( buffer, elcount(buffer), "0.0000 HMI__STMSGT_GADAS_PREDICTION_AR := %X\n", getValue( HMI__STMSGT_ADAS_PREDICTION_AR ) );        filePutString( buffer, elcount(buffer), hFile);
    snprintf( buffer, elcount(buffer), "0.0000 HMI_ADAS_Seg_RelProbb := %X\n", getValue( HMI_ADAS_Seg_RelProbb ));        filePutString( buffer, elcount(buffer), hFile);
    snprintf( buffer, elcount(buffer), "0.0000 HMI_ADAS_Seg_PathIdx := %X\n", getValue( HMI_ADAS_Seg_PathIdx ));        filePutString( buffer, elcount(buffer), hFile);
    snprintf( buffer, elcount(buffer), "0.0000 HMI_ADAS_Seg_CmpxInsct := %X\n", getValue( HMI_ADAS_Seg_CmpxInsct ));        filePutString( buffer, elcount(buffer), hFile);
    snprintf( buffer, elcount(buffer), "0.0000 HMI_ADAS_Seg_NumOfLaneOppDir := %X\n", getValue( HMI_ADAS_Seg_NumOfLaneOppDir ));        filePutString( buffer, elcount(buffer), hFile);
    snprintf( buffer, elcount(buffer), "0.0000 HMI_ADAS_Seg_WayForm := %X\n", getValue( HMI_ADAS_Seg_WayForm ));        filePutString( buffer, elcount(buffer), hFile);
    snprintf( buffer, elcount(buffer), "0.0000 HMI_ADAS_Seg_RoadDivd := %X\n", getValue( HMI_ADAS_Seg_RoadDivd ));        filePutString( buffer, elcount(buffer), hFile);
    snprintf( buffer, elcount(buffer), "0.0000 HMI_ADAS_Seg_ReTr := %X\n", getValue( HMI_ADAS_Seg_ReTr ));        filePutString( buffer, elcount(buffer), hFile);
    snprintf( buffer, elcount(buffer), "0.0000 HMI_ADAS_Seg_Tunnel := %X\n", getValue( HMI_ADAS_Seg_Tunnel ));        filePutString( buffer, elcount(buffer), hFile);
    snprintf( buffer, elcount(buffer), "0.0000 HMI_ADAS_Seg_Updt := %X\n", getValue( HMI_ADAS_Seg_Updt ));        filePutString( buffer, elcount(buffer), hFile);
    snprintf( buffer, elcount(buffer), "0.0000 HMI_ADAS_Seg_FuncRoadClass := %X\n", getValue( HMI_ADAS_Seg_FuncRoadClass ));        filePutString( buffer, elcount(buffer), hFile);
    snprintf( buffer, elcount(buffer), "0.0000 HMI_ADAS_Seg_Offset := %X\n", getValue( HMI_ADAS_Seg_Offset ));        filePutString( buffer, elcount(buffer), hFile);
    snprintf( buffer, elcount(buffer), "0.0000 HMI_ADAS_Seg_AreaBuildUp := %X\n", getValue( HMI_ADAS_Seg_AreaBuildUp ));        filePutString( buffer, elcount(buffer), hFile);
    snprintf( buffer, elcount(buffer), "0.0000 HMI_ADAS_Seg_Bridge := %X\n", getValue( HMI_ADAS_Seg_Bridge ));        filePutString( buffer, elcount(buffer), hFile);
    snprintf( buffer, elcount(buffer), "0.0000 HMI_ADAS_Seg_EffSpdLmtType := %X\n", getValue( HMI_ADAS_Seg_EffSpdLmtType ));        filePutString( buffer, elcount(buffer), hFile);
    snprintf( buffer, elcount(buffer), "0.0000 HMI_ADAS_Seg_NumOfLaneDrvDir := %X\n", getValue( HMI_ADAS_Seg_NumOfLaneDrvDir ));        filePutString( buffer, elcount(buffer), hFile);
    snprintf( buffer, elcount(buffer), "0.0000 HMI_ADAS_Seg_EffSpdLmt := %X\n", getValue( HMI_ADAS_Seg_EffSpdLmt ));        filePutString( buffer, elcount(buffer), hFile);
    snprintf( buffer, elcount(buffer), "0.0000 HMI_ADAS_Seg_PartRoute := %X\n", getValue( HMI_ADAS_Seg_PartRoute ));        filePutString( buffer, elcount(buffer), hFile);
    snprintf( buffer, elcount(buffer), "0.0000 HMI_ADAS_Seg_CycCnt := %X\n", getValue( HMI_ADAS_Seg_CycCnt ));        filePutString( buffer, elcount(buffer), hFile);
    snprintf( buffer, elcount(buffer), "0.0000 HMI_ADAS_Prediction_MsgTyp := %X\n", getValue( HMI_ADAS_Prediction_MsgTyp ));        filePutString( buffer, elcount(buffer), hFile);
    snprintf( buffer, elcount(buffer), "0.0000 HMI_ADAS_Stub_LastStub := %X\n", getValue( HMI_ADAS_Stub_LastStub ));        filePutString( buffer, elcount(buffer), hFile);
    snprintf( buffer, elcount(buffer), "0.0000 HMI_ADAS_Stub_PartRoute := %X\n", getValue( HMI_ADAS_Stub_PartRoute ));        filePutString( buffer, elcount(buffer), hFile);
    snprintf( buffer, elcount(buffer), "0.0000 HMI_ADAS_Stub_FuncRoadClass := %X\n", getValue( HMI_ADAS_Stub_FuncRoadClass ));        filePutString( buffer, elcount(buffer), hFile);
    snprintf( buffer, elcount(buffer), "0.0000 HMI_ADAS_Stub_Updt := %X\n", getValue( HMI_ADAS_Stub_Updt ));        filePutString( buffer, elcount(buffer), hFile);
    snprintf( buffer, elcount(buffer), "0.0000 HMI_ADAS_Stub_WayForm := %X\n", getValue( HMI_ADAS_Stub_WayForm ));        filePutString( buffer, elcount(buffer), hFile);
    snprintf( buffer, elcount(buffer), "0.0000 HMI_ADAS_Stub_WayRt := %X\n", getValue( HMI_ADAS_Stub_WayRt ));        filePutString( buffer, elcount(buffer), hFile);
    snprintf( buffer, elcount(buffer), "0.0000 HMI_ADAS_Stub_TurnAngl := %X\n", getValue( HMI_ADAS_Stub_TurnAngl ));        filePutString( buffer, elcount(buffer), hFile);
    snprintf( buffer, elcount(buffer), "0.0000 HMI_ADAS_Stub_SubPathIdx := %X\n", getValue( HMI_ADAS_Stub_SubPathIdx ));        filePutString( buffer, elcount(buffer), hFile);
    snprintf( buffer, elcount(buffer), "0.0000 HMI_ADAS_Stub_ReTr := %X\n", getValue( HMI_ADAS_Stub_ReTr ));        filePutString( buffer, elcount(buffer), hFile);
    snprintf( buffer, elcount(buffer), "0.0000 HMI_ADAS_Stub_NumOfLaneDrvDir := %X\n", getValue( HMI_ADAS_Stub_NumOfLaneDrvDir ));        filePutString( buffer, elcount(buffer), hFile);
    snprintf( buffer, elcount(buffer), "0.0000 HMI_ADAS_Stub_CmpxInsct := %X\n", getValue( HMI_ADAS_Stub_CmpxInsct ));        filePutString( buffer, elcount(buffer), hFile);
    snprintf( buffer, elcount(buffer), "0.0000 HMI_ADAS_Stub_CycCnt := %X\n", getValue( HMI_ADAS_Stub_CycCnt ));        filePutString( buffer, elcount(buffer), hFile);
    snprintf( buffer, elcount(buffer), "0.0000 HMI_ADAS_Stub_PathIdx := %X\n", getValue( HMI_ADAS_Stub_PathIdx ));        filePutString( buffer, elcount(buffer), hFile);
    snprintf( buffer, elcount(buffer), "0.0000 HMI_ADAS_Stub_Offset := %X\n", getValue( HMI_ADAS_Stub_Offset ));        filePutString( buffer, elcount(buffer), hFile);
    snprintf( buffer, elcount(buffer), "0.0000 HMI_ADAS_Stub_RelProbb := %X\n", getValue( HMI_ADAS_Stub_RelProbb ));        filePutString( buffer, elcount(buffer), hFile);
    snprintf( buffer, elcount(buffer), "0.0000 HMI_ADAS_Stub_NumOfLaneOppDir := %X\n", getValue( HMI_ADAS_Stub_NumOfLaneOppDir ));        filePutString( buffer, elcount(buffer), hFile);
    snprintf( buffer, elcount(buffer), "0.0000 HMI_ADAS_Meta_ProtVer_MinorSub := %X\n", getValue( HMI_ADAS_Meta_ProtVer_MinorSub ));        filePutString( buffer, elcount(buffer), hFile);
    snprintf( buffer, elcount(buffer), "0.0000 HMI_ADAS_Meta_CountryCode := %X\n", getValue( HMI_ADAS_Meta_CountryCode ));        filePutString( buffer, elcount(buffer), hFile);
    snprintf( buffer, elcount(buffer), "0.0000 HMI_ADAS_Meta_HwVer := %X\n", getValue( HMI_ADAS_Meta_HwVer ));        filePutString( buffer, elcount(buffer), hFile);
    snprintf( buffer, elcount(buffer), "0.0000 HMI_ADAS_Meta_MapProvid := %X\n", getValue( HMI_ADAS_Meta_MapProvid ));        filePutString( buffer, elcount(buffer), hFile);
    snprintf( buffer, elcount(buffer), "0.0000 HMI_ADAS_Meta_MapVerQuar := %X\n", getValue( HMI_ADAS_Meta_MapVerQuar ));        filePutString( buffer, elcount(buffer), hFile);
    snprintf( buffer, elcount(buffer), "0.0000 HMI_ADAS_Meta_MapVerYear := %X\n", getValue( HMI_ADAS_Meta_MapVerYear ));        filePutString( buffer, elcount(buffer), hFile);
    snprintf( buffer, elcount(buffer), "0.0000 HMI_ADAS_Meta_SpdUnits := %X\n", getValue( HMI_ADAS_Meta_SpdUnits ));        filePutString( buffer, elcount(buffer), hFile);
    snprintf( buffer, elcount(buffer), "0.0000 HMI_ADAS_Meta_ProtVer_Major := %X\n", getValue( HMI_ADAS_Meta_ProtVer_Major ));        filePutString( buffer, elcount(buffer), hFile);
    snprintf( buffer, elcount(buffer), "0.0000 HMI_ADAS_Meta_ProtVer_Minor := %X\n", getValue( HMI_ADAS_Meta_ProtVer_Minor ));        filePutString( buffer, elcount(buffer), hFile);
    snprintf( buffer, elcount(buffer), "0.0000 HMI_ADAS_Meta_RegionCode := %X\n", getValue( HMI_ADAS_Meta_RegionCode ));        filePutString( buffer, elcount(buffer), hFile);
    snprintf( buffer, elcount(buffer), "0.0000 HMI_ADAS_Meta_CycCnt := %X\n", getValue( HMI_ADAS_Meta_CycCnt ));        filePutString( buffer, elcount(buffer), hFile);
    snprintf( buffer, elcount(buffer), "0.0000 HMI_ADAS_Meta_DrvSide := %X\n", getValue( HMI_ADAS_Meta_DrvSide ));        filePutString( buffer, elcount(buffer), hFile);
}

on timer _tADAS_PREDICTION_AR
{
    putValue( HMI__STMSG_ADAS_PREDICTION_AR, 0 );
}

on EnvVar HMI__STMSG_ADAS_PREDICTION_AR
{
    long tDelay;
    if( getValue( this ) == 2 )
    {
        tDelay = getValue( HMI__STMSGT_ADAS_PREDICTION_AR );
        if( tDelay > 0 )    
            setTimer( _tADAS_PREDICTION_AR, tDelay );
        else
            putValue( HMI__STMSG_ADAS_PREDICTION_AR, 0 );
    }
}

on EnvVar HMI__ALLDEF_ADAS_PREDICTION_AR
{
    if( getValue(this))
    {
        // alle signale auf default einstellen
        putValue( HMI_ADAS_Prediction_MsgTyp, 7 );
    }
}

on envVar HMI__STMSG_PO_ADAS_PREDICTION_AR
{
    if( getValue( this ) )
        openPanel("ADAS_PREDICTION_AR");
}

on EnvVar HMI_ADAS_Seg_RelProbb
{
    _mADAS_PREDICTION_AR.ADAS_Seg_RelProbb.phys = getValue(this);
}

on EnvVar HMI_ADAS_Seg_PathIdx
{
    _mADAS_PREDICTION_AR.ADAS_Seg_PathIdx.phys = getValue(this);
}

on EnvVar HMI_ADAS_Seg_CmpxInsct
{
    _mADAS_PREDICTION_AR.ADAS_Seg_CmpxInsct.phys = getValue(this);
}

on EnvVar HMI_ADAS_Seg_NumOfLaneOppDir
{
    _mADAS_PREDICTION_AR.ADAS_Seg_NumOfLaneOppDir.phys = getValue(this);
}

on EnvVar HMI_ADAS_Seg_WayForm
{
    _mADAS_PREDICTION_AR.ADAS_Seg_WayForm.phys = getValue(this);
}

on EnvVar HMI_ADAS_Seg_RoadDivd
{
    _mADAS_PREDICTION_AR.ADAS_Seg_RoadDivd.phys = getValue(this);
}

on EnvVar HMI_ADAS_Seg_ReTr
{
    _mADAS_PREDICTION_AR.ADAS_Seg_ReTr.phys = getValue(this);
}

on EnvVar HMI_ADAS_Seg_Tunnel
{
    _mADAS_PREDICTION_AR.ADAS_Seg_Tunnel.phys = getValue(this);
}

on EnvVar HMI_ADAS_Seg_Updt
{
    _mADAS_PREDICTION_AR.ADAS_Seg_Updt.phys = getValue(this);
}

on EnvVar HMI_ADAS_Seg_FuncRoadClass
{
    _mADAS_PREDICTION_AR.ADAS_Seg_FuncRoadClass.phys = getValue(this);
}

on EnvVar HMI_ADAS_Seg_Offset
{
    _mADAS_PREDICTION_AR.ADAS_Seg_Offset.phys = getValue(this);
}

on EnvVar HMI_ADAS_Seg_AreaBuildUp
{
    _mADAS_PREDICTION_AR.ADAS_Seg_AreaBuildUp.phys = getValue(this);
}

on EnvVar HMI_ADAS_Seg_Bridge
{
    _mADAS_PREDICTION_AR.ADAS_Seg_Bridge.phys = getValue(this);
}

on EnvVar HMI_ADAS_Seg_EffSpdLmtType
{
    _mADAS_PREDICTION_AR.ADAS_Seg_EffSpdLmtType.phys = getValue(this);
}

on EnvVar HMI_ADAS_Seg_NumOfLaneDrvDir
{
    _mADAS_PREDICTION_AR.ADAS_Seg_NumOfLaneDrvDir.phys = getValue(this);
}

on EnvVar HMI_ADAS_Seg_EffSpdLmt
{
    _mADAS_PREDICTION_AR.ADAS_Seg_EffSpdLmt.phys = getValue(this);
}

on EnvVar HMI_ADAS_Seg_PartRoute
{
    _mADAS_PREDICTION_AR.ADAS_Seg_PartRoute.phys = getValue(this);
}

on EnvVar HMI_ADAS_Seg_CycCnt
{
    _mADAS_PREDICTION_AR.ADAS_Seg_CycCnt.phys = getValue(this);
}

on EnvVar HMI_ADAS_Prediction_MsgTyp
{
    _mADAS_PREDICTION_AR.ADAS_Prediction_MsgTyp.phys = getValue(this);
}

on EnvVar HMI_ADAS_Stub_LastStub
{
    _mADAS_PREDICTION_AR.ADAS_Stub_LastStub.phys = getValue(this);
}

on EnvVar HMI_ADAS_Stub_PartRoute
{
    _mADAS_PREDICTION_AR.ADAS_Stub_PartRoute.phys = getValue(this);
}

on EnvVar HMI_ADAS_Stub_FuncRoadClass
{
    _mADAS_PREDICTION_AR.ADAS_Stub_FuncRoadClass.phys = getValue(this);
}

on EnvVar HMI_ADAS_Stub_Updt
{
    _mADAS_PREDICTION_AR.ADAS_Stub_Updt.phys = getValue(this);
}

on EnvVar HMI_ADAS_Stub_WayForm
{
    _mADAS_PREDICTION_AR.ADAS_Stub_WayForm.phys = getValue(this);
}

on EnvVar HMI_ADAS_Stub_WayRt
{
    _mADAS_PREDICTION_AR.ADAS_Stub_WayRt.phys = getValue(this);
}

on EnvVar HMI_ADAS_Stub_TurnAngl
{
    _mADAS_PREDICTION_AR.ADAS_Stub_TurnAngl.phys = getValue(this);
}

on EnvVar HMI_ADAS_Stub_SubPathIdx
{
    _mADAS_PREDICTION_AR.ADAS_Stub_SubPathIdx.phys = getValue(this);
}

on EnvVar HMI_ADAS_Stub_ReTr
{
    _mADAS_PREDICTION_AR.ADAS_Stub_ReTr.phys = getValue(this);
}

on EnvVar HMI_ADAS_Stub_NumOfLaneDrvDir
{
    _mADAS_PREDICTION_AR.ADAS_Stub_NumOfLaneDrvDir.phys = getValue(this);
}

on EnvVar HMI_ADAS_Stub_CmpxInsct
{
    _mADAS_PREDICTION_AR.ADAS_Stub_CmpxInsct.phys = getValue(this);
}

on EnvVar HMI_ADAS_Stub_CycCnt
{
    _mADAS_PREDICTION_AR.ADAS_Stub_CycCnt.phys = getValue(this);
}

on EnvVar HMI_ADAS_Stub_PathIdx
{
    _mADAS_PREDICTION_AR.ADAS_Stub_PathIdx.phys = getValue(this);
}

on EnvVar HMI_ADAS_Stub_Offset
{
    _mADAS_PREDICTION_AR.ADAS_Stub_Offset.phys = getValue(this);
}

on EnvVar HMI_ADAS_Stub_RelProbb
{
    _mADAS_PREDICTION_AR.ADAS_Stub_RelProbb.phys = getValue(this);
}

on EnvVar HMI_ADAS_Stub_NumOfLaneOppDir
{
    _mADAS_PREDICTION_AR.ADAS_Stub_NumOfLaneOppDir.phys = getValue(this);
}

on EnvVar HMI_ADAS_Meta_ProtVer_MinorSub
{
    _mADAS_PREDICTION_AR.ADAS_Meta_ProtVer_MinorSub.phys = getValue(this);
}

on EnvVar HMI_ADAS_Meta_CountryCode
{
    _mADAS_PREDICTION_AR.ADAS_Meta_CountryCode.phys = getValue(this);
}

on EnvVar HMI_ADAS_Meta_HwVer
{
    _mADAS_PREDICTION_AR.ADAS_Meta_HwVer.phys = getValue(this);
}

on EnvVar HMI_ADAS_Meta_MapProvid
{
    _mADAS_PREDICTION_AR.ADAS_Meta_MapProvid.phys = getValue(this);
}

on EnvVar HMI_ADAS_Meta_MapVerQuar
{
    _mADAS_PREDICTION_AR.ADAS_Meta_MapVerQuar.phys = getValue(this);
}

on EnvVar HMI_ADAS_Meta_MapVerYear
{
    _mADAS_PREDICTION_AR.ADAS_Meta_MapVerYear.phys = getValue(this);
}

on EnvVar HMI_ADAS_Meta_SpdUnits
{
    _mADAS_PREDICTION_AR.ADAS_Meta_SpdUnits.phys = getValue(this);
}

on EnvVar HMI_ADAS_Meta_ProtVer_Major
{
    _mADAS_PREDICTION_AR.ADAS_Meta_ProtVer_Major.phys = getValue(this);
}

on EnvVar HMI_ADAS_Meta_ProtVer_Minor
{
    _mADAS_PREDICTION_AR.ADAS_Meta_ProtVer_Minor.phys = getValue(this);
}

on EnvVar HMI_ADAS_Meta_RegionCode
{
    _mADAS_PREDICTION_AR.ADAS_Meta_RegionCode.phys = getValue(this);
}

on EnvVar HMI_ADAS_Meta_CycCnt
{
    _mADAS_PREDICTION_AR.ADAS_Meta_CycCnt.phys = getValue(this);
}

on EnvVar HMI_ADAS_Meta_DrvSide
{
    _mADAS_PREDICTION_AR.ADAS_Meta_DrvSide.phys = getValue(this);
}

ADAS_PROFILE_LONG_AR_check_output()
{
     if( !getValue( HMI__STMSG_ADAS_PROFILE_LONG_AR))
    {
        // Botschaft ADAS_PROFILE_LONG_AR ID: 991 --- Sendeart cyclicX --- 
        _ADAS_PROFILE_LONG_AR_Cnt--;
        if( _ADAS_PROFILE_LONG_AR_Cnt < 1 )
        {
            // Zyklus abgelaufen, Nachricht senden
            output( _mADAS_PROFILE_LONG_AR );
            _ADAS_PROFILE_LONG_AR_Cnt = _ADAS_PROFILE_LONG_AR_CycleCount;
        }
    }
}

ADAS_PROFILE_LONG_AR_init()
{   /* Botschaft ADAS_PROFILE_LONG_AR ID: 991 --- Sendeart cyclicX --- 
BA_ "ApplMessage" BO_ 991 0;
BA_ "NmAsrMessage" BO_ 991 0;
BA_ "GenMsgMinAcceptLength" BO_ 991 8;
BA_ "GenMsgILSupport" BO_ 991 0;
BA_ "DiagState" BO_ 991 0;
BA_ "DiagRequest" BO_ 991 0;
BA_ "DiagResponse" BO_ 991 0;
BA_ "GenMsgStartValue" BO_ 991 "0";
BA_ "GenMsgStartDelayTime" BO_ 991 145;
BA_ "GenMsgCycleTime" BO_ 991 500;
BA_ "GenMsgSendType" BO_ 991 0;
    */
    _ADAS_PROFILE_LONG_AR_Timebase =            c_tDBKomTimer_20ms;
    _ADAS_PROFILE_LONG_AR_CycleCount =        500 / _ADAS_PROFILE_LONG_AR_Timebase;
    _ADAS_PROFILE_LONG_AR_StartDelay =        145 / _ADAS_PROFILE_LONG_AR_Timebase;
    _ADAS_PROFILE_LONG_AR_Cnt = _ADAS_PROFILE_LONG_AR_StartDelay;

    putValue( HMI__STMSGSD_ADAS_PROFILE_LONG_AR, _ADAS_PROFILE_LONG_AR_StartDelay * _ADAS_PROFILE_LONG_AR_Timebase );

    _mADAS_PROFILE_LONG_AR.ADAS_ProfLong_ProfTyp.phys = getValue( HMI_ADAS_ProfLong_ProfTyp );
    _mADAS_PROFILE_LONG_AR.ADAS_ProfLong_CtrlPoint_Longi.phys = getValue( HMI_ADAS_ProfLong_CtrlPoint_Longi );
    _mADAS_PROFILE_LONG_AR.ADAS_ProfLong_CycCnt_Longi.phys = getValue( HMI_ADAS_ProfLong_CycCnt_Longi );
    _mADAS_PROFILE_LONG_AR.ADAS_ProfLong_MsgTyp_Longi.phys = getValue( HMI_ADAS_ProfLong_MsgTyp_Longi );
    _mADAS_PROFILE_LONG_AR.ADAS_ProfLong_Offset_Longi.phys = getValue( HMI_ADAS_ProfLong_Offset_Longi );
    _mADAS_PROFILE_LONG_AR.ADAS_ProfLong_PathIdx_Longi.phys = getValue( HMI_ADAS_ProfLong_PathIdx_Longi );
    _mADAS_PROFILE_LONG_AR.ADAS_ProfLong_ReTr_Longi.phys = getValue( HMI_ADAS_ProfLong_ReTr_Longi );
    _mADAS_PROFILE_LONG_AR.ADAS_ProfLong_Updt_Longi.phys = getValue( HMI_ADAS_ProfLong_Updt_Longi );
    _mADAS_PROFILE_LONG_AR.ADAS_ProfLong_Val_Longit.phys = getValue( HMI_ADAS_ProfLong_Val_Longit );
    _mADAS_PROFILE_LONG_AR.ADAS_ProfLong_CtrlPoint_Latit.phys = getValue( HMI_ADAS_ProfLong_CtrlPoint_Latit );
    _mADAS_PROFILE_LONG_AR.ADAS_ProfLong_CycCnt_Latit.phys = getValue( HMI_ADAS_ProfLong_CycCnt_Latit );
    _mADAS_PROFILE_LONG_AR.ADAS_ProfLong_MsgTyp_Latit.phys = getValue( HMI_ADAS_ProfLong_MsgTyp_Latit );
    _mADAS_PROFILE_LONG_AR.ADAS_ProfLong_Offset_Latit.phys = getValue( HMI_ADAS_ProfLong_Offset_Latit );
    _mADAS_PROFILE_LONG_AR.ADAS_ProfLong_PathIdx_Latit.phys = getValue( HMI_ADAS_ProfLong_PathIdx_Latit );
    _mADAS_PROFILE_LONG_AR.ADAS_ProfLong_ReTr_Latit.phys = getValue( HMI_ADAS_ProfLong_ReTr_Latit );
    _mADAS_PROFILE_LONG_AR.ADAS_ProfLong_Updt_Latit.phys = getValue( HMI_ADAS_ProfLong_Updt_Latit );
    _mADAS_PROFILE_LONG_AR.ADAS_ProfLong_Val_Latit.phys = getValue( HMI_ADAS_ProfLong_Val_Latit );
    _mADAS_PROFILE_LONG_AR.ADAS_ProfLong_CtrlPoint_TrffcSign.phys = getValue( HMI_ADAS_ProfLong_CtrlPoint_TrffcSign );
    _mADAS_PROFILE_LONG_AR.ADAS_ProfLong_CycCnt_TrffcSign.phys = getValue( HMI_ADAS_ProfLong_CycCnt_TrffcSign );
    _mADAS_PROFILE_LONG_AR.ADAS_ProfLong_MsgTyp_TrffcSign.phys = getValue( HMI_ADAS_ProfLong_MsgTyp_TrffcSign );
    _mADAS_PROFILE_LONG_AR.ADAS_ProfLong_Offset_TrffcSign.phys = getValue( HMI_ADAS_ProfLong_Offset_TrffcSign );
    _mADAS_PROFILE_LONG_AR.ADAS_ProfLong_PathIdx_TrffcSign.phys = getValue( HMI_ADAS_ProfLong_PathIdx_TrffcSign );
    _mADAS_PROFILE_LONG_AR.ADAS_ProfLong_ReTr_TrffcSign.phys = getValue( HMI_ADAS_ProfLong_ReTr_TrffcSign );
    _mADAS_PROFILE_LONG_AR.ADAS_ProfLong_Updt_TrffcSign.phys = getValue( HMI_ADAS_ProfLong_Updt_TrffcSign );
    _mADAS_PROFILE_LONG_AR.ADAS_ProfLong_Val_Cond_TrffcSign.phys = getValue( HMI_ADAS_ProfLong_Val_Cond_TrffcSign );
    _mADAS_PROFILE_LONG_AR.ADAS_ProfLong_Val_Lane_TrffcSign.phys = getValue( HMI_ADAS_ProfLong_Val_Lane_TrffcSign );
    _mADAS_PROFILE_LONG_AR.ADAS_ProfLong_Val_SignLoc_TrffcSign.phys = getValue( HMI_ADAS_ProfLong_Val_SignLoc_TrffcSign );
    _mADAS_PROFILE_LONG_AR.ADAS_ProfLong_Val_TmSpecf_TrffcSign.phys = getValue( HMI_ADAS_ProfLong_Val_TmSpecf_TrffcSign );
    _mADAS_PROFILE_LONG_AR.ADAS_ProfLong_Val_TrffcSign.phys = getValue( HMI_ADAS_ProfLong_Val_TrffcSign );
    _mADAS_PROFILE_LONG_AR.ADAS_ProfLong_Val_Typ_TrffcSign.phys = getValue( HMI_ADAS_ProfLong_Val_Typ_TrffcSign );
    _mADAS_PROFILE_LONG_AR.ADAS_ProfLong_Val_VehSpecf_TrffcSign.phys = getValue( HMI_ADAS_ProfLong_Val_VehSpecf_TrffcSign );
    _mADAS_PROFILE_LONG_AR.ADAS_ProfLong_CtrlPoint_ExtLn.phys = getValue( HMI_ADAS_ProfLong_CtrlPoint_ExtLn );
    _mADAS_PROFILE_LONG_AR.ADAS_ProfLong_CycCnt_ExtLane.phys = getValue( HMI_ADAS_ProfLong_CycCnt_ExtLane );
    _mADAS_PROFILE_LONG_AR.ADAS_ProfLong_MsgTyp_ExtLane.phys = getValue( HMI_ADAS_ProfLong_MsgTyp_ExtLane );
    _mADAS_PROFILE_LONG_AR.ADAS_ProfLong_Offset_ExtLane.phys = getValue( HMI_ADAS_ProfLong_Offset_ExtLane );
    _mADAS_PROFILE_LONG_AR.ADAS_ProfLong_PathIdx_ExtLane.phys = getValue( HMI_ADAS_ProfLong_PathIdx_ExtLane );
    _mADAS_PROFILE_LONG_AR.ADAS_ProfLong_ReTr_ExtLane.phys = getValue( HMI_ADAS_ProfLong_ReTr_ExtLane );
    _mADAS_PROFILE_LONG_AR.ADAS_ProfLong_Updt_ExtLane.phys = getValue( HMI_ADAS_ProfLong_Updt_ExtLane );
    _mADAS_PROFILE_LONG_AR.ADAS_ProfLong_Val_1stPredLane.phys = getValue( HMI_ADAS_ProfLong_Val_1stPredLane );
    _mADAS_PROFILE_LONG_AR.ADAS_ProfLong_Val_ArrowMark.phys = getValue( HMI_ADAS_ProfLong_Val_ArrowMark );
    _mADAS_PROFILE_LONG_AR.ADAS_ProfLong_Val_LaneMarking.phys = getValue( HMI_ADAS_ProfLong_Val_LaneMarking );
    _mADAS_PROFILE_LONG_AR.ADAS_ProfLong_Val_LaneNum.phys = getValue( HMI_ADAS_ProfLong_Val_LaneNum );
    _mADAS_PROFILE_LONG_AR.ADAS_ProfLong_Val_LaneType.phys = getValue( HMI_ADAS_ProfLong_Val_LaneType );
    _mADAS_PROFILE_LONG_AR.ADAS_ProfLong_Val_LstPredLane.phys = getValue( HMI_ADAS_ProfLong_Val_LstPredLane );
    _mADAS_PROFILE_LONG_AR.ADAS_ProfLong_Val_PrioPredLn.phys = getValue( HMI_ADAS_ProfLong_Val_PrioPredLn );
    _mADAS_PROFILE_LONG_AR.ADAS_ProfLong_Val_Yield.phys = getValue( HMI_ADAS_ProfLong_Val_Yield );
    _mADAS_PROFILE_LONG_AR.ADAS_ProfLong_CtrlPoint_NPSL1.phys = getValue( HMI_ADAS_ProfLong_CtrlPoint_NPSL1 );
    _mADAS_PROFILE_LONG_AR.ADAS_ProfLong_CycCnt_NPSL1.phys = getValue( HMI_ADAS_ProfLong_CycCnt_NPSL1 );
    _mADAS_PROFILE_LONG_AR.ADAS_ProfLong_MsgTyp_NPSL1.phys = getValue( HMI_ADAS_ProfLong_MsgTyp_NPSL1 );
    _mADAS_PROFILE_LONG_AR.ADAS_ProfLong_Offset_NPSL1.phys = getValue( HMI_ADAS_ProfLong_Offset_NPSL1 );
    _mADAS_PROFILE_LONG_AR.ADAS_ProfLong_PathIdx_NPSL1.phys = getValue( HMI_ADAS_ProfLong_PathIdx_NPSL1 );
    _mADAS_PROFILE_LONG_AR.ADAS_ProfLong_ReTr_NPSL1.phys = getValue( HMI_ADAS_ProfLong_ReTr_NPSL1 );
    _mADAS_PROFILE_LONG_AR.ADAS_ProfLong_Updt_NPSL1.phys = getValue( HMI_ADAS_ProfLong_Updt_NPSL1 );
    _mADAS_PROFILE_LONG_AR.ADAS_ProfLong_Val_SpdLmt.phys = getValue( HMI_ADAS_ProfLong_Val_SpdLmt );
    _mADAS_PROFILE_LONG_AR.ADAS_ProfLong_Val_SpdLmt1.phys = getValue( HMI_ADAS_ProfLong_Val_SpdLmt1 );
    _mADAS_PROFILE_LONG_AR.ADAS_ProfLong_Val_SpdTyp.phys = getValue( HMI_ADAS_ProfLong_Val_SpdTyp );
    _mADAS_PROFILE_LONG_AR.ADAS_ProfLong_Val_SpdTyp1.phys = getValue( HMI_ADAS_ProfLong_Val_SpdTyp1 );
    _mADAS_PROFILE_LONG_AR.ADAS_ProfLong_Val_SpdUnt.phys = getValue( HMI_ADAS_ProfLong_Val_SpdUnt );
    _mADAS_PROFILE_LONG_AR.ADAS_ProfLong_Val_SpdVld.phys = getValue( HMI_ADAS_ProfLong_Val_SpdVld );
    _mADAS_PROFILE_LONG_AR.ADAS_ProfLong_Val_SpdVld1.phys = getValue( HMI_ADAS_ProfLong_Val_SpdVld1 );
    _mADAS_PROFILE_LONG_AR.ADAS_ProfLong_CtrlPoint_NPSL2.phys = getValue( HMI_ADAS_ProfLong_CtrlPoint_NPSL2 );
    _mADAS_PROFILE_LONG_AR.ADAS_ProfLong_CycCnt_NPSL2.phys = getValue( HMI_ADAS_ProfLong_CycCnt_NPSL2 );
    _mADAS_PROFILE_LONG_AR.ADAS_ProfLong_MsgTyp_NPSL2.phys = getValue( HMI_ADAS_ProfLong_MsgTyp_NPSL2 );
    _mADAS_PROFILE_LONG_AR.ADAS_ProfLong_Offset_NPSL2.phys = getValue( HMI_ADAS_ProfLong_Offset_NPSL2 );
    _mADAS_PROFILE_LONG_AR.ADAS_ProfLong_PathIdx_NPSL2.phys = getValue( HMI_ADAS_ProfLong_PathIdx_NPSL2 );
    _mADAS_PROFILE_LONG_AR.ADAS_ProfLong_ReTr_NPSL2.phys = getValue( HMI_ADAS_ProfLong_ReTr_NPSL2 );
    _mADAS_PROFILE_LONG_AR.ADAS_ProfLong_Updt_NPSL2.phys = getValue( HMI_ADAS_ProfLong_Updt_NPSL2 );
    _mADAS_PROFILE_LONG_AR.ADAS_ProfLong_Val_SpdLmt2.phys = getValue( HMI_ADAS_ProfLong_Val_SpdLmt2 );
    _mADAS_PROFILE_LONG_AR.ADAS_ProfLong_Val_SpdTyp2.phys = getValue( HMI_ADAS_ProfLong_Val_SpdTyp2 );
    _mADAS_PROFILE_LONG_AR.ADAS_ProfLong_Val_SpdUnt2.phys = getValue( HMI_ADAS_ProfLong_Val_SpdUnt2 );
    _mADAS_PROFILE_LONG_AR.ADAS_ProfLong_Val_SpdVld2.phys = getValue( HMI_ADAS_ProfLong_Val_SpdVld2 );
    _mADAS_PROFILE_LONG_AR.ADAS_ProfLong_CtrlPoint_FAPData.phys = getValue( HMI_ADAS_ProfLong_CtrlPoint_FAPData );
    _mADAS_PROFILE_LONG_AR.ADAS_ProfLong_CycCnt_FAPData.phys = getValue( HMI_ADAS_ProfLong_CycCnt_FAPData );
    _mADAS_PROFILE_LONG_AR.ADAS_ProfLong_MsgTyp_FAPData.phys = getValue( HMI_ADAS_ProfLong_MsgTyp_FAPData );
    _mADAS_PROFILE_LONG_AR.ADAS_ProfLong_Offset_FAPData.phys = getValue( HMI_ADAS_ProfLong_Offset_FAPData );
    _mADAS_PROFILE_LONG_AR.ADAS_ProfLong_PathIdx_FAPData.phys = getValue( HMI_ADAS_ProfLong_PathIdx_FAPData );
    _mADAS_PROFILE_LONG_AR.ADAS_ProfLong_ReTr_FAPData.phys = getValue( HMI_ADAS_ProfLong_ReTr_FAPData );
    _mADAS_PROFILE_LONG_AR.ADAS_ProfLong_Updt_FAPData.phys = getValue( HMI_ADAS_ProfLong_Updt_FAPData );
    _mADAS_PROFILE_LONG_AR.ADAS_ProfLong_Val_FAPData.phys = getValue( HMI_ADAS_ProfLong_Val_FAPData );
}

ADAS_PROFILE_LONG_AR_saveEnvVars( dword hFile )
{
    filePutString("\n// Knoten TGW: ADAS_PROFILE_LONG_AR\n", 37, hFile);
    snprintf( buffer, elcount(buffer), "0.0000 HMI__STMSG_TADAS_PROFILE_LONG_AR := %X\n", getValue( HMI__STMSG_ADAS_PROFILE_LONG_AR ) );        filePutString( buffer, elcount(buffer), hFile);
    snprintf( buffer, elcount(buffer), "0.0000 HMI__STMSGT_ADAS_PROFILE_LONG_AR := %X\n", getValue( HMI__STMSGT_ADAS_PROFILE_LONG_AR ) );        filePutString( buffer, elcount(buffer), hFile);
    snprintf( buffer, elcount(buffer), "0.0000 HMI_ADAS_ProfLong_ProfTyp := %X\n", getValue( HMI_ADAS_ProfLong_ProfTyp ));        filePutString( buffer, elcount(buffer), hFile);
    snprintf( buffer, elcount(buffer), "0.0000 HMI_ADAS_ProfLong_CtrlPoint_Longi := %X\n", getValue( HMI_ADAS_ProfLong_CtrlPoint_Longi ));        filePutString( buffer, elcount(buffer), hFile);
    snprintf( buffer, elcount(buffer), "0.0000 HMI_ADAS_ProfLong_CycCnt_Longi := %X\n", getValue( HMI_ADAS_ProfLong_CycCnt_Longi ));        filePutString( buffer, elcount(buffer), hFile);
    snprintf( buffer, elcount(buffer), "0.0000 HMI_ADAS_ProfLong_MsgTyp_Longi := %X\n", getValue( HMI_ADAS_ProfLong_MsgTyp_Longi ));        filePutString( buffer, elcount(buffer), hFile);
    snprintf( buffer, elcount(buffer), "0.0000 HMI_ADAS_ProfLong_Offset_Longi := %X\n", getValue( HMI_ADAS_ProfLong_Offset_Longi ));        filePutString( buffer, elcount(buffer), hFile);
    snprintf( buffer, elcount(buffer), "0.0000 HMI_ADAS_ProfLong_PathIdx_Longi := %X\n", getValue( HMI_ADAS_ProfLong_PathIdx_Longi ));        filePutString( buffer, elcount(buffer), hFile);
    snprintf( buffer, elcount(buffer), "0.0000 HMI_ADAS_ProfLong_ReTr_Longi := %X\n", getValue( HMI_ADAS_ProfLong_ReTr_Longi ));        filePutString( buffer, elcount(buffer), hFile);
    snprintf( buffer, elcount(buffer), "0.0000 HMI_ADAS_ProfLong_Updt_Longi := %X\n", getValue( HMI_ADAS_ProfLong_Updt_Longi ));        filePutString( buffer, elcount(buffer), hFile);
    snprintf( buffer, elcount(buffer), "0.0000 HMI_ADAS_ProfLong_Val_Longit := %X\n", getValue( HMI_ADAS_ProfLong_Val_Longit ));        filePutString( buffer, elcount(buffer), hFile);
    snprintf( buffer, elcount(buffer), "0.0000 HMI_ADAS_ProfLong_CtrlPoint_Latit := %X\n", getValue( HMI_ADAS_ProfLong_CtrlPoint_Latit ));        filePutString( buffer, elcount(buffer), hFile);
    snprintf( buffer, elcount(buffer), "0.0000 HMI_ADAS_ProfLong_CycCnt_Latit := %X\n", getValue( HMI_ADAS_ProfLong_CycCnt_Latit ));        filePutString( buffer, elcount(buffer), hFile);
    snprintf( buffer, elcount(buffer), "0.0000 HMI_ADAS_ProfLong_MsgTyp_Latit := %X\n", getValue( HMI_ADAS_ProfLong_MsgTyp_Latit ));        filePutString( buffer, elcount(buffer), hFile);
    snprintf( buffer, elcount(buffer), "0.0000 HMI_ADAS_ProfLong_Offset_Latit := %X\n", getValue( HMI_ADAS_ProfLong_Offset_Latit ));        filePutString( buffer, elcount(buffer), hFile);
    snprintf( buffer, elcount(buffer), "0.0000 HMI_ADAS_ProfLong_PathIdx_Latit := %X\n", getValue( HMI_ADAS_ProfLong_PathIdx_Latit ));        filePutString( buffer, elcount(buffer), hFile);
    snprintf( buffer, elcount(buffer), "0.0000 HMI_ADAS_ProfLong_ReTr_Latit := %X\n", getValue( HMI_ADAS_ProfLong_ReTr_Latit ));        filePutString( buffer, elcount(buffer), hFile);
    snprintf( buffer, elcount(buffer), "0.0000 HMI_ADAS_ProfLong_Updt_Latit := %X\n", getValue( HMI_ADAS_ProfLong_Updt_Latit ));        filePutString( buffer, elcount(buffer), hFile);
    snprintf( buffer, elcount(buffer), "0.0000 HMI_ADAS_ProfLong_Val_Latit := %X\n", getValue( HMI_ADAS_ProfLong_Val_Latit ));        filePutString( buffer, elcount(buffer), hFile);
    snprintf( buffer, elcount(buffer), "0.0000 HMI_ADAS_ProfLong_CtrlPoint_TrffcSign := %X\n", getValue( HMI_ADAS_ProfLong_CtrlPoint_TrffcSign ));        filePutString( buffer, elcount(buffer), hFile);
    snprintf( buffer, elcount(buffer), "0.0000 HMI_ADAS_ProfLong_CycCnt_TrffcSign := %X\n", getValue( HMI_ADAS_ProfLong_CycCnt_TrffcSign ));        filePutString( buffer, elcount(buffer), hFile);
    snprintf( buffer, elcount(buffer), "0.0000 HMI_ADAS_ProfLong_MsgTyp_TrffcSign := %X\n", getValue( HMI_ADAS_ProfLong_MsgTyp_TrffcSign ));        filePutString( buffer, elcount(buffer), hFile);
    snprintf( buffer, elcount(buffer), "0.0000 HMI_ADAS_ProfLong_Offset_TrffcSign := %X\n", getValue( HMI_ADAS_ProfLong_Offset_TrffcSign ));        filePutString( buffer, elcount(buffer), hFile);
    snprintf( buffer, elcount(buffer), "0.0000 HMI_ADAS_ProfLong_PathIdx_TrffcSign := %X\n", getValue( HMI_ADAS_ProfLong_PathIdx_TrffcSign ));        filePutString( buffer, elcount(buffer), hFile);
    snprintf( buffer, elcount(buffer), "0.0000 HMI_ADAS_ProfLong_ReTr_TrffcSign := %X\n", getValue( HMI_ADAS_ProfLong_ReTr_TrffcSign ));        filePutString( buffer, elcount(buffer), hFile);
    snprintf( buffer, elcount(buffer), "0.0000 HMI_ADAS_ProfLong_Updt_TrffcSign := %X\n", getValue( HMI_ADAS_ProfLong_Updt_TrffcSign ));        filePutString( buffer, elcount(buffer), hFile);
    snprintf( buffer, elcount(buffer), "0.0000 HMI_ADAS_ProfLong_Val_Cond_TrffcSign := %X\n", getValue( HMI_ADAS_ProfLong_Val_Cond_TrffcSign ));        filePutString( buffer, elcount(buffer), hFile);
    snprintf( buffer, elcount(buffer), "0.0000 HMI_ADAS_ProfLong_Val_Lane_TrffcSign := %X\n", getValue( HMI_ADAS_ProfLong_Val_Lane_TrffcSign ));        filePutString( buffer, elcount(buffer), hFile);
    snprintf( buffer, elcount(buffer), "0.0000 HMI_ADAS_ProfLong_Val_SignLoc_TrffcSign := %X\n", getValue( HMI_ADAS_ProfLong_Val_SignLoc_TrffcSign ));        filePutString( buffer, elcount(buffer), hFile);
    snprintf( buffer, elcount(buffer), "0.0000 HMI_ADAS_ProfLong_Val_TmSpecf_TrffcSign := %X\n", getValue( HMI_ADAS_ProfLong_Val_TmSpecf_TrffcSign ));        filePutString( buffer, elcount(buffer), hFile);
    snprintf( buffer, elcount(buffer), "0.0000 HMI_ADAS_ProfLong_Val_TrffcSign := %X\n", getValue( HMI_ADAS_ProfLong_Val_TrffcSign ));        filePutString( buffer, elcount(buffer), hFile);
    snprintf( buffer, elcount(buffer), "0.0000 HMI_ADAS_ProfLong_Val_Typ_TrffcSign := %X\n", getValue( HMI_ADAS_ProfLong_Val_Typ_TrffcSign ));        filePutString( buffer, elcount(buffer), hFile);
    snprintf( buffer, elcount(buffer), "0.0000 HMI_ADAS_ProfLong_Val_VehSpecf_TrffcSign := %X\n", getValue( HMI_ADAS_ProfLong_Val_VehSpecf_TrffcSign ));        filePutString( buffer, elcount(buffer), hFile);
    snprintf( buffer, elcount(buffer), "0.0000 HMI_ADAS_ProfLong_CtrlPoint_ExtLn := %X\n", getValue( HMI_ADAS_ProfLong_CtrlPoint_ExtLn ));        filePutString( buffer, elcount(buffer), hFile);
    snprintf( buffer, elcount(buffer), "0.0000 HMI_ADAS_ProfLong_CycCnt_ExtLane := %X\n", getValue( HMI_ADAS_ProfLong_CycCnt_ExtLane ));        filePutString( buffer, elcount(buffer), hFile);
    snprintf( buffer, elcount(buffer), "0.0000 HMI_ADAS_ProfLong_MsgTyp_ExtLane := %X\n", getValue( HMI_ADAS_ProfLong_MsgTyp_ExtLane ));        filePutString( buffer, elcount(buffer), hFile);
    snprintf( buffer, elcount(buffer), "0.0000 HMI_ADAS_ProfLong_Offset_ExtLane := %X\n", getValue( HMI_ADAS_ProfLong_Offset_ExtLane ));        filePutString( buffer, elcount(buffer), hFile);
    snprintf( buffer, elcount(buffer), "0.0000 HMI_ADAS_ProfLong_PathIdx_ExtLane := %X\n", getValue( HMI_ADAS_ProfLong_PathIdx_ExtLane ));        filePutString( buffer, elcount(buffer), hFile);
    snprintf( buffer, elcount(buffer), "0.0000 HMI_ADAS_ProfLong_ReTr_ExtLane := %X\n", getValue( HMI_ADAS_ProfLong_ReTr_ExtLane ));        filePutString( buffer, elcount(buffer), hFile);
    snprintf( buffer, elcount(buffer), "0.0000 HMI_ADAS_ProfLong_Updt_ExtLane := %X\n", getValue( HMI_ADAS_ProfLong_Updt_ExtLane ));        filePutString( buffer, elcount(buffer), hFile);
    snprintf( buffer, elcount(buffer), "0.0000 HMI_ADAS_ProfLong_Val_1stPredLane := %X\n", getValue( HMI_ADAS_ProfLong_Val_1stPredLane ));        filePutString( buffer, elcount(buffer), hFile);
    snprintf( buffer, elcount(buffer), "0.0000 HMI_ADAS_ProfLong_Val_ArrowMark := %X\n", getValue( HMI_ADAS_ProfLong_Val_ArrowMark ));        filePutString( buffer, elcount(buffer), hFile);
    snprintf( buffer, elcount(buffer), "0.0000 HMI_ADAS_ProfLong_Val_LaneMarking := %X\n", getValue( HMI_ADAS_ProfLong_Val_LaneMarking ));        filePutString( buffer, elcount(buffer), hFile);
    snprintf( buffer, elcount(buffer), "0.0000 HMI_ADAS_ProfLong_Val_LaneNum := %X\n", getValue( HMI_ADAS_ProfLong_Val_LaneNum ));        filePutString( buffer, elcount(buffer), hFile);
    snprintf( buffer, elcount(buffer), "0.0000 HMI_ADAS_ProfLong_Val_LaneType := %X\n", getValue( HMI_ADAS_ProfLong_Val_LaneType ));        filePutString( buffer, elcount(buffer), hFile);
    snprintf( buffer, elcount(buffer), "0.0000 HMI_ADAS_ProfLong_Val_LstPredLane := %X\n", getValue( HMI_ADAS_ProfLong_Val_LstPredLane ));        filePutString( buffer, elcount(buffer), hFile);
    snprintf( buffer, elcount(buffer), "0.0000 HMI_ADAS_ProfLong_Val_PrioPredLn := %X\n", getValue( HMI_ADAS_ProfLong_Val_PrioPredLn ));        filePutString( buffer, elcount(buffer), hFile);
    snprintf( buffer, elcount(buffer), "0.0000 HMI_ADAS_ProfLong_Val_Yield := %X\n", getValue( HMI_ADAS_ProfLong_Val_Yield ));        filePutString( buffer, elcount(buffer), hFile);
    snprintf( buffer, elcount(buffer), "0.0000 HMI_ADAS_ProfLong_CtrlPoint_NPSL1 := %X\n", getValue( HMI_ADAS_ProfLong_CtrlPoint_NPSL1 ));        filePutString( buffer, elcount(buffer), hFile);
    snprintf( buffer, elcount(buffer), "0.0000 HMI_ADAS_ProfLong_CycCnt_NPSL1 := %X\n", getValue( HMI_ADAS_ProfLong_CycCnt_NPSL1 ));        filePutString( buffer, elcount(buffer), hFile);
    snprintf( buffer, elcount(buffer), "0.0000 HMI_ADAS_ProfLong_MsgTyp_NPSL1 := %X\n", getValue( HMI_ADAS_ProfLong_MsgTyp_NPSL1 ));        filePutString( buffer, elcount(buffer), hFile);
    snprintf( buffer, elcount(buffer), "0.0000 HMI_ADAS_ProfLong_Offset_NPSL1 := %X\n", getValue( HMI_ADAS_ProfLong_Offset_NPSL1 ));        filePutString( buffer, elcount(buffer), hFile);
    snprintf( buffer, elcount(buffer), "0.0000 HMI_ADAS_ProfLong_PathIdx_NPSL1 := %X\n", getValue( HMI_ADAS_ProfLong_PathIdx_NPSL1 ));        filePutString( buffer, elcount(buffer), hFile);
    snprintf( buffer, elcount(buffer), "0.0000 HMI_ADAS_ProfLong_ReTr_NPSL1 := %X\n", getValue( HMI_ADAS_ProfLong_ReTr_NPSL1 ));        filePutString( buffer, elcount(buffer), hFile);
    snprintf( buffer, elcount(buffer), "0.0000 HMI_ADAS_ProfLong_Updt_NPSL1 := %X\n", getValue( HMI_ADAS_ProfLong_Updt_NPSL1 ));        filePutString( buffer, elcount(buffer), hFile);
    snprintf( buffer, elcount(buffer), "0.0000 HMI_ADAS_ProfLong_Val_SpdLmt := %X\n", getValue( HMI_ADAS_ProfLong_Val_SpdLmt ));        filePutString( buffer, elcount(buffer), hFile);
    snprintf( buffer, elcount(buffer), "0.0000 HMI_ADAS_ProfLong_Val_SpdLmt1 := %X\n", getValue( HMI_ADAS_ProfLong_Val_SpdLmt1 ));        filePutString( buffer, elcount(buffer), hFile);
    snprintf( buffer, elcount(buffer), "0.0000 HMI_ADAS_ProfLong_Val_SpdTyp := %X\n", getValue( HMI_ADAS_ProfLong_Val_SpdTyp ));        filePutString( buffer, elcount(buffer), hFile);
    snprintf( buffer, elcount(buffer), "0.0000 HMI_ADAS_ProfLong_Val_SpdTyp1 := %X\n", getValue( HMI_ADAS_ProfLong_Val_SpdTyp1 ));        filePutString( buffer, elcount(buffer), hFile);
    snprintf( buffer, elcount(buffer), "0.0000 HMI_ADAS_ProfLong_Val_SpdUnt := %X\n", getValue( HMI_ADAS_ProfLong_Val_SpdUnt ));        filePutString( buffer, elcount(buffer), hFile);
    snprintf( buffer, elcount(buffer), "0.0000 HMI_ADAS_ProfLong_Val_SpdVld := %X\n", getValue( HMI_ADAS_ProfLong_Val_SpdVld ));        filePutString( buffer, elcount(buffer), hFile);
    snprintf( buffer, elcount(buffer), "0.0000 HMI_ADAS_ProfLong_Val_SpdVld1 := %X\n", getValue( HMI_ADAS_ProfLong_Val_SpdVld1 ));        filePutString( buffer, elcount(buffer), hFile);
    snprintf( buffer, elcount(buffer), "0.0000 HMI_ADAS_ProfLong_CtrlPoint_NPSL2 := %X\n", getValue( HMI_ADAS_ProfLong_CtrlPoint_NPSL2 ));        filePutString( buffer, elcount(buffer), hFile);
    snprintf( buffer, elcount(buffer), "0.0000 HMI_ADAS_ProfLong_CycCnt_NPSL2 := %X\n", getValue( HMI_ADAS_ProfLong_CycCnt_NPSL2 ));        filePutString( buffer, elcount(buffer), hFile);
    snprintf( buffer, elcount(buffer), "0.0000 HMI_ADAS_ProfLong_MsgTyp_NPSL2 := %X\n", getValue( HMI_ADAS_ProfLong_MsgTyp_NPSL2 ));        filePutString( buffer, elcount(buffer), hFile);
    snprintf( buffer, elcount(buffer), "0.0000 HMI_ADAS_ProfLong_Offset_NPSL2 := %X\n", getValue( HMI_ADAS_ProfLong_Offset_NPSL2 ));        filePutString( buffer, elcount(buffer), hFile);
    snprintf( buffer, elcount(buffer), "0.0000 HMI_ADAS_ProfLong_PathIdx_NPSL2 := %X\n", getValue( HMI_ADAS_ProfLong_PathIdx_NPSL2 ));        filePutString( buffer, elcount(buffer), hFile);
    snprintf( buffer, elcount(buffer), "0.0000 HMI_ADAS_ProfLong_ReTr_NPSL2 := %X\n", getValue( HMI_ADAS_ProfLong_ReTr_NPSL2 ));        filePutString( buffer, elcount(buffer), hFile);
    snprintf( buffer, elcount(buffer), "0.0000 HMI_ADAS_ProfLong_Updt_NPSL2 := %X\n", getValue( HMI_ADAS_ProfLong_Updt_NPSL2 ));        filePutString( buffer, elcount(buffer), hFile);
    snprintf( buffer, elcount(buffer), "0.0000 HMI_ADAS_ProfLong_Val_SpdLmt2 := %X\n", getValue( HMI_ADAS_ProfLong_Val_SpdLmt2 ));        filePutString( buffer, elcount(buffer), hFile);
    snprintf( buffer, elcount(buffer), "0.0000 HMI_ADAS_ProfLong_Val_SpdTyp2 := %X\n", getValue( HMI_ADAS_ProfLong_Val_SpdTyp2 ));        filePutString( buffer, elcount(buffer), hFile);
    snprintf( buffer, elcount(buffer), "0.0000 HMI_ADAS_ProfLong_Val_SpdUnt2 := %X\n", getValue( HMI_ADAS_ProfLong_Val_SpdUnt2 ));        filePutString( buffer, elcount(buffer), hFile);
    snprintf( buffer, elcount(buffer), "0.0000 HMI_ADAS_ProfLong_Val_SpdVld2 := %X\n", getValue( HMI_ADAS_ProfLong_Val_SpdVld2 ));        filePutString( buffer, elcount(buffer), hFile);
  
    snprintf( buffer, elcount(buffer), "0.0000 HMI_ADAS_ProfLong_CtrlPoint_FAPData := %X\n", getValue( HMI_ADAS_ProfLong_CtrlPoint_FAPData ));        filePutString( buffer, elcount(buffer), hFile);
    snprintf( buffer, elcount(buffer), "0.0000 HMI_ADAS_ProfLong_CycCnt_FAPData := %X\n", getValue( HMI_ADAS_ProfLong_CycCnt_FAPData ));        filePutString( buffer, elcount(buffer), hFile);
    snprintf( buffer, elcount(buffer), "0.0000 HMI_ADAS_ProfLong_MsgTyp_FAPData := %X\n", getValue( HMI_ADAS_ProfLong_MsgTyp_FAPData ));        filePutString( buffer, elcount(buffer), hFile);
    snprintf( buffer, elcount(buffer), "0.0000 HMI_ADAS_ProfLong_Offset_FAPData := %X\n", getValue( HMI_ADAS_ProfLong_Offset_FAPData ));        filePutString( buffer, elcount(buffer), hFile);
    snprintf( buffer, elcount(buffer), "0.0000 HMI_ADAS_ProfLong_PathIdx_FAPData := %X\n", getValue( HMI_ADAS_ProfLong_PathIdx_FAPData ));        filePutString( buffer, elcount(buffer), hFile);
    snprintf( buffer, elcount(buffer), "0.0000 HMI_ADAS_ProfLong_ReTr_FAPData := %X\n", getValue( HMI_ADAS_ProfLong_ReTr_FAPData ));        filePutString( buffer, elcount(buffer), hFile);
    snprintf( buffer, elcount(buffer), "0.0000 HMI_ADAS_ProfLong_Updt_FAPData := %X\n", getValue( HMI_ADAS_ProfLong_Updt_FAPData ));        filePutString( buffer, elcount(buffer), hFile);
    snprintf( buffer, elcount(buffer), "0.0000 HMI_ADAS_ProfLong_Val_FAPData := %X\n", getValue( HMI_ADAS_ProfLong_Val_FAPData ));        filePutString( buffer, elcount(buffer), hFile);
}

on timer _tADAS_PROFILE_LONG_AR
{
    putValue( HMI__STMSG_ADAS_PROFILE_LONG_AR, 0 );
}

on EnvVar HMI__STMSG_ADAS_PROFILE_LONG_AR
{
    long tDelay;
    if( getValue( this ) == 2 )
    {
        tDelay = getValue( HMI__STMSGT_ADAS_PROFILE_LONG_AR );
        if( tDelay > 0 )    
            setTimer( _tADAS_PROFILE_LONG_AR, tDelay );
        else
            putValue( HMI__STMSG_ADAS_PROFILE_LONG_AR, 0 );
    }
}

on EnvVar HMI__ALLDEF_ADAS_PROFILE_LONG_AR
{
    if( getValue(this))
    {
        // alle signale auf default einstellen
        putValue( HMI_ADAS_ProfLong_ProfTyp, 31 );
    }
}

on envVar HMI__STMSG_PO_ADAS_PROFILE_LONG_AR
{
    if( getValue( this ) )
        openPanel("ADAS_PROFILE_LONG_AR");
}

on EnvVar HMI_ADAS_ProfLong_ProfTyp
{
    _mADAS_PROFILE_LONG_AR.ADAS_ProfLong_ProfTyp.phys = getValue(this);
}

on EnvVar HMI_ADAS_ProfLong_CtrlPoint_Longi
{
    _mADAS_PROFILE_LONG_AR.ADAS_ProfLong_CtrlPoint_Longi.phys = getValue(this);
}

on EnvVar HMI_ADAS_ProfLong_CycCnt_Longi
{
    _mADAS_PROFILE_LONG_AR.ADAS_ProfLong_CycCnt_Longi.phys = getValue(this);
}

on EnvVar HMI_ADAS_ProfLong_MsgTyp_Longi
{
    _mADAS_PROFILE_LONG_AR.ADAS_ProfLong_MsgTyp_Longi.phys = getValue(this);
}

on EnvVar HMI_ADAS_ProfLong_Offset_Longi
{
    _mADAS_PROFILE_LONG_AR.ADAS_ProfLong_Offset_Longi.phys = getValue(this);
}

on EnvVar HMI_ADAS_ProfLong_PathIdx_Longi
{
    _mADAS_PROFILE_LONG_AR.ADAS_ProfLong_PathIdx_Longi.phys = getValue(this);
}

on EnvVar HMI_ADAS_ProfLong_ReTr_Longi
{
    _mADAS_PROFILE_LONG_AR.ADAS_ProfLong_ReTr_Longi.phys = getValue(this);
}

on EnvVar HMI_ADAS_ProfLong_Updt_Longi
{
    _mADAS_PROFILE_LONG_AR.ADAS_ProfLong_Updt_Longi.phys = getValue(this);
}

on EnvVar HMI_ADAS_ProfLong_Val_Longit
{
    _mADAS_PROFILE_LONG_AR.ADAS_ProfLong_Val_Longit.phys = getValue(this);
}

on EnvVar HMI_ADAS_ProfLong_CtrlPoint_Latit
{
    _mADAS_PROFILE_LONG_AR.ADAS_ProfLong_CtrlPoint_Latit.phys = getValue(this);
}

on EnvVar HMI_ADAS_ProfLong_CycCnt_Latit
{
    _mADAS_PROFILE_LONG_AR.ADAS_ProfLong_CycCnt_Latit.phys = getValue(this);
}

on EnvVar HMI_ADAS_ProfLong_MsgTyp_Latit
{
    _mADAS_PROFILE_LONG_AR.ADAS_ProfLong_MsgTyp_Latit.phys = getValue(this);
}

on EnvVar HMI_ADAS_ProfLong_Offset_Latit
{
    _mADAS_PROFILE_LONG_AR.ADAS_ProfLong_Offset_Latit.phys = getValue(this);
}

on EnvVar HMI_ADAS_ProfLong_PathIdx_Latit
{
    _mADAS_PROFILE_LONG_AR.ADAS_ProfLong_PathIdx_Latit.phys = getValue(this);
}

on EnvVar HMI_ADAS_ProfLong_ReTr_Latit
{
    _mADAS_PROFILE_LONG_AR.ADAS_ProfLong_ReTr_Latit.phys = getValue(this);
}

on EnvVar HMI_ADAS_ProfLong_Updt_Latit
{
    _mADAS_PROFILE_LONG_AR.ADAS_ProfLong_Updt_Latit.phys = getValue(this);
}

on EnvVar HMI_ADAS_ProfLong_Val_Latit
{
    _mADAS_PROFILE_LONG_AR.ADAS_ProfLong_Val_Latit.phys = getValue(this);
}

on EnvVar HMI_ADAS_ProfLong_CtrlPoint_TrffcSign
{
    _mADAS_PROFILE_LONG_AR.ADAS_ProfLong_CtrlPoint_TrffcSign.phys = getValue(this);
}

on EnvVar HMI_ADAS_ProfLong_CycCnt_TrffcSign
{
    _mADAS_PROFILE_LONG_AR.ADAS_ProfLong_CycCnt_TrffcSign.phys = getValue(this);
}

on EnvVar HMI_ADAS_ProfLong_MsgTyp_TrffcSign
{
    _mADAS_PROFILE_LONG_AR.ADAS_ProfLong_MsgTyp_TrffcSign.phys = getValue(this);
}

on EnvVar HMI_ADAS_ProfLong_Offset_TrffcSign
{
    _mADAS_PROFILE_LONG_AR.ADAS_ProfLong_Offset_TrffcSign.phys = getValue(this);
}

on EnvVar HMI_ADAS_ProfLong_PathIdx_TrffcSign
{
    _mADAS_PROFILE_LONG_AR.ADAS_ProfLong_PathIdx_TrffcSign.phys = getValue(this);
}

on EnvVar HMI_ADAS_ProfLong_ReTr_TrffcSign
{
    _mADAS_PROFILE_LONG_AR.ADAS_ProfLong_ReTr_TrffcSign.phys = getValue(this);
}

on EnvVar HMI_ADAS_ProfLong_Updt_TrffcSign
{
    _mADAS_PROFILE_LONG_AR.ADAS_ProfLong_Updt_TrffcSign.phys = getValue(this);
}

on EnvVar HMI_ADAS_ProfLong_Val_Cond_TrffcSign
{
    _mADAS_PROFILE_LONG_AR.ADAS_ProfLong_Val_Cond_TrffcSign.phys = getValue(this);
}

on EnvVar HMI_ADAS_ProfLong_Val_Lane_TrffcSign
{
    _mADAS_PROFILE_LONG_AR.ADAS_ProfLong_Val_Lane_TrffcSign.phys = getValue(this);
}

on EnvVar HMI_ADAS_ProfLong_Val_SignLoc_TrffcSign
{
    _mADAS_PROFILE_LONG_AR.ADAS_ProfLong_Val_SignLoc_TrffcSign.phys = getValue(this);
}

on EnvVar HMI_ADAS_ProfLong_Val_TmSpecf_TrffcSign
{
    _mADAS_PROFILE_LONG_AR.ADAS_ProfLong_Val_TmSpecf_TrffcSign.phys = getValue(this);
}

on EnvVar HMI_ADAS_ProfLong_Val_TrffcSign
{
    _mADAS_PROFILE_LONG_AR.ADAS_ProfLong_Val_TrffcSign.phys = getValue(this);
}

on EnvVar HMI_ADAS_ProfLong_Val_Typ_TrffcSign
{
    _mADAS_PROFILE_LONG_AR.ADAS_ProfLong_Val_Typ_TrffcSign.phys = getValue(this);
}

on EnvVar HMI_ADAS_ProfLong_Val_VehSpecf_TrffcSign
{
    _mADAS_PROFILE_LONG_AR.ADAS_ProfLong_Val_VehSpecf_TrffcSign.phys = getValue(this);
}

on EnvVar HMI_ADAS_ProfLong_CtrlPoint_ExtLn
{
    _mADAS_PROFILE_LONG_AR.ADAS_ProfLong_CtrlPoint_ExtLn.phys = getValue(this);
}

on EnvVar HMI_ADAS_ProfLong_CycCnt_ExtLane
{
    _mADAS_PROFILE_LONG_AR.ADAS_ProfLong_CycCnt_ExtLane.phys = getValue(this);
}

on EnvVar HMI_ADAS_ProfLong_MsgTyp_ExtLane
{
    _mADAS_PROFILE_LONG_AR.ADAS_ProfLong_MsgTyp_ExtLane.phys = getValue(this);
}

on EnvVar HMI_ADAS_ProfLong_Offset_ExtLane
{
    _mADAS_PROFILE_LONG_AR.ADAS_ProfLong_Offset_ExtLane.phys = getValue(this);
}

on EnvVar HMI_ADAS_ProfLong_PathIdx_ExtLane
{
    _mADAS_PROFILE_LONG_AR.ADAS_ProfLong_PathIdx_ExtLane.phys = getValue(this);
}

on EnvVar HMI_ADAS_ProfLong_ReTr_ExtLane
{
    _mADAS_PROFILE_LONG_AR.ADAS_ProfLong_ReTr_ExtLane.phys = getValue(this);
}

on EnvVar HMI_ADAS_ProfLong_Updt_ExtLane
{
    _mADAS_PROFILE_LONG_AR.ADAS_ProfLong_Updt_ExtLane.phys = getValue(this);
}

on EnvVar HMI_ADAS_ProfLong_Val_1stPredLane
{
    _mADAS_PROFILE_LONG_AR.ADAS_ProfLong_Val_1stPredLane.phys = getValue(this);
}

on EnvVar HMI_ADAS_ProfLong_Val_ArrowMark
{
    _mADAS_PROFILE_LONG_AR.ADAS_ProfLong_Val_ArrowMark.phys = getValue(this);
}

on EnvVar HMI_ADAS_ProfLong_Val_LaneMarking
{
    _mADAS_PROFILE_LONG_AR.ADAS_ProfLong_Val_LaneMarking.phys = getValue(this);
}

on EnvVar HMI_ADAS_ProfLong_Val_LaneNum
{
    _mADAS_PROFILE_LONG_AR.ADAS_ProfLong_Val_LaneNum.phys = getValue(this);
}

on EnvVar HMI_ADAS_ProfLong_Val_LaneType
{
    _mADAS_PROFILE_LONG_AR.ADAS_ProfLong_Val_LaneType.phys = getValue(this);
}

on EnvVar HMI_ADAS_ProfLong_Val_LstPredLane
{
    _mADAS_PROFILE_LONG_AR.ADAS_ProfLong_Val_LstPredLane.phys = getValue(this);
}

on EnvVar HMI_ADAS_ProfLong_Val_PrioPredLn
{
    _mADAS_PROFILE_LONG_AR.ADAS_ProfLong_Val_PrioPredLn.phys = getValue(this);
}

on EnvVar HMI_ADAS_ProfLong_Val_Yield
{
    _mADAS_PROFILE_LONG_AR.ADAS_ProfLong_Val_Yield.phys = getValue(this);
}

on EnvVar HMI_ADAS_ProfLong_CtrlPoint_NPSL1
{
    _mADAS_PROFILE_LONG_AR.ADAS_ProfLong_CtrlPoint_NPSL1.phys = getValue(this);
}

on EnvVar HMI_ADAS_ProfLong_CycCnt_NPSL1
{
    _mADAS_PROFILE_LONG_AR.ADAS_ProfLong_CycCnt_NPSL1.phys = getValue(this);
}

on EnvVar HMI_ADAS_ProfLong_MsgTyp_NPSL1
{
    _mADAS_PROFILE_LONG_AR.ADAS_ProfLong_MsgTyp_NPSL1.phys = getValue(this);
}

on EnvVar HMI_ADAS_ProfLong_Offset_NPSL1
{
    _mADAS_PROFILE_LONG_AR.ADAS_ProfLong_Offset_NPSL1.phys = getValue(this);
}

on EnvVar HMI_ADAS_ProfLong_PathIdx_NPSL1
{
    _mADAS_PROFILE_LONG_AR.ADAS_ProfLong_PathIdx_NPSL1.phys = getValue(this);
}

on EnvVar HMI_ADAS_ProfLong_ReTr_NPSL1
{
    _mADAS_PROFILE_LONG_AR.ADAS_ProfLong_ReTr_NPSL1.phys = getValue(this);
}

on EnvVar HMI_ADAS_ProfLong_Updt_NPSL1
{
    _mADAS_PROFILE_LONG_AR.ADAS_ProfLong_Updt_NPSL1.phys = getValue(this);
}

on EnvVar HMI_ADAS_ProfLong_Val_SpdLmt
{
    _mADAS_PROFILE_LONG_AR.ADAS_ProfLong_Val_SpdLmt.phys = getValue(this);
}

on EnvVar HMI_ADAS_ProfLong_Val_SpdLmt1
{
    _mADAS_PROFILE_LONG_AR.ADAS_ProfLong_Val_SpdLmt1.phys = getValue(this);
}

on EnvVar HMI_ADAS_ProfLong_Val_SpdTyp
{
    _mADAS_PROFILE_LONG_AR.ADAS_ProfLong_Val_SpdTyp.phys = getValue(this);
}

on EnvVar HMI_ADAS_ProfLong_Val_SpdTyp1
{
    _mADAS_PROFILE_LONG_AR.ADAS_ProfLong_Val_SpdTyp1.phys = getValue(this);
}

on EnvVar HMI_ADAS_ProfLong_Val_SpdUnt
{
    _mADAS_PROFILE_LONG_AR.ADAS_ProfLong_Val_SpdUnt.phys = getValue(this);
}

on EnvVar HMI_ADAS_ProfLong_Val_SpdVld
{
    _mADAS_PROFILE_LONG_AR.ADAS_ProfLong_Val_SpdVld.phys = getValue(this);
}

on EnvVar HMI_ADAS_ProfLong_Val_SpdVld1
{
    _mADAS_PROFILE_LONG_AR.ADAS_ProfLong_Val_SpdVld1.phys = getValue(this);
}

on EnvVar HMI_ADAS_ProfLong_CtrlPoint_NPSL2
{
    _mADAS_PROFILE_LONG_AR.ADAS_ProfLong_CtrlPoint_NPSL2.phys = getValue(this);
}

on EnvVar HMI_ADAS_ProfLong_CycCnt_NPSL2
{
    _mADAS_PROFILE_LONG_AR.ADAS_ProfLong_CycCnt_NPSL2.phys = getValue(this);
}

on EnvVar HMI_ADAS_ProfLong_MsgTyp_NPSL2
{
    _mADAS_PROFILE_LONG_AR.ADAS_ProfLong_MsgTyp_NPSL2.phys = getValue(this);
}

on EnvVar HMI_ADAS_ProfLong_Offset_NPSL2
{
    _mADAS_PROFILE_LONG_AR.ADAS_ProfLong_Offset_NPSL2.phys = getValue(this);
}

on EnvVar HMI_ADAS_ProfLong_PathIdx_NPSL2
{
    _mADAS_PROFILE_LONG_AR.ADAS_ProfLong_PathIdx_NPSL2.phys = getValue(this);
}

on EnvVar HMI_ADAS_ProfLong_ReTr_NPSL2
{
    _mADAS_PROFILE_LONG_AR.ADAS_ProfLong_ReTr_NPSL2.phys = getValue(this);
}

on EnvVar HMI_ADAS_ProfLong_Updt_NPSL2
{
    _mADAS_PROFILE_LONG_AR.ADAS_ProfLong_Updt_NPSL2.phys = getValue(this);
}

on EnvVar HMI_ADAS_ProfLong_Val_SpdLmt2
{
    _mADAS_PROFILE_LONG_AR.ADAS_ProfLong_Val_SpdLmt2.phys = getValue(this);
}

on EnvVar HMI_ADAS_ProfLong_Val_SpdTyp2
{
    _mADAS_PROFILE_LONG_AR.ADAS_ProfLong_Val_SpdTyp2.phys = getValue(this);
}

on EnvVar HMI_ADAS_ProfLong_Val_SpdUnt2
{
    _mADAS_PROFILE_LONG_AR.ADAS_ProfLong_Val_SpdUnt2.phys = getValue(this);
}

on EnvVar HMI_ADAS_ProfLong_Val_SpdVld2
{
    _mADAS_PROFILE_LONG_AR.ADAS_ProfLong_Val_SpdVld2.phys = getValue(this);
}

on EnvVar HMI_ADAS_ProfLong_CtrlPoint_FAPData
{
    _mADAS_PROFILE_LONG_AR.ADAS_ProfLong_CtrlPoint_FAPData.phys = getValue(this);
}

on EnvVar HMI_ADAS_ProfLong_CycCnt_FAPData
{
    _mADAS_PROFILE_LONG_AR.ADAS_ProfLong_CycCnt_FAPData.phys = getValue(this);
}

on EnvVar HMI_ADAS_ProfLong_MsgTyp_FAPData
{
    _mADAS_PROFILE_LONG_AR.ADAS_ProfLong_MsgTyp_FAPData.phys = getValue(this);
}

on EnvVar HMI_ADAS_ProfLong_Offset_FAPData
{
    _mADAS_PROFILE_LONG_AR.ADAS_ProfLong_Offset_FAPData.phys = getValue(this);
}

on EnvVar HMI_ADAS_ProfLong_PathIdx_FAPData
{
    _mADAS_PROFILE_LONG_AR.ADAS_ProfLong_PathIdx_FAPData.phys = getValue(this);
}

on EnvVar HMI_ADAS_ProfLong_ReTr_FAPData
{
    _mADAS_PROFILE_LONG_AR.ADAS_ProfLong_ReTr_FAPData.phys = getValue(this);
}

on EnvVar HMI_ADAS_ProfLong_Updt_FAPData
{
    _mADAS_PROFILE_LONG_AR.ADAS_ProfLong_Updt_FAPData.phys = getValue(this);
}
on EnvVar HMI_ADAS_ProfLong_Val_FAPData
{
    _mADAS_PROFILE_LONG_AR.ADAS_ProfLong_Val_FAPData.phys = getValue(this);
}

ADAS_PROFILE_SHORT_AR_check_output()
{
     if(  !getValue( HMI__STMSG_ADAS_PROFILE_SHORT_AR ) )
    {
        // Botschaft ADAS_PROFILE_SHORT_AR ID: 523 --- Sendeart cyclicX --- 
        _ADAS_PROFILE_SHORT_AR_Cnt--;
        if(  _ADAS_PROFILE_SHORT_AR_Cnt < 1 )
        {
            // Zyklus abgelaufen, Nachricht senden
            output( _mADAS_PROFILE_SHORT_AR );
            _ADAS_PROFILE_SHORT_AR_Cnt = _ADAS_PROFILE_SHORT_AR_CycleCount;
        }
    }
}

ADAS_PROFILE_SHORT_AR_init()
{   /* Botschaft ADAS_PROFILE_SHORT_AR ID: 523 --- Sendeart cyclicX --- 
BA_ "ApplMessage" BO_ 523 0;
BA_ "NmAsrMessage" BO_ 523 0;
BA_ "GenMsgMinAcceptLength" BO_ 523 8;
BA_ "GenMsgILSupport" BO_ 523 0;
BA_ "DiagState" BO_ 523 0;
BA_ "DiagRequest" BO_ 523 0;
BA_ "DiagResponse" BO_ 523 0;
BA_ "GenMsgStartValue" BO_ 523 "0";
BA_ "GenMsgStartDelayTime" BO_ 523 50;
BA_ "GenMsgCycleTime" BO_ 523 100;
BA_ "GenMsgSendType" BO_ 523 0;
    */
    _ADAS_PROFILE_SHORT_AR_Timebase =            c_tDBKomTimer_20ms;
    _ADAS_PROFILE_SHORT_AR_CycleCount =        100 / _ADAS_PROFILE_SHORT_AR_Timebase;
    _ADAS_PROFILE_SHORT_AR_StartDelay =         50 / _ADAS_PROFILE_SHORT_AR_Timebase;
    _ADAS_PROFILE_SHORT_AR_Cnt = _ADAS_PROFILE_SHORT_AR_StartDelay;

    putValue( HMI__STMSGSD_ADAS_PROFILE_SHORT_AR, _ADAS_PROFILE_SHORT_AR_StartDelay * _ADAS_PROFILE_SHORT_AR_Timebase );

    _mADAS_PROFILE_SHORT_AR.ADAS_ProfShort_Value0_CL.phys = getValue( HMI_ADAS_ProfShort_Value0_CL );
    _mADAS_PROFILE_SHORT_AR.ADAS_ProfShort_AccurClass_CL.phys = getValue( HMI_ADAS_ProfShort_AccurClass_CL );
    _mADAS_PROFILE_SHORT_AR.ADAS_ProfShort_Value1_CL.phys = getValue( HMI_ADAS_ProfShort_Value1_CL );
    _mADAS_PROFILE_SHORT_AR.ADAS_ProfShort_Dist1_CL.phys = getValue( HMI_ADAS_ProfShort_Dist1_CL );
    _mADAS_PROFILE_SHORT_AR.ADAS_ProfShort_ProfTyp.phys = getValue( HMI_ADAS_ProfShort_ProfTyp );
    _mADAS_PROFILE_SHORT_AR.ADAS_ProfShort_PathIdx_CL.phys = getValue( HMI_ADAS_ProfShort_PathIdx_CL );
    _mADAS_PROFILE_SHORT_AR.ADAS_ProfShort_Updt_CL.phys = getValue( HMI_ADAS_ProfShort_Updt_CL );
    _mADAS_PROFILE_SHORT_AR.ADAS_ProfShort_MsgTyp_CL.phys = getValue( HMI_ADAS_ProfShort_MsgTyp_CL );
    _mADAS_PROFILE_SHORT_AR.ADAS_ProfShort_ReTr_CL.phys = getValue( HMI_ADAS_ProfShort_ReTr_CL );
    _mADAS_PROFILE_SHORT_AR.ADAS_ProfShort_CycCnt_CL.phys = getValue( HMI_ADAS_ProfShort_CycCnt_CL );
    _mADAS_PROFILE_SHORT_AR.ADAS_ProfShort_CtrlPoint_CL.phys = getValue( HMI_ADAS_ProfShort_CtrlPoint_CL );
    _mADAS_PROFILE_SHORT_AR.ADAS_ProfShort_Offset_CL.phys = getValue( HMI_ADAS_ProfShort_Offset_CL );
    _mADAS_PROFILE_SHORT_AR.ADAS_ProfShort_Value1_RN.phys = getValue( HMI_ADAS_ProfShort_Value1_RN );
    _mADAS_PROFILE_SHORT_AR.ADAS_ProfShort_Dist1_RN.phys = getValue( HMI_ADAS_ProfShort_Dist1_RN );
    _mADAS_PROFILE_SHORT_AR.ADAS_ProfShort_Value0_RN.phys = getValue( HMI_ADAS_ProfShort_Value0_RN );
    _mADAS_PROFILE_SHORT_AR.ADAS_ProfShort_AccurClass_RN.phys = getValue( HMI_ADAS_ProfShort_AccurClass_RN );
    _mADAS_PROFILE_SHORT_AR.ADAS_ProfShort_Offset_RN.phys = getValue( HMI_ADAS_ProfShort_Offset_RN );
    _mADAS_PROFILE_SHORT_AR.ADAS_ProfShort_PathIdx_RN.phys = getValue( HMI_ADAS_ProfShort_PathIdx_RN );
    _mADAS_PROFILE_SHORT_AR.ADAS_ProfShort_Updt_RN.phys = getValue( HMI_ADAS_ProfShort_Updt_RN );
    _mADAS_PROFILE_SHORT_AR.ADAS_ProfShort_MsgTyp_RN.phys = getValue( HMI_ADAS_ProfShort_MsgTyp_RN );
    _mADAS_PROFILE_SHORT_AR.ADAS_ProfShort_ReTr_RN.phys = getValue( HMI_ADAS_ProfShort_ReTr_RN );
    _mADAS_PROFILE_SHORT_AR.ADAS_ProfShort_CycCnt_RN.phys = getValue( HMI_ADAS_ProfShort_CycCnt_RN );
    _mADAS_PROFILE_SHORT_AR.ADAS_ProfShort_CtrlPoint_RN.phys = getValue( HMI_ADAS_ProfShort_CtrlPoint_RN );
    _mADAS_PROFILE_SHORT_AR.ADAS_ProfShort_Value1_SS.phys = getValue( HMI_ADAS_ProfShort_Value1_SS );
    _mADAS_PROFILE_SHORT_AR.ADAS_ProfShort_Offset_SS.phys = getValue( HMI_ADAS_ProfShort_Offset_SS );
    _mADAS_PROFILE_SHORT_AR.ADAS_ProfShort_PathIdx_SS.phys = getValue( HMI_ADAS_ProfShort_PathIdx_SS );
    _mADAS_PROFILE_SHORT_AR.ADAS_ProfShort_Updt_SS.phys = getValue( HMI_ADAS_ProfShort_Updt_SS );
    _mADAS_PROFILE_SHORT_AR.ADAS_ProfShort_MsgTyp_SS.phys = getValue( HMI_ADAS_ProfShort_MsgTyp_SS );
    _mADAS_PROFILE_SHORT_AR.ADAS_ProfShort_ReTr_SS.phys = getValue( HMI_ADAS_ProfShort_ReTr_SS );
    _mADAS_PROFILE_SHORT_AR.ADAS_ProfShort_CycCnt_SS.phys = getValue( HMI_ADAS_ProfShort_CycCnt_SS );
    _mADAS_PROFILE_SHORT_AR.ADAS_ProfShort_CtrlPoint_SS.phys = getValue( HMI_ADAS_ProfShort_CtrlPoint_SS );
    _mADAS_PROFILE_SHORT_AR.ADAS_ProfShort_Dist1_SS.phys = getValue( HMI_ADAS_ProfShort_Dist1_SS );
    _mADAS_PROFILE_SHORT_AR.ADAS_ProfShort_Value0_SS.phys = getValue( HMI_ADAS_ProfShort_Value0_SS );
    _mADAS_PROFILE_SHORT_AR.ADAS_ProfShort_AccurClass_SS.phys = getValue( HMI_ADAS_ProfShort_AccurClass_SS );
    _mADAS_PROFILE_SHORT_AR.ADAS_ProfShort_Value1_SL.phys = getValue( HMI_ADAS_ProfShort_Value1_SL );
    _mADAS_PROFILE_SHORT_AR.ADAS_ProfShort_Offset_SL.phys = getValue( HMI_ADAS_ProfShort_Offset_SL );
    _mADAS_PROFILE_SHORT_AR.ADAS_ProfShort_PathIdx_SL.phys = getValue( HMI_ADAS_ProfShort_PathIdx_SL );
    _mADAS_PROFILE_SHORT_AR.ADAS_ProfShort_Updt_SL.phys = getValue( HMI_ADAS_ProfShort_Updt_SL );
    _mADAS_PROFILE_SHORT_AR.ADAS_ProfShort_MsgTyp_SL.phys = getValue( HMI_ADAS_ProfShort_MsgTyp_SL );
    _mADAS_PROFILE_SHORT_AR.ADAS_ProfShort_ReTr_SL.phys = getValue( HMI_ADAS_ProfShort_ReTr_SL );
    _mADAS_PROFILE_SHORT_AR.ADAS_ProfShort_CycCnt_SL.phys = getValue( HMI_ADAS_ProfShort_CycCnt_SL );
    _mADAS_PROFILE_SHORT_AR.ADAS_ProfShort_CtrlPoint_SL.phys = getValue( HMI_ADAS_ProfShort_CtrlPoint_SL );
    _mADAS_PROFILE_SHORT_AR.ADAS_ProfShort_AccurClass_SL.phys = getValue( HMI_ADAS_ProfShort_AccurClass_SL );
    _mADAS_PROFILE_SHORT_AR.ADAS_ProfShort_Dist1_SL.phys = getValue( HMI_ADAS_ProfShort_Dist1_SL );
    _mADAS_PROFILE_SHORT_AR.ADAS_ProfShort_Value0_SL.phys = getValue( HMI_ADAS_ProfShort_Value0_SL );
    _mADAS_PROFILE_SHORT_AR.ADAS_ProfShort_Dist1_RA.phys = getValue( HMI_ADAS_ProfShort_Dist1_RA );
    _mADAS_PROFILE_SHORT_AR.ADAS_ProfShort_Value1_RA.phys = getValue( HMI_ADAS_ProfShort_Value1_RA );
    _mADAS_PROFILE_SHORT_AR.ADAS_ProfShort_Offset_RA.phys = getValue( HMI_ADAS_ProfShort_Offset_RA );
    _mADAS_PROFILE_SHORT_AR.ADAS_ProfShort_PathIdx_RA.phys = getValue( HMI_ADAS_ProfShort_PathIdx_RA );
    _mADAS_PROFILE_SHORT_AR.ADAS_ProfShort_Updt_RA.phys = getValue( HMI_ADAS_ProfShort_Updt_RA );
    _mADAS_PROFILE_SHORT_AR.ADAS_ProfShort_MsgTyp_RA.phys = getValue( HMI_ADAS_ProfShort_MsgTyp_RA );
    _mADAS_PROFILE_SHORT_AR.ADAS_ProfShort_ReTr_RA.phys = getValue( HMI_ADAS_ProfShort_ReTr_RA );
    _mADAS_PROFILE_SHORT_AR.ADAS_ProfShort_CycCnt_RA.phys = getValue( HMI_ADAS_ProfShort_CycCnt_RA );
    _mADAS_PROFILE_SHORT_AR.ADAS_ProfShort_CtrlPoint_RA.phys = getValue( HMI_ADAS_ProfShort_CtrlPoint_RA );
    _mADAS_PROFILE_SHORT_AR.ADAS_ProfShort_Value0_RA.phys = getValue( HMI_ADAS_ProfShort_Value0_RA );
    _mADAS_PROFILE_SHORT_AR.ADAS_ProfShort_AccurClass_RA.phys = getValue( HMI_ADAS_ProfShort_AccurClass_RA );
    _mADAS_PROFILE_SHORT_AR.ADAS_ProfShort_Dist1_RC.phys = getValue( HMI_ADAS_ProfShort_Dist1_RC );
    _mADAS_PROFILE_SHORT_AR.ADAS_ProfShort_Value0_RC.phys = getValue( HMI_ADAS_ProfShort_Value0_RC );
    _mADAS_PROFILE_SHORT_AR.ADAS_ProfShort_AccurClass_RC.phys = getValue( HMI_ADAS_ProfShort_AccurClass_RC );
    _mADAS_PROFILE_SHORT_AR.ADAS_ProfShort_Offset_RC.phys = getValue( HMI_ADAS_ProfShort_Offset_RC );
    _mADAS_PROFILE_SHORT_AR.ADAS_ProfShort_PathIdx_RC.phys = getValue( HMI_ADAS_ProfShort_PathIdx_RC );
    _mADAS_PROFILE_SHORT_AR.ADAS_ProfShort_Updt_RC.phys = getValue( HMI_ADAS_ProfShort_Updt_RC );
    _mADAS_PROFILE_SHORT_AR.ADAS_ProfShort_MsgTyp_RC.phys = getValue( HMI_ADAS_ProfShort_MsgTyp_RC );
    _mADAS_PROFILE_SHORT_AR.ADAS_ProfShort_ReTr_RC.phys = getValue( HMI_ADAS_ProfShort_ReTr_RC );
    _mADAS_PROFILE_SHORT_AR.ADAS_ProfShort_CycCnt_RC.phys = getValue( HMI_ADAS_ProfShort_CycCnt_RC );
    _mADAS_PROFILE_SHORT_AR.ADAS_ProfShort_CtrlPoint_RC.phys = getValue( HMI_ADAS_ProfShort_CtrlPoint_RC );
    _mADAS_PROFILE_SHORT_AR.ADAS_ProfShort_Value1_RC.phys = getValue( HMI_ADAS_ProfShort_Value1_RC );
    _mADAS_PROFILE_SHORT_AR.ADAS_ProfShort_Value0_VSS.phys = getValue( HMI_ADAS_ProfShort_Value0_VSS );
    _mADAS_PROFILE_SHORT_AR.ADAS_ProfShort_Dist1_VSS.phys = getValue( HMI_ADAS_ProfShort_Dist1_VSS );
    _mADAS_PROFILE_SHORT_AR.ADAS_ProfShort_Value1_VSS.phys = getValue( HMI_ADAS_ProfShort_Value1_VSS );
    _mADAS_PROFILE_SHORT_AR.ADAS_ProfShort_Offset_VSS.phys = getValue( HMI_ADAS_ProfShort_Offset_VSS );
    _mADAS_PROFILE_SHORT_AR.ADAS_ProfShort_PathIdx_VSS.phys = getValue( HMI_ADAS_ProfShort_PathIdx_VSS );
    _mADAS_PROFILE_SHORT_AR.ADAS_ProfShort_Updt_VSS.phys = getValue( HMI_ADAS_ProfShort_Updt_VSS );
    _mADAS_PROFILE_SHORT_AR.ADAS_ProfShort_MsgTyp_VSS.phys = getValue( HMI_ADAS_ProfShort_MsgTyp_VSS );
    _mADAS_PROFILE_SHORT_AR.ADAS_ProfShort_ReTr_VSS.phys = getValue( HMI_ADAS_ProfShort_ReTr_VSS );
    _mADAS_PROFILE_SHORT_AR.ADAS_ProfShort_CycCnt_VSS.phys = getValue( HMI_ADAS_ProfShort_CycCnt_VSS );
    _mADAS_PROFILE_SHORT_AR.ADAS_ProfShort_CtrlPoint_VSS.phys = getValue( HMI_ADAS_ProfShort_CtrlPoint_VSS );
    _mADAS_PROFILE_SHORT_AR.ADAS_ProfShort_AccurClass_VSS.phys = getValue( HMI_ADAS_ProfShort_AccurClass_VSS );
    _mADAS_PROFILE_SHORT_AR.ADAS_ProfShort_Dist1_HCS.phys = getValue( HMI_ADAS_ProfShort_Dist1_HCS );
    _mADAS_PROFILE_SHORT_AR.ADAS_ProfShort_Value1_HCS.phys = getValue( HMI_ADAS_ProfShort_Value1_HCS );
    _mADAS_PROFILE_SHORT_AR.ADAS_ProfShort_Offset_HCS.phys = getValue( HMI_ADAS_ProfShort_Offset_HCS );
    _mADAS_PROFILE_SHORT_AR.ADAS_ProfShort_PathIdx_HCS.phys = getValue( HMI_ADAS_ProfShort_PathIdx_HCS );
    _mADAS_PROFILE_SHORT_AR.ADAS_ProfShort_Updt_HCS.phys = getValue( HMI_ADAS_ProfShort_Updt_HCS );
    _mADAS_PROFILE_SHORT_AR.ADAS_ProfShort_MsgTyp_HCS.phys = getValue( HMI_ADAS_ProfShort_MsgTyp_HCS );
    _mADAS_PROFILE_SHORT_AR.ADAS_ProfShort_ReTr_HCS.phys = getValue( HMI_ADAS_ProfShort_ReTr_HCS );
    _mADAS_PROFILE_SHORT_AR.ADAS_ProfShort_CycCnt_HCS.phys = getValue( HMI_ADAS_ProfShort_CycCnt_HCS );
    _mADAS_PROFILE_SHORT_AR.ADAS_ProfShort_CtrlPoint_HCS.phys = getValue( HMI_ADAS_ProfShort_CtrlPoint_HCS );
    _mADAS_PROFILE_SHORT_AR.ADAS_ProfShort_Value0_HCS.phys = getValue( HMI_ADAS_ProfShort_Value0_HCS );
    _mADAS_PROFILE_SHORT_AR.ADAS_ProfShort_AccurClass_HCS.phys = getValue( HMI_ADAS_ProfShort_AccurClass_HCS );
    _mADAS_PROFILE_SHORT_AR.ADAS_ProfShort_AccurClass_LD.phys = getValue( HMI_ADAS_ProfShort_AccurClass_LD );
    _mADAS_PROFILE_SHORT_AR.ADAS_ProfShort_Dist1_LD.phys = getValue( HMI_ADAS_ProfShort_Dist1_LD );
    _mADAS_PROFILE_SHORT_AR.ADAS_ProfShort_Value1_LT.phys = getValue( HMI_ADAS_ProfShort_Value1_LT );
    _mADAS_PROFILE_SHORT_AR.ADAS_ProfShort_Updt_LD.phys = getValue( HMI_ADAS_ProfShort_Updt_LD );
    _mADAS_PROFILE_SHORT_AR.ADAS_ProfShort_ReTr_LD.phys = getValue( HMI_ADAS_ProfShort_ReTr_LD );
    _mADAS_PROFILE_SHORT_AR.ADAS_ProfShort_PathIdx_LD.phys = getValue( HMI_ADAS_ProfShort_PathIdx_LD );
    _mADAS_PROFILE_SHORT_AR.ADAS_ProfShort_Offset_LD.phys = getValue( HMI_ADAS_ProfShort_Offset_LD );
    _mADAS_PROFILE_SHORT_AR.ADAS_ProfShort_MsgTyp_LD.phys = getValue( HMI_ADAS_ProfShort_MsgTyp_LD );
    _mADAS_PROFILE_SHORT_AR.ADAS_ProfShort_CycCnt_LD.phys = getValue( HMI_ADAS_ProfShort_CycCnt_LD );
    _mADAS_PROFILE_SHORT_AR.ADAS_ProfShort_CtrlPoint_LD.phys = getValue( HMI_ADAS_ProfShort_CtrlPoint_LD );
    _mADAS_PROFILE_SHORT_AR.ADAS_ProfShort_Value0_LT.phys = getValue( HMI_ADAS_ProfShort_Value0_LT );
    _mADAS_PROFILE_SHORT_AR.ADAS_ProfShort_Value1_DT.phys = getValue( HMI_ADAS_ProfShort_Value1_DT );
    _mADAS_PROFILE_SHORT_AR.ADAS_ProfShort_Value0_DT.phys = getValue( HMI_ADAS_ProfShort_Value0_DT );
}

ADAS_PROFILE_SHORT_AR_saveEnvVars( dword hFile )
{
    filePutString("\n// Knoten TGW: ADAS_PROFILE_SHORT_AR\n", 38, hFile);
    snprintf( buffer, elcount(buffer), "0.0000 HMI__STMSG_ADAS_PROFILE_SHORT_AR := %X\n", getValue( HMI__STMSG_ADAS_PROFILE_SHORT_AR ) );        filePutString( buffer, elcount(buffer), hFile);
    snprintf( buffer, elcount(buffer), "0.0000 HMI__STMSGTADAS_PROFILE_SHORT_AR := %X\n", getValue( HMI__STMSGT_ADAS_PROFILE_SHORT_AR ) );        filePutString( buffer, elcount(buffer), hFile);
    snprintf( buffer, elcount(buffer), "0.0000 HMI_ADAS_ProfShort_Value0_CL := %X\n", getValue( HMI_ADAS_ProfShort_Value0_CL ));        filePutString( buffer, elcount(buffer), hFile);
    snprintf( buffer, elcount(buffer), "0.0000 HMI_ADAS_ProfShort_AccurClass_CL := %X\n", getValue( HMI_ADAS_ProfShort_AccurClass_CL ));        filePutString( buffer, elcount(buffer), hFile);
    snprintf( buffer, elcount(buffer), "0.0000 HMI_ADAS_ProfShort_Value1_CL := %X\n", getValue( HMI_ADAS_ProfShort_Value1_CL ));        filePutString( buffer, elcount(buffer), hFile);
    snprintf( buffer, elcount(buffer), "0.0000 HMI_ADAS_ProfShort_Dist1_CL := %X\n", getValue( HMI_ADAS_ProfShort_Dist1_CL ));        filePutString( buffer, elcount(buffer), hFile);
    snprintf( buffer, elcount(buffer), "0.0000 HMI_ADAS_ProfShort_ProfTyp := %X\n", getValue(HMI_ADAS_ProfShort_ProfTyp));        filePutString (buffer, elcount(buffer), hFile);
    snprintf( buffer, elcount(buffer), "0.0000 HMI_ADAS_ProfShort_PathIdx_CL := %X\n", getValue( HMI_ADAS_ProfShort_PathIdx_CL ));        filePutString( buffer, elcount(buffer), hFile);
    snprintf( buffer, elcount(buffer), "0.0000 HMI_ADAS_ProfShort_Updt_CL := %X\n", getValue( HMI_ADAS_ProfShort_Updt_CL ));        filePutString( buffer, elcount(buffer), hFile);
    snprintf( buffer, elcount(buffer), "0.0000 HMI_ADAS_ProfShort_MsgTyp_CL := %X\n", getValue( HMI_ADAS_ProfShort_MsgTyp_CL ));        filePutString( buffer, elcount(buffer), hFile);
    snprintf( buffer, elcount(buffer), "0.0000 HMI_ADAS_ProfShort_ReTr_CL := %X\n", getValue( HMI_ADAS_ProfShort_ReTr_CL ));        filePutString( buffer, elcount(buffer), hFile);
    snprintf( buffer, elcount(buffer), "0.0000 HMI_ADAS_ProfShort_CycCnt_CL := %X\n", getValue( HMI_ADAS_ProfShort_CycCnt_CL ));        filePutString( buffer, elcount(buffer), hFile);
    snprintf( buffer, elcount(buffer), "0.0000 HMI_ADAS_ProfShort_CtrlPoint_CL := %X\n", getValue( HMI_ADAS_ProfShort_CtrlPoint_CL ));        filePutString( buffer, elcount(buffer), hFile);
    snprintf( buffer, elcount(buffer), "0.0000 HMI_ADAS_ProfShort_Offset_CL := %X\n", getValue( HMI_ADAS_ProfShort_Offset_CL ));        filePutString( buffer, elcount(buffer), hFile);
    snprintf( buffer, elcount(buffer), "0.0000 HMI_ADAS_ProfShort_Value1_RN := %X\n", getValue( HMI_ADAS_ProfShort_Value1_RN ));        filePutString( buffer, elcount(buffer), hFile);
    snprintf( buffer, elcount(buffer), "0.0000 HMI_ADAS_ProfShort_Dist1_RN := %X\n", getValue( HMI_ADAS_ProfShort_Dist1_RN ));        filePutString( buffer, elcount(buffer), hFile);
    snprintf( buffer, elcount(buffer), "0.0000 HMI_ADAS_ProfShort_Value0_RN := %X\n", getValue( HMI_ADAS_ProfShort_Value0_RN ));        filePutString( buffer, elcount(buffer), hFile);
    snprintf( buffer, elcount(buffer), "0.0000 HMI_ADAS_ProfShort_AccurClass_RN := %X\n", getValue( HMI_ADAS_ProfShort_AccurClass_RN ));        filePutString( buffer, elcount(buffer), hFile);
    snprintf( buffer, elcount(buffer), "0.0000 HMI_ADAS_ProfShort_Offset_RN := %X\n", getValue( HMI_ADAS_ProfShort_Offset_RN ));        filePutString( buffer, elcount(buffer), hFile);
    snprintf( buffer, elcount(buffer), "0.0000 HMI_ADAS_ProfShort_PathIdx_RN := %X\n", getValue( HMI_ADAS_ProfShort_PathIdx_RN ));        filePutString( buffer, elcount(buffer), hFile);
    snprintf( buffer, elcount(buffer), "0.0000 HMI_ADAS_ProfShort_Updt_RN := %X\n", getValue( HMI_ADAS_ProfShort_Updt_RN ));        filePutString( buffer, elcount(buffer), hFile);
    snprintf( buffer, elcount(buffer), "0.0000 HMI_ADAS_ProfShort_MsgTyp_RN := %X\n", getValue( HMI_ADAS_ProfShort_MsgTyp_RN ));        filePutString( buffer, elcount(buffer), hFile);
    snprintf( buffer, elcount(buffer), "0.0000 HMI_ADAS_ProfShort_ReTr_RN := %X\n", getValue( HMI_ADAS_ProfShort_ReTr_RN ));        filePutString( buffer, elcount(buffer), hFile);
    snprintf( buffer, elcount(buffer), "0.0000 HMI_ADAS_ProfShort_CycCnt_RN := %X\n", getValue( HMI_ADAS_ProfShort_CycCnt_RN ));        filePutString( buffer, elcount(buffer), hFile);
    snprintf( buffer, elcount(buffer), "0.0000 HMI_ADAS_ProfShort_CtrlPoint_RN := %X\n", getValue( HMI_ADAS_ProfShort_CtrlPoint_RN ));        filePutString( buffer, elcount(buffer), hFile);
    snprintf( buffer, elcount(buffer), "0.0000 HMI_ADAS_ProfShort_Value1_SS := %X\n", getValue( HMI_ADAS_ProfShort_Value1_SS ));        filePutString( buffer, elcount(buffer), hFile);
    snprintf( buffer, elcount(buffer), "0.0000 HMI_ADAS_ProfShort_Offset_SS := %X\n", getValue( HMI_ADAS_ProfShort_Offset_SS ));        filePutString( buffer, elcount(buffer), hFile);
    snprintf( buffer, elcount(buffer), "0.0000 HMI_ADAS_ProfShort_PathIdx_SS := %X\n", getValue( HMI_ADAS_ProfShort_PathIdx_SS ));        filePutString( buffer, elcount(buffer), hFile);
    snprintf( buffer, elcount(buffer), "0.0000 HMI_ADAS_ProfShort_Updt_SS := %X\n", getValue( HMI_ADAS_ProfShort_Updt_SS ));        filePutString( buffer, elcount(buffer), hFile);
    snprintf( buffer, elcount(buffer), "0.0000 HMI_ADAS_ProfShort_MsgTyp_SS := %X\n", getValue( HMI_ADAS_ProfShort_MsgTyp_SS ));        filePutString( buffer, elcount(buffer), hFile);
    snprintf( buffer, elcount(buffer), "0.0000 HMI_ADAS_ProfShort_ReTr_SS := %X\n", getValue( HMI_ADAS_ProfShort_ReTr_SS ));        filePutString( buffer, elcount(buffer), hFile);
    snprintf( buffer, elcount(buffer), "0.0000 HMI_ADAS_ProfShort_CycCnt_SS := %X\n", getValue( HMI_ADAS_ProfShort_CycCnt_SS ));        filePutString( buffer, elcount(buffer), hFile);
    snprintf( buffer, elcount(buffer), "0.0000 HMI_ADAS_ProfShort_CtrlPoint_SS := %X\n", getValue( HMI_ADAS_ProfShort_CtrlPoint_SS ));        filePutString( buffer, elcount(buffer), hFile);
    snprintf( buffer, elcount(buffer), "0.0000 HMI_ADAS_ProfShort_Dist1_SS := %X\n", getValue( HMI_ADAS_ProfShort_Dist1_SS ));        filePutString( buffer, elcount(buffer), hFile);
    snprintf( buffer, elcount(buffer), "0.0000 HMI_ADAS_ProfShort_Value0_SS := %X\n", getValue( HMI_ADAS_ProfShort_Value0_SS ));        filePutString( buffer, elcount(buffer), hFile);
    snprintf( buffer, elcount(buffer), "0.0000 HMI_ADAS_ProfShort_AccurClass_SS := %X\n", getValue( HMI_ADAS_ProfShort_AccurClass_SS ));        filePutString( buffer, elcount(buffer), hFile);
    snprintf( buffer, elcount(buffer), "0.0000 HMI_ADAS_ProfShort_Value1_SL := %X\n", getValue( HMI_ADAS_ProfShort_Value1_SL ));        filePutString( buffer, elcount(buffer), hFile);
    snprintf( buffer, elcount(buffer), "0.0000 HMI_ADAS_ProfShort_Offset_SL := %X\n", getValue( HMI_ADAS_ProfShort_Offset_SL ));        filePutString( buffer, elcount(buffer), hFile);
    snprintf( buffer, elcount(buffer), "0.0000 HMI_ADAS_ProfShort_PathIdx_SL := %X\n", getValue( HMI_ADAS_ProfShort_PathIdx_SL ));        filePutString( buffer, elcount(buffer), hFile);
    snprintf( buffer, elcount(buffer), "0.0000 HMI_ADAS_ProfShort_Updt_SL := %X\n", getValue( HMI_ADAS_ProfShort_Updt_SL ));        filePutString( buffer, elcount(buffer), hFile);
    snprintf( buffer, elcount(buffer), "0.0000 HMI_ADAS_ProfShort_MsgTyp_SL := %X\n", getValue( HMI_ADAS_ProfShort_MsgTyp_SL ));        filePutString( buffer, elcount(buffer), hFile);
    snprintf( buffer, elcount(buffer), "0.0000 HMI_ADAS_ProfShort_ReTr_SL := %X\n", getValue( HMI_ADAS_ProfShort_ReTr_SL ));        filePutString( buffer, elcount(buffer), hFile);
    snprintf( buffer, elcount(buffer), "0.0000 HMI_ADAS_ProfShort_CycCnt_SL := %X\n", getValue( HMI_ADAS_ProfShort_CycCnt_SL ));        filePutString( buffer, elcount(buffer), hFile);
    snprintf( buffer, elcount(buffer), "0.0000 HMI_ADAS_ProfShort_CtrlPoint_SL := %X\n", getValue( HMI_ADAS_ProfShort_CtrlPoint_SL ));        filePutString( buffer, elcount(buffer), hFile);
    snprintf( buffer, elcount(buffer), "0.0000 HMI_ADAS_ProfShort_AccurClass_SL := %X\n", getValue( HMI_ADAS_ProfShort_AccurClass_SL ));        filePutString( buffer, elcount(buffer), hFile);
    snprintf( buffer, elcount(buffer), "0.0000 HMI_ADAS_ProfShort_Dist1_SL := %X\n", getValue( HMI_ADAS_ProfShort_Dist1_SL ));        filePutString( buffer, elcount(buffer), hFile);
    snprintf( buffer, elcount(buffer), "0.0000 HMI_ADAS_ProfShort_Value0_SL := %X\n", getValue( HMI_ADAS_ProfShort_Value0_SL ));        filePutString( buffer, elcount(buffer), hFile);
    snprintf( buffer, elcount(buffer), "0.0000 HMI_ADAS_ProfShort_Dist1_RA := %X\n", getValue( HMI_ADAS_ProfShort_Dist1_RA ));        filePutString( buffer, elcount(buffer), hFile);
    snprintf( buffer, elcount(buffer), "0.0000 HMI_ADAS_ProfShort_Value1_RA := %X\n", getValue( HMI_ADAS_ProfShort_Value1_RA ));        filePutString( buffer, elcount(buffer), hFile);
    snprintf( buffer, elcount(buffer), "0.0000 HMI_ADAS_ProfShort_Offset_RA := %X\n", getValue( HMI_ADAS_ProfShort_Offset_RA ));        filePutString( buffer, elcount(buffer), hFile);
    snprintf( buffer, elcount(buffer), "0.0000 HMI_ADAS_ProfShort_PathIdx_RA := %X\n", getValue( HMI_ADAS_ProfShort_PathIdx_RA ));        filePutString( buffer, elcount(buffer), hFile);
    snprintf( buffer, elcount(buffer), "0.0000 HMI_ADAS_ProfShort_Updt_RA := %X\n", getValue( HMI_ADAS_ProfShort_Updt_RA ));        filePutString( buffer, elcount(buffer), hFile);
    snprintf( buffer, elcount(buffer), "0.0000 HMI_ADAS_ProfShort_MsgTyp_RA := %X\n", getValue( HMI_ADAS_ProfShort_MsgTyp_RA ));        filePutString( buffer, elcount(buffer), hFile);
    snprintf( buffer, elcount(buffer), "0.0000 HMI_ADAS_ProfShort_ReTr_RA := %X\n", getValue( HMI_ADAS_ProfShort_ReTr_RA ));        filePutString( buffer, elcount(buffer), hFile);
    snprintf( buffer, elcount(buffer), "0.0000 HMI_ADAS_ProfShort_CycCnt_RA := %X\n", getValue( HMI_ADAS_ProfShort_CycCnt_RA ));        filePutString( buffer, elcount(buffer), hFile);
    snprintf( buffer, elcount(buffer), "0.0000 HMI_ADAS_ProfShort_CtrlPoint_RA := %X\n", getValue( HMI_ADAS_ProfShort_CtrlPoint_RA ));        filePutString( buffer, elcount(buffer), hFile);
    snprintf( buffer, elcount(buffer), "0.0000 HMI_ADAS_ProfShort_Value0_RA := %X\n", getValue( HMI_ADAS_ProfShort_Value0_RA ));        filePutString( buffer, elcount(buffer), hFile);
    snprintf( buffer, elcount(buffer), "0.0000 HMI_ADAS_ProfShort_AccurClass_RA := %X\n", getValue( HMI_ADAS_ProfShort_AccurClass_RA ));        filePutString( buffer, elcount(buffer), hFile);
    snprintf( buffer, elcount(buffer), "0.0000 HMI_ADAS_ProfShort_Dist1_RC := %X\n", getValue( HMI_ADAS_ProfShort_Dist1_RC ));        filePutString( buffer, elcount(buffer), hFile);
    snprintf( buffer, elcount(buffer), "0.0000 HMI_ADAS_ProfShort_Value0_RC := %X\n", getValue( HMI_ADAS_ProfShort_Value0_RC ));        filePutString( buffer, elcount(buffer), hFile);
    snprintf( buffer, elcount(buffer), "0.0000 HMI_ADAS_ProfShort_AccurClass_RC := %X\n", getValue( HMI_ADAS_ProfShort_AccurClass_RC ));        filePutString( buffer, elcount(buffer), hFile);
    snprintf( buffer, elcount(buffer), "0.0000 HMI_ADAS_ProfShort_Offset_RC := %X\n", getValue( HMI_ADAS_ProfShort_Offset_RC ));        filePutString( buffer, elcount(buffer), hFile);
    snprintf( buffer, elcount(buffer), "0.0000 HMI_ADAS_ProfShort_PathIdx_RC := %X\n", getValue( HMI_ADAS_ProfShort_PathIdx_RC ));        filePutString( buffer, elcount(buffer), hFile);
    snprintf( buffer, elcount(buffer), "0.0000 HMI_ADAS_ProfShort_Updt_RC := %X\n", getValue( HMI_ADAS_ProfShort_Updt_RC ));        filePutString( buffer, elcount(buffer), hFile);
    snprintf( buffer, elcount(buffer), "0.0000 HMI_ADAS_ProfShort_MsgTyp_RC := %X\n", getValue( HMI_ADAS_ProfShort_MsgTyp_RC ));        filePutString( buffer, elcount(buffer), hFile);
    snprintf( buffer, elcount(buffer), "0.0000 HMI_ADAS_ProfShort_ReTr_RC := %X\n", getValue( HMI_ADAS_ProfShort_ReTr_RC ));        filePutString( buffer, elcount(buffer), hFile);
    snprintf( buffer, elcount(buffer), "0.0000 HMI_ADAS_ProfShort_CycCnt_RC := %X\n", getValue( HMI_ADAS_ProfShort_CycCnt_RC ));        filePutString( buffer, elcount(buffer), hFile);
    snprintf( buffer, elcount(buffer), "0.0000 HMI_ADAS_ProfShort_CtrlPoint_RC := %X\n", getValue( HMI_ADAS_ProfShort_CtrlPoint_RC ));        filePutString( buffer, elcount(buffer), hFile);
    snprintf( buffer, elcount(buffer), "0.0000 HMI_ADAS_ProfShort_Value1_RC := %X\n", getValue( HMI_ADAS_ProfShort_Value1_RC ));        filePutString( buffer, elcount(buffer), hFile);
    snprintf( buffer, elcount(buffer), "0.0000 HMI_ADAS_ProfShort_Value0_VSS := %X\n", getValue( HMI_ADAS_ProfShort_Value0_VSS ));        filePutString( buffer, elcount(buffer), hFile);
    snprintf( buffer, elcount(buffer), "0.0000 HMI_ADAS_ProfShort_Dist1_VSS := %X\n", getValue( HMI_ADAS_ProfShort_Dist1_VSS ));        filePutString( buffer, elcount(buffer), hFile);
    snprintf( buffer, elcount(buffer), "0.0000 HMI_ADAS_ProfShort_Value1_VSS := %X\n", getValue( HMI_ADAS_ProfShort_Value1_VSS ));        filePutString( buffer, elcount(buffer), hFile);
    snprintf( buffer, elcount(buffer), "0.0000 HMI_ADAS_ProfShort_Offset_VSS := %X\n", getValue( HMI_ADAS_ProfShort_Offset_VSS ));        filePutString( buffer, elcount(buffer), hFile);
    snprintf( buffer, elcount(buffer), "0.0000 HMI_ADAS_ProfShort_PathIdx_VSS := %X\n", getValue( HMI_ADAS_ProfShort_PathIdx_VSS ));        filePutString( buffer, elcount(buffer), hFile);
    snprintf( buffer, elcount(buffer), "0.0000 HMI_ADAS_ProfShort_Updt_VSS := %X\n", getValue( HMI_ADAS_ProfShort_Updt_VSS ));        filePutString( buffer, elcount(buffer), hFile);
    snprintf( buffer, elcount(buffer), "0.0000 HMI_ADAS_ProfShort_MsgTyp_VSS := %X\n", getValue( HMI_ADAS_ProfShort_MsgTyp_VSS ));        filePutString( buffer, elcount(buffer), hFile);
    snprintf( buffer, elcount(buffer), "0.0000 HMI_ADAS_ProfShort_ReTr_VSS := %X\n", getValue( HMI_ADAS_ProfShort_ReTr_VSS ));        filePutString( buffer, elcount(buffer), hFile);
    snprintf( buffer, elcount(buffer), "0.0000 HMI_ADAS_ProfShort_CycCnt_VSS := %X\n", getValue( HMI_ADAS_ProfShort_CycCnt_VSS ));        filePutString( buffer, elcount(buffer), hFile);
    snprintf( buffer, elcount(buffer), "0.0000 HMI_ADAS_ProfShort_CtrlPoint_VSS := %X\n", getValue( HMI_ADAS_ProfShort_CtrlPoint_VSS ));        filePutString( buffer, elcount(buffer), hFile);
    snprintf( buffer, elcount(buffer), "0.0000 HMI_ADAS_ProfShort_AccurClass_VSS := %X\n", getValue( HMI_ADAS_ProfShort_AccurClass_VSS ));        filePutString( buffer, elcount(buffer), hFile);
    snprintf( buffer, elcount(buffer), "0.0000 HMI_ADAS_ProfShort_Dist1_HCS := %X\n", getValue( HMI_ADAS_ProfShort_Dist1_HCS ));        filePutString( buffer, elcount(buffer), hFile);
    snprintf( buffer, elcount(buffer), "0.0000 HMI_ADAS_ProfShort_Value1_HCS := %X\n", getValue( HMI_ADAS_ProfShort_Value1_HCS ));        filePutString( buffer, elcount(buffer), hFile);
    snprintf( buffer, elcount(buffer), "0.0000 HMI_ADAS_ProfShort_Offset_HCS := %X\n", getValue( HMI_ADAS_ProfShort_Offset_HCS ));        filePutString( buffer, elcount(buffer), hFile);
    snprintf( buffer, elcount(buffer), "0.0000 HMI_ADAS_ProfShort_PathIdx_HCS := %X\n", getValue( HMI_ADAS_ProfShort_PathIdx_HCS ));        filePutString( buffer, elcount(buffer), hFile);
    snprintf( buffer, elcount(buffer), "0.0000 HMI_ADAS_ProfShort_Updt_HCS := %X\n", getValue( HMI_ADAS_ProfShort_Updt_HCS ));        filePutString( buffer, elcount(buffer), hFile);
    snprintf( buffer, elcount(buffer), "0.0000 HMI_ADAS_ProfShort_MsgTyp_HCS := %X\n", getValue( HMI_ADAS_ProfShort_MsgTyp_HCS ));        filePutString( buffer, elcount(buffer), hFile);
    snprintf( buffer, elcount(buffer), "0.0000 HMI_ADAS_ProfShort_ReTr_HCS := %X\n", getValue( HMI_ADAS_ProfShort_ReTr_HCS ));        filePutString( buffer, elcount(buffer), hFile);
    snprintf( buffer, elcount(buffer), "0.0000 HMI_ADAS_ProfShort_CycCnt_HCS := %X\n", getValue( HMI_ADAS_ProfShort_CycCnt_HCS ));        filePutString( buffer, elcount(buffer), hFile);
    snprintf( buffer, elcount(buffer), "0.0000 HMI_ADAS_ProfShort_CtrlPoint_HCS := %X\n", getValue( HMI_ADAS_ProfShort_CtrlPoint_HCS ));        filePutString( buffer, elcount(buffer), hFile);
    snprintf( buffer, elcount(buffer), "0.0000 HMI_ADAS_ProfShort_Value0_HCS := %X\n", getValue( HMI_ADAS_ProfShort_Value0_HCS ));        filePutString( buffer, elcount(buffer), hFile);
    snprintf( buffer, elcount(buffer), "0.0000 HMI_ADAS_ProfShort_AccurClass_HCS := %X\n", getValue( HMI_ADAS_ProfShort_AccurClass_HCS ));        filePutString( buffer, elcount(buffer), hFile);
    snprintf( buffer, elcount(buffer), "0.0000 HMI_ADAS_ProfShort_AccurClass_LD := %X\n", getValue( HMI_ADAS_ProfShort_AccurClass_LD ));        filePutString( buffer, elcount(buffer), hFile);
    snprintf( buffer, elcount(buffer), "0.0000 HMI_ADAS_ProfShort_Dist1_LD := %X\n", getValue( HMI_ADAS_ProfShort_Dist1_LD ));        filePutString( buffer, elcount(buffer), hFile);
    snprintf( buffer, elcount(buffer), "0.0000 HMI_ADAS_ProfShort_Value1_LT := %X\n", getValue( HMI_ADAS_ProfShort_Value1_LT ));        filePutString( buffer, elcount(buffer), hFile);
    snprintf( buffer, elcount(buffer), "0.0000 HMI_ADAS_ProfShort_Updt_LD := %X\n", getValue( HMI_ADAS_ProfShort_Updt_LD ));        filePutString( buffer, elcount(buffer), hFile);
    snprintf( buffer, elcount(buffer), "0.0000 HMI_ADAS_ProfShort_ReTr_LD := %X\n", getValue( HMI_ADAS_ProfShort_ReTr_LD ));        filePutString( buffer, elcount(buffer), hFile);
    snprintf( buffer, elcount(buffer), "0.0000 HMI_ADAS_ProfShort_PathIdx_LD := %X\n", getValue( HMI_ADAS_ProfShort_PathIdx_LD ));        filePutString( buffer, elcount(buffer), hFile);
    snprintf( buffer, elcount(buffer), "0.0000 HMI_ADAS_ProfShort_Offset_LD := %X\n", getValue( HMI_ADAS_ProfShort_Offset_LD ));        filePutString( buffer, elcount(buffer), hFile);
    snprintf( buffer, elcount(buffer), "0.0000 HMI_ADAS_ProfShort_MsgTyp_LD := %X\n", getValue( HMI_ADAS_ProfShort_MsgTyp_LD ));        filePutString( buffer, elcount(buffer), hFile);
    snprintf( buffer, elcount(buffer), "0.0000 HMI_ADAS_ProfShort_CycCnt_LD := %X\n", getValue( HMI_ADAS_ProfShort_CycCnt_LD ));        filePutString( buffer, elcount(buffer), hFile);
    snprintf( buffer, elcount(buffer), "0.0000 HMI_ADAS_ProfShort_CtrlPoint_LD := %X\n", getValue( HMI_ADAS_ProfShort_CtrlPoint_LD ));        filePutString( buffer, elcount(buffer), hFile);
    snprintf( buffer, elcount(buffer), "0.0000 HMI_ADAS_ProfShort_Value0_LT := %X\n", getValue( HMI_ADAS_ProfShort_Value0_LT ));        filePutString( buffer, elcount(buffer), hFile);
    snprintf( buffer, elcount(buffer), "0.0000 HMI_ADAS_ProfShort_Value1_DT := %X\n", getValue( HMI_ADAS_ProfShort_Value1_DT ));        filePutString( buffer, elcount(buffer), hFile);
    snprintf( buffer, elcount(buffer), "0.0000 HMI_ADAS_ProfShort_Value0_DT := %X\n", getValue( HMI_ADAS_ProfShort_Value0_DT ));        filePutString( buffer, elcount(buffer), hFile);
}

on timer _tADAS_PROFILE_SHORT_AR
{
    putValue( HMI__STMSG_ADAS_PROFILE_SHORT_AR, 0 );
}

on EnvVar HMI__STMSG_ADAS_PROFILE_SHORT_AR
{
    long tDelay;
    if( getValue( this ) == 2 )
    {
        tDelay = getValue( HMI__STMSGT_ADAS_PROFILE_SHORT_AR );
        if( tDelay > 0 )    
            setTimer( _tADAS_PROFILE_SHORT_AR, tDelay );
        else
            putValue( HMI__STMSG_ADAS_PROFILE_SHORT_AR, 0 );
    }
}

on envVar HMI__STMSG_PO_ADAS_PROFILE_SHORT_AR
{
    if( getValue( this ) )
        openPanel("ADAS_PROFILE_SHORT_AR");
}

on EnvVar HMI_ADAS_ProfShort_Value0_CL
{
    _mADAS_PROFILE_SHORT_AR.ADAS_ProfShort_Value0_CL.phys = getValue(this);
}

on EnvVar HMI_ADAS_ProfShort_AccurClass_CL
{
    _mADAS_PROFILE_SHORT_AR.ADAS_ProfShort_AccurClass_CL.phys = getValue(this);
}

on EnvVar HMI_ADAS_ProfShort_Value1_CL
{
    _mADAS_PROFILE_SHORT_AR.ADAS_ProfShort_Value1_CL.phys = getValue(this);
}

on EnvVar HMI_ADAS_ProfShort_Dist1_CL
{
    _mADAS_PROFILE_SHORT_AR.ADAS_ProfShort_Dist1_CL.phys = getValue(this);
}

on EnvVar HMI_ADAS_ProfShort_ProfTyp
{
    _mADAS_PROFILE_SHORT_AR.ADAS_ProfShort_ProfTyp.phys = getValue(this);
}

on EnvVar HMI_ADAS_ProfShort_PathIdx_CL
{
    _mADAS_PROFILE_SHORT_AR.ADAS_ProfShort_PathIdx_CL.phys = getValue(this);
}

on EnvVar HMI_ADAS_ProfShort_Updt_CL
{
    _mADAS_PROFILE_SHORT_AR.ADAS_ProfShort_Updt_CL.phys = getValue(this);
}

on EnvVar HMI_ADAS_ProfShort_MsgTyp_CL
{
    _mADAS_PROFILE_SHORT_AR.ADAS_ProfShort_MsgTyp_CL.phys = getValue(this);
}

on EnvVar HMI_ADAS_ProfShort_ReTr_CL
{
    _mADAS_PROFILE_SHORT_AR.ADAS_ProfShort_ReTr_CL.phys = getValue(this);
}

on EnvVar HMI_ADAS_ProfShort_CycCnt_CL
{
    _mADAS_PROFILE_SHORT_AR.ADAS_ProfShort_CycCnt_CL.phys = getValue(this);
}

on EnvVar HMI_ADAS_ProfShort_CtrlPoint_CL
{
    _mADAS_PROFILE_SHORT_AR.ADAS_ProfShort_CtrlPoint_CL.phys = getValue(this);
}

on EnvVar HMI_ADAS_ProfShort_Offset_CL
{
    _mADAS_PROFILE_SHORT_AR.ADAS_ProfShort_Offset_CL.phys = getValue(this);
}

on EnvVar HMI_ADAS_ProfShort_Value1_RN
{
    _mADAS_PROFILE_SHORT_AR.ADAS_ProfShort_Value1_RN.phys = getValue(this);
}

on EnvVar HMI_ADAS_ProfShort_Dist1_RN
{
    _mADAS_PROFILE_SHORT_AR.ADAS_ProfShort_Dist1_RN.phys = getValue(this);
}

on EnvVar HMI_ADAS_ProfShort_Value0_RN
{
    _mADAS_PROFILE_SHORT_AR.ADAS_ProfShort_Value0_RN.phys = getValue(this);
}

on EnvVar HMI_ADAS_ProfShort_AccurClass_RN
{
    _mADAS_PROFILE_SHORT_AR.ADAS_ProfShort_AccurClass_RN.phys = getValue(this);
}

on EnvVar HMI_ADAS_ProfShort_Offset_RN
{
    _mADAS_PROFILE_SHORT_AR.ADAS_ProfShort_Offset_RN.phys = getValue(this);
}

on EnvVar HMI_ADAS_ProfShort_PathIdx_RN
{
    _mADAS_PROFILE_SHORT_AR.ADAS_ProfShort_PathIdx_RN.phys = getValue(this);
}

on EnvVar HMI_ADAS_ProfShort_Updt_RN
{
    _mADAS_PROFILE_SHORT_AR.ADAS_ProfShort_Updt_RN.phys = getValue(this);
}

on EnvVar HMI_ADAS_ProfShort_MsgTyp_RN
{
    _mADAS_PROFILE_SHORT_AR.ADAS_ProfShort_MsgTyp_RN.phys = getValue(this);
}

on EnvVar HMI_ADAS_ProfShort_ReTr_RN
{
    _mADAS_PROFILE_SHORT_AR.ADAS_ProfShort_ReTr_RN.phys = getValue(this);
}

on EnvVar HMI_ADAS_ProfShort_CycCnt_RN
{
    _mADAS_PROFILE_SHORT_AR.ADAS_ProfShort_CycCnt_RN.phys = getValue(this);
}

on EnvVar HMI_ADAS_ProfShort_CtrlPoint_RN
{
    _mADAS_PROFILE_SHORT_AR.ADAS_ProfShort_CtrlPoint_RN.phys = getValue(this);
}

on EnvVar HMI_ADAS_ProfShort_Value1_SS
{
    _mADAS_PROFILE_SHORT_AR.ADAS_ProfShort_Value1_SS.phys = getValue(this);
}

on EnvVar HMI_ADAS_ProfShort_Offset_SS
{
    _mADAS_PROFILE_SHORT_AR.ADAS_ProfShort_Offset_SS.phys = getValue(this);
}

on EnvVar HMI_ADAS_ProfShort_PathIdx_SS
{
    _mADAS_PROFILE_SHORT_AR.ADAS_ProfShort_PathIdx_SS.phys = getValue(this);
}

on EnvVar HMI_ADAS_ProfShort_Updt_SS
{
    _mADAS_PROFILE_SHORT_AR.ADAS_ProfShort_Updt_SS.phys = getValue(this);
}

on EnvVar HMI_ADAS_ProfShort_MsgTyp_SS
{
    _mADAS_PROFILE_SHORT_AR.ADAS_ProfShort_MsgTyp_SS.phys = getValue(this);
}

on EnvVar HMI_ADAS_ProfShort_ReTr_SS
{
    _mADAS_PROFILE_SHORT_AR.ADAS_ProfShort_ReTr_SS.phys = getValue(this);
}

on EnvVar HMI_ADAS_ProfShort_CycCnt_SS
{
    _mADAS_PROFILE_SHORT_AR.ADAS_ProfShort_CycCnt_SS.phys = getValue(this);
}

on EnvVar HMI_ADAS_ProfShort_CtrlPoint_SS
{
    _mADAS_PROFILE_SHORT_AR.ADAS_ProfShort_CtrlPoint_SS.phys = getValue(this);
}

on EnvVar HMI_ADAS_ProfShort_Dist1_SS
{
    _mADAS_PROFILE_SHORT_AR.ADAS_ProfShort_Dist1_SS.phys = getValue(this);
}

on EnvVar HMI_ADAS_ProfShort_Value0_SS
{
    _mADAS_PROFILE_SHORT_AR.ADAS_ProfShort_Value0_SS.phys = getValue(this);
}

on EnvVar HMI_ADAS_ProfShort_AccurClass_SS
{
    _mADAS_PROFILE_SHORT_AR.ADAS_ProfShort_AccurClass_SS.phys = getValue(this);
}

on EnvVar HMI_ADAS_ProfShort_Value1_SL
{
    _mADAS_PROFILE_SHORT_AR.ADAS_ProfShort_Value1_SL.phys = getValue(this);
}

on EnvVar HMI_ADAS_ProfShort_Offset_SL
{
    _mADAS_PROFILE_SHORT_AR.ADAS_ProfShort_Offset_SL.phys = getValue(this);
}

on EnvVar HMI_ADAS_ProfShort_PathIdx_SL
{
    _mADAS_PROFILE_SHORT_AR.ADAS_ProfShort_PathIdx_SL.phys = getValue(this);
}

on EnvVar HMI_ADAS_ProfShort_Updt_SL
{
    _mADAS_PROFILE_SHORT_AR.ADAS_ProfShort_Updt_SL.phys = getValue(this);
}

on EnvVar HMI_ADAS_ProfShort_MsgTyp_SL
{
    _mADAS_PROFILE_SHORT_AR.ADAS_ProfShort_MsgTyp_SL.phys = getValue(this);
}

on EnvVar HMI_ADAS_ProfShort_ReTr_SL
{
    _mADAS_PROFILE_SHORT_AR.ADAS_ProfShort_ReTr_SL.phys = getValue(this);
}

on EnvVar HMI_ADAS_ProfShort_CycCnt_SL
{
    _mADAS_PROFILE_SHORT_AR.ADAS_ProfShort_CycCnt_SL.phys = getValue(this);
}

on EnvVar HMI_ADAS_ProfShort_CtrlPoint_SL
{
    _mADAS_PROFILE_SHORT_AR.ADAS_ProfShort_CtrlPoint_SL.phys = getValue(this);
}

on EnvVar HMI_ADAS_ProfShort_AccurClass_SL
{
    _mADAS_PROFILE_SHORT_AR.ADAS_ProfShort_AccurClass_SL.phys = getValue(this);
}

on EnvVar HMI_ADAS_ProfShort_Dist1_SL
{
    _mADAS_PROFILE_SHORT_AR.ADAS_ProfShort_Dist1_SL.phys = getValue(this);
}

on EnvVar HMI_ADAS_ProfShort_Value0_SL
{
    _mADAS_PROFILE_SHORT_AR.ADAS_ProfShort_Value0_SL.phys = getValue(this);
}

on EnvVar HMI_ADAS_ProfShort_Dist1_RA
{
    _mADAS_PROFILE_SHORT_AR.ADAS_ProfShort_Dist1_RA.phys = getValue(this);
}

on EnvVar HMI_ADAS_ProfShort_Value1_RA
{
    _mADAS_PROFILE_SHORT_AR.ADAS_ProfShort_Value1_RA.phys = getValue(this);
}

on EnvVar HMI_ADAS_ProfShort_Offset_RA
{
    _mADAS_PROFILE_SHORT_AR.ADAS_ProfShort_Offset_RA.phys = getValue(this);
}

on EnvVar HMI_ADAS_ProfShort_PathIdx_RA
{
    _mADAS_PROFILE_SHORT_AR.ADAS_ProfShort_PathIdx_RA.phys = getValue(this);
}

on EnvVar HMI_ADAS_ProfShort_Updt_RA
{
    _mADAS_PROFILE_SHORT_AR.ADAS_ProfShort_Updt_RA.phys = getValue(this);
}

on EnvVar HMI_ADAS_ProfShort_MsgTyp_RA
{
    _mADAS_PROFILE_SHORT_AR.ADAS_ProfShort_MsgTyp_RA.phys = getValue(this);
}

on EnvVar HMI_ADAS_ProfShort_ReTr_RA
{
    _mADAS_PROFILE_SHORT_AR.ADAS_ProfShort_ReTr_RA.phys = getValue(this);
}

on EnvVar HMI_ADAS_ProfShort_CycCnt_RA
{
    _mADAS_PROFILE_SHORT_AR.ADAS_ProfShort_CycCnt_RA.phys = getValue(this);
}

on EnvVar HMI_ADAS_ProfShort_CtrlPoint_RA
{
    _mADAS_PROFILE_SHORT_AR.ADAS_ProfShort_CtrlPoint_RA.phys = getValue(this);
}

on EnvVar HMI_ADAS_ProfShort_Value0_RA
{
    _mADAS_PROFILE_SHORT_AR.ADAS_ProfShort_Value0_RA.phys = getValue(this);
}

on EnvVar HMI_ADAS_ProfShort_AccurClass_RA
{
    _mADAS_PROFILE_SHORT_AR.ADAS_ProfShort_AccurClass_RA.phys = getValue(this);
}

on EnvVar HMI_ADAS_ProfShort_Dist1_RC
{
    _mADAS_PROFILE_SHORT_AR.ADAS_ProfShort_Dist1_RC.phys = getValue(this);
}

on EnvVar HMI_ADAS_ProfShort_Value0_RC
{
    _mADAS_PROFILE_SHORT_AR.ADAS_ProfShort_Value0_RC.phys = getValue(this);
}

on EnvVar HMI_ADAS_ProfShort_AccurClass_RC
{
    _mADAS_PROFILE_SHORT_AR.ADAS_ProfShort_AccurClass_RC.phys = getValue(this);
}

on EnvVar HMI_ADAS_ProfShort_Offset_RC
{
    _mADAS_PROFILE_SHORT_AR.ADAS_ProfShort_Offset_RC.phys = getValue(this);
}

on EnvVar HMI_ADAS_ProfShort_PathIdx_RC
{
    _mADAS_PROFILE_SHORT_AR.ADAS_ProfShort_PathIdx_RC.phys = getValue(this);
}

on EnvVar HMI_ADAS_ProfShort_Updt_RC
{
    _mADAS_PROFILE_SHORT_AR.ADAS_ProfShort_Updt_RC.phys = getValue(this);
}

on EnvVar HMI_ADAS_ProfShort_MsgTyp_RC
{
    _mADAS_PROFILE_SHORT_AR.ADAS_ProfShort_MsgTyp_RC.phys = getValue(this);
}

on EnvVar HMI_ADAS_ProfShort_ReTr_RC
{
    _mADAS_PROFILE_SHORT_AR.ADAS_ProfShort_ReTr_RC.phys = getValue(this);
}

on EnvVar HMI_ADAS_ProfShort_CycCnt_RC
{
    _mADAS_PROFILE_SHORT_AR.ADAS_ProfShort_CycCnt_RC.phys = getValue(this);
}

on EnvVar HMI_ADAS_ProfShort_CtrlPoint_RC
{
    _mADAS_PROFILE_SHORT_AR.ADAS_ProfShort_CtrlPoint_RC.phys = getValue(this);
}

on EnvVar HMI_ADAS_ProfShort_Value1_RC
{
    _mADAS_PROFILE_SHORT_AR.ADAS_ProfShort_Value1_RC.phys = getValue(this);
}

on EnvVar HMI_ADAS_ProfShort_Value0_VSS
{
    _mADAS_PROFILE_SHORT_AR.ADAS_ProfShort_Value0_VSS.phys = getValue(this);
}

on EnvVar HMI_ADAS_ProfShort_Dist1_VSS
{
    _mADAS_PROFILE_SHORT_AR.ADAS_ProfShort_Dist1_VSS.phys = getValue(this);
}

on EnvVar HMI_ADAS_ProfShort_Value1_VSS
{
    _mADAS_PROFILE_SHORT_AR.ADAS_ProfShort_Value1_VSS.phys = getValue(this);
}

on EnvVar HMI_ADAS_ProfShort_Offset_VSS
{
    _mADAS_PROFILE_SHORT_AR.ADAS_ProfShort_Offset_VSS.phys = getValue(this);
}

on EnvVar HMI_ADAS_ProfShort_PathIdx_VSS
{
    _mADAS_PROFILE_SHORT_AR.ADAS_ProfShort_PathIdx_VSS.phys = getValue(this);
}

on EnvVar HMI_ADAS_ProfShort_Updt_VSS
{
    _mADAS_PROFILE_SHORT_AR.ADAS_ProfShort_Updt_VSS.phys = getValue(this);
}

on EnvVar HMI_ADAS_ProfShort_MsgTyp_VSS
{
    _mADAS_PROFILE_SHORT_AR.ADAS_ProfShort_MsgTyp_VSS.phys = getValue(this);
}

on EnvVar HMI_ADAS_ProfShort_ReTr_VSS
{
    _mADAS_PROFILE_SHORT_AR.ADAS_ProfShort_ReTr_VSS.phys = getValue(this);
}

on EnvVar HMI_ADAS_ProfShort_CycCnt_VSS
{
    _mADAS_PROFILE_SHORT_AR.ADAS_ProfShort_CycCnt_VSS.phys = getValue(this);
}

on EnvVar HMI_ADAS_ProfShort_CtrlPoint_VSS
{
    _mADAS_PROFILE_SHORT_AR.ADAS_ProfShort_CtrlPoint_VSS.phys = getValue(this);
}

on EnvVar HMI_ADAS_ProfShort_AccurClass_VSS
{
    _mADAS_PROFILE_SHORT_AR.ADAS_ProfShort_AccurClass_VSS.phys = getValue(this);
}

on EnvVar HMI_ADAS_ProfShort_Dist1_HCS
{
    _mADAS_PROFILE_SHORT_AR.ADAS_ProfShort_Dist1_HCS.phys = getValue(this);
}

on EnvVar HMI_ADAS_ProfShort_Value1_HCS
{
    _mADAS_PROFILE_SHORT_AR.ADAS_ProfShort_Value1_HCS.phys = getValue(this);
}

on EnvVar HMI_ADAS_ProfShort_Offset_HCS
{
    _mADAS_PROFILE_SHORT_AR.ADAS_ProfShort_Offset_HCS.phys = getValue(this);
}

on EnvVar HMI_ADAS_ProfShort_PathIdx_HCS
{
    _mADAS_PROFILE_SHORT_AR.ADAS_ProfShort_PathIdx_HCS.phys = getValue(this);
}

on EnvVar HMI_ADAS_ProfShort_Updt_HCS
{
    _mADAS_PROFILE_SHORT_AR.ADAS_ProfShort_Updt_HCS.phys = getValue(this);
}

on EnvVar HMI_ADAS_ProfShort_MsgTyp_HCS
{
    _mADAS_PROFILE_SHORT_AR.ADAS_ProfShort_MsgTyp_HCS.phys = getValue(this);
}

on EnvVar HMI_ADAS_ProfShort_ReTr_HCS
{
    _mADAS_PROFILE_SHORT_AR.ADAS_ProfShort_ReTr_HCS.phys = getValue(this);
}

on EnvVar HMI_ADAS_ProfShort_CycCnt_HCS
{
    _mADAS_PROFILE_SHORT_AR.ADAS_ProfShort_CycCnt_HCS.phys = getValue(this);
}

on EnvVar HMI_ADAS_ProfShort_CtrlPoint_HCS
{
    _mADAS_PROFILE_SHORT_AR.ADAS_ProfShort_CtrlPoint_HCS.phys = getValue(this);
}

on EnvVar HMI_ADAS_ProfShort_Value0_HCS
{
    _mADAS_PROFILE_SHORT_AR.ADAS_ProfShort_Value0_HCS.phys = getValue(this);
}

on EnvVar HMI_ADAS_ProfShort_AccurClass_HCS
{
    _mADAS_PROFILE_SHORT_AR.ADAS_ProfShort_AccurClass_HCS.phys = getValue(this);
}

on EnvVar HMI_ADAS_ProfShort_AccurClass_LD
{
    _mADAS_PROFILE_SHORT_AR.ADAS_ProfShort_AccurClass_LD.phys = getValue(this);
}

on EnvVar HMI_ADAS_ProfShort_Dist1_LD
{
    _mADAS_PROFILE_SHORT_AR.ADAS_ProfShort_Dist1_LD.phys = getValue(this);
}

on EnvVar HMI_ADAS_ProfShort_Value1_LT
{
    _mADAS_PROFILE_SHORT_AR.ADAS_ProfShort_Value1_LT.phys = getValue(this);
}

on EnvVar HMI_ADAS_ProfShort_Updt_LD
{
    _mADAS_PROFILE_SHORT_AR.ADAS_ProfShort_Updt_LD.phys = getValue(this);
}

on EnvVar HMI_ADAS_ProfShort_ReTr_LD
{
    _mADAS_PROFILE_SHORT_AR.ADAS_ProfShort_ReTr_LD.phys = getValue(this);
}

on EnvVar HMI_ADAS_ProfShort_PathIdx_LD
{
    _mADAS_PROFILE_SHORT_AR.ADAS_ProfShort_PathIdx_LD.phys = getValue(this);
}

on EnvVar HMI_ADAS_ProfShort_Offset_LD
{
    _mADAS_PROFILE_SHORT_AR.ADAS_ProfShort_Offset_LD.phys = getValue(this);
}

on EnvVar HMI_ADAS_ProfShort_MsgTyp_LD
{
    _mADAS_PROFILE_SHORT_AR.ADAS_ProfShort_MsgTyp_LD.phys = getValue(this);
}

on EnvVar HMI_ADAS_ProfShort_CycCnt_LD
{
    _mADAS_PROFILE_SHORT_AR.ADAS_ProfShort_CycCnt_LD.phys = getValue(this);
}

on EnvVar HMI_ADAS_ProfShort_CtrlPoint_LD
{
    _mADAS_PROFILE_SHORT_AR.ADAS_ProfShort_CtrlPoint_LD.phys = getValue(this);
}

on EnvVar HMI_ADAS_ProfShort_Value0_LT
{
    _mADAS_PROFILE_SHORT_AR.ADAS_ProfShort_Value0_LT.phys = getValue(this);
}

on EnvVar HMI_ADAS_ProfShort_Value1_DT
{
    _mADAS_PROFILE_SHORT_AR.ADAS_ProfShort_Value1_DT.phys = getValue(this);
}

on EnvVar HMI_ADAS_ProfShort_Value0_DT
{
    _mADAS_PROFILE_SHORT_AR.ADAS_ProfShort_Value0_DT.phys = getValue(this);
}

on EnvVar HMI__ALLDEF_ADAS_PROFILE_SHORT_AR
{
    if( getValue(this))
    {
        // alle signale auf default einstellen
        putValue( HMI_ADAS_ProfShort_ProfTyp, 31 );
    }
}

ADASLR_POSITION_AR_check_output()
{
      if(  !getValue( HMI__STMSG_ADASLR_POSITION_AR ))
    {
        // Botschaft ADASLR_POSITION_AR ID: 1221 --- Sendeart cyclicX --- 
        _ADASLR_POSITION_AR_Cnt--;
        if(  _ADASLR_POSITION_AR_Cnt < 1 )
        {
            // Nachricht wg. abgelaufenem Zyklus ausgeben
            output( _mADASLR_POSITION_AR );
            // Zyklus-Zähler zurücksetzen
            _ADASLR_POSITION_AR_Cnt = _ADASLR_POSITION_AR_CycleCount;
        }
    }
}

ADASLR_POSITION_AR_init()
{   /* Botschaft ADASLR_POSITION_AR ID: 1221 --- Sendeart cyclicX --- 
BA_ "ApplMessage" BO_ 1221 0;
BA_ "NmAsrMessage" BO_ 1221 0;
BA_ "GenMsgMinAcceptLength" BO_ 1221 8;
BA_ "GenMsgILSupport" BO_ 1221 1;
BA_ "DiagState" BO_ 1221 0;
BA_ "DiagRequest" BO_ 1221 0;
BA_ "DiagResponse" BO_ 1221 0;
BA_ "GenMsgStartValue" BO_ 1221 "0";
BA_ "GenMsgStartDelayTime" BO_ 1221 25;
BA_ "GenMsgCycleTime" BO_ 1221 5000;
BA_ "GenMsgSendType" BO_ 1221 0;
    */
    _ADASLR_POSITION_AR_Timebase =              c_tDBKomTimer_20ms;
    _ADASLR_POSITION_AR_CycleCount =           5000 / _ADASLR_POSITION_AR_Timebase;
    _ADASLR_POSITION_AR_StartDelay =             25 / _ADASLR_POSITION_AR_Timebase;
    _ADASLR_POSITION_AR_Cnt = _ADASLR_POSITION_AR_StartDelay;

    putValue( HMI__STMSGSD_ADASLR_POSITION_AR, _ADASLR_POSITION_AR_StartDelay * _ADASLR_POSITION_AR_Timebase );

    _mADASLR_POSITION_AR.ADASLR_Posn_Age.phys = getValue( HMI_ADASLR_Posn_Age );
    _mADASLR_POSITION_AR.ADASLR_Posn_CurLane.phys = getValue( HMI_ADASLR_Posn_CurLane );
    _mADASLR_POSITION_AR.ADASLR_Posn_CycCnt.phys = getValue( HMI_ADASLR_Posn_CycCnt );
    _mADASLR_POSITION_AR.ADASLR_Posn_Idx.phys = getValue( HMI_ADASLR_Posn_Idx );
    _mADASLR_POSITION_AR.ADASLR_Posn_MsgTyp.phys = getValue( HMI_ADASLR_Posn_MsgTyp );
    _mADASLR_POSITION_AR.ADASLR_Posn_Offset.phys = getValue( HMI_ADASLR_Posn_Offset );
    _mADASLR_POSITION_AR.ADASLR_Posn_PathIdx.phys = getValue( HMI_ADASLR_Posn_PathIdx );
    _mADASLR_POSITION_AR.ADASLR_Posn_PosConfdc.phys = getValue( HMI_ADASLR_Posn_PosConfdc );
    _mADASLR_POSITION_AR.ADASLR_Posn_PosProbb.phys = getValue( HMI_ADASLR_Posn_PosProbb );
    _mADASLR_POSITION_AR.ADASLR_Posn_RelHead.phys = getValue( HMI_ADASLR_Posn_RelHead );
    _mADASLR_POSITION_AR.ADASLR_Posn_Spd.phys = getValue( HMI_ADASLR_Posn_Spd );
}

ADASLR_POSITION_AR_saveEnvVars( dword hFile )
{
    filePutString("\n// Knoten TGW: ADASLR_POSITION_AR\n", 26, hFile);
    snprintf( buffer, elcount(buffer), "0.0000 HMI__STMSG_ADASLR_POSITION_AR := %X\n", getValue( HMI__STMSG_ADASLR_POSITION_AR ) );        filePutString( buffer, elcount(buffer), hFile);
    snprintf( buffer, elcount(buffer), "0.0000 HMI__STMSGT_ADASLR_POSITION_AR := %X\n", getValue( HMI__STMSGT_ADASLR_POSITION_AR ) );        filePutString( buffer, elcount(buffer), hFile);
    snprintf( buffer, elcount(buffer), "0.0000 HMI_ADASLR_Posn_Age := %X\n", getValue( HMI_ADASLR_Posn_Age ) );        filePutString( buffer, elcount(buffer), hFile);
    snprintf( buffer, elcount(buffer), "0.0000 HMI_ADASLR_Posn_CurLane := %X\n", getValue( HMI_ADASLR_Posn_CurLane ) );        filePutString( buffer, elcount(buffer), hFile);
    snprintf( buffer, elcount(buffer), "0.0000 HMI_ADASLR_Posn_CycCnt := %X\n", getValue( HMI_ADASLR_Posn_CycCnt ) );        filePutString( buffer, elcount(buffer), hFile);
    snprintf( buffer, elcount(buffer), "0.0000 HMI_ADASLR_Posn_Idx := %X\n", getValue( HMI_ADASLR_Posn_Idx ) );        filePutString( buffer, elcount(buffer), hFile);
    snprintf( buffer, elcount(buffer), "0.0000 HMI_ADASLR_Posn_MsgTyp := %X\n", getValue( HMI_ADASLR_Posn_MsgTyp ) );        filePutString( buffer, elcount(buffer), hFile);
    snprintf( buffer, elcount(buffer), "0.0000 HMI_ADASLR_Posn_Offset := %X\n", getValue( HMI_ADASLR_Posn_Offset ) );        filePutString( buffer, elcount(buffer), hFile);
    snprintf( buffer, elcount(buffer), "0.0000 HMI_ADASLR_Posn_PathIdx := %X\n", getValue( HMI_ADASLR_Posn_PathIdx ) );        filePutString( buffer, elcount(buffer), hFile);
    snprintf( buffer, elcount(buffer), "0.0000 HMI_ADASLR_Posn_PosConfdc := %X\n", getValue( HMI_ADASLR_Posn_PosConfdc ) );        filePutString( buffer, elcount(buffer), hFile);
    snprintf( buffer, elcount(buffer), "0.0000 HMI_ADASLR_Posn_PosProbb := %X\n", getValue( HMI_ADASLR_Posn_PosProbb ) );        filePutString( buffer, elcount(buffer), hFile);
    snprintf( buffer, elcount(buffer), "0.0000 HMI_ADASLR_Posn_RelHead := %X\n", getValue( HMI_ADASLR_Posn_RelHead ) );        filePutString( buffer, elcount(buffer), hFile);
    snprintf( buffer, elcount(buffer), "0.0000 HMI_ADASLR_Posn_Spd := %X\n", getValue( HMI_ADASLR_Posn_Spd ) );        filePutString( buffer, elcount(buffer), hFile);
}

on timer _tADASLR_POSITION_AR
{
    putValue( HMI__STMSG_ADASLR_POSITION_AR, 0 );
}

on EnvVar HMI__STMSG_ADASLR_POSITION_AR
{
    long tDelay;
    if( getValue( this ) == 2 )
    {
        tDelay = getValue( HMI__STMSGT_ADASLR_POSITION_AR );
        if( tDelay > 0 )    
            setTimer( _tADASLR_POSITION_AR, tDelay );
        else
            putValue( HMI__STMSG_ADASLR_POSITION_AR, 0 );
    }
}

on envVar HMI__STMSG_PO_ADASLR_POSITION_AR
{
    if( getValue( this ) )
        openPanel("ADASLR_POSITION_AR");
}

on EnvVar HMI_ADASLR_Posn_Age
{
    _mADASLR_POSITION_AR.ADASLR_Posn_Age.phys = getValue(this);
}

on EnvVar HMI_ADASLR_Posn_CurLane
{
    _mADASLR_POSITION_AR.ADASLR_Posn_CurLane.phys = getValue(this);
}

on EnvVar HMI_ADASLR_Posn_CycCnt
{
    _mADASLR_POSITION_AR.ADASLR_Posn_CycCnt.phys = getValue(this);
}

on EnvVar HMI_ADASLR_Posn_Idx
{
    _mADASLR_POSITION_AR.ADASLR_Posn_Idx.phys = getValue(this);
}

on EnvVar HMI_ADASLR_Posn_MsgTyp
{
    _mADASLR_POSITION_AR.ADASLR_Posn_MsgTyp.phys = getValue(this);
}

on EnvVar HMI_ADASLR_Posn_Offset
{
    _mADASLR_POSITION_AR.ADASLR_Posn_Offset.phys = getValue(this);
}

on EnvVar HMI_ADASLR_Posn_PathIdx
{
    _mADASLR_POSITION_AR.ADASLR_Posn_PathIdx.phys = getValue(this);
}

on EnvVar HMI_ADASLR_Posn_PosConfdc
{
    _mADASLR_POSITION_AR.ADASLR_Posn_PosConfdc.phys = getValue(this);
}

on EnvVar HMI_ADASLR_Posn_PosProbb
{
    _mADASLR_POSITION_AR.ADASLR_Posn_PosProbb.phys = getValue(this);
}

on EnvVar HMI_ADASLR_Posn_RelHead
{
    _mADASLR_POSITION_AR.ADASLR_Posn_RelHead.phys = getValue(this);
}

on EnvVar HMI_ADASLR_Posn_Spd
{
    _mADASLR_POSITION_AR.ADASLR_Posn_Spd.phys = getValue(this);
}

ADASLR_PROFILE_LONG_AR_check_output()
{
      if(  !getValue( HMI__STMSG_ADASLR_PROFILE_LONG_AR ))
    {
        // Botschaft ADASLR_PROFILE_LONG_AR ID: 990 --- Sendeart cyclicX --- 
        _ADASLR_PROFILE_LONG_AR_Cnt--;
        if(  _ADASLR_PROFILE_LONG_AR_Cnt < 1 )
        {
            // Nachricht wg. abgelaufenem Zyklus ausgeben
            output( _mADASLR_PROFILE_LONG_AR );
            // Zyklus-Zähler zurücksetzen
            _ADASLR_PROFILE_LONG_AR_Cnt = _ADASLR_PROFILE_LONG_AR_CycleCount;
        }
    }
}

ADASLR_PROFILE_LONG_AR_init()
{   /* Botschaft ADASLR_PROFILE_LONG_AR ID: 990 --- Sendeart cyclicX --- 
BA_ "ApplMessage" BO_ 990 0;
BA_ "NmAsrMessage" BO_ 990 0;
BA_ "GenMsgMinAcceptLength" BO_ 990 8;
BA_ "GenMsgILSupport" BO_ 990 0;
BA_ "DiagState" BO_ 990 0;
BA_ "DiagRequest" BO_ 990 0;
BA_ "DiagResponse" BO_ 990 0;
BA_ "GenMsgStartValue" BO_ 990 "0";
BA_ "GenMsgStartDelayTime" BO_ 990 35;
BA_ "GenMsgCycleTime" BO_ 990 1000;
BA_ "GenMsgSendType" BO_ 990 0;
    */
    _ADASLR_PROFILE_LONG_AR_Timebase =         c_tDBKomTimer_20ms;
    _ADASLR_PROFILE_LONG_AR_CycleCount =     1000 / _ADASLR_PROFILE_LONG_AR_Timebase;
    _ADASLR_PROFILE_LONG_AR_StartDelay =       35 / _ADASLR_PROFILE_LONG_AR_Timebase;
    _ADASLR_PROFILE_LONG_AR_Cnt = _ADASLR_PROFILE_LONG_AR_StartDelay;

    putValue( HMI__STMSGSD_ADASLR_PROFILE_LONG_AR, _ADASLR_PROFILE_LONG_AR_StartDelay * _ADASLR_PROFILE_LONG_AR_Timebase );

    _mADASLR_PROFILE_LONG_AR.ADASLR_ProfLong_ProfTyp.phys = getValue( HMI_ADASLR_ProfLong_ProfTyp );
    _mADASLR_PROFILE_LONG_AR.ADASLR_ProfLong_CtrlPnt_SpdCl.phys = getValue( HMI_ADASLR_ProfLong_CtrlPnt_SpdCl );
    _mADASLR_PROFILE_LONG_AR.ADASLR_ProfLong_CycCnt_SpdCl.phys = getValue( HMI_ADASLR_ProfLong_CycCnt_SpdCl );
    _mADASLR_PROFILE_LONG_AR.ADASLR_ProfLong_MsgTyp_SpdCl.phys = getValue( HMI_ADASLR_ProfLong_MsgTyp_SpdCl );
    _mADASLR_PROFILE_LONG_AR.ADASLR_ProfLong_Offset_SpdCl.phys = getValue( HMI_ADASLR_ProfLong_Offset_SpdCl );
    _mADASLR_PROFILE_LONG_AR.ADASLR_ProfLong_PathIdx_SpdCl.phys = getValue( HMI_ADASLR_ProfLong_PathIdx_SpdCl );
    _mADASLR_PROFILE_LONG_AR.ADASLR_ProfLong_ReTr_SpdCl.phys = getValue( HMI_ADASLR_ProfLong_ReTr_SpdCl );
    _mADASLR_PROFILE_LONG_AR.ADASLR_ProfLong_Updt_SpdCl.phys = getValue( HMI_ADASLR_ProfLong_Updt_SpdCl );
    _mADASLR_PROFILE_LONG_AR.ADASLR_ProfLong_Val_SpdCl.phys = getValue( HMI_ADASLR_ProfLong_Val_SpdCl );
    _mADASLR_PROFILE_LONG_AR.ADASLR_ProfLong_CtrlPnt_Hght.phys = getValue( HMI_ADASLR_ProfLong_CtrlPnt_Hght );
    _mADASLR_PROFILE_LONG_AR.ADASLR_ProfLong_CycCnt_Hght.phys = getValue( HMI_ADASLR_ProfLong_CycCnt_Hght );
	_mADASLR_PROFILE_LONG_AR.ADASLR_ProfLong_CycCnt_Latit.phys = getValue( HMI_ADASLR_ProfLong_CycCnt_Latit );
	_mADASLR_PROFILE_LONG_AR.ADASLR_ProfLong_CycCnt_Longi.phys = getValue( HMI_ADASLR_ProfLong_CycCnt_Longi );
    _mADASLR_PROFILE_LONG_AR.ADASLR_ProfLong_MsgTyp_Hght.phys = getValue( HMI_ADASLR_ProfLong_MsgTyp_Hght );
    _mADASLR_PROFILE_LONG_AR.ADASLR_ProfLong_Offset_Hght.phys = getValue( HMI_ADASLR_ProfLong_Offset_Hght );
    _mADASLR_PROFILE_LONG_AR.ADASLR_ProfLong_PathIdx_Hght.phys = getValue( HMI_ADASLR_ProfLong_PathIdx_Hght );
    _mADASLR_PROFILE_LONG_AR.ADASLR_ProfLong_ReTr_Hght.phys = getValue( HMI_ADASLR_ProfLong_ReTr_Hght );
    _mADASLR_PROFILE_LONG_AR.ADASLR_ProfLong_Updt_Hght.phys = getValue( HMI_ADASLR_ProfLong_Updt_Hght );
    _mADASLR_PROFILE_LONG_AR.ADASLR_ProfLong_Val_Hght.phys = getValue( HMI_ADASLR_ProfLong_Val_Hght );
	_mADASLR_PROFILE_LONG_AR.ADASLR_ProfLong_CtrlPnt_Latit.phys = getValue( HMI_ADASLR_ProfLong_CtrlPnt_Latit );
	_mADASLR_PROFILE_LONG_AR.ADASLR_ProfLong_CtrlPnt_Longi.phys = getValue( HMI_ADASLR_ProfLong_CtrlPnt_Longi );
    _mADASLR_PROFILE_LONG_AR.ADASLR_ProfLong_BuA_SpecZ.phys = getValue( HMI_ADASLR_ProfLong_BuA_SpecZ );
    _mADASLR_PROFILE_LONG_AR.ADASLR_ProfLong_CtrlPnt_SpecZ.phys = getValue( HMI_ADASLR_ProfLong_CtrlPnt_SpecZ );
    _mADASLR_PROFILE_LONG_AR.ADASLR_ProfLong_CycCnt_SpecZ.phys = getValue( HMI_ADASLR_ProfLong_CycCnt_SpecZ );
    _mADASLR_PROFILE_LONG_AR.ADASLR_ProfLong_Dest_SpecZ.phys = getValue( HMI_ADASLR_ProfLong_Dest_SpecZ );
    _mADASLR_PROFILE_LONG_AR.ADASLR_ProfLong_MsgTyp_SpecZ.phys = getValue( HMI_ADASLR_ProfLong_MsgTyp_SpecZ );
	_mADASLR_PROFILE_LONG_AR.ADASLR_ProfLong_MsgTyp_Latit.phys = getValue( HMI_ADASLR_ProfLong_MsgTyp_Latit );
	_mADASLR_PROFILE_LONG_AR.ADASLR_ProfLong_MsgTyp_Longi.phys = getValue( HMI_ADASLR_ProfLong_MsgTyp_Longi );
    _mADASLR_PROFILE_LONG_AR.ADASLR_ProfLong_Offset_SpecZ.phys = getValue( HMI_ADASLR_ProfLong_Offset_SpecZ );
	_mADASLR_PROFILE_LONG_AR.ADASLR_ProfLong_Offset_Latit.phys = getValue( HMI_ADASLR_ProfLong_Offset_Latit );
	_mADASLR_PROFILE_LONG_AR.ADASLR_ProfLong_Offset_Longi.phys = getValue( HMI_ADASLR_ProfLong_Offset_Longi );
	_mADASLR_PROFILE_LONG_AR.ADASLR_ProfLong_PathIdx_Latit.phys = getValue( HMI_ADASLR_ProfLong_PathIdx_Latit );
	_mADASLR_PROFILE_LONG_AR.ADASLR_ProfLong_PathIdx_Longi.phys = getValue( HMI_ADASLR_ProfLong_PathIdx_Longi );
    _mADASLR_PROFILE_LONG_AR.ADASLR_ProfLong_PathIdx_SpecZ.phys = getValue( HMI_ADASLR_ProfLong_PathIdx_SpecZ );
    _mADASLR_PROFILE_LONG_AR.ADASLR_ProfLong_ReTr_SpecZ.phys = getValue( HMI_ADASLR_ProfLong_ReTr_SpecZ );
    _mADASLR_PROFILE_LONG_AR.ADASLR_ProfLong_Updt_SpecZ.phys = getValue( HMI_ADASLR_ProfLong_Updt_SpecZ );
	_mADASLR_PROFILE_LONG_AR.ADASLR_ProfLong_Updt_Latit.phys = getValue( HMI_ADASLR_ProfLong_Updt_Latit );
	_mADASLR_PROFILE_LONG_AR.ADASLR_ProfLong_Updt_Longi.phys = getValue( HMI_ADASLR_ProfLong_Updt_Longi );
    _mADASLR_PROFILE_LONG_AR.ADASLR_ProfLong_Val_SpecZ.phys = getValue( HMI_ADASLR_ProfLong_Val_SpecZ );
	_mADASLR_PROFILE_LONG_AR.ADASLR_ProfLong_Val_Latit.phys = getValue( HMI_ADASLR_ProfLong_Val_Latit );
	_mADASLR_PROFILE_LONG_AR.ADASLR_ProfLong_Val_Longi.phys = getValue( HMI_ADASLR_ProfLong_Val_Longi );
    _mADASLR_PROFILE_LONG_AR.ADASLR_ProfLong_CtrlPnt_RestA.phys = getValue( HMI_ADASLR_ProfLong_CtrlPnt_RestA );
    _mADASLR_PROFILE_LONG_AR.ADASLR_ProfLong_CycCnt_RestA.phys = getValue( HMI_ADASLR_ProfLong_CycCnt_RestA );
    _mADASLR_PROFILE_LONG_AR.ADASLR_ProfLong_MsgTyp_RestA.phys = getValue( HMI_ADASLR_ProfLong_MsgTyp_RestA );
    _mADASLR_PROFILE_LONG_AR.ADASLR_ProfLong_Offset_RestA.phys = getValue( HMI_ADASLR_ProfLong_Offset_RestA );
    _mADASLR_PROFILE_LONG_AR.ADASLR_ProfLong_PathIdx_RestA.phys = getValue( HMI_ADASLR_ProfLong_PathIdx_RestA );
    _mADASLR_PROFILE_LONG_AR.ADASLR_ProfLong_ReTr_RestA.phys = getValue( HMI_ADASLR_ProfLong_ReTr_RestA );
	_mADASLR_PROFILE_LONG_AR.ADASLR_ProfLong_ReTr_Latit.phys = getValue( HMI_ADASLR_ProfLong_ReTr_Latit );
	_mADASLR_PROFILE_LONG_AR.ADASLR_ProfLong_ReTr_Longi.phys = getValue( HMI_ADASLR_ProfLong_ReTr_Longi );
    _mADASLR_PROFILE_LONG_AR.ADASLR_ProfLong_Updt_RestA.phys = getValue( HMI_ADASLR_ProfLong_Updt_RestA );
    _mADASLR_PROFILE_LONG_AR.ADASLR_ProfLong_Val_RestA.phys = getValue( HMI_ADASLR_ProfLong_Val_RestA );
    _mADASLR_PROFILE_LONG_AR.ADASLR_ProfLong_CtrlPnt_PTData.phys = getValue( HMI_ADASLR_ProfLong_CtrlPnt_PTData );
    _mADASLR_PROFILE_LONG_AR.ADASLR_ProfLong_CycCnt_PTData.phys = getValue( HMI_ADASLR_ProfLong_CycCnt_PTData );
    _mADASLR_PROFILE_LONG_AR.ADASLR_ProfLong_MsgTyp_PTData.phys = getValue( HMI_ADASLR_ProfLong_MsgTyp_PTData );
    _mADASLR_PROFILE_LONG_AR.ADASLR_ProfLong_Offset_PTData.phys = getValue( HMI_ADASLR_ProfLong_Offset_PTData );
    _mADASLR_PROFILE_LONG_AR.ADASLR_ProfLong_PathIdx_PTData.phys = getValue( HMI_ADASLR_ProfLong_PathIdx_PTData );
    _mADASLR_PROFILE_LONG_AR.ADASLR_ProfLong_ReTr_PTData.phys = getValue( HMI_ADASLR_ProfLong_ReTr_PTData );
    _mADASLR_PROFILE_LONG_AR.ADASLR_ProfLong_Updt_PTData.phys = getValue( HMI_ADASLR_ProfLong_Updt_PTData );
    _mADASLR_PROFILE_LONG_AR.ADASLR_ProfLong_Val_AttrId_PTData.phys = getValue( HMI_ADASLR_ProfLong_Val_AttrId_PTData );
    _mADASLR_PROFILE_LONG_AR.ADASLR_ProfLong_Val_AttrOfst_PTData.phys = getValue( HMI_ADASLR_ProfLong_Val_AttrOfst_PTData );
    _mADASLR_PROFILE_LONG_AR.ADASLR_ProfLong_Val_ComRtNum_PTData.phys = getValue( HMI_ADASLR_ProfLong_Val_ComRtNum_PTData );
    _mADASLR_PROFILE_LONG_AR.ADASLR_ProfLong_Val_PTData.phys = getValue( HMI_ADASLR_ProfLong_Val_PTData );
    _mADASLR_PROFILE_LONG_AR.ADASLR_ProfLong_EngyAvl_CNG_RestA.phys = getValue( HMI_ADASLR_ProfLong_EngyAvl_CNG_RestA );
    _mADASLR_PROFILE_LONG_AR.ADASLR_ProfLong_EngyAvl_Diesel_RestA.phys = getValue( HMI_ADASLR_ProfLong_EngyAvl_Diesel_RestA );
    _mADASLR_PROFILE_LONG_AR.ADASLR_ProfLong_EngyAvl_EngyTyp1_RestA.phys = getValue( HMI_ADASLR_ProfLong_EngyAvl_EngyTyp1_RestA );
    _mADASLR_PROFILE_LONG_AR.ADASLR_ProfLong_EngyAvl_EngyTyp2_RestA.phys = getValue( HMI_ADASLR_ProfLong_EngyAvl_EngyTyp2_RestA );
    _mADASLR_PROFILE_LONG_AR.ADASLR_ProfLong_EngyAvl_Gasoline_RestA.phys = getValue( HMI_ADASLR_ProfLong_EngyAvl_Gasoline_RestA );
    _mADASLR_PROFILE_LONG_AR.ADASLR_ProfLong_EngyAvl_H2_RestA.phys = getValue( HMI_ADASLR_ProfLong_EngyAvl_H2_RestA );
    _mADASLR_PROFILE_LONG_AR.ADASLR_ProfLong_EngyAvl_LNG_RestA.phys = getValue( HMI_ADASLR_ProfLong_EngyAvl_LNG_RestA );
    _mADASLR_PROFILE_LONG_AR.ADASLR_ProfLong_EngyAvl_Pwr_RestA.phys = getValue( HMI_ADASLR_ProfLong_EngyAvl_Pwr_RestA );
    _mADASLR_PROFILE_LONG_AR.ADASLR_ProfLong_AirTemp_WthrOffboard.phys = getValue( HMI_ADASLR_ProfLong_AirTemp_WthrOffboard );
    _mADASLR_PROFILE_LONG_AR.ADASLR_ProfLong_CtrlPnt_WthrOffboard.phys = getValue( HMI_ADASLR_ProfLong_CtrlPnt_WthrOffboard );
    _mADASLR_PROFILE_LONG_AR.ADASLR_ProfLong_CycCnt_WthrOffboard.phys = getValue( HMI_ADASLR_ProfLong_CycCnt_WthrOffboard );
    _mADASLR_PROFILE_LONG_AR.ADASLR_ProfLong_MsgTyp_WthrOffboard.phys = getValue( HMI_ADASLR_ProfLong_MsgTyp_WthrOffboard );
    _mADASLR_PROFILE_LONG_AR.ADASLR_ProfLong_Offset_WthrOffboard.phys = getValue( HMI_ADASLR_ProfLong_Offset_WthrOffboard );
    _mADASLR_PROFILE_LONG_AR.ADASLR_ProfLong_PathIdx_WthrOffboard.phys = getValue( HMI_ADASLR_ProfLong_PathIdx_WthrOffboard );
    _mADASLR_PROFILE_LONG_AR.ADASLR_ProfLong_ReTr_WthrOffboard.phys = getValue( HMI_ADASLR_ProfLong_ReTr_WthrOffboard );
    _mADASLR_PROFILE_LONG_AR.ADASLR_ProfLong_Updt_WthrOffboard.phys = getValue( HMI_ADASLR_ProfLong_Updt_WthrOffboard );
    _mADASLR_PROFILE_LONG_AR.ADASLR_ProfLong_WindDir_WthrOffboard.phys = getValue( HMI_ADASLR_ProfLong_WindDir_WthrOffboard );
    _mADASLR_PROFILE_LONG_AR.ADASLR_ProfLong_WindSpd_WthrOffboard.phys = getValue( HMI_ADASLR_ProfLong_WindSpd_WthrOffboard );
    _mADASLR_PROFILE_LONG_AR.ADASLR_ProfLong_AvgSpd_AvgSpdOffboard.phys = getValue( HMI_ADASLR_ProfLong_AvgSpd_AvgSpdOffboard );
    _mADASLR_PROFILE_LONG_AR.ADASLR_ProfLong_CtrlPnt_AvgSpdOffboard.phys = getValue( HMI_ADASLR_ProfLong_CtrlPnt_AvgSpdOffboard );
    _mADASLR_PROFILE_LONG_AR.ADASLR_ProfLong_CycCnt_AvgSpdOffboard.phys = getValue( HMI_ADASLR_ProfLong_CycCnt_AvgSpdOffboard );
    _mADASLR_PROFILE_LONG_AR.ADASLR_ProfLong_MsgTyp_AvgSpdOffboard.phys = getValue( HMI_ADASLR_ProfLong_MsgTyp_AvgSpdOffboard );
    _mADASLR_PROFILE_LONG_AR.ADASLR_ProfLong_Offset_AvgSpdOffboard.phys = getValue( HMI_ADASLR_ProfLong_Offset_AvgSpdOffboard );
    _mADASLR_PROFILE_LONG_AR.ADASLR_ProfLong_PathIdx_AvgSpdOffboard.phys = getValue( HMI_ADASLR_ProfLong_PathIdx_AvgSpdOffboard );
    _mADASLR_PROFILE_LONG_AR.ADASLR_ProfLong_ReTr_AvgSpdOffboard.phys = getValue( HMI_ADASLR_ProfLong_ReTr_AvgSpdOffboard );
    _mADASLR_PROFILE_LONG_AR.ADASLR_ProfLong_Updt_AvgSpdOffboard.phys = getValue( HMI_ADASLR_ProfLong_Updt_AvgSpdOffboard );
}

ADASLR_PROFILE_LONG_AR_saveEnvVars( dword hFile )
{
    filePutString("\n// Knoten TGW: ADASLR_PROFILE_LONG_AR\n", 26, hFile);
    snprintf( buffer, elcount(buffer), "0.0000 HMI__STMSG_ADASLR_PROFILE_LONG_AR := %X\n", getValue( HMI__STMSG_ADASLR_PROFILE_LONG_AR ) );        filePutString( buffer, elcount(buffer), hFile);
    snprintf( buffer, elcount(buffer), "0.0000 HMI__STMSGT_ADASLR_PROFILE_LONG_AR := %X\n", getValue( HMI__STMSGT_ADASLR_PROFILE_LONG_AR ) );        filePutString( buffer, elcount(buffer), hFile);
    snprintf( buffer, elcount(buffer), "0.0000 HMI_ADASLR_ProfLong_ProfTyp := %X\n", getValue( HMI_ADASLR_ProfLong_ProfTyp ) );        filePutString( buffer, elcount(buffer), hFile);
    snprintf( buffer, elcount(buffer), "0.0000 HMI_ADASLR_ProfLong_CtrlPnt_SpdCl := %X\n", getValue( HMI_ADASLR_ProfLong_CtrlPnt_SpdCl ) );        filePutString( buffer, elcount(buffer), hFile);
    snprintf( buffer, elcount(buffer), "0.0000 HMI_ADASLR_ProfLong_CycCnt_SpdCl := %X\n", getValue( HMI_ADASLR_ProfLong_CycCnt_SpdCl ) );        filePutString( buffer, elcount(buffer), hFile);
    snprintf( buffer, elcount(buffer), "0.0000 HMI_ADASLR_ProfLong_MsgTyp_SpdCl := %X\n", getValue( HMI_ADASLR_ProfLong_MsgTyp_SpdCl ) );        filePutString( buffer, elcount(buffer), hFile);
    snprintf( buffer, elcount(buffer), "0.0000 HMI_ADASLR_ProfLong_Offset_SpdCl := %X\n", getValue( HMI_ADASLR_ProfLong_Offset_SpdCl ) );        filePutString( buffer, elcount(buffer), hFile);
    snprintf( buffer, elcount(buffer), "0.0000 HMI_ADASLR_ProfLong_PathIdx_SpdCl := %X\n", getValue( HMI_ADASLR_ProfLong_PathIdx_SpdCl ) );        filePutString( buffer, elcount(buffer), hFile);
    snprintf( buffer, elcount(buffer), "0.0000 HMI_ADASLR_ProfLong_ReTr_SpdCl := %X\n", getValue( HMI_ADASLR_ProfLong_ReTr_SpdCl ) );        filePutString( buffer, elcount(buffer), hFile);
    snprintf( buffer, elcount(buffer), "0.0000 HMI_ADASLR_ProfLong_Updt_SpdCl := %X\n", getValue( HMI_ADASLR_ProfLong_Updt_SpdCl ) );        filePutString( buffer, elcount(buffer), hFile);
    snprintf( buffer, elcount(buffer), "0.0000 HMI_ADASLR_ProfLong_Val_SpdCl := %X\n", getValue( HMI_ADASLR_ProfLong_Val_SpdCl ) );        filePutString( buffer, elcount(buffer), hFile);
    snprintf( buffer, elcount(buffer), "0.0000 HMI_ADASLR_ProfLong_CtrlPnt_Hght := %X\n", getValue( HMI_ADASLR_ProfLong_CtrlPnt_Hght ) );        filePutString( buffer, elcount(buffer), hFile);
    snprintf( buffer, elcount(buffer), "0.0000 HMI_ADASLR_ProfLong_CtrlPnt_Latit := %X\n", getValue( HMI_ADASLR_ProfLong_CtrlPnt_Latit ) );		 filePutString( buffer, elcount(buffer), hFile);
	snprintf( buffer, elcount(buffer), "0.0000 HMI_ADASLR_ProfLong_CtrlPnt_Longi := %X\n", getValue( HMI_ADASLR_ProfLong_CtrlPnt_Longi ) );		 filePutString( buffer, elcount(buffer), hFile);
	snprintf( buffer, elcount(buffer), "0.0000 HMI_ADASLR_ProfLong_CycCnt_Hght := %X\n", getValue( HMI_ADASLR_ProfLong_CycCnt_Hght ) );        filePutString( buffer, elcount(buffer), hFile);
    snprintf( buffer, elcount(buffer), "0.0000 HMI_ADASLR_ProfLong_CycCnt_Longi := %X\n", getValue( HMI_ADASLR_ProfLong_CycCnt_Longi ) ); 		 filePutString( buffer, elcount(buffer), hFile);
	snprintf( buffer, elcount(buffer), "0.0000 HMI_ADASLR_ProfLong_CycCnt_Latit := %X\n", getValue( HMI_ADASLR_ProfLong_CycCnt_Latit ) );		 filePutString( buffer, elcount(buffer), hFile);
	snprintf( buffer, elcount(buffer), "0.0000 HMI_ADASLR_ProfLong_MsgTyp_Hght := %X\n", getValue( HMI_ADASLR_ProfLong_MsgTyp_Hght ) );        filePutString( buffer, elcount(buffer), hFile);
    snprintf( buffer, elcount(buffer), "0.0000 HMI_ADASLR_ProfLong_MsgTyp_Latit := %X\n", getValue( HMI_ADASLR_ProfLong_MsgTyp_Latit ) );		 filePutString( buffer, elcount(buffer), hFile);
	snprintf( buffer, elcount(buffer), "0.0000 HMI_ADASLR_ProfLong_MsgTyp_Longi := %X\n", getValue( HMI_ADASLR_ProfLong_MsgTyp_Longi ) );		 filePutString( buffer, elcount(buffer), hFile);
	snprintf( buffer, elcount(buffer), "0.0000 HMI_ADASLR_ProfLong_Offset_Hght := %X\n", getValue( HMI_ADASLR_ProfLong_Offset_Hght ) );        filePutString( buffer, elcount(buffer), hFile);
    snprintf( buffer, elcount(buffer), "0.0000 HMI_ADASLR_ProfLong_Offset_Longi := %X\n", getValue( HMI_ADASLR_ProfLong_Offset_Longi ) );		 filePutString( buffer, elcount(buffer), hFile);
	snprintf( buffer, elcount(buffer), "0.0000 HMI_ADASLR_ProfLong_Offset_Latit := %X\n", getValue( HMI_ADASLR_ProfLong_Offset_Latit ) );		 filePutString( buffer, elcount(buffer), hFile);
	snprintf( buffer, elcount(buffer), "0.0000 HMI_ADASLR_ProfLong_PathIdx_Hght := %X\n", getValue( HMI_ADASLR_ProfLong_PathIdx_Hght ) );        filePutString( buffer, elcount(buffer), hFile);
    snprintf( buffer, elcount(buffer), "0.0000 HMI_ADASLR_ProfLong_PathIdx_Longi := %X\n", getValue( HMI_ADASLR_ProfLong_PathIdx_Longi ) ); 	 filePutString( buffer, elcount(buffer), hFile);
	snprintf( buffer, elcount(buffer), "0.0000 HMI_ADASLR_ProfLong_PathIdx_Latit := %X\n", getValue( HMI_ADASLR_ProfLong_PathIdx_Latit ) ); 	 filePutString( buffer, elcount(buffer), hFile);
	snprintf( buffer, elcount(buffer), "0.0000 HMI_ADASLR_ProfLong_ReTr_Hght := %X\n", getValue( HMI_ADASLR_ProfLong_ReTr_Hght ) );        filePutString( buffer, elcount(buffer), hFile);
    snprintf( buffer, elcount(buffer), "0.0000 HMI_ADASLR_ProfLong_Updt_Hght := %X\n", getValue( HMI_ADASLR_ProfLong_Updt_Hght ) );        filePutString( buffer, elcount(buffer), hFile);
    snprintf( buffer, elcount(buffer), "0.0000 HMI_ADASLR_ProfLong_Updt_Longi := %X\n", getValue( HMI_ADASLR_ProfLong_Updt_Longi ) );		filePutString( buffer, elcount(buffer), hFile);
	snprintf( buffer, elcount(buffer), "0.0000 HMI_ADASLR_ProfLong_Updt_Latit := %X\n", getValue( HMI_ADASLR_ProfLong_Updt_Latit ) ); 		filePutString( buffer, elcount(buffer), hFile);
	snprintf( buffer, elcount(buffer), "0.0000 HMI_ADASLR_ProfLong_Val_Hght := %X\n", getValue( HMI_ADASLR_ProfLong_Val_Hght ) );        filePutString( buffer, elcount(buffer), hFile);
    snprintf( buffer, elcount(buffer), "0.0000 HMI_ADASLR_ProfLong_Val_Longi := %X\n", getValue( HMI_ADASLR_ProfLong_Val_Longi ) );		 filePutString( buffer, elcount(buffer), hFile);
	snprintf( buffer, elcount(buffer), "0.0000 HMI_ADASLR_ProfLong_Val_Latit := %X\n", getValue( HMI_ADASLR_ProfLong_Val_Latit ) );		 filePutString( buffer, elcount(buffer), hFile);
	snprintf( buffer, elcount(buffer), "0.0000 HMI_ADASLR_ProfLong_BuA_SpecZ := %X\n", getValue( HMI_ADASLR_ProfLong_BuA_SpecZ ) );        filePutString( buffer, elcount(buffer), hFile);
    snprintf( buffer, elcount(buffer), "0.0000 HMI_ADASLR_ProfLong_CtrlPnt_SpecZ := %X\n", getValue( HMI_ADASLR_ProfLong_CtrlPnt_SpecZ ) );        filePutString( buffer, elcount(buffer), hFile);
    snprintf( buffer, elcount(buffer), "0.0000 HMI_ADASLR_ProfLong_CycCnt_SpecZ := %X\n", getValue( HMI_ADASLR_ProfLong_CycCnt_SpecZ ) );        filePutString( buffer, elcount(buffer), hFile);
    snprintf( buffer, elcount(buffer), "0.0000 HMI_ADASLR_ProfLong_Dest_SpecZ := %X\n", getValue( HMI_ADASLR_ProfLong_Dest_SpecZ ) );        filePutString( buffer, elcount(buffer), hFile);
    snprintf( buffer, elcount(buffer), "0.0000 HMI_ADASLR_ProfLong_MsgTyp_SpecZ := %X\n", getValue( HMI_ADASLR_ProfLong_MsgTyp_SpecZ ) );        filePutString( buffer, elcount(buffer), hFile);
    snprintf( buffer, elcount(buffer), "0.0000 HMI_ADASLR_ProfLong_Offset_SpecZ := %X\n", getValue( HMI_ADASLR_ProfLong_Offset_SpecZ ) );        filePutString( buffer, elcount(buffer), hFile);
    snprintf( buffer, elcount(buffer), "0.0000 HMI_ADASLR_ProfLong_PathIdx_SpecZ := %X\n", getValue( HMI_ADASLR_ProfLong_PathIdx_SpecZ ) );        filePutString( buffer, elcount(buffer), hFile);
    snprintf( buffer, elcount(buffer), "0.0000 HMI_ADASLR_ProfLong_ReTr_SpecZ := %X\n", getValue( HMI_ADASLR_ProfLong_ReTr_SpecZ ) );        filePutString( buffer, elcount(buffer), hFile);
    snprintf( buffer, elcount(buffer), "0.0000 HMI_ADASLR_ProfLong_Updt_SpecZ := %X\n", getValue( HMI_ADASLR_ProfLong_Updt_SpecZ ) );        filePutString( buffer, elcount(buffer), hFile);
    snprintf( buffer, elcount(buffer), "0.0000 HMI_ADASLR_ProfLong_Val_SpecZ := %X\n", getValue( HMI_ADASLR_ProfLong_Val_SpecZ ) );        filePutString( buffer, elcount(buffer), hFile);
    snprintf( buffer, elcount(buffer), "0.0000 HMI_ADASLR_ProfLong_CtrlPnt_RestA := %X\n", getValue( HMI_ADASLR_ProfLong_CtrlPnt_RestA ) );        filePutString( buffer, elcount(buffer), hFile);
    snprintf( buffer, elcount(buffer), "0.0000 HMI_ADASLR_ProfLong_CycCnt_RestA := %X\n", getValue( HMI_ADASLR_ProfLong_CycCnt_RestA ) );        filePutString( buffer, elcount(buffer), hFile);
    snprintf( buffer, elcount(buffer), "0.0000 HMI_ADASLR_ProfLong_MsgTyp_RestA := %X\n", getValue( HMI_ADASLR_ProfLong_MsgTyp_RestA ) );        filePutString( buffer, elcount(buffer), hFile);
    snprintf( buffer, elcount(buffer), "0.0000 HMI_ADASLR_ProfLong_Offset_RestA := %X\n", getValue( HMI_ADASLR_ProfLong_Offset_RestA ) );        filePutString( buffer, elcount(buffer), hFile);
    snprintf( buffer, elcount(buffer), "0.0000 HMI_ADASLR_ProfLong_PathIdx_RestA := %X\n", getValue( HMI_ADASLR_ProfLong_PathIdx_RestA ) );        filePutString( buffer, elcount(buffer), hFile);
    snprintf( buffer, elcount(buffer), "0.0000 HMI_ADASLR_ProfLong_ReTr_RestA := %X\n", getValue( HMI_ADASLR_ProfLong_ReTr_RestA ) );        filePutString( buffer, elcount(buffer), hFile);
    snprintf( buffer, elcount(buffer), "0.0000 HMI_ADASLR_ProfLong_ReTr_Longi := %X\n", getValue( HMI_ADASLR_ProfLong_ReTr_Longi ) );		 filePutString( buffer, elcount(buffer), hFile);
	snprintf( buffer, elcount(buffer), "0.0000 HMI_ADASLR_ProfLong_ReTr_Latit := %X\n", getValue( HMI_ADASLR_ProfLong_ReTr_Latit ) );		 filePutString( buffer, elcount(buffer), hFile);
	snprintf( buffer, elcount(buffer), "0.0000 HMI_ADASLR_ProfLong_Updt_RestA := %X\n", getValue( HMI_ADASLR_ProfLong_Updt_RestA ) );        filePutString( buffer, elcount(buffer), hFile);
    snprintf( buffer, elcount(buffer), "0.0000 HMI_ADASLR_ProfLong_Val_RestA := %X\n", getValue( HMI_ADASLR_ProfLong_Val_RestA ) );        filePutString( buffer, elcount(buffer), hFile);
    snprintf( buffer, elcount(buffer), "0.0000 HMI_ADASLR_ProfLong_CtrlPnt_PTData := %X\n", getValue( HMI_ADASLR_ProfLong_CtrlPnt_PTData ) );        filePutString( buffer, elcount(buffer), hFile);
    snprintf( buffer, elcount(buffer), "0.0000 HMI_ADASLR_ProfLong_CycCnt_PTData := %X\n", getValue( HMI_ADASLR_ProfLong_CycCnt_PTData ) );        filePutString( buffer, elcount(buffer), hFile);
    snprintf( buffer, elcount(buffer), "0.0000 HMI_ADASLR_ProfLong_MsgTyp_PTData := %X\n", getValue( HMI_ADASLR_ProfLong_MsgTyp_PTData ) );        filePutString( buffer, elcount(buffer), hFile);
    snprintf( buffer, elcount(buffer), "0.0000 HMI_ADASLR_ProfLong_Offset_PTData := %X\n", getValue( HMI_ADASLR_ProfLong_Offset_PTData ) );        filePutString( buffer, elcount(buffer), hFile);
    snprintf( buffer, elcount(buffer), "0.0000 HMI_ADASLR_ProfLong_PathIdx_PTData := %X\n", getValue( HMI_ADASLR_ProfLong_PathIdx_PTData ) );        filePutString( buffer, elcount(buffer), hFile);
    snprintf( buffer, elcount(buffer), "0.0000 HMI_ADASLR_ProfLong_ReTr_PTData := %X\n", getValue( HMI_ADASLR_ProfLong_ReTr_PTData ) );        filePutString( buffer, elcount(buffer), hFile);
    snprintf( buffer, elcount(buffer), "0.0000 HMI_ADASLR_ProfLong_Updt_PTData := %X\n", getValue( HMI_ADASLR_ProfLong_Updt_PTData ) );        filePutString( buffer, elcount(buffer), hFile);
    snprintf( buffer, elcount(buffer), "0.0000 HMI_ADASLR_ProfLong_Val_AttrId_PTData := %X\n", getValue( HMI_ADASLR_ProfLong_Val_AttrId_PTData ) );        filePutString( buffer, elcount(buffer), hFile);
    snprintf( buffer, elcount(buffer), "0.0000 HMI_ADASLR_ProfLong_Val_AttrOfst_PTData := %X\n", getValue( HMI_ADASLR_ProfLong_Val_AttrOfst_PTData ) );        filePutString( buffer, elcount(buffer), hFile);
    snprintf( buffer, elcount(buffer), "0.0000 HMI_ADASLR_ProfLong_Val_ComRtNum_PTData := %X\n", getValue( HMI_ADASLR_ProfLong_Val_ComRtNum_PTData ) );        filePutString( buffer, elcount(buffer), hFile);
    snprintf( buffer, elcount(buffer), "0.0000 HMI_ADASLR_ProfLong_Val_PTData := %X\n", getValue( HMI_ADASLR_ProfLong_Val_PTData ) );        filePutString( buffer, elcount(buffer), hFile);
    snprintf( buffer, elcount(buffer), "0.0000 HMI_ADASLR_ProfLong_EngyAvl_CNG_RestA := %X\n", getValue( HMI_ADASLR_ProfLong_EngyAvl_CNG_RestA ) );        filePutString( buffer, elcount(buffer), hFile);
    snprintf( buffer, elcount(buffer), "0.0000 HMI_ADASLR_ProfLong_EngyAvl_Diesel_RestA := %X\n", getValue( HMI_ADASLR_ProfLong_EngyAvl_Diesel_RestA ) );        filePutString( buffer, elcount(buffer), hFile);
    snprintf( buffer, elcount(buffer), "0.0000 HMI_ADASLR_ProfLong_EngyAvl_EngyTyp1_RestA := %X\n", getValue( HMI_ADASLR_ProfLong_EngyAvl_EngyTyp1_RestA ) );        filePutString( buffer, elcount(buffer), hFile);
    snprintf( buffer, elcount(buffer), "0.0000 HMI_ADASLR_ProfLong_EngyAvl_EngyTyp2_RestA := %X\n", getValue( HMI_ADASLR_ProfLong_EngyAvl_EngyTyp2_RestA ) );        filePutString( buffer, elcount(buffer), hFile);
    snprintf( buffer, elcount(buffer), "0.0000 HMI_ADASLR_ProfLong_EngyAvl_Gasoline_RestA := %X\n", getValue( HMI_ADASLR_ProfLong_EngyAvl_Gasoline_RestA ) );        filePutString( buffer, elcount(buffer), hFile);
    snprintf( buffer, elcount(buffer), "0.0000 HMI_ADASLR_ProfLong_EngyAvl_H2_RestA := %X\n", getValue( HMI_ADASLR_ProfLong_EngyAvl_H2_RestA ) );        filePutString( buffer, elcount(buffer), hFile);
    snprintf( buffer, elcount(buffer), "0.0000 HMI_ADASLR_ProfLong_EngyAvl_LNG_RestA := %X\n", getValue( HMI_ADASLR_ProfLong_EngyAvl_LNG_RestA ) );        filePutString( buffer, elcount(buffer), hFile);
    snprintf( buffer, elcount(buffer), "0.0000 HMI_ADASLR_ProfLong_EngyAvl_Pwr_RestA := %X\n", getValue( HMI_ADASLR_ProfLong_EngyAvl_Pwr_RestA ) );        filePutString( buffer, elcount(buffer), hFile);
    snprintf( buffer, elcount(buffer), "0.0000 HMI_ADASLR_ProfLong_AirTemp_WthrOffboard:= %X\n", getValue( HMI_ADASLR_ProfLong_AirTemp_WthrOffboard) );        filePutString( buffer, elcount(buffer), hFile);
    snprintf( buffer, elcount(buffer), "0.0000 HMI_ADASLR_ProfLong_CtrlPnt_WthrOffboard:= %X\n", getValue( HMI_ADASLR_ProfLong_CtrlPnt_WthrOffboard) );        filePutString( buffer, elcount(buffer), hFile);
    snprintf( buffer, elcount(buffer), "0.0000 HMI_ADASLR_ProfLong_CycCnt_WthrOffboard:= %X\n", getValue( HMI_ADASLR_ProfLong_CycCnt_WthrOffboard) );        filePutString( buffer, elcount(buffer), hFile);
    snprintf( buffer, elcount(buffer), "0.0000 HMI_ADASLR_ProfLong_MsgTyp_WthrOffboard:= %X\n", getValue( HMI_ADASLR_ProfLong_MsgTyp_WthrOffboard) );        filePutString( buffer, elcount(buffer), hFile);
    snprintf( buffer, elcount(buffer), "0.0000 HMI_ADASLR_ProfLong_Offset_WthrOffboard:= %X\n", getValue( HMI_ADASLR_ProfLong_Offset_WthrOffboard) );        filePutString( buffer, elcount(buffer), hFile);
    snprintf( buffer, elcount(buffer), "0.0000 HMI_ADASLR_ProfLong_PathIdx_WthrOffboard:= %X\n", getValue( HMI_ADASLR_ProfLong_PathIdx_WthrOffboard) );        filePutString( buffer, elcount(buffer), hFile);
    snprintf( buffer, elcount(buffer), "0.0000 HMI_ADASLR_ProfLong_ReTr_WthrOffboard:= %X\n", getValue( HMI_ADASLR_ProfLong_ReTr_WthrOffboard) );        filePutString( buffer, elcount(buffer), hFile);
    snprintf( buffer, elcount(buffer), "0.0000 HMI_ADASLR_ProfLong_Updt_WthrOffboard:= %X\n", getValue( HMI_ADASLR_ProfLong_Updt_WthrOffboard) );        filePutString( buffer, elcount(buffer), hFile);
    snprintf( buffer, elcount(buffer), "0.0000 HMI_ADASLR_ProfLong_WindDir_WthrOffboard:= %X\n", getValue( HMI_ADASLR_ProfLong_WindDir_WthrOffboard) );        filePutString( buffer, elcount(buffer), hFile);
    snprintf( buffer, elcount(buffer), "0.0000 HMI_ADASLR_ProfLong_WindSpd_WthrOffboard:= %X\n", getValue( HMI_ADASLR_ProfLong_WindSpd_WthrOffboard) );        filePutString( buffer, elcount(buffer), hFile);
    snprintf( buffer, elcount(buffer), "0.0000 HMI_ADASLR_ProfLong_AvgSpd_AvgSpdOffboard:= %X\n", getValue( HMI_ADASLR_ProfLong_AvgSpd_AvgSpdOffboard) );        filePutString( buffer, elcount(buffer), hFile);
    snprintf( buffer, elcount(buffer), "0.0000 HMI_ADASLR_ProfLong_CtrlPnt_AvgSpdOffboard:= %X\n", getValue( HMI_ADASLR_ProfLong_CtrlPnt_AvgSpdOffboard) );        filePutString( buffer, elcount(buffer), hFile);
    snprintf( buffer, elcount(buffer), "0.0000 HMI_ADASLR_ProfLong_CycCnt_AvgSpdOffboard:= %X\n", getValue( HMI_ADASLR_ProfLong_CycCnt_AvgSpdOffboard) );        filePutString( buffer, elcount(buffer), hFile);
    snprintf( buffer, elcount(buffer), "0.0000 HMI_ADASLR_ProfLong_MsgTyp_AvgSpdOffboard:= %X\n", getValue( HMI_ADASLR_ProfLong_MsgTyp_AvgSpdOffboard) );        filePutString( buffer, elcount(buffer), hFile);
    snprintf( buffer, elcount(buffer), "0.0000 HMI_ADASLR_ProfLong_Offset_AvgSpdOffboard:= %X\n", getValue( HMI_ADASLR_ProfLong_Offset_AvgSpdOffboard) );        filePutString( buffer, elcount(buffer), hFile);
    snprintf( buffer, elcount(buffer), "0.0000 HMI_ADASLR_ProfLong_PathIdx_AvgSpdOffboard:= %X\n", getValue( HMI_ADASLR_ProfLong_PathIdx_AvgSpdOffboard) );        filePutString( buffer, elcount(buffer), hFile);
    snprintf( buffer, elcount(buffer), "0.0000 HMI_ADASLR_ProfLong_ReTr_AvgSpdOffboard:= %X\n", getValue( HMI_ADASLR_ProfLong_ReTr_AvgSpdOffboard) );        filePutString( buffer, elcount(buffer), hFile);
    snprintf( buffer, elcount(buffer), "0.0000 HMI_ADASLR_ProfLong_Updt_AvgSpdOffboard:= %X\n", getValue( HMI_ADASLR_ProfLong_Updt_AvgSpdOffboard) );        filePutString( buffer, elcount(buffer), hFile);
}

on timer _tADASLR_PROFILE_LONG_AR
{
    putValue( HMI__STMSG_ADASLR_PROFILE_LONG_AR, 0 );
}

on EnvVar HMI__STMSG_ADASLR_PROFILE_LONG_AR
{
    long tDelay;
    if( getValue( this ) == 2 )
    {
        tDelay = getValue( HMI__STMSGT_ADASLR_PROFILE_LONG_AR );
        if( tDelay > 0 )    
            setTimer( _tADASLR_PROFILE_LONG_AR, tDelay );
        else
            putValue( HMI__STMSG_ADASLR_PROFILE_LONG_AR, 0 );
    }
}

on envVar HMI__STMSG_PO_ADASLR_PROFILE_LONG_AR
{
    if( getValue( this ) )
        openPanel("ADASLR_PROFILE_LONG_AR");
}

on EnvVar HMI_ADASLR_ProfLong_ProfTyp
{
    _mADASLR_PROFILE_LONG_AR.ADASLR_ProfLong_ProfTyp.phys = getValue(this);
}

on EnvVar HMI_ADASLR_ProfLong_CycCnt_SpdCl
{
    _mADASLR_PROFILE_LONG_AR.ADASLR_ProfLong_CycCnt_SpdCl.phys = getValue(this);
}

on EnvVar HMI_ADASLR_ProfLong_PathIdx_SpdCl
{
    _mADASLR_PROFILE_LONG_AR.ADASLR_ProfLong_PathIdx_SpdCl.phys = getValue(this);
}

on EnvVar HMI_ADASLR_ProfLong_ReTr_SpdCl
{
    _mADASLR_PROFILE_LONG_AR.ADASLR_ProfLong_ReTr_SpdCl.phys = getValue(this);
}

on EnvVar HMI_ADASLR_ProfLong_Offset_SpdCl
{
    _mADASLR_PROFILE_LONG_AR.ADASLR_ProfLong_Offset_SpdCl.phys = getValue(this);
}

on EnvVar HMI_ADASLR_ProfLong_Updt_SpdCl
{
    _mADASLR_PROFILE_LONG_AR.ADASLR_ProfLong_Updt_SpdCl.phys = getValue(this);
}

on EnvVar HMI_ADASLR_ProfLong_Updt_Latit
{
	_mADASLR_PROFILE_LONG_AR.ADASLR_ProfLong_Updt_Latit.phys = getValue(this);
}

on EnvVar HMI_ADASLR_ProfLong_Updt_Longi
{
	_mADASLR_PROFILE_LONG_AR.ADASLR_ProfLong_Updt_Longi.phys = getValue(this);
}

on EnvVar HMI_ADASLR_ProfLong_CtrlPnt_SpdCl
{
    _mADASLR_PROFILE_LONG_AR.ADASLR_ProfLong_CtrlPnt_SpdCl.phys = getValue(this);
}

on EnvVar HMI_ADASLR_ProfLong_MsgTyp_SpdCl
{
    _mADASLR_PROFILE_LONG_AR.ADASLR_ProfLong_MsgTyp_SpdCl.phys = getValue(this);
}

on EnvVar HMI_ADASLR_ProfLong_Val_SpdCl
{
    _mADASLR_PROFILE_LONG_AR.ADASLR_ProfLong_Val_SpdCl.phys = getValue(this);
}

on EnvVar HMI_ADASLR_ProfLong_Val_Latit
{
	_mADASLR_PROFILE_LONG_AR.ADASLR_ProfLong_Val_Latit.phys = getValue(this);
}

on EnvVar HMI_ADASLR_ProfLong_Val_Longi
{
	_mADASLR_PROFILE_LONG_AR.ADASLR_ProfLong_Val_Longi.phys = getValue(this);
}

on EnvVar HMI_ADASLR_ProfLong_PathIdx_Hght
{
    _mADASLR_PROFILE_LONG_AR.ADASLR_ProfLong_PathIdx_Hght.phys = getValue(this);
}

on EnvVar HMI_ADASLR_ProfLong_PathIdx_Latit
{
	_mADASLR_PROFILE_LONG_AR.ADASLR_ProfLong_PathIdx_Latit.phys = getValue(this);
}

on EnvVar HMI_ADASLR_ProfLong_PathIdx_Longi
{
	_mADASLR_PROFILE_LONG_AR.ADASLR_ProfLong_PathIdx_Longi.phys = getValue(this);
}

on EnvVar HMI_ADASLR_ProfLong_Updt_Hght
{
    _mADASLR_PROFILE_LONG_AR.ADASLR_ProfLong_Updt_Hght.phys = getValue(this);
}

on EnvVar HMI_ADASLR_ProfLong_Val_Hght
{
    _mADASLR_PROFILE_LONG_AR.ADASLR_ProfLong_Val_Hght.phys = getValue(this);
}

on EnvVar HMI_ADASLR_ProfLong_CycCnt_Hght
{
    _mADASLR_PROFILE_LONG_AR.ADASLR_ProfLong_CycCnt_Hght.phys = getValue(this);
}

on EnvVar HMI_ADASLR_ProfLong_ReTr_Hght
{
    _mADASLR_PROFILE_LONG_AR.ADASLR_ProfLong_ReTr_Hght.phys = getValue(this);
}

on EnvVar HMI_ADASLR_ProfLong_ReTr_Latit
{
	_mADASLR_PROFILE_LONG_AR.ADASLR_ProfLong_ReTr_Latit.phys = getValue(this);
}

on EnvVar HMI_ADASLR_ProfLong_ReTr_Longi
{
	_mADASLR_PROFILE_LONG_AR.ADASLR_ProfLong_ReTr_Longi.phys = getValue(this);
}

on EnvVar HMI_ADASLR_ProfLong_CtrlPnt_Longi
{
	_mADASLR_PROFILE_LONG_AR.ADASLR_ProfLong_CtrlPnt_Longi.phys = getValue(this);
}

on EnvVar HMI_ADASLR_ProfLong_CtrlPnt_Latit
{
	_mADASLR_PROFILE_LONG_AR.ADASLR_ProfLong_CtrlPnt_Latit.phys = getValue(this);
}

on EnvVar HMI_ADASLR_ProfLong_CycCnt_Latit
{
	_mADASLR_PROFILE_LONG_AR.ADASLR_ProfLong_CycCnt_Latit.phys = getValue(this);
}

on EnvVar HMI_ADASLR_ProfLong_CycCnt_Longi
{
	_mADASLR_PROFILE_LONG_AR.ADASLR_ProfLong_CycCnt_Longi.phys = getValue(this);
}

on EnvVar HMI_ADASLR_ProfLong_Offset_Hght
{
    _mADASLR_PROFILE_LONG_AR.ADASLR_ProfLong_Offset_Hght.phys = getValue(this);
}

on EnvVar HMI_ADASLR_ProfLong_Offset_Latit
{
	_mADASLR_PROFILE_LONG_AR.ADASLR_ProfLong_Offset_Latit.phys = getValue(this);
}

on EnvVar HMI_ADASLR_ProfLong_Offset_Longi
{
	_mADASLR_PROFILE_LONG_AR.ADASLR_ProfLong_Offset_Longi.phys = getValue(this);
}

on EnvVar HMI_ADASLR_ProfLong_MsgTyp_Hght
{
    _mADASLR_PROFILE_LONG_AR.ADASLR_ProfLong_MsgTyp_Hght.phys = getValue(this);
}

on EnvVar HMI_ADASLR_ProfLong_MsgTyp_Latit
{
	_mADASLR_PROFILE_LONG_AR.ADASLR_ProfLong_MsgTyp_Latit.phys = getValue(this);
}

on EnvVar HMI_ADASLR_ProfLong_MsgTyp_Longi
{
	_mADASLR_PROFILE_LONG_AR.ADASLR_ProfLong_MsgTyp_Longi.phys = getValue(this);
}
on EnvVar HMI_ADASLR_ProfLong_CtrlPnt_Hght
{
    _mADASLR_PROFILE_LONG_AR.ADASLR_ProfLong_CtrlPnt_Hght.phys = getValue(this);
}

on EnvVar HMI_ADASLR_ProfLong_BuA_SpecZ
{
    _mADASLR_PROFILE_LONG_AR.ADASLR_ProfLong_BuA_SpecZ.phys = getValue(this);
}

on EnvVar HMI_ADASLR_ProfLong_CtrlPnt_SpecZ
{
    _mADASLR_PROFILE_LONG_AR.ADASLR_ProfLong_CtrlPnt_SpecZ.phys = getValue(this);
}

on EnvVar HMI_ADASLR_ProfLong_CycCnt_SpecZ
{
    _mADASLR_PROFILE_LONG_AR.ADASLR_ProfLong_CycCnt_SpecZ.phys = getValue(this);
}

on EnvVar HMI_ADASLR_ProfLong_Dest_SpecZ
{
    _mADASLR_PROFILE_LONG_AR.ADASLR_ProfLong_Dest_SpecZ.phys = getValue(this);
}

on EnvVar HMI_ADASLR_ProfLong_MsgTyp_SpecZ
{
    _mADASLR_PROFILE_LONG_AR.ADASLR_ProfLong_MsgTyp_SpecZ.phys = getValue(this);
}

on EnvVar HMI_ADASLR_ProfLong_Offset_SpecZ
{
    _mADASLR_PROFILE_LONG_AR.ADASLR_ProfLong_Offset_SpecZ.phys = getValue(this);
}

on EnvVar HMI_ADASLR_ProfLong_PathIdx_SpecZ
{
    _mADASLR_PROFILE_LONG_AR.ADASLR_ProfLong_PathIdx_SpecZ.phys = getValue(this);
}

on EnvVar HMI_ADASLR_ProfLong_ReTr_SpecZ
{
    _mADASLR_PROFILE_LONG_AR.ADASLR_ProfLong_ReTr_SpecZ.phys = getValue(this);
}

on EnvVar HMI_ADASLR_ProfLong_Updt_SpecZ
{
    _mADASLR_PROFILE_LONG_AR.ADASLR_ProfLong_Updt_SpecZ.phys = getValue(this);
}

on EnvVar HMI_ADASLR_ProfLong_Val_SpecZ
{
    _mADASLR_PROFILE_LONG_AR.ADASLR_ProfLong_Val_SpecZ.phys = getValue(this);
}

on EnvVar HMI_ADASLR_ProfLong_CtrlPnt_RestA
{
    _mADASLR_PROFILE_LONG_AR.ADASLR_ProfLong_CtrlPnt_RestA.phys = getValue(this);
}

on EnvVar HMI_ADASLR_ProfLong_CycCnt_RestA
{
    _mADASLR_PROFILE_LONG_AR.ADASLR_ProfLong_CycCnt_RestA.phys = getValue(this);
}

on EnvVar HMI_ADASLR_ProfLong_MsgTyp_RestA
{
    _mADASLR_PROFILE_LONG_AR.ADASLR_ProfLong_MsgTyp_RestA.phys = getValue(this);
}

on EnvVar HMI_ADASLR_ProfLong_Offset_RestA
{
    _mADASLR_PROFILE_LONG_AR.ADASLR_ProfLong_Offset_RestA.phys = getValue(this);
}

on EnvVar HMI_ADASLR_ProfLong_PathIdx_RestA
{
    _mADASLR_PROFILE_LONG_AR.ADASLR_ProfLong_PathIdx_RestA.phys = getValue(this);
}

on EnvVar HMI_ADASLR_ProfLong_ReTr_RestA
{
    _mADASLR_PROFILE_LONG_AR.ADASLR_ProfLong_ReTr_RestA.phys = getValue(this);
}

on EnvVar HMI_ADASLR_ProfLong_Updt_RestA
{
    _mADASLR_PROFILE_LONG_AR.ADASLR_ProfLong_Updt_RestA.phys = getValue(this);
}

on EnvVar HMI_ADASLR_ProfLong_Val_RestA
{
    _mADASLR_PROFILE_LONG_AR.ADASLR_ProfLong_Val_RestA.phys = getValue(this);
}

on EnvVar HMI_ADASLR_ProfLong_CtrlPnt_PTData
{
    _mADASLR_PROFILE_LONG_AR.ADASLR_ProfLong_CtrlPnt_PTData.phys = getValue(this);
}

on EnvVar HMI_ADASLR_ProfLong_CycCnt_PTData
{
    _mADASLR_PROFILE_LONG_AR.ADASLR_ProfLong_CycCnt_PTData.phys = getValue(this);
}

on EnvVar HMI_ADASLR_ProfLong_MsgTyp_PTData
{
    _mADASLR_PROFILE_LONG_AR.ADASLR_ProfLong_MsgTyp_PTData.phys = getValue(this);
}

on EnvVar HMI_ADASLR_ProfLong_Offset_PTData
{
    _mADASLR_PROFILE_LONG_AR.ADASLR_ProfLong_Offset_PTData.phys = getValue(this);
}

on EnvVar HMI_ADASLR_ProfLong_PathIdx_PTData
{
    _mADASLR_PROFILE_LONG_AR.ADASLR_ProfLong_PathIdx_PTData.phys = getValue(this);
}

on EnvVar HMI_ADASLR_ProfLong_ReTr_PTData
{
    _mADASLR_PROFILE_LONG_AR.ADASLR_ProfLong_ReTr_PTData.phys = getValue(this);
}

on EnvVar HMI_ADASLR_ProfLong_Updt_PTData
{
    _mADASLR_PROFILE_LONG_AR.ADASLR_ProfLong_Updt_PTData.phys = getValue(this);
}

on EnvVar HMI_ADASLR_ProfLong_Val_AttrId_PTData
{
    _mADASLR_PROFILE_LONG_AR.ADASLR_ProfLong_Val_AttrId_PTData.phys = getValue(this);
}

on EnvVar HMI_ADASLR_ProfLong_Val_AttrOfst_PTData
{
    _mADASLR_PROFILE_LONG_AR.ADASLR_ProfLong_Val_AttrOfst_PTData.phys = getValue(this);
}

on EnvVar HMI_ADASLR_ProfLong_Val_ComRtNum_PTData
{
    _mADASLR_PROFILE_LONG_AR.ADASLR_ProfLong_Val_ComRtNum_PTData.phys = getValue(this);
}

on EnvVar HMI_ADASLR_ProfLong_Val_PTData
{
    _mADASLR_PROFILE_LONG_AR.ADASLR_ProfLong_Val_PTData.phys = getValue(this);
}

on EnvVar HMI_ADASLR_ProfLong_EngyAvl_Pwr_RestA
{
    _mADASLR_PROFILE_LONG_AR.ADASLR_ProfLong_EngyAvl_Pwr_RestA.phys = getValue(this);
}

on EnvVar HMI_ADASLR_ProfLong_EngyAvl_CNG_RestA
{
    _mADASLR_PROFILE_LONG_AR.ADASLR_ProfLong_EngyAvl_CNG_RestA.phys = getValue(this);
}

on EnvVar HMI_ADASLR_ProfLong_EngyAvl_Diesel_RestA
{
    _mADASLR_PROFILE_LONG_AR.ADASLR_ProfLong_EngyAvl_Diesel_RestA.phys = getValue(this);

}

on EnvVar HMI_ADASLR_ProfLong_EngyAvl_EngyTyp1_RestA
{
    _mADASLR_PROFILE_LONG_AR.ADASLR_ProfLong_EngyAvl_EngyTyp1_RestA.phys = getValue(this);
}

on EnvVar HMI_ADASLR_ProfLong_EngyAvl_EngyTyp2_RestA
{
    _mADASLR_PROFILE_LONG_AR.ADASLR_ProfLong_EngyAvl_EngyTyp2_RestA.phys = getValue(this);
}

on EnvVar HMI_ADASLR_ProfLong_EngyAvl_Gasoline_RestA
{
    _mADASLR_PROFILE_LONG_AR.ADASLR_ProfLong_EngyAvl_Gasoline_RestA.phys = getValue(this);
}

on EnvVar HMI_ADASLR_ProfLong_EngyAvl_H2_RestA
{
    _mADASLR_PROFILE_LONG_AR.ADASLR_ProfLong_EngyAvl_H2_RestA.phys = getValue(this);
}

on EnvVar HMI_ADASLR_ProfLong_EngyAvl_LNG_RestA
{
    _mADASLR_PROFILE_LONG_AR.ADASLR_ProfLong_EngyAvl_LNG_RestA.phys = getValue(this);
}

on EnvVar HMI_ADASLR_ProfLong_AirTemp_WthrOffboard
{
	_mADASLR_PROFILE_LONG_AR.ADASLR_ProfLong_AirTemp_WthrOffboard.phys = getValue(this);
}

on EnvVar HMI_ADASLR_ProfLong_CtrlPnt_WthrOffboard
{
	_mADASLR_PROFILE_LONG_AR.ADASLR_ProfLong_CtrlPnt_WthrOffboard.phys = getValue(this);
}

on EnvVar HMI_ADASLR_ProfLong_CycCnt_WthrOffboard
{
	_mADASLR_PROFILE_LONG_AR.ADASLR_ProfLong_CycCnt_WthrOffboard.phys = getValue(this);
}

on EnvVar HMI_ADASLR_ProfLong_MsgTyp_WthrOffboard
{
	_mADASLR_PROFILE_LONG_AR.ADASLR_ProfLong_MsgTyp_WthrOffboard.phys = getValue(this);
}

on EnvVar HMI_ADASLR_ProfLong_Offset_WthrOffboard
{
	_mADASLR_PROFILE_LONG_AR.ADASLR_ProfLong_Offset_WthrOffboard.phys = getValue(this);
}

on EnvVar HMI_ADASLR_ProfLong_PathIdx_WthrOffboard
{
	_mADASLR_PROFILE_LONG_AR.ADASLR_ProfLong_PathIdx_WthrOffboard.phys = getValue(this);
}

on EnvVar HMI_ADASLR_ProfLong_ReTr_WthrOffboard
{
	_mADASLR_PROFILE_LONG_AR.ADASLR_ProfLong_ReTr_WthrOffboard.phys = getValue(this);
}

on EnvVar HMI_ADASLR_ProfLong_Updt_WthrOffboard
{
	_mADASLR_PROFILE_LONG_AR.ADASLR_ProfLong_Updt_WthrOffboard.phys = getValue(this);
}

on EnvVar HMI_ADASLR_ProfLong_WindDir_WthrOffboard
{
	_mADASLR_PROFILE_LONG_AR.ADASLR_ProfLong_WindDir_WthrOffboard.phys = getValue(this);
}

on EnvVar HMI_ADASLR_ProfLong_WindSpd_WthrOffboard
{
	_mADASLR_PROFILE_LONG_AR.ADASLR_ProfLong_WindSpd_WthrOffboard.phys = getValue(this);
}

on EnvVar HMI_ADASLR_ProfLong_AvgSpd_AvgSpdOffboard
{
	_mADASLR_PROFILE_LONG_AR.ADASLR_ProfLong_AvgSpd_AvgSpdOffboard.phys = getValue(this);
}

on EnvVar HMI_ADASLR_ProfLong_CtrlPnt_AvgSpdOffboard
{
	_mADASLR_PROFILE_LONG_AR.ADASLR_ProfLong_CtrlPnt_AvgSpdOffboard.phys = getValue(this);
}
on EnvVar HMI_ADASLR_ProfLong_CycCnt_AvgSpdOffboard
{
	_mADASLR_PROFILE_LONG_AR.ADASLR_ProfLong_CycCnt_AvgSpdOffboard.phys = getValue(this);
}

on EnvVar HMI_ADASLR_ProfLong_MsgTyp_AvgSpdOffboard
{
	_mADASLR_PROFILE_LONG_AR.ADASLR_ProfLong_MsgTyp_AvgSpdOffboard.phys = getValue(this);
}

on EnvVar HMI_ADASLR_ProfLong_Offset_AvgSpdOffboard
{
	_mADASLR_PROFILE_LONG_AR.ADASLR_ProfLong_Offset_AvgSpdOffboard.phys = getValue(this);
}

on EnvVar HMI_ADASLR_ProfLong_PathIdx_AvgSpdOffboard
{
	_mADASLR_PROFILE_LONG_AR.ADASLR_ProfLong_PathIdx_AvgSpdOffboard.phys = getValue(this);
}

on EnvVar HMI_ADASLR_ProfLong_ReTr_AvgSpdOffboard
{
	_mADASLR_PROFILE_LONG_AR.ADASLR_ProfLong_ReTr_AvgSpdOffboard.phys = getValue(this);
}

on EnvVar HMI_ADASLR_ProfLong_Updt_AvgSpdOffboard
{
	_mADASLR_PROFILE_LONG_AR.ADASLR_ProfLong_Updt_AvgSpdOffboard.phys = getValue(this);
}

Car2X_Disp_Rq_AR_check_output()
{
    if( !getValue( HMI__STMSG_Car2X_Disp_Rq_AR ))
    {
        // Botschaft Car2X_Disp_Rq_AR ID: 886 --- Sendeart cyclicAndSpontanWithDelay --- 
        _Car2X_Disp_Rq_AR_Cnt--;
        if( _Car2X_Disp_Rq_AR_Cnt < 1 )
        {
            // Nachricht wg. abgelaufenem Zyklus ausgeben
            output( _mCar2X_Disp_Rq_AR );
            _Car2X_Disp_Rq_AR_Cnt = _Car2X_Disp_Rq_AR_CycleCount; // Zyklus-Zähler zurücksetzen
             _Car2X_Disp_Rq_AR_SpontanFlag = 0; // Spontan-Flag zurücksetzen
        }
        else if( _Car2X_Disp_Rq_AR_SpontanFlag)
        {
            // Nachricht wg. spontaner Änderung ausgeben
            output( _mCar2X_Disp_Rq_AR );
             _Car2X_Disp_Rq_AR_SpontanFlag = 0; // Spontan-Flag zurücksetzen
        }
    }
}

Car2X_Disp_Rq_AR_init()
{   /* Botschaft Car2X_Disp_Rq_AR ID: 886 --- Sendeart cyclicAndSpontanWithDelay --- 
BA_ "ApplMessage" BO_ 886 0;
BA_ "NmAsrMessage" BO_ 886 0;
BA_ "GenMsgMinAcceptLength" BO_ 886 2;
BA_ "GenMsgILSupport" BO_ 886 1;
BA_ "DiagState" BO_ 886 0;
BA_ "DiagRequest" BO_ 886 0;
BA_ "DiagResponse" BO_ 886 0;
BA_ "GenMsgStartValue" BO_ 886 "0";
BA_ "GenMsgStartDelayTime" BO_ 886 55;
BA_ "GenMsgDelayTime" BO_ 886 100;
BA_ "GenMsgNrOfRepetition" BO_ 886 0;
BA_ "GenMsgCycleTime" BO_ 886 1000;
BA_ "GenMsgSendType" BO_ 886 5;
    */
    _Car2X_Disp_Rq_AR_Timebase =               c_tDBKomTimer_20ms;
    _Car2X_Disp_Rq_AR_CycleCount =           1000 / _Car2X_Disp_Rq_AR_Timebase;
    _Car2X_Disp_Rq_AR_StartDelay =             15 / _Car2X_Disp_Rq_AR_Timebase;
    _Car2X_Disp_Rq_AR_Cnt = _Car2X_Disp_Rq_AR_StartDelay;
    _Car2X_Disp_Rq_AR_SpontanFlag = 0;

    putValue( HMI__STMSGSD_Car2X_Disp_Rq_AR, _Car2X_Disp_Rq_AR_StartDelay * _Car2X_Disp_Rq_AR_Timebase );

    _mCar2X_Disp_Rq_AR.Car2X_WarnIcon_Disp_Rq.phys = getValue( HMI_Car2X_WarnIcon_Disp_Rq );
}

Car2X_Disp_Rq_AR_saveEnvVars( dword hFile )
{
    filePutString("\n// Knoten TGW: Car2X_Disp_Rq_AR\n", 26, hFile);
    snprintf( buffer, elcount(buffer), "0.0000 HMI__STMSG_Car2X_Disp_Rq_AR := %X\n", getValue( HMI__STMSG_Car2X_Disp_Rq_AR ) );        filePutString( buffer, elcount(buffer), hFile);
    snprintf( buffer, elcount(buffer), "0.0000 HMI__STMSGT_Car2X_Disp_Rq_AR := %X\n", getValue( HMI__STMSGT_Car2X_Disp_Rq_AR ) );        filePutString( buffer, elcount(buffer), hFile);
    snprintf( buffer, elcount(buffer), "0.0000 HMI_Car2X_WarnIcon_Disp_Rq := %X\n", getValue( HMI_Car2X_WarnIcon_Disp_Rq ) );        filePutString( buffer, elcount(buffer), hFile);
}

on timer _tCar2X_Disp_Rq_AR
{
    putValue( HMI__STMSG_Car2X_Disp_Rq_AR, 0 );
}

on EnvVar HMI__STMSG_Car2X_Disp_Rq_AR
{
    long tDelay;
    if( getValue( this ) == 2 )
    {
        tDelay = getValue( HMI__STMSGT_Car2X_Disp_Rq_AR );
        if( tDelay > 0 )    
            setTimer( _tCar2X_Disp_Rq_AR, tDelay );
        else
            putValue( HMI__STMSG_Car2X_Disp_Rq_AR, 0 );
    }
}

on envVar HMI__STMSG_PO_Car2X_Disp_Rq_AR
{
    if( getValue( this ) )
        openPanel("Car2X_Disp_Rq_AR");
}

on EnvVar HMI_Car2X_WarnIcon_Disp_Rq
{
    _mCar2X_Disp_Rq_AR.Car2X_WarnIcon_Disp_Rq.phys = getValue(this);
    _Car2X_Disp_Rq_AR_SpontanFlag = 1;
}

CCGW_Disp_Rq_AR_check_output()
{
    if( !getValue( HMI__STMSG_CCGW_Disp_Rq_AR ))
    {
        // Botschaft CCGW_Disp_Rq_AR ID: 2463105024 --- Sendeart cyclicAndSpontanWithDelay --- 
        _CCGW_Disp_Rq_AR_Cnt--;
        if( _CCGW_Disp_Rq_AR_Cnt < 1 )
        {
            // Nachricht wg. abgelaufenem Zyklus ausgeben
            output( _mCCGW_Disp_Rq_AR );
            _CCGW_Disp_Rq_AR_Cnt = _CCGW_Disp_Rq_AR_CycleCount; // Zyklus-Zähler zurücksetzen
             _CCGW_Disp_Rq_AR_SpontanFlag = 0; // Spontan-Flag zurücksetzen
        }
        else if( _CCGW_Disp_Rq_AR_SpontanFlag)
        {
            // Nachricht wg. spontaner Änderung ausgeben
            output( _mCCGW_Disp_Rq_AR );
             _CCGW_Disp_Rq_AR_SpontanFlag = 0; // Spontan-Flag zurücksetzen
        }
    }
}

CCGW_Disp_Rq_AR_init()
{   /* Botschaft CCGW_Disp_Rq_AR ID: 2463105024 --- Sendeart cyclicAndSpontanWithDelay --- 
BA_ "ApplMessage" BO_ 2463105024 0;
BA_ "NmAsrMessage" BO_ 2463105024 0;
BA_ "GenMsgMinAcceptLength" BO_ 2463105024 8;
BA_ "GenMsgILSupport" BO_ 2463105024 1;
BA_ "DiagState" BO_ 2463105024 0;
BA_ "DiagRequest" BO_ 2463105024 0;
BA_ "DiagResponse" BO_ 2463105024 0;
BA_ "GenMsgStartValue" BO_ 2463105024 "0";
BA_ "GenMsgStartDelayTime" BO_ 2463105024 15;
BA_ "GenMsgDelayTime" BO_ 2463105024 5;
BA_ "GenMsgNrOfRepetitions" BO_ 2463105024 0;
BA_ "GenMsgCycleTime" BO_ 2463105024 1000;
BA_ "GenMsgSendType" BO_ 2463105024 5;
    */
    _CCGW_Disp_Rq_AR_Timebase =               c_tDBKomTimer_20ms;
    _CCGW_Disp_Rq_AR_CycleCount =           1000 / _CCGW_Disp_Rq_AR_Timebase;
    _CCGW_Disp_Rq_AR_StartDelay =             15 / _CCGW_Disp_Rq_AR_Timebase;
    _CCGW_Disp_Rq_AR_Cnt = _CCGW_Disp_Rq_AR_StartDelay;
    _CCGW_Disp_Rq_AR_SpontanFlag = 0;

    putValue( HMI__STMSGSD_CCGW_Disp_Rq_AR, _CCGW_Disp_Rq_AR_StartDelay * _CCGW_Disp_Rq_AR_Timebase );

    _mCCGW_Disp_Rq_AR.CCGW_Msg1_Disp_Rq.phys = getValue( HMI_CCGW_Msg1_Disp_Rq );
	_mCCGW_Disp_Rq_AR.CCGW_Msg2_Disp_Rq.phys = getValue( HMI_CCGW_Msg2_Disp_Rq );
	_mCCGW_Disp_Rq_AR.CCGW_Msg3_Disp_Rq.phys = getValue( HMI_CCGW_Msg3_Disp_Rq );
	_mCCGW_Disp_Rq_AR.CCGW_Msg4_Disp_Rq.phys = getValue( HMI_CCGW_Msg4_Disp_Rq );
	_mCCGW_Disp_Rq_AR.CCGW_Msg5_Disp_Rq.phys = getValue( HMI_CCGW_Msg5_Disp_Rq );
	_mCCGW_Disp_Rq_AR.CCGW_Msg6_Disp_Rq.phys = getValue( HMI_CCGW_Msg6_Disp_Rq );
	_mCCGW_Disp_Rq_AR.CCGW_Msg7_Disp_Rq.phys = getValue( HMI_CCGW_Msg7_Disp_Rq );
	_mCCGW_Disp_Rq_AR.CCGW_Msg8_Disp_Rq.phys = getValue( HMI_CCGW_Msg8_Disp_Rq );
	_mCCGW_Disp_Rq_AR.CCGW_Msg9_Disp_Rq.phys = getValue( HMI_CCGW_Msg9_Disp_Rq );
	_mCCGW_Disp_Rq_AR.CCGW_Msg10_Disp_Rq.phys = getValue( HMI_CCGW_Msg10_Disp_Rq );
	_mCCGW_Disp_Rq_AR.CCGW_Msg11_Disp_Rq.phys = getValue( HMI_CCGW_Msg11_Disp_Rq );
	_mCCGW_Disp_Rq_AR.CCGW_Msg12_Disp_Rq.phys = getValue( HMI_CCGW_Msg12_Disp_Rq );
	_mCCGW_Disp_Rq_AR.CCGW_Msg13_Disp_Rq.phys = getValue( HMI_CCGW_Msg13_Disp_Rq );
	_mCCGW_Disp_Rq_AR.CCGW_Msg14_Disp_Rq.phys = getValue( HMI_CCGW_Msg14_Disp_Rq );
	_mCCGW_Disp_Rq_AR.CCGW_Msg15_Disp_Rq.phys = getValue( HMI_CCGW_Msg15_Disp_Rq );
	_mCCGW_Disp_Rq_AR.CCGW_Msg16_Disp_Rq.phys = getValue( HMI_CCGW_Msg16_Disp_Rq );
	_mCCGW_Disp_Rq_AR.CCGW_Msg17_Disp_Rq.phys = getValue( HMI_CCGW_Msg17_Disp_Rq );
	_mCCGW_Disp_Rq_AR.CCGW_Msg18_Disp_Rq.phys = getValue( HMI_CCGW_Msg18_Disp_Rq );
	_mCCGW_Disp_Rq_AR.CCGW_Msg19_Disp_Rq.phys = getValue( HMI_CCGW_Msg19_Disp_Rq );
	_mCCGW_Disp_Rq_AR.CCGW_Msg20_Disp_Rq.phys = getValue( HMI_CCGW_Msg20_Disp_Rq );
	_mCCGW_Disp_Rq_AR.CCGW_Msg21_Disp_Rq.phys = getValue( HMI_CCGW_Msg21_Disp_Rq );
	_mCCGW_Disp_Rq_AR.CCGW_Msg22_Disp_Rq.phys = getValue( HMI_CCGW_Msg22_Disp_Rq );
	_mCCGW_Disp_Rq_AR.CCGW_Msg23_Disp_Rq.phys = getValue( HMI_CCGW_Msg23_Disp_Rq );
	_mCCGW_Disp_Rq_AR.CCGW_Msg24_Disp_Rq.phys = getValue( HMI_CCGW_Msg24_Disp_Rq );
	_mCCGW_Disp_Rq_AR.CCGW_Msg25_Disp_Rq.phys = getValue( HMI_CCGW_Msg25_Disp_Rq );
	_mCCGW_Disp_Rq_AR.CCGW_Msg26_Disp_Rq.phys = getValue( HMI_CCGW_Msg26_Disp_Rq );
	_mCCGW_Disp_Rq_AR.CCGW_Msg27_Disp_Rq.phys = getValue( HMI_CCGW_Msg27_Disp_Rq );
	_mCCGW_Disp_Rq_AR.CCGW_Msg28_Disp_Rq.phys = getValue( HMI_CCGW_Msg28_Disp_Rq );
	_mCCGW_Disp_Rq_AR.CCGW_Msg29_Disp_Rq.phys = getValue( HMI_CCGW_Msg29_Disp_Rq );
	_mCCGW_Disp_Rq_AR.CCGW_Msg30_Disp_Rq.phys = getValue( HMI_CCGW_Msg30_Disp_Rq );
	_mCCGW_Disp_Rq_AR.CCGW_Msg31_Disp_Rq.phys = getValue( HMI_CCGW_Msg31_Disp_Rq );
	_mCCGW_Disp_Rq_AR.CCGW_Msg32_Disp_Rq.phys = getValue( HMI_CCGW_Msg32_Disp_Rq );
	_mCCGW_Disp_Rq_AR.CCGW_Msg33_Disp_Rq.phys = getValue( HMI_CCGW_Msg33_Disp_Rq );
	_mCCGW_Disp_Rq_AR.CCGW_Msg34_Disp_Rq.phys = getValue( HMI_CCGW_Msg34_Disp_Rq );
	_mCCGW_Disp_Rq_AR.CCGW_Msg35_Disp_Rq.phys = getValue( HMI_CCGW_Msg35_Disp_Rq );
	_mCCGW_Disp_Rq_AR.CCGW_Msg36_Disp_Rq.phys = getValue( HMI_CCGW_Msg36_Disp_Rq );
	_mCCGW_Disp_Rq_AR.CCGW_Msg37_Disp_Rq.phys = getValue( HMI_CCGW_Msg37_Disp_Rq );
	_mCCGW_Disp_Rq_AR.CCGW_Msg38_Disp_Rq.phys = getValue( HMI_CCGW_Msg38_Disp_Rq );
	_mCCGW_Disp_Rq_AR.CCGW_Msg39_Disp_Rq.phys = getValue( HMI_CCGW_Msg39_Disp_Rq );
	_mCCGW_Disp_Rq_AR.CCGW_Msg40_Disp_Rq.phys = getValue( HMI_CCGW_Msg40_Disp_Rq );
	_mCCGW_Disp_Rq_AR.CCGW_Msg41_Disp_Rq.phys = getValue( HMI_CCGW_Msg41_Disp_Rq );
	_mCCGW_Disp_Rq_AR.CCGW_Msg42_Disp_Rq.phys = getValue( HMI_CCGW_Msg42_Disp_Rq );
	_mCCGW_Disp_Rq_AR.CCGW_Msg43_Disp_Rq.phys = getValue( HMI_CCGW_Msg43_Disp_Rq );
	_mCCGW_Disp_Rq_AR.CCGW_Msg44_Disp_Rq.phys = getValue( HMI_CCGW_Msg44_Disp_Rq );
	_mCCGW_Disp_Rq_AR.CCGW_Msg45_Disp_Rq.phys = getValue( HMI_CCGW_Msg45_Disp_Rq );
	_mCCGW_Disp_Rq_AR.CCGW_Msg46_Disp_Rq.phys = getValue( HMI_CCGW_Msg46_Disp_Rq );
	_mCCGW_Disp_Rq_AR.CCGW_Msg47_Disp_Rq.phys = getValue( HMI_CCGW_Msg47_Disp_Rq );
	_mCCGW_Disp_Rq_AR.CCGW_Msg48_Disp_Rq.phys = getValue( HMI_CCGW_Msg48_Disp_Rq );
	_mCCGW_Disp_Rq_AR.CCGW_Msg49_Disp_Rq.phys = getValue( HMI_CCGW_Msg49_Disp_Rq );
	_mCCGW_Disp_Rq_AR.CCGW_Msg50_Disp_Rq.phys = getValue( HMI_CCGW_Msg50_Disp_Rq );
	_mCCGW_Disp_Rq_AR.CCGW_Msg51_Disp_Rq.phys = getValue( HMI_CCGW_Msg51_Disp_Rq );
	_mCCGW_Disp_Rq_AR.CCGW_Msg52_Disp_Rq.phys = getValue( HMI_CCGW_Msg52_Disp_Rq );
	_mCCGW_Disp_Rq_AR.CCGW_Msg53_Disp_Rq.phys = getValue( HMI_CCGW_Msg53_Disp_Rq );
	_mCCGW_Disp_Rq_AR.CCGW_Msg54_Disp_Rq.phys = getValue( HMI_CCGW_Msg54_Disp_Rq );
	_mCCGW_Disp_Rq_AR.CCGW_Msg55_Disp_Rq.phys = getValue( HMI_CCGW_Msg55_Disp_Rq );
	_mCCGW_Disp_Rq_AR.CCGW_Msg56_Disp_Rq.phys = getValue( HMI_CCGW_Msg57_Disp_Rq );
	_mCCGW_Disp_Rq_AR.CCGW_Msg58_Disp_Rq.phys = getValue( HMI_CCGW_Msg58_Disp_Rq );
	_mCCGW_Disp_Rq_AR.CCGW_Msg59_Disp_Rq.phys = getValue( HMI_CCGW_Msg59_Disp_Rq );
	_mCCGW_Disp_Rq_AR.CCGW_Msg60_Disp_Rq.phys = getValue( HMI_CCGW_Msg60_Disp_Rq );
	_mCCGW_Disp_Rq_AR.CCGW_Msg61_Disp_Rq.phys = getValue( HMI_CCGW_Msg61_Disp_Rq );
	_mCCGW_Disp_Rq_AR.CCGW_Msg62_Disp_Rq.phys = getValue( HMI_CCGW_Msg62_Disp_Rq );
	_mCCGW_Disp_Rq_AR.CCGW_Msg63_Disp_Rq.phys = getValue( HMI_CCGW_Msg63_Disp_Rq );
	_mCCGW_Disp_Rq_AR.CCGW_Msg64_Disp_Rq.phys = getValue( HMI_CCGW_Msg64_Disp_Rq );
	
}

CCGW_Disp_Rq_AR_saveEnvVars( dword hFile )
{
    filePutString("\n// Knoten EIS: CCGW_Disp_Rq_AR\n", 28, hFile );
    snprintf( buffer, elcount( buffer ), "0.0000 HMI__STMSG_CCGW_Disp_Rq_AR := %X\n", getValue( HMI__STMSG_CCGW_Disp_Rq_AR ) );        filePutString( buffer, elcount( buffer ), hFile );
    snprintf( buffer, elcount( buffer ), "0.0000 HMI__STMSGT_CCGW_Disp_Rq_AR := %X\n", getValue( HMI__STMSGT_CCGW_Disp_Rq_AR ) );        filePutString( buffer, elcount( buffer ), hFile );
    
	snprintf( buffer, elcount( buffer ), "0.0000 HMI_CCGW_Msg1_Disp_Rq := %X\n", getValue( HMI_CCGW_Msg1_Disp_Rq ) );        filePutString( buffer, elcount( buffer ), hFile );
	snprintf( buffer, elcount( buffer ), "0.0000 HMI_CCGW_Msg2_Disp_Rq := %X\n", getValue( HMI_CCGW_Msg2_Disp_Rq ) );        filePutString( buffer, elcount( buffer ), hFile );
	snprintf( buffer, elcount( buffer ), "0.0000 HMI_CCGW_Msg3_Disp_Rq := %X\n", getValue( HMI_CCGW_Msg3_Disp_Rq ) );        filePutString( buffer, elcount( buffer ), hFile );
	snprintf( buffer, elcount( buffer ), "0.0000 HMI_CCGW_Msg4_Disp_Rq := %X\n", getValue( HMI_CCGW_Msg4_Disp_Rq ) );        filePutString( buffer, elcount( buffer ), hFile );
	snprintf( buffer, elcount( buffer ), "0.0000 HMI_CCGW_Msg5_Disp_Rq := %X\n", getValue( HMI_CCGW_Msg5_Disp_Rq ) );        filePutString( buffer, elcount( buffer ), hFile );
	snprintf( buffer, elcount( buffer ), "0.0000 HMI_CCGW_Msg6_Disp_Rq := %X\n", getValue( HMI_CCGW_Msg6_Disp_Rq ) );        filePutString( buffer, elcount( buffer ), hFile );
	snprintf( buffer, elcount( buffer ), "0.0000 HMI_CCGW_Msg7_Disp_Rq := %X\n", getValue( HMI_CCGW_Msg7_Disp_Rq ) );        filePutString( buffer, elcount( buffer ), hFile );
	snprintf( buffer, elcount( buffer ), "0.0000 HMI_CCGW_Msg8_Disp_Rq := %X\n", getValue( HMI_CCGW_Msg8_Disp_Rq ) );        filePutString( buffer, elcount( buffer ), hFile );
	snprintf( buffer, elcount( buffer ), "0.0000 HMI_CCGW_Msg9_Disp_Rq := %X\n", getValue( HMI_CCGW_Msg9_Disp_Rq ) );        filePutString( buffer, elcount( buffer ), hFile );
    snprintf( buffer, elcount( buffer ), "0.0000 HMI_CCGW_Msg10_Disp_Rq := %X\n", getValue( HMI_CCGW_Msg10_Disp_Rq ) );        filePutString( buffer, elcount( buffer ), hFile );
	snprintf( buffer, elcount( buffer ), "0.0000 HMI_CCGW_Msg11_Disp_Rq := %X\n", getValue( HMI_CCGW_Msg11_Disp_Rq ) );        filePutString( buffer, elcount( buffer ), hFile );
	snprintf( buffer, elcount( buffer ), "0.0000 HMI_CCGW_Msg12_Disp_Rq := %X\n", getValue( HMI_CCGW_Msg12_Disp_Rq ) );        filePutString( buffer, elcount( buffer ), hFile );
	snprintf( buffer, elcount( buffer ), "0.0000 HMI_CCGW_Msg13_Disp_Rq := %X\n", getValue( HMI_CCGW_Msg13_Disp_Rq ) );        filePutString( buffer, elcount( buffer ), hFile );
	snprintf( buffer, elcount( buffer ), "0.0000 HMI_CCGW_Msg14_Disp_Rq := %X\n", getValue( HMI_CCGW_Msg14_Disp_Rq ) );        filePutString( buffer, elcount( buffer ), hFile );
	snprintf( buffer, elcount( buffer ), "0.0000 HMI_CCGW_Msg15_Disp_Rq := %X\n", getValue( HMI_CCGW_Msg15_Disp_Rq ) );        filePutString( buffer, elcount( buffer ), hFile );
	snprintf( buffer, elcount( buffer ), "0.0000 HMI_CCGW_Msg16_Disp_Rq := %X\n", getValue( HMI_CCGW_Msg16_Disp_Rq ) );        filePutString( buffer, elcount( buffer ), hFile );
	snprintf( buffer, elcount( buffer ), "0.0000 HMI_CCGW_Msg17_Disp_Rq := %X\n", getValue( HMI_CCGW_Msg17_Disp_Rq ) );        filePutString( buffer, elcount( buffer ), hFile );
	snprintf( buffer, elcount( buffer ), "0.0000 HMI_CCGW_Msg18_Disp_Rq := %X\n", getValue( HMI_CCGW_Msg18_Disp_Rq ) );        filePutString( buffer, elcount( buffer ), hFile );
	snprintf( buffer, elcount( buffer ), "0.0000 HMI_CCGW_Msg19_Disp_Rq := %X\n", getValue( HMI_CCGW_Msg19_Disp_Rq ) );        filePutString( buffer, elcount( buffer ), hFile );
    snprintf( buffer, elcount( buffer ), "0.0000 HMI_CCGW_Msg20_Disp_Rq := %X\n", getValue( HMI_CCGW_Msg20_Disp_Rq ) );        filePutString( buffer, elcount( buffer ), hFile );
	snprintf( buffer, elcount( buffer ), "0.0000 HMI_CCGW_Msg21_Disp_Rq := %X\n", getValue( HMI_CCGW_Msg21_Disp_Rq ) );        filePutString( buffer, elcount( buffer ), hFile );
	snprintf( buffer, elcount( buffer ), "0.0000 HMI_CCGW_Msg22_Disp_Rq := %X\n", getValue( HMI_CCGW_Msg22_Disp_Rq ) );        filePutString( buffer, elcount( buffer ), hFile );
	snprintf( buffer, elcount( buffer ), "0.0000 HMI_CCGW_Msg23_Disp_Rq := %X\n", getValue( HMI_CCGW_Msg23_Disp_Rq ) );        filePutString( buffer, elcount( buffer ), hFile );
	snprintf( buffer, elcount( buffer ), "0.0000 HMI_CCGW_Msg24_Disp_Rq := %X\n", getValue( HMI_CCGW_Msg24_Disp_Rq ) );        filePutString( buffer, elcount( buffer ), hFile );
	snprintf( buffer, elcount( buffer ), "0.0000 HMI_CCGW_Msg25_Disp_Rq := %X\n", getValue( HMI_CCGW_Msg25_Disp_Rq ) );        filePutString( buffer, elcount( buffer ), hFile );
	snprintf( buffer, elcount( buffer ), "0.0000 HMI_CCGW_Msg26_Disp_Rq := %X\n", getValue( HMI_CCGW_Msg26_Disp_Rq ) );        filePutString( buffer, elcount( buffer ), hFile );
	snprintf( buffer, elcount( buffer ), "0.0000 HMI_CCGW_Msg27_Disp_Rq := %X\n", getValue( HMI_CCGW_Msg27_Disp_Rq ) );        filePutString( buffer, elcount( buffer ), hFile );
	snprintf( buffer, elcount( buffer ), "0.0000 HMI_CCGW_Msg28_Disp_Rq := %X\n", getValue( HMI_CCGW_Msg28_Disp_Rq ) );        filePutString( buffer, elcount( buffer ), hFile );
	snprintf( buffer, elcount( buffer ), "0.0000 HMI_CCGW_Msg29_Disp_Rq := %X\n", getValue( HMI_CCGW_Msg29_Disp_Rq ) );        filePutString( buffer, elcount( buffer ), hFile );
    snprintf( buffer, elcount( buffer ), "0.0000 HMI_CCGW_Msg30_Disp_Rq := %X\n", getValue( HMI_CCGW_Msg30_Disp_Rq ) );        filePutString( buffer, elcount( buffer ), hFile );
	snprintf( buffer, elcount( buffer ), "0.0000 HMI_CCGW_Msg31_Disp_Rq := %X\n", getValue( HMI_CCGW_Msg31_Disp_Rq ) );        filePutString( buffer, elcount( buffer ), hFile );
	snprintf( buffer, elcount( buffer ), "0.0000 HMI_CCGW_Msg32_Disp_Rq := %X\n", getValue( HMI_CCGW_Msg32_Disp_Rq ) );        filePutString( buffer, elcount( buffer ), hFile );
	snprintf( buffer, elcount( buffer ), "0.0000 HMI_CCGW_Msg33_Disp_Rq := %X\n", getValue( HMI_CCGW_Msg33_Disp_Rq ) );        filePutString( buffer, elcount( buffer ), hFile );
	snprintf( buffer, elcount( buffer ), "0.0000 HMI_CCGW_Msg34_Disp_Rq := %X\n", getValue( HMI_CCGW_Msg34_Disp_Rq ) );        filePutString( buffer, elcount( buffer ), hFile );
	snprintf( buffer, elcount( buffer ), "0.0000 HMI_CCGW_Msg35_Disp_Rq := %X\n", getValue( HMI_CCGW_Msg35_Disp_Rq ) );        filePutString( buffer, elcount( buffer ), hFile );
	snprintf( buffer, elcount( buffer ), "0.0000 HMI_CCGW_Msg36_Disp_Rq := %X\n", getValue( HMI_CCGW_Msg36_Disp_Rq ) );        filePutString( buffer, elcount( buffer ), hFile );
	snprintf( buffer, elcount( buffer ), "0.0000 HMI_CCGW_Msg37_Disp_Rq := %X\n", getValue( HMI_CCGW_Msg37_Disp_Rq ) );        filePutString( buffer, elcount( buffer ), hFile );
	snprintf( buffer, elcount( buffer ), "0.0000 HMI_CCGW_Msg38_Disp_Rq := %X\n", getValue( HMI_CCGW_Msg38_Disp_Rq ) );        filePutString( buffer, elcount( buffer ), hFile );
	snprintf( buffer, elcount( buffer ), "0.0000 HMI_CCGW_Msg39_Disp_Rq := %X\n", getValue( HMI_CCGW_Msg39_Disp_Rq ) );        filePutString( buffer, elcount( buffer ), hFile );
    snprintf( buffer, elcount( buffer ), "0.0000 HMI_CCGW_Msg40_Disp_Rq := %X\n", getValue( HMI_CCGW_Msg40_Disp_Rq ) );        filePutString( buffer, elcount( buffer ), hFile );
	snprintf( buffer, elcount( buffer ), "0.0000 HMI_CCGW_Msg41_Disp_Rq := %X\n", getValue( HMI_CCGW_Msg41_Disp_Rq ) );        filePutString( buffer, elcount( buffer ), hFile );
	snprintf( buffer, elcount( buffer ), "0.0000 HMI_CCGW_Msg42_Disp_Rq := %X\n", getValue( HMI_CCGW_Msg42_Disp_Rq ) );        filePutString( buffer, elcount( buffer ), hFile );
	snprintf( buffer, elcount( buffer ), "0.0000 HMI_CCGW_Msg43_Disp_Rq := %X\n", getValue( HMI_CCGW_Msg43_Disp_Rq ) );        filePutString( buffer, elcount( buffer ), hFile );
	snprintf( buffer, elcount( buffer ), "0.0000 HMI_CCGW_Msg44_Disp_Rq := %X\n", getValue( HMI_CCGW_Msg44_Disp_Rq ) );        filePutString( buffer, elcount( buffer ), hFile );
	snprintf( buffer, elcount( buffer ), "0.0000 HMI_CCGW_Msg45_Disp_Rq := %X\n", getValue( HMI_CCGW_Msg45_Disp_Rq ) );        filePutString( buffer, elcount( buffer ), hFile );
	snprintf( buffer, elcount( buffer ), "0.0000 HMI_CCGW_Msg46_Disp_Rq := %X\n", getValue( HMI_CCGW_Msg46_Disp_Rq ) );        filePutString( buffer, elcount( buffer ), hFile );
	snprintf( buffer, elcount( buffer ), "0.0000 HMI_CCGW_Msg47_Disp_Rq := %X\n", getValue( HMI_CCGW_Msg47_Disp_Rq ) );        filePutString( buffer, elcount( buffer ), hFile );
	snprintf( buffer, elcount( buffer ), "0.0000 HMI_CCGW_Msg48_Disp_Rq := %X\n", getValue( HMI_CCGW_Msg48_Disp_Rq ) );        filePutString( buffer, elcount( buffer ), hFile );
	snprintf( buffer, elcount( buffer ), "0.0000 HMI_CCGW_Msg49_Disp_Rq := %X\n", getValue( HMI_CCGW_Msg49_Disp_Rq ) );        filePutString( buffer, elcount( buffer ), hFile );
    snprintf( buffer, elcount( buffer ), "0.0000 HMI_CCGW_Msg50_Disp_Rq := %X\n", getValue( HMI_CCGW_Msg50_Disp_Rq ) );        filePutString( buffer, elcount( buffer ), hFile );
	snprintf( buffer, elcount( buffer ), "0.0000 HMI_CCGW_Msg51_Disp_Rq := %X\n", getValue( HMI_CCGW_Msg51_Disp_Rq ) );        filePutString( buffer, elcount( buffer ), hFile );
	snprintf( buffer, elcount( buffer ), "0.0000 HMI_CCGW_Msg52_Disp_Rq := %X\n", getValue( HMI_CCGW_Msg52_Disp_Rq ) );        filePutString( buffer, elcount( buffer ), hFile );
	snprintf( buffer, elcount( buffer ), "0.0000 HMI_CCGW_Msg53_Disp_Rq := %X\n", getValue( HMI_CCGW_Msg53_Disp_Rq ) );        filePutString( buffer, elcount( buffer ), hFile );
	snprintf( buffer, elcount( buffer ), "0.0000 HMI_CCGW_Msg54_Disp_Rq := %X\n", getValue( HMI_CCGW_Msg54_Disp_Rq ) );        filePutString( buffer, elcount( buffer ), hFile );
	snprintf( buffer, elcount( buffer ), "0.0000 HMI_CCGW_Msg55_Disp_Rq := %X\n", getValue( HMI_CCGW_Msg55_Disp_Rq ) );        filePutString( buffer, elcount( buffer ), hFile );
	snprintf( buffer, elcount( buffer ), "0.0000 HMI_CCGW_Msg56_Disp_Rq := %X\n", getValue( HMI_CCGW_Msg56_Disp_Rq ) );        filePutString( buffer, elcount( buffer ), hFile );
	snprintf( buffer, elcount( buffer ), "0.0000 HMI_CCGW_Msg57_Disp_Rq := %X\n", getValue( HMI_CCGW_Msg57_Disp_Rq ) );        filePutString( buffer, elcount( buffer ), hFile );
	snprintf( buffer, elcount( buffer ), "0.0000 HMI_CCGW_Msg58_Disp_Rq := %X\n", getValue( HMI_CCGW_Msg58_Disp_Rq ) );        filePutString( buffer, elcount( buffer ), hFile );
	snprintf( buffer, elcount( buffer ), "0.0000 HMI_CCGW_Msg59_Disp_Rq := %X\n", getValue( HMI_CCGW_Msg59_Disp_Rq ) );        filePutString( buffer, elcount( buffer ), hFile );
    snprintf( buffer, elcount( buffer ), "0.0000 HMI_CCGW_Msg60_Disp_Rq := %X\n", getValue( HMI_CCGW_Msg60_Disp_Rq ) );        filePutString( buffer, elcount( buffer ), hFile );
	snprintf( buffer, elcount( buffer ), "0.0000 HMI_CCGW_Msg61_Disp_Rq := %X\n", getValue( HMI_CCGW_Msg61_Disp_Rq ) );        filePutString( buffer, elcount( buffer ), hFile );
	snprintf( buffer, elcount( buffer ), "0.0000 HMI_CCGW_Msg62_Disp_Rq := %X\n", getValue( HMI_CCGW_Msg62_Disp_Rq ) );        filePutString( buffer, elcount( buffer ), hFile );
	snprintf( buffer, elcount( buffer ), "0.0000 HMI_CCGW_Msg63_Disp_Rq := %X\n", getValue( HMI_CCGW_Msg63_Disp_Rq ) );        filePutString( buffer, elcount( buffer ), hFile );
	snprintf( buffer, elcount( buffer ), "0.0000 HMI_CCGW_Msg64_Disp_Rq := %X\n", getValue( HMI_CCGW_Msg64_Disp_Rq ) );        filePutString( buffer, elcount( buffer ), hFile );
	
}
on timer _tCCGW_Disp_Rq_AR
{
    putValue( HMI__STMSG_CCGW_Disp_Rq_AR, 0 );
}

on EnvVar HMI__STMSG_CCGW_Disp_Rq_AR
{
    long tDelay;
    if( getValue( this ) == 2 )
    {
        tDelay = getValue( HMI__STMSGT_CCGW_Disp_Rq_AR );
        if( tDelay > 0)    
            setTimer( _tCCGW_Disp_Rq_AR, tDelay );
        else
            putValue( HMI__STMSG_CCGW_Disp_Rq_AR, 0 );
    }
}

on envVar HMI__STMSG_PO_CCGW_Disp_Rq_AR
{
    if( getValue( this ) )
        openPanel("CCGW_Disp_Rq_AR");
}


on EnvVar HMI_CCGW_Msg1_Disp_Rq
{
    _mCCGW_Disp_Rq_AR.CCGW_Msg1_Disp_Rq.phys = getValue(this);
    _CCGW_Disp_Rq_AR_SpontanFlag = 1;
}

on EnvVar HMI_CCGW_Msg2_Disp_Rq
{
    _mCCGW_Disp_Rq_AR.CCGW_Msg2_Disp_Rq.phys = getValue(this);
    _CCGW_Disp_Rq_AR_SpontanFlag = 1;
}

on EnvVar HMI_CCGW_Msg3_Disp_Rq
{
    _mCCGW_Disp_Rq_AR.CCGW_Msg3_Disp_Rq.phys = getValue(this);
    _CCGW_Disp_Rq_AR_SpontanFlag = 1;
}

on EnvVar HMI_CCGW_Msg4_Disp_Rq
{
    _mCCGW_Disp_Rq_AR.CCGW_Msg4_Disp_Rq.phys = getValue(this);
    _CCGW_Disp_Rq_AR_SpontanFlag = 1;
}

on EnvVar HMI_CCGW_Msg5_Disp_Rq
{
    _mCCGW_Disp_Rq_AR.CCGW_Msg5_Disp_Rq.phys = getValue(this);
    _CCGW_Disp_Rq_AR_SpontanFlag = 1;
}

on EnvVar HMI_CCGW_Msg6_Disp_Rq
{
    _mCCGW_Disp_Rq_AR.CCGW_Msg6_Disp_Rq.phys = getValue(this);
    _CCGW_Disp_Rq_AR_SpontanFlag = 1;
}

on EnvVar HMI_CCGW_Msg7_Disp_Rq
{
    _mCCGW_Disp_Rq_AR.CCGW_Msg7_Disp_Rq.phys = getValue(this);
    _CCGW_Disp_Rq_AR_SpontanFlag = 1;
}

on EnvVar HMI_CCGW_Msg8_Disp_Rq
{
    _mCCGW_Disp_Rq_AR.CCGW_Msg8_Disp_Rq.phys = getValue(this);
    _CCGW_Disp_Rq_AR_SpontanFlag = 1;
}

on EnvVar HMI_CCGW_Msg9_Disp_Rq
{
    _mCCGW_Disp_Rq_AR.CCGW_Msg9_Disp_Rq.phys = getValue(this);
    _CCGW_Disp_Rq_AR_SpontanFlag = 1;
}

on EnvVar HMI_CCGW_Msg10_Disp_Rq
{
    _mCCGW_Disp_Rq_AR.CCGW_Msg10_Disp_Rq.phys = getValue(this);
    _CCGW_Disp_Rq_AR_SpontanFlag = 1;
}

on EnvVar HMI_CCGW_Msg11_Disp_Rq
{
    _mCCGW_Disp_Rq_AR.CCGW_Msg11_Disp_Rq.phys = getValue(this);
    _CCGW_Disp_Rq_AR_SpontanFlag = 1;
}

on EnvVar HMI_CCGW_Msg12_Disp_Rq
{
    _mCCGW_Disp_Rq_AR.CCGW_Msg12_Disp_Rq.phys = getValue(this);
    _CCGW_Disp_Rq_AR_SpontanFlag = 1;
}

on EnvVar HMI_CCGW_Msg13_Disp_Rq
{
    _mCCGW_Disp_Rq_AR.CCGW_Msg13_Disp_Rq.phys = getValue(this);
    _CCGW_Disp_Rq_AR_SpontanFlag = 1;
}

on EnvVar HMI_CCGW_Msg14_Disp_Rq
{
    _mCCGW_Disp_Rq_AR.CCGW_Msg14_Disp_Rq.phys = getValue(this);
    _CCGW_Disp_Rq_AR_SpontanFlag = 1;
}

on EnvVar HMI_CCGW_Msg15_Disp_Rq
{
    _mCCGW_Disp_Rq_AR.CCGW_Msg15_Disp_Rq.phys = getValue(this);
    _CCGW_Disp_Rq_AR_SpontanFlag = 1;
}

on EnvVar HMI_CCGW_Msg16_Disp_Rq
{
    _mCCGW_Disp_Rq_AR.CCGW_Msg16_Disp_Rq.phys = getValue(this);
    _CCGW_Disp_Rq_AR_SpontanFlag = 1;
}

on EnvVar HMI_CCGW_Msg17_Disp_Rq
{
    _mCCGW_Disp_Rq_AR.CCGW_Msg17_Disp_Rq.phys = getValue(this);
    _CCGW_Disp_Rq_AR_SpontanFlag = 1;
}

on EnvVar HMI_CCGW_Msg18_Disp_Rq
{
    _mCCGW_Disp_Rq_AR.CCGW_Msg18_Disp_Rq.phys = getValue(this);
    _CCGW_Disp_Rq_AR_SpontanFlag = 1;
}

on EnvVar HMI_CCGW_Msg19_Disp_Rq
{
    _mCCGW_Disp_Rq_AR.CCGW_Msg19_Disp_Rq.phys = getValue(this);
    _CCGW_Disp_Rq_AR_SpontanFlag = 1;
}

on EnvVar HMI_CCGW_Msg20_Disp_Rq
{
    _mCCGW_Disp_Rq_AR.CCGW_Msg20_Disp_Rq.phys = getValue(this);
    _CCGW_Disp_Rq_AR_SpontanFlag = 1;
}

on EnvVar HMI_CCGW_Msg21_Disp_Rq
{
    _mCCGW_Disp_Rq_AR.CCGW_Msg21_Disp_Rq.phys = getValue(this);
    _CCGW_Disp_Rq_AR_SpontanFlag = 1;
}

on EnvVar HMI_CCGW_Msg22_Disp_Rq
{
    _mCCGW_Disp_Rq_AR.CCGW_Msg22_Disp_Rq.phys = getValue(this);
    _CCGW_Disp_Rq_AR_SpontanFlag = 1;
}

on EnvVar HMI_CCGW_Msg23_Disp_Rq
{
    _mCCGW_Disp_Rq_AR.CCGW_Msg23_Disp_Rq.phys = getValue(this);
    _CCGW_Disp_Rq_AR_SpontanFlag = 1;
}

on EnvVar HMI_CCGW_Msg24_Disp_Rq
{
    _mCCGW_Disp_Rq_AR.CCGW_Msg24_Disp_Rq.phys = getValue(this);
    _CCGW_Disp_Rq_AR_SpontanFlag = 1;
}

on EnvVar HMI_CCGW_Msg25_Disp_Rq
{
    _mCCGW_Disp_Rq_AR.CCGW_Msg25_Disp_Rq.phys = getValue(this);
    _CCGW_Disp_Rq_AR_SpontanFlag = 1;
}

on EnvVar HMI_CCGW_Msg26_Disp_Rq
{
    _mCCGW_Disp_Rq_AR.CCGW_Msg26_Disp_Rq.phys = getValue(this);
    _CCGW_Disp_Rq_AR_SpontanFlag = 1;
}

on EnvVar HMI_CCGW_Msg27_Disp_Rq
{
    _mCCGW_Disp_Rq_AR.CCGW_Msg27_Disp_Rq.phys = getValue(this);
    _CCGW_Disp_Rq_AR_SpontanFlag = 1;
}

on EnvVar HMI_CCGW_Msg28_Disp_Rq
{
    _mCCGW_Disp_Rq_AR.CCGW_Msg28_Disp_Rq.phys = getValue(this);
    _CCGW_Disp_Rq_AR_SpontanFlag = 1;
}

on EnvVar HMI_CCGW_Msg29_Disp_Rq
{
    _mCCGW_Disp_Rq_AR.CCGW_Msg29_Disp_Rq.phys = getValue(this);
    _CCGW_Disp_Rq_AR_SpontanFlag = 1;
}

on EnvVar HMI_CCGW_Msg30_Disp_Rq
{
    _mCCGW_Disp_Rq_AR.CCGW_Msg30_Disp_Rq.phys = getValue(this);
    _CCGW_Disp_Rq_AR_SpontanFlag = 1;
}

on EnvVar HMI_CCGW_Msg31_Disp_Rq
{
    _mCCGW_Disp_Rq_AR.CCGW_Msg31_Disp_Rq.phys = getValue(this);
    _CCGW_Disp_Rq_AR_SpontanFlag = 1;
}

on EnvVar HMI_CCGW_Msg32_Disp_Rq
{
    _mCCGW_Disp_Rq_AR.CCGW_Msg32_Disp_Rq.phys = getValue(this);
    _CCGW_Disp_Rq_AR_SpontanFlag = 1;
}

on EnvVar HMI_CCGW_Msg33_Disp_Rq
{
    _mCCGW_Disp_Rq_AR.CCGW_Msg33_Disp_Rq.phys = getValue(this);
    _CCGW_Disp_Rq_AR_SpontanFlag = 1;
}

on EnvVar HMI_CCGW_Msg34_Disp_Rq
{
    _mCCGW_Disp_Rq_AR.CCGW_Msg34_Disp_Rq.phys = getValue(this);
    _CCGW_Disp_Rq_AR_SpontanFlag = 1;
}

on EnvVar HMI_CCGW_Msg35_Disp_Rq
{
    _mCCGW_Disp_Rq_AR.CCGW_Msg35_Disp_Rq.phys = getValue(this);
    _CCGW_Disp_Rq_AR_SpontanFlag = 1;
}

on EnvVar HMI_CCGW_Msg36_Disp_Rq
{
    _mCCGW_Disp_Rq_AR.CCGW_Msg36_Disp_Rq.phys = getValue(this);
    _CCGW_Disp_Rq_AR_SpontanFlag = 1;
}

on EnvVar HMI_CCGW_Msg37_Disp_Rq
{
    _mCCGW_Disp_Rq_AR.CCGW_Msg37_Disp_Rq.phys = getValue(this);
    _CCGW_Disp_Rq_AR_SpontanFlag = 1;
}

on EnvVar HMI_CCGW_Msg38_Disp_Rq
{
    _mCCGW_Disp_Rq_AR.CCGW_Msg38_Disp_Rq.phys = getValue(this);
    _CCGW_Disp_Rq_AR_SpontanFlag = 1;
}

on EnvVar HMI_CCGW_Msg39_Disp_Rq
{
    _mCCGW_Disp_Rq_AR.CCGW_Msg39_Disp_Rq.phys = getValue(this);
    _CCGW_Disp_Rq_AR_SpontanFlag = 1;
}

on EnvVar HMI_CCGW_Msg40_Disp_Rq
{
    _mCCGW_Disp_Rq_AR.CCGW_Msg40_Disp_Rq.phys = getValue(this);
    _CCGW_Disp_Rq_AR_SpontanFlag = 1;
}

on EnvVar HMI_CCGW_Msg41_Disp_Rq
{
    _mCCGW_Disp_Rq_AR.CCGW_Msg41_Disp_Rq.phys = getValue(this);
    _CCGW_Disp_Rq_AR_SpontanFlag = 1;
}

on EnvVar HMI_CCGW_Msg42_Disp_Rq
{
    _mCCGW_Disp_Rq_AR.CCGW_Msg42_Disp_Rq.phys = getValue(this);
    _CCGW_Disp_Rq_AR_SpontanFlag = 1;
}

on EnvVar HMI_CCGW_Msg43_Disp_Rq
{
    _mCCGW_Disp_Rq_AR.CCGW_Msg43_Disp_Rq.phys = getValue(this);
    _CCGW_Disp_Rq_AR_SpontanFlag = 1;
}

on EnvVar HMI_CCGW_Msg44_Disp_Rq
{
    _mCCGW_Disp_Rq_AR.CCGW_Msg44_Disp_Rq.phys = getValue(this);
    _CCGW_Disp_Rq_AR_SpontanFlag = 1;
}

on EnvVar HMI_CCGW_Msg45_Disp_Rq
{
    _mCCGW_Disp_Rq_AR.CCGW_Msg45_Disp_Rq.phys = getValue(this);
    _CCGW_Disp_Rq_AR_SpontanFlag = 1;
}

on EnvVar HMI_CCGW_Msg46_Disp_Rq
{
    _mCCGW_Disp_Rq_AR.CCGW_Msg46_Disp_Rq.phys = getValue(this);
    _CCGW_Disp_Rq_AR_SpontanFlag = 1;
}

on EnvVar HMI_CCGW_Msg47_Disp_Rq
{
    _mCCGW_Disp_Rq_AR.CCGW_Msg47_Disp_Rq.phys = getValue(this);
    _CCGW_Disp_Rq_AR_SpontanFlag = 1;
}

on EnvVar HMI_CCGW_Msg48_Disp_Rq
{
    _mCCGW_Disp_Rq_AR.CCGW_Msg48_Disp_Rq.phys = getValue(this);
    _CCGW_Disp_Rq_AR_SpontanFlag = 1;
}

on EnvVar HMI_CCGW_Msg49_Disp_Rq
{
    _mCCGW_Disp_Rq_AR.CCGW_Msg49_Disp_Rq.phys = getValue(this);
    _CCGW_Disp_Rq_AR_SpontanFlag = 1;
}

on EnvVar HMI_CCGW_Msg50_Disp_Rq
{
    _mCCGW_Disp_Rq_AR.CCGW_Msg50_Disp_Rq.phys = getValue(this);
    _CCGW_Disp_Rq_AR_SpontanFlag = 1;
}


on EnvVar HMI_CCGW_Msg51_Disp_Rq
{
    _mCCGW_Disp_Rq_AR.CCGW_Msg51_Disp_Rq.phys = getValue(this);
    _CCGW_Disp_Rq_AR_SpontanFlag = 1;
}

on EnvVar HMI_CCGW_Msg52_Disp_Rq
{
    _mCCGW_Disp_Rq_AR.CCGW_Msg52_Disp_Rq.phys = getValue(this);
    _CCGW_Disp_Rq_AR_SpontanFlag = 1;
}

on EnvVar HMI_CCGW_Msg53_Disp_Rq
{
    _mCCGW_Disp_Rq_AR.CCGW_Msg53_Disp_Rq.phys = getValue(this);
    _CCGW_Disp_Rq_AR_SpontanFlag = 1;
}

on EnvVar HMI_CCGW_Msg54_Disp_Rq
{
    _mCCGW_Disp_Rq_AR.CCGW_Msg54_Disp_Rq.phys = getValue(this);
    _CCGW_Disp_Rq_AR_SpontanFlag = 1;
}

on EnvVar HMI_CCGW_Msg55_Disp_Rq
{
    _mCCGW_Disp_Rq_AR.CCGW_Msg55_Disp_Rq.phys = getValue(this);
    _CCGW_Disp_Rq_AR_SpontanFlag = 1;
}

on EnvVar HMI_CCGW_Msg56_Disp_Rq
{
    _mCCGW_Disp_Rq_AR.CCGW_Msg56_Disp_Rq.phys = getValue(this);
    _CCGW_Disp_Rq_AR_SpontanFlag = 1;
}

on EnvVar HMI_CCGW_Msg57_Disp_Rq
{
    _mCCGW_Disp_Rq_AR.CCGW_Msg57_Disp_Rq.phys = getValue(this);
    _CCGW_Disp_Rq_AR_SpontanFlag = 1;
}

on EnvVar HMI_CCGW_Msg58_Disp_Rq
{
    _mCCGW_Disp_Rq_AR.CCGW_Msg58_Disp_Rq.phys = getValue(this);
    _CCGW_Disp_Rq_AR_SpontanFlag = 1;
}

on EnvVar HMI_CCGW_Msg59_Disp_Rq
{
    _mCCGW_Disp_Rq_AR.CCGW_Msg59_Disp_Rq.phys = getValue(this);
    _CCGW_Disp_Rq_AR_SpontanFlag = 1;
}

on EnvVar HMI_CCGW_Msg60_Disp_Rq
{
    _mCCGW_Disp_Rq_AR.CCGW_Msg60_Disp_Rq.phys = getValue(this);
    _CCGW_Disp_Rq_AR_SpontanFlag = 1;
}

on EnvVar HMI_CCGW_Msg61_Disp_Rq
{
    _mCCGW_Disp_Rq_AR.CCGW_Msg61_Disp_Rq.phys = getValue(this);
    _CCGW_Disp_Rq_AR_SpontanFlag = 1;
}

on EnvVar HMI_CCGW_Msg62_Disp_Rq
{
    _mCCGW_Disp_Rq_AR.CCGW_Msg62_Disp_Rq.phys = getValue(this);
    _CCGW_Disp_Rq_AR_SpontanFlag = 1;
}

on EnvVar HMI_CCGW_Msg63_Disp_Rq
{
    _mCCGW_Disp_Rq_AR.CCGW_Msg63_Disp_Rq.phys = getValue(this);
    _CCGW_Disp_Rq_AR_SpontanFlag = 1;
}

on EnvVar HMI_CCGW_Msg64_Disp_Rq
{
    _mCCGW_Disp_Rq_AR.CCGW_Msg64_Disp_Rq.phys = getValue(this);
    _CCGW_Disp_Rq_AR_SpontanFlag = 1;
}

CCGW_Disp_Rq2_AR_check_output()
{
    if( !getValue( HMI__STMSG_CCGW_Disp_Rq2_AR ))
    {
        // Botschaft CCGW_Disp_Rq2_AR ID: 2463367168 --- Sendeart cyclicAndSpontanWithDelay --- 
        _CCGW_Disp_Rq2_AR_Cnt--;
        if( _CCGW_Disp_Rq2_AR_Cnt < 1 )
        {
            // Nachricht wg. abgelaufenem Zyklus ausgeben
            output( _mCCGW_Disp_Rq2_AR );
            _CCGW_Disp_Rq2_AR_Cnt = _CCGW_Disp_Rq2_AR_CycleCount; // Zyklus-Zähler zurücksetzen
             _CCGW_Disp_Rq2_AR_SpontanFlag = 0; // Spontan-Flag zurücksetzen
        }
        else if( _CCGW_Disp_Rq2_AR_SpontanFlag)
        {
            // Nachricht wg. spontaner Änderung ausgeben
            output( _mCCGW_Disp_Rq2_AR );
             _CCGW_Disp_Rq2_AR_SpontanFlag = 0; // Spontan-Flag zurücksetzen
        }
    }
}

CCGW_Disp_Rq2_AR_init()
{   /* Botschaft CCGW_Disp_Rq2_AR ID: 2463367168 --- Sendeart cyclicAndSpontanWithDelay --- 
BA_ "ApplMessage" BO_ 2463367168 0;
BA_ "NmAsrMessage" BO_ 2463367168 0;
BA_ "GenMsgMinAcceptLength" BO_ 2463367168 8;
BA_ "GenMsgILSupport" BO_ 2463367168 1;
BA_ "DiagState" BO_ 2463367168 0;
BA_ "DiagRequest" BO_ 2463367168 0;
BA_ "DiagResponse" BO_ 2463367168 0;
BA_ "GenMsgStartValue" BO_ 2463367168 "0";
BA_ "GenMsgStartDelayTime" BO_ 2463367168 15;
BA_ "GenMsgDelayTime" BO_ 2463367168 5;
BA_ "GenMsgNrOfRepetitions" BO_ 2463367168 0;
BA_ "GenMsgCycleTime" BO_ 2463367168 1000;
BA_ "GenMsgSendType" BO_ 2463367168 5;
    */
    _CCGW_Disp_Rq2_AR_Timebase =               c_tDBKomTimer_20ms;
    _CCGW_Disp_Rq2_AR_CycleCount =           1000 / _CCGW_Disp_Rq2_AR_Timebase;
    _CCGW_Disp_Rq2_AR_StartDelay =             15 / _CCGW_Disp_Rq2_AR_Timebase;
    _CCGW_Disp_Rq2_AR_Cnt = _CCGW_Disp_Rq2_AR_StartDelay;
    _CCGW_Disp_Rq2_AR_SpontanFlag = 0;

    putValue( HMI__STMSGSD_CCGW_Disp_Rq2_AR, _CCGW_Disp_Rq2_AR_StartDelay * _CCGW_Disp_Rq2_AR_Timebase );

    _mCCGW_Disp_Rq2_AR.CCGW_Msg65_Disp_Rq.phys = getValue( HMI_CCGW_Msg65_Disp_Rq );
	_mCCGW_Disp_Rq2_AR.CCGW_Msg66_Disp_Rq.phys = getValue( HMI_CCGW_Msg66_Disp_Rq );
	_mCCGW_Disp_Rq2_AR.CCGW_Msg67_Disp_Rq.phys = getValue( HMI_CCGW_Msg67_Disp_Rq );
	_mCCGW_Disp_Rq2_AR.CCGW_Msg68_Disp_Rq.phys = getValue( HMI_CCGW_Msg68_Disp_Rq );
	_mCCGW_Disp_Rq2_AR.CCGW_Msg69_Disp_Rq.phys = getValue( HMI_CCGW_Msg69_Disp_Rq );
	_mCCGW_Disp_Rq2_AR.CCGW_Msg70_Disp_Rq.phys = getValue( HMI_CCGW_Msg70_Disp_Rq );
	_mCCGW_Disp_Rq2_AR.CCGW_Msg71_Disp_Rq.phys = getValue( HMI_CCGW_Msg71_Disp_Rq );
	_mCCGW_Disp_Rq2_AR.CCGW_Msg72_Disp_Rq.phys = getValue( HMI_CCGW_Msg72_Disp_Rq );
	_mCCGW_Disp_Rq2_AR.CCGW_Msg73_Disp_Rq.phys = getValue( HMI_CCGW_Msg73_Disp_Rq );
	_mCCGW_Disp_Rq2_AR.CCGW_Msg74_Disp_Rq.phys = getValue( HMI_CCGW_Msg74_Disp_Rq );
	_mCCGW_Disp_Rq2_AR.CCGW_Msg75_Disp_Rq.phys = getValue( HMI_CCGW_Msg75_Disp_Rq );
	_mCCGW_Disp_Rq2_AR.CCGW_Msg76_Disp_Rq.phys = getValue( HMI_CCGW_Msg76_Disp_Rq );
	_mCCGW_Disp_Rq2_AR.CCGW_Msg77_Disp_Rq.phys = getValue( HMI_CCGW_Msg77_Disp_Rq );
	_mCCGW_Disp_Rq2_AR.CCGW_Msg78_Disp_Rq.phys = getValue( HMI_CCGW_Msg78_Disp_Rq );
	_mCCGW_Disp_Rq2_AR.CCGW_Msg79_Disp_Rq.phys = getValue( HMI_CCGW_Msg79_Disp_Rq );
	_mCCGW_Disp_Rq2_AR.CCGW_Msg80_Disp_Rq.phys = getValue( HMI_CCGW_Msg80_Disp_Rq );
	_mCCGW_Disp_Rq2_AR.CCGW_Msg81_Disp_Rq.phys = getValue( HMI_CCGW_Msg81_Disp_Rq );
	_mCCGW_Disp_Rq2_AR.CCGW_Msg82_Disp_Rq.phys = getValue( HMI_CCGW_Msg82_Disp_Rq );
	_mCCGW_Disp_Rq2_AR.CCGW_Msg83_Disp_Rq.phys = getValue( HMI_CCGW_Msg83_Disp_Rq );
	_mCCGW_Disp_Rq2_AR.CCGW_Msg84_Disp_Rq.phys = getValue( HMI_CCGW_Msg84_Disp_Rq );
	_mCCGW_Disp_Rq2_AR.CCGW_Msg85_Disp_Rq.phys = getValue( HMI_CCGW_Msg85_Disp_Rq );
	_mCCGW_Disp_Rq2_AR.CCGW_Msg86_Disp_Rq.phys = getValue( HMI_CCGW_Msg86_Disp_Rq );
	_mCCGW_Disp_Rq2_AR.CCGW_Msg87_Disp_Rq.phys = getValue( HMI_CCGW_Msg87_Disp_Rq );
	_mCCGW_Disp_Rq2_AR.CCGW_Msg88_Disp_Rq.phys = getValue( HMI_CCGW_Msg88_Disp_Rq );
	_mCCGW_Disp_Rq2_AR.CCGW_Msg89_Disp_Rq.phys = getValue( HMI_CCGW_Msg89_Disp_Rq );
	_mCCGW_Disp_Rq2_AR.CCGW_Msg90_Disp_Rq.phys = getValue( HMI_CCGW_Msg90_Disp_Rq );
	_mCCGW_Disp_Rq2_AR.CCGW_Msg91_Disp_Rq.phys = getValue( HMI_CCGW_Msg91_Disp_Rq );
	_mCCGW_Disp_Rq2_AR.CCGW_Msg92_Disp_Rq.phys = getValue( HMI_CCGW_Msg92_Disp_Rq );
	_mCCGW_Disp_Rq2_AR.CCGW_Msg93_Disp_Rq.phys = getValue( HMI_CCGW_Msg93_Disp_Rq );
	_mCCGW_Disp_Rq2_AR.CCGW_Msg94_Disp_Rq.phys = getValue( HMI_CCGW_Msg94_Disp_Rq );
	_mCCGW_Disp_Rq2_AR.CCGW_Msg95_Disp_Rq.phys = getValue( HMI_CCGW_Msg95_Disp_Rq );
	_mCCGW_Disp_Rq2_AR.CCGW_Msg96_Disp_Rq.phys = getValue( HMI_CCGW_Msg96_Disp_Rq );
	_mCCGW_Disp_Rq2_AR.CCGW_Msg97_Disp_Rq.phys = getValue( HMI_CCGW_Msg97_Disp_Rq );
	_mCCGW_Disp_Rq2_AR.CCGW_Msg98_Disp_Rq.phys = getValue( HMI_CCGW_Msg98_Disp_Rq );
	_mCCGW_Disp_Rq2_AR.CCGW_Msg99_Disp_Rq.phys = getValue( HMI_CCGW_Msg99_Disp_Rq );
	_mCCGW_Disp_Rq2_AR.CCGW_Msg100_Disp_Rq.phys = getValue( HMI_CCGW_Msg100_Disp_Rq );
	_mCCGW_Disp_Rq2_AR.CCGW_Msg101_Disp_Rq.phys = getValue( HMI_CCGW_Msg101_Disp_Rq );
	_mCCGW_Disp_Rq2_AR.CCGW_Msg102_Disp_Rq.phys = getValue( HMI_CCGW_Msg102_Disp_Rq );
	_mCCGW_Disp_Rq2_AR.CCGW_Msg103_Disp_Rq.phys = getValue( HMI_CCGW_Msg103_Disp_Rq );
	_mCCGW_Disp_Rq2_AR.CCGW_Msg104_Disp_Rq.phys = getValue( HMI_CCGW_Msg104_Disp_Rq );
	_mCCGW_Disp_Rq2_AR.CCGW_Msg105_Disp_Rq.phys = getValue( HMI_CCGW_Msg105_Disp_Rq );
	_mCCGW_Disp_Rq2_AR.CCGW_Msg106_Disp_Rq.phys = getValue( HMI_CCGW_Msg106_Disp_Rq );
	_mCCGW_Disp_Rq2_AR.CCGW_Msg107_Disp_Rq.phys = getValue( HMI_CCGW_Msg107_Disp_Rq );
	_mCCGW_Disp_Rq2_AR.CCGW_Msg108_Disp_Rq.phys = getValue( HMI_CCGW_Msg108_Disp_Rq );
	_mCCGW_Disp_Rq2_AR.CCGW_Msg109_Disp_Rq.phys = getValue( HMI_CCGW_Msg109_Disp_Rq );
	_mCCGW_Disp_Rq2_AR.CCGW_Msg110_Disp_Rq.phys = getValue( HMI_CCGW_Msg110_Disp_Rq );
	_mCCGW_Disp_Rq2_AR.CCGW_Msg111_Disp_Rq.phys = getValue( HMI_CCGW_Msg111_Disp_Rq );
	_mCCGW_Disp_Rq2_AR.CCGW_Msg112_Disp_Rq.phys = getValue( HMI_CCGW_Msg112_Disp_Rq );
	_mCCGW_Disp_Rq2_AR.CCGW_Msg113_Disp_Rq.phys = getValue( HMI_CCGW_Msg113_Disp_Rq );
	_mCCGW_Disp_Rq2_AR.CCGW_Msg114_Disp_Rq.phys = getValue( HMI_CCGW_Msg114_Disp_Rq );
	_mCCGW_Disp_Rq2_AR.CCGW_Msg115_Disp_Rq.phys = getValue( HMI_CCGW_Msg115_Disp_Rq );
	_mCCGW_Disp_Rq2_AR.CCGW_Msg116_Disp_Rq.phys = getValue( HMI_CCGW_Msg116_Disp_Rq );
	_mCCGW_Disp_Rq2_AR.CCGW_Msg117_Disp_Rq.phys = getValue( HMI_CCGW_Msg117_Disp_Rq );
	_mCCGW_Disp_Rq2_AR.CCGW_Msg118_Disp_Rq.phys = getValue( HMI_CCGW_Msg118_Disp_Rq );
	_mCCGW_Disp_Rq2_AR.CCGW_Msg119_Disp_Rq.phys = getValue( HMI_CCGW_Msg119_Disp_Rq );
	_mCCGW_Disp_Rq2_AR.CCGW_Msg120_Disp_Rq.phys = getValue( HMI_CCGW_Msg120_Disp_Rq );
	_mCCGW_Disp_Rq2_AR.CCGW_Msg121_Disp_Rq.phys = getValue( HMI_CCGW_Msg121_Disp_Rq );
	_mCCGW_Disp_Rq2_AR.CCGW_Msg122_Disp_Rq.phys = getValue( HMI_CCGW_Msg122_Disp_Rq );
	_mCCGW_Disp_Rq2_AR.CCGW_Msg123_Disp_Rq.phys = getValue( HMI_CCGW_Msg123_Disp_Rq );
	_mCCGW_Disp_Rq2_AR.CCGW_Msg124_Disp_Rq.phys = getValue( HMI_CCGW_Msg124_Disp_Rq );
	_mCCGW_Disp_Rq2_AR.CCGW_Msg125_Disp_Rq.phys = getValue( HMI_CCGW_Msg125_Disp_Rq );
	_mCCGW_Disp_Rq2_AR.CCGW_Msg126_Disp_Rq.phys = getValue( HMI_CCGW_Msg126_Disp_Rq );
	_mCCGW_Disp_Rq2_AR.CCGW_Msg127_Disp_Rq.phys = getValue( HMI_CCGW_Msg127_Disp_Rq );
	_mCCGW_Disp_Rq2_AR.CCGW_Msg128_Disp_Rq.phys = getValue( HMI_CCGW_Msg128_Disp_Rq );
	
}

CCGW_Disp_Rq2_AR_saveEnvVars( dword hFile )
{
    filePutString("\n// Knoten EIS: CCGW_Disp_Rq2_AR\n", 28, hFile );
    snprintf( buffer, elcount( buffer ), "0.0000 HMI__STMSG_CCGW_Disp_Rq2_AR := %X\n", getValue( HMI__STMSG_CCGW_Disp_Rq2_AR ) );        filePutString( buffer, elcount( buffer ), hFile );
    snprintf( buffer, elcount( buffer ), "0.0000 HMI__STMSGT_CCGW_Disp_Rq2_AR := %X\n", getValue( HMI__STMSGT_CCGW_Disp_Rq2_AR ) );        filePutString( buffer, elcount( buffer ), hFile );
    
	snprintf( buffer, elcount( buffer ), "0.0000 HMI_CCGW_Msg65_Disp_Rq := %X\n", getValue( HMI_CCGW_Msg65_Disp_Rq ) );        filePutString( buffer, elcount( buffer ), hFile );
	snprintf( buffer, elcount( buffer ), "0.0000 HMI_CCGW_Msg66_Disp_Rq := %X\n", getValue( HMI_CCGW_Msg66_Disp_Rq ) );        filePutString( buffer, elcount( buffer ), hFile );
	snprintf( buffer, elcount( buffer ), "0.0000 HMI_CCGW_Msg67_Disp_Rq := %X\n", getValue( HMI_CCGW_Msg67_Disp_Rq ) );        filePutString( buffer, elcount( buffer ), hFile );
	snprintf( buffer, elcount( buffer ), "0.0000 HMI_CCGW_Msg68_Disp_Rq := %X\n", getValue( HMI_CCGW_Msg68_Disp_Rq ) );        filePutString( buffer, elcount( buffer ), hFile );
	snprintf( buffer, elcount( buffer ), "0.0000 HMI_CCGW_Msg69_Disp_Rq := %X\n", getValue( HMI_CCGW_Msg69_Disp_Rq ) );        filePutString( buffer, elcount( buffer ), hFile );
	snprintf( buffer, elcount( buffer ), "0.0000 HMI_CCGW_Msg70_Disp_Rq := %X\n", getValue( HMI_CCGW_Msg70_Disp_Rq ) );        filePutString( buffer, elcount( buffer ), hFile );
	snprintf( buffer, elcount( buffer ), "0.0000 HMI_CCGW_Msg71_Disp_Rq := %X\n", getValue( HMI_CCGW_Msg71_Disp_Rq ) );        filePutString( buffer, elcount( buffer ), hFile );
	snprintf( buffer, elcount( buffer ), "0.0000 HMI_CCGW_Msg72_Disp_Rq := %X\n", getValue( HMI_CCGW_Msg72_Disp_Rq ) );        filePutString( buffer, elcount( buffer ), hFile );
	snprintf( buffer, elcount( buffer ), "0.0000 HMI_CCGW_Msg73_Disp_Rq := %X\n", getValue( HMI_CCGW_Msg73_Disp_Rq ) );        filePutString( buffer, elcount( buffer ), hFile );
    snprintf( buffer, elcount( buffer ), "0.0000 HMI_CCGW_Msg74_Disp_Rq := %X\n", getValue( HMI_CCGW_Msg74_Disp_Rq ) );        filePutString( buffer, elcount( buffer ), hFile );
	snprintf( buffer, elcount( buffer ), "0.0000 HMI_CCGW_Msg75_Disp_Rq := %X\n", getValue( HMI_CCGW_Msg75_Disp_Rq ) );        filePutString( buffer, elcount( buffer ), hFile );
	snprintf( buffer, elcount( buffer ), "0.0000 HMI_CCGW_Msg76_Disp_Rq := %X\n", getValue( HMI_CCGW_Msg76_Disp_Rq ) );        filePutString( buffer, elcount( buffer ), hFile );
	snprintf( buffer, elcount( buffer ), "0.0000 HMI_CCGW_Msg77_Disp_Rq := %X\n", getValue( HMI_CCGW_Msg77_Disp_Rq ) );        filePutString( buffer, elcount( buffer ), hFile );
	snprintf( buffer, elcount( buffer ), "0.0000 HMI_CCGW_Msg78_Disp_Rq := %X\n", getValue( HMI_CCGW_Msg78_Disp_Rq ) );        filePutString( buffer, elcount( buffer ), hFile );
	snprintf( buffer, elcount( buffer ), "0.0000 HMI_CCGW_Msg79_Disp_Rq := %X\n", getValue( HMI_CCGW_Msg79_Disp_Rq ) );        filePutString( buffer, elcount( buffer ), hFile );
	snprintf( buffer, elcount( buffer ), "0.0000 HMI_CCGW_Msg80_Disp_Rq := %X\n", getValue( HMI_CCGW_Msg80_Disp_Rq ) );        filePutString( buffer, elcount( buffer ), hFile );
	snprintf( buffer, elcount( buffer ), "0.0000 HMI_CCGW_Msg81_Disp_Rq := %X\n", getValue( HMI_CCGW_Msg81_Disp_Rq ) );        filePutString( buffer, elcount( buffer ), hFile );
	snprintf( buffer, elcount( buffer ), "0.0000 HMI_CCGW_Msg82_Disp_Rq := %X\n", getValue( HMI_CCGW_Msg82_Disp_Rq ) );        filePutString( buffer, elcount( buffer ), hFile );
	snprintf( buffer, elcount( buffer ), "0.0000 HMI_CCGW_Msg83_Disp_Rq := %X\n", getValue( HMI_CCGW_Msg83_Disp_Rq ) );        filePutString( buffer, elcount( buffer ), hFile );
    snprintf( buffer, elcount( buffer ), "0.0000 HMI_CCGW_Msg84_Disp_Rq := %X\n", getValue( HMI_CCGW_Msg84_Disp_Rq ) );        filePutString( buffer, elcount( buffer ), hFile );
	snprintf( buffer, elcount( buffer ), "0.0000 HMI_CCGW_Msg85_Disp_Rq := %X\n", getValue( HMI_CCGW_Msg85_Disp_Rq ) );        filePutString( buffer, elcount( buffer ), hFile );
	snprintf( buffer, elcount( buffer ), "0.0000 HMI_CCGW_Msg86_Disp_Rq := %X\n", getValue( HMI_CCGW_Msg86_Disp_Rq ) );        filePutString( buffer, elcount( buffer ), hFile );
	snprintf( buffer, elcount( buffer ), "0.0000 HMI_CCGW_Msg87_Disp_Rq := %X\n", getValue( HMI_CCGW_Msg87_Disp_Rq ) );        filePutString( buffer, elcount( buffer ), hFile );
	snprintf( buffer, elcount( buffer ), "0.0000 HMI_CCGW_Msg88_Disp_Rq := %X\n", getValue( HMI_CCGW_Msg88_Disp_Rq ) );        filePutString( buffer, elcount( buffer ), hFile );
	snprintf( buffer, elcount( buffer ), "0.0000 HMI_CCGW_Msg89_Disp_Rq := %X\n", getValue( HMI_CCGW_Msg89_Disp_Rq ) );        filePutString( buffer, elcount( buffer ), hFile );
	snprintf( buffer, elcount( buffer ), "0.0000 HMI_CCGW_Msg90_Disp_Rq := %X\n", getValue( HMI_CCGW_Msg90_Disp_Rq ) );        filePutString( buffer, elcount( buffer ), hFile );
	snprintf( buffer, elcount( buffer ), "0.0000 HMI_CCGW_Msg91_Disp_Rq := %X\n", getValue( HMI_CCGW_Msg91_Disp_Rq ) );        filePutString( buffer, elcount( buffer ), hFile );
	snprintf( buffer, elcount( buffer ), "0.0000 HMI_CCGW_Msg92_Disp_Rq := %X\n", getValue( HMI_CCGW_Msg92_Disp_Rq ) );        filePutString( buffer, elcount( buffer ), hFile );
	snprintf( buffer, elcount( buffer ), "0.0000 HMI_CCGW_Msg93_Disp_Rq := %X\n", getValue( HMI_CCGW_Msg93_Disp_Rq ) );        filePutString( buffer, elcount( buffer ), hFile );
    snprintf( buffer, elcount( buffer ), "0.0000 HMI_CCGW_Msg94_Disp_Rq := %X\n", getValue( HMI_CCGW_Msg94_Disp_Rq ) );        filePutString( buffer, elcount( buffer ), hFile );
	snprintf( buffer, elcount( buffer ), "0.0000 HMI_CCGW_Msg95_Disp_Rq := %X\n", getValue( HMI_CCGW_Msg95_Disp_Rq ) );        filePutString( buffer, elcount( buffer ), hFile );
	snprintf( buffer, elcount( buffer ), "0.0000 HMI_CCGW_Msg96_Disp_Rq := %X\n", getValue( HMI_CCGW_Msg96_Disp_Rq ) );        filePutString( buffer, elcount( buffer ), hFile );
	snprintf( buffer, elcount( buffer ), "0.0000 HMI_CCGW_Msg97_Disp_Rq := %X\n", getValue( HMI_CCGW_Msg97_Disp_Rq ) );        filePutString( buffer, elcount( buffer ), hFile );
	snprintf( buffer, elcount( buffer ), "0.0000 HMI_CCGW_Msg98_Disp_Rq := %X\n", getValue( HMI_CCGW_Msg98_Disp_Rq ) );        filePutString( buffer, elcount( buffer ), hFile );
	snprintf( buffer, elcount( buffer ), "0.0000 HMI_CCGW_Msg99_Disp_Rq := %X\n", getValue( HMI_CCGW_Msg99_Disp_Rq ) );        filePutString( buffer, elcount( buffer ), hFile );
	snprintf( buffer, elcount( buffer ), "0.0000 HMI_CCGW_Msg100_Disp_Rq := %X\n", getValue( HMI_CCGW_Msg100_Disp_Rq ) );        filePutString( buffer, elcount( buffer ), hFile );
	snprintf( buffer, elcount( buffer ), "0.0000 HMI_CCGW_Msg101_Disp_Rq := %X\n", getValue( HMI_CCGW_Msg101_Disp_Rq ) );        filePutString( buffer, elcount( buffer ), hFile );
	snprintf( buffer, elcount( buffer ), "0.0000 HMI_CCGW_Msg102_Disp_Rq := %X\n", getValue( HMI_CCGW_Msg102_Disp_Rq ) );        filePutString( buffer, elcount( buffer ), hFile );
	snprintf( buffer, elcount( buffer ), "0.0000 HMI_CCGW_Msg103_Disp_Rq := %X\n", getValue( HMI_CCGW_Msg103_Disp_Rq ) );        filePutString( buffer, elcount( buffer ), hFile );
    snprintf( buffer, elcount( buffer ), "0.0000 HMI_CCGW_Msg104_Disp_Rq := %X\n", getValue( HMI_CCGW_Msg104_Disp_Rq ) );        filePutString( buffer, elcount( buffer ), hFile );
	snprintf( buffer, elcount( buffer ), "0.0000 HMI_CCGW_Msg105_Disp_Rq := %X\n", getValue( HMI_CCGW_Msg105_Disp_Rq ) );        filePutString( buffer, elcount( buffer ), hFile );
	snprintf( buffer, elcount( buffer ), "0.0000 HMI_CCGW_Msg106_Disp_Rq := %X\n", getValue( HMI_CCGW_Msg106_Disp_Rq ) );        filePutString( buffer, elcount( buffer ), hFile );
	snprintf( buffer, elcount( buffer ), "0.0000 HMI_CCGW_Msg107_Disp_Rq := %X\n", getValue( HMI_CCGW_Msg107_Disp_Rq ) );        filePutString( buffer, elcount( buffer ), hFile );
	snprintf( buffer, elcount( buffer ), "0.0000 HMI_CCGW_Msg108_Disp_Rq := %X\n", getValue( HMI_CCGW_Msg108_Disp_Rq ) );        filePutString( buffer, elcount( buffer ), hFile );
	snprintf( buffer, elcount( buffer ), "0.0000 HMI_CCGW_Msg109_Disp_Rq := %X\n", getValue( HMI_CCGW_Msg109_Disp_Rq ) );        filePutString( buffer, elcount( buffer ), hFile );
	snprintf( buffer, elcount( buffer ), "0.0000 HMI_CCGW_Msg110_Disp_Rq := %X\n", getValue( HMI_CCGW_Msg110_Disp_Rq ) );        filePutString( buffer, elcount( buffer ), hFile );
	snprintf( buffer, elcount( buffer ), "0.0000 HMI_CCGW_Msg111_Disp_Rq := %X\n", getValue( HMI_CCGW_Msg111_Disp_Rq ) );        filePutString( buffer, elcount( buffer ), hFile );
	snprintf( buffer, elcount( buffer ), "0.0000 HMI_CCGW_Msg112_Disp_Rq := %X\n", getValue( HMI_CCGW_Msg112_Disp_Rq ) );        filePutString( buffer, elcount( buffer ), hFile );
	snprintf( buffer, elcount( buffer ), "0.0000 HMI_CCGW_Msg113_Disp_Rq := %X\n", getValue( HMI_CCGW_Msg113_Disp_Rq ) );        filePutString( buffer, elcount( buffer ), hFile );
    snprintf( buffer, elcount( buffer ), "0.0000 HMI_CCGW_Msg114_Disp_Rq := %X\n", getValue( HMI_CCGW_Msg114_Disp_Rq ) );        filePutString( buffer, elcount( buffer ), hFile );
	snprintf( buffer, elcount( buffer ), "0.0000 HMI_CCGW_Msg115_Disp_Rq := %X\n", getValue( HMI_CCGW_Msg115_Disp_Rq ) );        filePutString( buffer, elcount( buffer ), hFile );
	snprintf( buffer, elcount( buffer ), "0.0000 HMI_CCGW_Msg116_Disp_Rq := %X\n", getValue( HMI_CCGW_Msg116_Disp_Rq ) );        filePutString( buffer, elcount( buffer ), hFile );
	snprintf( buffer, elcount( buffer ), "0.0000 HMI_CCGW_Msg117_Disp_Rq := %X\n", getValue( HMI_CCGW_Msg117_Disp_Rq ) );        filePutString( buffer, elcount( buffer ), hFile );
	snprintf( buffer, elcount( buffer ), "0.0000 HMI_CCGW_Msg118_Disp_Rq := %X\n", getValue( HMI_CCGW_Msg118_Disp_Rq ) );        filePutString( buffer, elcount( buffer ), hFile );
	snprintf( buffer, elcount( buffer ), "0.0000 HMI_CCGW_Msg119_Disp_Rq := %X\n", getValue( HMI_CCGW_Msg119_Disp_Rq ) );        filePutString( buffer, elcount( buffer ), hFile );
	snprintf( buffer, elcount( buffer ), "0.0000 HMI_CCGW_Msg120_Disp_Rq := %X\n", getValue( HMI_CCGW_Msg120_Disp_Rq ) );        filePutString( buffer, elcount( buffer ), hFile );
	snprintf( buffer, elcount( buffer ), "0.0000 HMI_CCGW_Msg121_Disp_Rq := %X\n", getValue( HMI_CCGW_Msg121_Disp_Rq ) );        filePutString( buffer, elcount( buffer ), hFile );
	snprintf( buffer, elcount( buffer ), "0.0000 HMI_CCGW_Msg122_Disp_Rq := %X\n", getValue( HMI_CCGW_Msg122_Disp_Rq ) );        filePutString( buffer, elcount( buffer ), hFile );
	snprintf( buffer, elcount( buffer ), "0.0000 HMI_CCGW_Msg123_Disp_Rq := %X\n", getValue( HMI_CCGW_Msg123_Disp_Rq ) );        filePutString( buffer, elcount( buffer ), hFile );
    snprintf( buffer, elcount( buffer ), "0.0000 HMI_CCGW_Msg124_Disp_Rq := %X\n", getValue( HMI_CCGW_Msg124_Disp_Rq ) );        filePutString( buffer, elcount( buffer ), hFile );
	snprintf( buffer, elcount( buffer ), "0.0000 HMI_CCGW_Msg125_Disp_Rq := %X\n", getValue( HMI_CCGW_Msg125_Disp_Rq ) );        filePutString( buffer, elcount( buffer ), hFile );
	snprintf( buffer, elcount( buffer ), "0.0000 HMI_CCGW_Msg126_Disp_Rq := %X\n", getValue( HMI_CCGW_Msg126_Disp_Rq ) );        filePutString( buffer, elcount( buffer ), hFile );
	snprintf( buffer, elcount( buffer ), "0.0000 HMI_CCGW_Msg127_Disp_Rq := %X\n", getValue( HMI_CCGW_Msg127_Disp_Rq ) );        filePutString( buffer, elcount( buffer ), hFile );
	snprintf( buffer, elcount( buffer ), "0.0000 HMI_CCGW_Msg128_Disp_Rq := %X\n", getValue( HMI_CCGW_Msg128_Disp_Rq ) );        filePutString( buffer, elcount( buffer ), hFile );
	
}
on timer _tCCGW_Disp_Rq2_AR
{
    putValue( HMI__STMSG_CCGW_Disp_Rq2_AR, 0 );
}

on EnvVar HMI__STMSG_CCGW_Disp_Rq2_AR
{
    long tDelay;
    if( getValue( this ) == 2 )
    {
        tDelay = getValue( HMI__STMSGT_CCGW_Disp_Rq2_AR );
        if( tDelay > 0)    
            setTimer( _tCCGW_Disp_Rq2_AR, tDelay );
        else
            putValue( HMI__STMSG_CCGW_Disp_Rq2_AR, 0 );
    }
}

on envVar HMI__STMSG_PO_CCGW_Disp_Rq2_AR
{
    if( getValue( this ) )
        openPanel("CCGW_Disp_Rq2_AR");
}


on EnvVar HMI_CCGW_Msg65_Disp_Rq
{
    _mCCGW_Disp_Rq2_AR.CCGW_Msg65_Disp_Rq.phys = getValue(this);
    _CCGW_Disp_Rq2_AR_SpontanFlag = 1;
}

on EnvVar HMI_CCGW_Msg66_Disp_Rq
{
    _mCCGW_Disp_Rq2_AR.CCGW_Msg66_Disp_Rq.phys = getValue(this);
    _CCGW_Disp_Rq2_AR_SpontanFlag = 1;
}

on EnvVar HMI_CCGW_Msg67_Disp_Rq
{
    _mCCGW_Disp_Rq2_AR.CCGW_Msg67_Disp_Rq.phys = getValue(this);
    _CCGW_Disp_Rq2_AR_SpontanFlag = 1;
}

on EnvVar HMI_CCGW_Msg68_Disp_Rq
{
    _mCCGW_Disp_Rq2_AR.CCGW_Msg68_Disp_Rq.phys = getValue(this);
    _CCGW_Disp_Rq2_AR_SpontanFlag = 1;
}

on EnvVar HMI_CCGW_Msg69_Disp_Rq
{
    _mCCGW_Disp_Rq2_AR.CCGW_Msg69_Disp_Rq.phys = getValue(this);
    _CCGW_Disp_Rq2_AR_SpontanFlag = 1;
}

on EnvVar HMI_CCGW_Msg70_Disp_Rq
{
    _mCCGW_Disp_Rq2_AR.CCGW_Msg70_Disp_Rq.phys = getValue(this);
    _CCGW_Disp_Rq2_AR_SpontanFlag = 1;
}

on EnvVar HMI_CCGW_Msg71_Disp_Rq
{
    _mCCGW_Disp_Rq2_AR.CCGW_Msg71_Disp_Rq.phys = getValue(this);
    _CCGW_Disp_Rq2_AR_SpontanFlag = 1;
}

on EnvVar HMI_CCGW_Msg72_Disp_Rq
{
    _mCCGW_Disp_Rq2_AR.CCGW_Msg72_Disp_Rq.phys = getValue(this);
    _CCGW_Disp_Rq2_AR_SpontanFlag = 1;
}

on EnvVar HMI_CCGW_Msg73_Disp_Rq
{
    _mCCGW_Disp_Rq2_AR.CCGW_Msg73_Disp_Rq.phys = getValue(this);
    _CCGW_Disp_Rq2_AR_SpontanFlag = 1;
}

on EnvVar HMI_CCGW_Msg74_Disp_Rq
{
    _mCCGW_Disp_Rq2_AR.CCGW_Msg74_Disp_Rq.phys = getValue(this);
    _CCGW_Disp_Rq2_AR_SpontanFlag = 1;
}

on EnvVar HMI_CCGW_Msg75_Disp_Rq
{
    _mCCGW_Disp_Rq2_AR.CCGW_Msg75_Disp_Rq.phys = getValue(this);
    _CCGW_Disp_Rq2_AR_SpontanFlag = 1;
}

on EnvVar HMI_CCGW_Msg76_Disp_Rq
{
    _mCCGW_Disp_Rq2_AR.CCGW_Msg76_Disp_Rq.phys = getValue(this);
    _CCGW_Disp_Rq2_AR_SpontanFlag = 1;
}

on EnvVar HMI_CCGW_Msg77_Disp_Rq
{
    _mCCGW_Disp_Rq2_AR.CCGW_Msg77_Disp_Rq.phys = getValue(this);
    _CCGW_Disp_Rq2_AR_SpontanFlag = 1;
}

on EnvVar HMI_CCGW_Msg78_Disp_Rq
{
    _mCCGW_Disp_Rq2_AR.CCGW_Msg78_Disp_Rq.phys = getValue(this);
    _CCGW_Disp_Rq2_AR_SpontanFlag = 1;
}

on EnvVar HMI_CCGW_Msg79_Disp_Rq
{
    _mCCGW_Disp_Rq2_AR.CCGW_Msg79_Disp_Rq.phys = getValue(this);
    _CCGW_Disp_Rq2_AR_SpontanFlag = 1;
}

on EnvVar HMI_CCGW_Msg80_Disp_Rq
{
    _mCCGW_Disp_Rq2_AR.CCGW_Msg80_Disp_Rq.phys = getValue(this);
    _CCGW_Disp_Rq2_AR_SpontanFlag = 1;
}

on EnvVar HMI_CCGW_Msg81_Disp_Rq
{
    _mCCGW_Disp_Rq2_AR.CCGW_Msg81_Disp_Rq.phys = getValue(this);
    _CCGW_Disp_Rq2_AR_SpontanFlag = 1;
}

on EnvVar HMI_CCGW_Msg82_Disp_Rq
{
    _mCCGW_Disp_Rq2_AR.CCGW_Msg82_Disp_Rq.phys = getValue(this);
    _CCGW_Disp_Rq2_AR_SpontanFlag = 1;
}

on EnvVar HMI_CCGW_Msg83_Disp_Rq
{
    _mCCGW_Disp_Rq2_AR.CCGW_Msg83_Disp_Rq.phys = getValue(this);
    _CCGW_Disp_Rq2_AR_SpontanFlag = 1;
}

on EnvVar HMI_CCGW_Msg84_Disp_Rq
{
    _mCCGW_Disp_Rq2_AR.CCGW_Msg84_Disp_Rq.phys = getValue(this);
    _CCGW_Disp_Rq2_AR_SpontanFlag = 1;
}

on EnvVar HMI_CCGW_Msg85_Disp_Rq
{
    _mCCGW_Disp_Rq2_AR.CCGW_Msg85_Disp_Rq.phys = getValue(this);
    _CCGW_Disp_Rq2_AR_SpontanFlag = 1;
}

on EnvVar HMI_CCGW_Msg86_Disp_Rq
{
    _mCCGW_Disp_Rq2_AR.CCGW_Msg86_Disp_Rq.phys = getValue(this);
    _CCGW_Disp_Rq2_AR_SpontanFlag = 1;
}

on EnvVar HMI_CCGW_Msg87_Disp_Rq
{
    _mCCGW_Disp_Rq2_AR.CCGW_Msg87_Disp_Rq.phys = getValue(this);
    _CCGW_Disp_Rq2_AR_SpontanFlag = 1;
}

on EnvVar HMI_CCGW_Msg88_Disp_Rq
{
    _mCCGW_Disp_Rq2_AR.CCGW_Msg88_Disp_Rq.phys = getValue(this);
    _CCGW_Disp_Rq2_AR_SpontanFlag = 1;
}

on EnvVar HMI_CCGW_Msg89_Disp_Rq
{
    _mCCGW_Disp_Rq2_AR.CCGW_Msg89_Disp_Rq.phys = getValue(this);
    _CCGW_Disp_Rq2_AR_SpontanFlag = 1;
}

on EnvVar HMI_CCGW_Msg90_Disp_Rq
{
    _mCCGW_Disp_Rq2_AR.CCGW_Msg90_Disp_Rq.phys = getValue(this);
    _CCGW_Disp_Rq2_AR_SpontanFlag = 1;
}

on EnvVar HMI_CCGW_Msg91_Disp_Rq
{
    _mCCGW_Disp_Rq2_AR.CCGW_Msg91_Disp_Rq.phys = getValue(this);
    _CCGW_Disp_Rq2_AR_SpontanFlag = 1;
}

on EnvVar HMI_CCGW_Msg92_Disp_Rq
{
    _mCCGW_Disp_Rq2_AR.CCGW_Msg92_Disp_Rq.phys = getValue(this);
    _CCGW_Disp_Rq2_AR_SpontanFlag = 1;
}

on EnvVar HMI_CCGW_Msg93_Disp_Rq
{
    _mCCGW_Disp_Rq2_AR.CCGW_Msg93_Disp_Rq.phys = getValue(this);
    _CCGW_Disp_Rq2_AR_SpontanFlag = 1;
}

on EnvVar HMI_CCGW_Msg94_Disp_Rq
{
    _mCCGW_Disp_Rq2_AR.CCGW_Msg94_Disp_Rq.phys = getValue(this);
    _CCGW_Disp_Rq2_AR_SpontanFlag = 1;
}

on EnvVar HMI_CCGW_Msg95_Disp_Rq
{
    _mCCGW_Disp_Rq2_AR.CCGW_Msg95_Disp_Rq.phys = getValue(this);
    _CCGW_Disp_Rq2_AR_SpontanFlag = 1;
}

on EnvVar HMI_CCGW_Msg96_Disp_Rq
{
    _mCCGW_Disp_Rq2_AR.CCGW_Msg96_Disp_Rq.phys = getValue(this);
    _CCGW_Disp_Rq2_AR_SpontanFlag = 1;
}

on EnvVar HMI_CCGW_Msg97_Disp_Rq
{
    _mCCGW_Disp_Rq2_AR.CCGW_Msg97_Disp_Rq.phys = getValue(this);
    _CCGW_Disp_Rq2_AR_SpontanFlag = 1;
}

on EnvVar HMI_CCGW_Msg98_Disp_Rq
{
    _mCCGW_Disp_Rq2_AR.CCGW_Msg98_Disp_Rq.phys = getValue(this);
    _CCGW_Disp_Rq2_AR_SpontanFlag = 1;
}

on EnvVar HMI_CCGW_Msg99_Disp_Rq
{
    _mCCGW_Disp_Rq2_AR.CCGW_Msg99_Disp_Rq.phys = getValue(this);
    _CCGW_Disp_Rq2_AR_SpontanFlag = 1;
}

on EnvVar HMI_CCGW_Msg100_Disp_Rq
{
    _mCCGW_Disp_Rq2_AR.CCGW_Msg100_Disp_Rq.phys = getValue(this);
    _CCGW_Disp_Rq2_AR_SpontanFlag = 1;
}

on EnvVar HMI_CCGW_Msg101_Disp_Rq
{
    _mCCGW_Disp_Rq2_AR.CCGW_Msg101_Disp_Rq.phys = getValue(this);
    _CCGW_Disp_Rq2_AR_SpontanFlag = 1;
}

on EnvVar HMI_CCGW_Msg102_Disp_Rq
{
    _mCCGW_Disp_Rq2_AR.CCGW_Msg102_Disp_Rq.phys = getValue(this);
    _CCGW_Disp_Rq2_AR_SpontanFlag = 1;
}

on EnvVar HMI_CCGW_Msg103_Disp_Rq
{
    _mCCGW_Disp_Rq2_AR.CCGW_Msg103_Disp_Rq.phys = getValue(this);
    _CCGW_Disp_Rq2_AR_SpontanFlag = 1;
}

on EnvVar HMI_CCGW_Msg104_Disp_Rq
{
    _mCCGW_Disp_Rq2_AR.CCGW_Msg104_Disp_Rq.phys = getValue(this);
    _CCGW_Disp_Rq2_AR_SpontanFlag = 1;
}

on EnvVar HMI_CCGW_Msg105_Disp_Rq
{
    _mCCGW_Disp_Rq2_AR.CCGW_Msg105_Disp_Rq.phys = getValue(this);
    _CCGW_Disp_Rq2_AR_SpontanFlag = 1;
}

on EnvVar HMI_CCGW_Msg106_Disp_Rq
{
    _mCCGW_Disp_Rq2_AR.CCGW_Msg106_Disp_Rq.phys = getValue(this);
    _CCGW_Disp_Rq2_AR_SpontanFlag = 1;
}

on EnvVar HMI_CCGW_Msg107_Disp_Rq
{
    _mCCGW_Disp_Rq2_AR.CCGW_Msg107_Disp_Rq.phys = getValue(this);
    _CCGW_Disp_Rq2_AR_SpontanFlag = 1;
}

on EnvVar HMI_CCGW_Msg108_Disp_Rq
{
    _mCCGW_Disp_Rq2_AR.CCGW_Msg108_Disp_Rq.phys = getValue(this);
    _CCGW_Disp_Rq2_AR_SpontanFlag = 1;
}

on EnvVar HMI_CCGW_Msg109_Disp_Rq
{
    _mCCGW_Disp_Rq2_AR.CCGW_Msg109_Disp_Rq.phys = getValue(this);
    _CCGW_Disp_Rq2_AR_SpontanFlag = 1;
}

on EnvVar HMI_CCGW_Msg110_Disp_Rq
{
    _mCCGW_Disp_Rq2_AR.CCGW_Msg110_Disp_Rq.phys = getValue(this);
    _CCGW_Disp_Rq2_AR_SpontanFlag = 1;
}

on EnvVar HMI_CCGW_Msg111_Disp_Rq
{
    _mCCGW_Disp_Rq2_AR.CCGW_Msg111_Disp_Rq.phys = getValue(this);
    _CCGW_Disp_Rq2_AR_SpontanFlag = 1;
}

on EnvVar HMI_CCGW_Msg112_Disp_Rq
{
    _mCCGW_Disp_Rq2_AR.CCGW_Msg112_Disp_Rq.phys = getValue(this);
    _CCGW_Disp_Rq2_AR_SpontanFlag = 1;
}

on EnvVar HMI_CCGW_Msg113_Disp_Rq
{
    _mCCGW_Disp_Rq2_AR.CCGW_Msg113_Disp_Rq.phys = getValue(this);
    _CCGW_Disp_Rq2_AR_SpontanFlag = 1;
}

on EnvVar HMI_CCGW_Msg114_Disp_Rq
{
    _mCCGW_Disp_Rq2_AR.CCGW_Msg114_Disp_Rq.phys = getValue(this);
    _CCGW_Disp_Rq2_AR_SpontanFlag = 1;
}


on EnvVar HMI_CCGW_Msg115_Disp_Rq
{
    _mCCGW_Disp_Rq2_AR.CCGW_Msg115_Disp_Rq.phys = getValue(this);
    _CCGW_Disp_Rq2_AR_SpontanFlag = 1;
}

on EnvVar HMI_CCGW_Msg116_Disp_Rq
{
    _mCCGW_Disp_Rq2_AR.CCGW_Msg116_Disp_Rq.phys = getValue(this);
    _CCGW_Disp_Rq2_AR_SpontanFlag = 1;
}

on EnvVar HMI_CCGW_Msg117_Disp_Rq
{
    _mCCGW_Disp_Rq2_AR.CCGW_Msg117_Disp_Rq.phys = getValue(this);
    _CCGW_Disp_Rq2_AR_SpontanFlag = 1;
}

on EnvVar HMI_CCGW_Msg118_Disp_Rq
{
    _mCCGW_Disp_Rq2_AR.CCGW_Msg118_Disp_Rq.phys = getValue(this);
    _CCGW_Disp_Rq2_AR_SpontanFlag = 1;
}

on EnvVar HMI_CCGW_Msg119_Disp_Rq
{
    _mCCGW_Disp_Rq2_AR.CCGW_Msg119_Disp_Rq.phys = getValue(this);
    _CCGW_Disp_Rq2_AR_SpontanFlag = 1;
}

on EnvVar HMI_CCGW_Msg120_Disp_Rq
{
    _mCCGW_Disp_Rq2_AR.CCGW_Msg120_Disp_Rq.phys = getValue(this);
    _CCGW_Disp_Rq2_AR_SpontanFlag = 1;
}

on EnvVar HMI_CCGW_Msg121_Disp_Rq
{
    _mCCGW_Disp_Rq2_AR.CCGW_Msg121_Disp_Rq.phys = getValue(this);
    _CCGW_Disp_Rq2_AR_SpontanFlag = 1;
}

on EnvVar HMI_CCGW_Msg122_Disp_Rq
{
    _mCCGW_Disp_Rq2_AR.CCGW_Msg122_Disp_Rq.phys = getValue(this);
    _CCGW_Disp_Rq2_AR_SpontanFlag = 1;
}

on EnvVar HMI_CCGW_Msg123_Disp_Rq
{
    _mCCGW_Disp_Rq2_AR.CCGW_Msg123_Disp_Rq.phys = getValue(this);
    _CCGW_Disp_Rq2_AR_SpontanFlag = 1;
}

on EnvVar HMI_CCGW_Msg124_Disp_Rq
{
    _mCCGW_Disp_Rq2_AR.CCGW_Msg124_Disp_Rq.phys = getValue(this);
    _CCGW_Disp_Rq2_AR_SpontanFlag = 1;
}

on EnvVar HMI_CCGW_Msg125_Disp_Rq
{
    _mCCGW_Disp_Rq2_AR.CCGW_Msg125_Disp_Rq.phys = getValue(this);
    _CCGW_Disp_Rq2_AR_SpontanFlag = 1;
}

on EnvVar HMI_CCGW_Msg126_Disp_Rq
{
    _mCCGW_Disp_Rq2_AR.CCGW_Msg126_Disp_Rq.phys = getValue(this);
    _CCGW_Disp_Rq2_AR_SpontanFlag = 1;
}

on EnvVar HMI_CCGW_Msg127_Disp_Rq
{
    _mCCGW_Disp_Rq2_AR.CCGW_Msg127_Disp_Rq.phys = getValue(this);
    _CCGW_Disp_Rq2_AR_SpontanFlag = 1;
}

on EnvVar HMI_CCGW_Msg128_Disp_Rq
{
    _mCCGW_Disp_Rq2_AR.CCGW_Msg128_Disp_Rq.phys = getValue(this);
    _CCGW_Disp_Rq2_AR_SpontanFlag = 1;
}


CCGW_Disp_Rq3_AR_check_output()
{
    if( !getValue( HMI__STMSG_CCGW_Disp_Rq3_AR ))
    {
        // Botschaft CCGW_Disp_Rq3_AR ID: 2428239872 --- Sendeart cyclicAndSpontanWithDelay --- 
        _CCGW_Disp_Rq3_AR_Cnt--;
        if( _CCGW_Disp_Rq3_AR_Cnt < 1 )
        {
            // Nachricht wg. abgelaufenem Zyklus ausgeben
            output( _mCCGW_Disp_Rq3_AR );
            _CCGW_Disp_Rq3_AR_Cnt = _CCGW_Disp_Rq3_AR_CycleCount; // Zyklus-Zähler zurücksetzen
             _CCGW_Disp_Rq3_AR_SpontanFlag = 0; // Spontan-Flag zurücksetzen
        }
        else if( _CCGW_Disp_Rq3_AR_SpontanFlag)
        {
            // Nachricht wg. spontaner Änderung ausgeben
            output( _mCCGW_Disp_Rq3_AR );
             _CCGW_Disp_Rq3_AR_SpontanFlag = 0; // Spontan-Flag zurücksetzen
        }
    }
}

CCGW_Disp_Rq3_AR_init()
{   /* Botschaft CCGW_Disp_Rq3_AR ID: 2428239872 --- Sendeart cyclicAndSpontanWithDelay --- 
BA_ "ApplMessage" BO_ 2428239872 0;
BA_ "NmAsrMessage" BO_ 2428239872 0;
BA_ "GenMsgMinAcceptLength" BO_ 2428239872 8;
BA_ "GenMsgILSupport" BO_ 2428239872 1;
BA_ "DiagState" BO_ 2428239872 0;
BA_ "DiagRequest" BO_ 2428239872 0;
BA_ "DiagResponse" BO_ 2428239872 0;
BA_ "GenMsgStartValue" BO_ 2428239872 "0";
BA_ "GenMsgStartDelayTime" BO_ 2428239872 15;
BA_ "GenMsgDelayTime" BO_ 2428239872 5;
BA_ "GenMsgNrOfRepetitions" BO_ 2428239872 0;
BA_ "GenMsgCycleTime" BO_ 2428239872 1000;
BA_ "GenMsgSendType" BO_ 2428239872 5;
    */
    _CCGW_Disp_Rq3_AR_Timebase =               c_tDBKomTimer_20ms;
    _CCGW_Disp_Rq3_AR_CycleCount =           1000 / _CCGW_Disp_Rq3_AR_Timebase;
    _CCGW_Disp_Rq3_AR_StartDelay =             15 / _CCGW_Disp_Rq3_AR_Timebase;
    _CCGW_Disp_Rq3_AR_Cnt = _CCGW_Disp_Rq3_AR_StartDelay;
    _CCGW_Disp_Rq3_AR_SpontanFlag = 0;

    putValue( HMI__STMSGSD_CCGW_Disp_Rq3_AR, _CCGW_Disp_Rq3_AR_StartDelay * _CCGW_Disp_Rq3_AR_Timebase );

    _mCCGW_Disp_Rq3_AR.SmartCharge_Stat.phys = getValue( HMI_SmartCharge_Stat );
	_mCCGW_Disp_Rq3_AR.StWhlHeat_Actv_Stat_IC.phys = getValue( HMI_StWhlHeat_Actv_Stat_IC );
	_mCCGW_Disp_Rq3_AR.StWhlHeat_Coupling_Stat_IC.phys = getValue( HMI_StWhlHeat_Coupling_Stat_IC );
	_mCCGW_Disp_Rq3_AR.WeekDepTm_NextDepTm_Hour.phys = getValue( HMI_WeekDepTm_NextDepTm_Hour );
	_mCCGW_Disp_Rq3_AR.WeekDepTm_NextDepTm_Minute.phys = getValue( HMI_WeekDepTm_NextDepTm_Minute );
	_mCCGW_Disp_Rq3_AR.WeekDepTm_NextDepTm_Weekday.phys = getValue( HMI_WeekDepTm_NextDepTm_Weekday );
}

CCGW_Disp_Rq3_AR_saveEnvVars( dword hFile )
{
    filePutString("\n// Knoten EIS: CCGW_Disp_Rq3_AR\n", 28, hFile );
    snprintf( buffer, elcount( buffer ), "0.0000 HMI__STMSG_CCGW_Disp_Rq3_AR := %X\n", getValue( HMI__STMSG_CCGW_Disp_Rq3_AR ) );        filePutString( buffer, elcount( buffer ), hFile );
    snprintf( buffer, elcount( buffer ), "0.0000 HMI__STMSGT_CCGW_Disp_Rq3_AR := %X\n", getValue( HMI__STMSGT_CCGW_Disp_Rq3_AR ) );        filePutString( buffer, elcount( buffer ), hFile );
    
	snprintf( buffer, elcount( buffer ), "0.0000 HMI_SmartCharge_Stat := %X\n", getValue( HMI_SmartCharge_Stat ) );        filePutString( buffer, elcount( buffer ), hFile );
	snprintf( buffer, elcount( buffer ), "0.0000 HMI_StWhlHeat_Actv_Stat_IC := %X\n", getValue( HMI_StWhlHeat_Actv_Stat_IC ) );        filePutString( buffer, elcount( buffer ), hFile );
	snprintf( buffer, elcount( buffer ), "0.0000 HMI_StWhlHeat_Coupling_Stat_IC := %X\n", getValue( HMI_StWhlHeat_Coupling_Stat_IC ) );        filePutString( buffer, elcount( buffer ), hFile );
	snprintf( buffer, elcount( buffer ), "0.0000 HMI_WeekDepTm_NextDepTm_Hour := %X\n", getValue( HMI_WeekDepTm_NextDepTm_Hour ) );        filePutString( buffer, elcount( buffer ), hFile );
	snprintf( buffer, elcount( buffer ), "0.0000 HMI_WeekDepTm_NextDepTm_Minute := %X\n", getValue( HMI_WeekDepTm_NextDepTm_Minute ) );        filePutString( buffer, elcount( buffer ), hFile );
	snprintf( buffer, elcount( buffer ), "0.0000 HMI_WeekDepTm_NextDepTm_Weekday := %X\n", getValue( HMI_WeekDepTm_NextDepTm_Weekday ) );        filePutString( buffer, elcount( buffer ), hFile );
}

on timer _tCCGW_Disp_Rq3_AR
{
    putValue( HMI__STMSG_CCGW_Disp_Rq3_AR, 0 );
}

on EnvVar HMI__STMSG_CCGW_Disp_Rq3_AR
{
    long tDelay;
    if( getValue( this ) == 2 )
    {
        tDelay = getValue( HMI__STMSGT_CCGW_Disp_Rq3_AR );
        if( tDelay > 0)    
            setTimer( _tCCGW_Disp_Rq3_AR, tDelay );
        else
            putValue( HMI__STMSG_CCGW_Disp_Rq3_AR, 0 );
    }
}

on envVar HMI__STMSG_PO_CCGW_Disp_Rq3_AR
{
    if( getValue( this ) )
        openPanel("CCGW_Disp_Rq3_AR");
}


on EnvVar HMI_SmartCharge_Stat
{
    _mCCGW_Disp_Rq3_AR.SmartCharge_Stat.phys = getValue(this);
    _CCGW_Disp_Rq3_AR_SpontanFlag = 1;
}

on EnvVar HMI_StWhlHeat_Actv_Stat_IC
{
    _mCCGW_Disp_Rq3_AR.StWhlHeat_Actv_Stat_IC.phys = getValue(this);
    _CCGW_Disp_Rq3_AR_SpontanFlag = 1;
}

on EnvVar HMI_StWhlHeat_Coupling_Stat_IC
{
    _mCCGW_Disp_Rq3_AR.StWhlHeat_Coupling_Stat_IC.phys = getValue(this);
    _CCGW_Disp_Rq3_AR_SpontanFlag = 1;
}

on EnvVar HMI_WeekDepTm_NextDepTm_Hour
{
    _mCCGW_Disp_Rq3_AR.WeekDepTm_NextDepTm_Hour.phys = getValue(this);
    _CCGW_Disp_Rq3_AR_SpontanFlag = 1;
}

on EnvVar HMI_WeekDepTm_NextDepTm_Minute
{
    _mCCGW_Disp_Rq3_AR.WeekDepTm_NextDepTm_Minute.phys = getValue(this);
    _CCGW_Disp_Rq3_AR_SpontanFlag = 1;
}

on EnvVar HMI_WeekDepTm_NextDepTm_Weekday
{
    _mCCGW_Disp_Rq3_AR.WeekDepTm_NextDepTm_Weekday.phys = getValue(this);
    _CCGW_Disp_Rq3_AR_SpontanFlag = 1;
}

void CC_Rq_ActvComf_AR_Activity(int active)
{
    if( active)
    {
        if( _CC_Rq_ActvComf_AR_SigActivity == 0 )
            _CC_Rq_ActvComf_AR_Cnt = 1;
        _CC_Rq_ActvComf_AR_SigActivity++;
    }
    else
    {
        _CC_Rq_ActvComf_AR_SigActivity--;
    }
}

int CC_Rq_ActvComf_AR_Change(int lastValue, int sigValue, int inActValue)
{
    bActiveHelper = (sigValue != inActValue);
      if( !lastValue && bActiveHelper)
        CC_Rq_ActvComf_AR_Activity( 1 );
      else if( lastValue && !bActiveHelper)
        CC_Rq_ActvComf_AR_Activity(0 );
    return bActiveHelper;
}

CC_Rq_ActvComf_AR_check_output()
{
      if( !getValue( HMI__STMSG_CC_Rq_ActvComf_AR ) )
    {
        // Botschaft CC_Rq_ActvComf_AR ID: 205 --- Sendeart 2 cyclicIfActiveX --- 
        if( _CC_Rq_ActvComf_AR_SigActivity )
            _CC_Rq_ActvComf_AR_Cnt--;
        if( _CC_Rq_ActvComf_AR_Cnt < 1 )
        {
            CC_Rq_ActvComf_AR_output(); // Zyklus abgelaufen, Nachricht senden
            _CC_Rq_ActvComf_AR_Cnt = _CC_Rq_ActvComf_AR_CycleCount;
        }
    }
}

CC_Rq_ActvComf_AR_init()
{   /* Botschaft CC_Rq_ActvComf_AR ID: 205 --- Sendeart 2 cyclicIfActive --- 
BA_ "ApplMessage" BO_ 205 0;
BA_ "NmAsrMessage" BO_ 205 0;
BA_ "GenMsgMinAcceptLength" BO_ 205 1;
BA_ "GenMsgILSupport" BO_ 205 1;
BA_ "DiagState" BO_ 205 0;
BA_ "DiagRequest" BO_ 205 0;
BA_ "DiagResponse" BO_ 205 0;
BA_ "GenMsgStartValue" BO_ 205 "0";
BA_ "GenMsgStartDelayTime" BO_ 205 0;
BA_ "GenMsgDelayTime" BO_ 205 5;
BA_ "GenMsgCycleTime" BO_ 205 0;
BA_ "GenMsgCycleTimeActive" BO_ 205 20;
BA_ "GenMsgSendType" BO_ 205 2;
    */
    _CC_Rq_ActvComf_AR_Timebase =      c_tDBKomTimer_20ms;
    _CC_Rq_ActvComf_AR_CycleCount =    20 / _CC_Rq_ActvComf_AR_Timebase;
    _CC_Rq_ActvComf_AR_StartDelay =     0 / _CC_Rq_ActvComf_AR_Timebase;
    _CC_Rq_ActvComf_AR_Cnt = 0;
    _CC_Rq_ActvComf_AR_Active = 0;
    _CC_Rq_ActvComf_AR_SigActivity = 0;

//  putValue( HMI__STMSGSD_CC_Rq_ActvComf_AR, _CC_Rq_ActvComf_AR_StartDelay * _CC_Rq_ActvComf_AR_Timebase );

    _mCC_Rq_ActvComf_AR.CC_ActvComf_Rq.phys     = getValue( HMI_CC_ActvComf_Rq );                 _CC_Rq_ActvComf_AR_CC_ActvComf_Rq_LastState = CC_Rq_ActvComf_AR_Change( _CC_Rq_ActvComf_AR_CC_ActvComf_Rq_LastState, _mCC_Rq_ActvComf_AR.CC_ActvComf_Rq, 0 );
    _mCC_Rq_ActvComf_AR.CC_ActvComf_Tgl.phys  = getValue( HMI_CC_ActvComf_Tgl );
}

CC_Rq_ActvComf_AR_output()
{
    output( _mCC_Rq_ActvComf_AR );
}

CC_Rq_ActvComf_AR_saveEnvVars( dword hFile )
{
    filePutString("\n// Knoten EIS: CC_Rq_ActvComf_AR\n", 31, hFile );
    snprintf( buffer, elcount( buffer ), "0.0000 HMI__STMSG_CC_Rq_ActvComf_AR := %X\n", getValue( HMI__STMSG_CC_Rq_ActvComf_AR ) );    filePutString( buffer, elcount( buffer ), hFile );
    snprintf( buffer, elcount( buffer ), "0.0000 HMI__STMSGT_CC_Rq_ActvComf_AR := %X\n", getValue( HMI__STMSGT_CC_Rq_ActvComf_AR ) );    filePutString( buffer, elcount( buffer ), hFile );
    snprintf( buffer, elcount( buffer ), "0.0000 HMI_CC_ActvComf_Rq := %X\n", getValue( HMI_CC_ActvComf_Rq ) );    filePutString( buffer, elcount( buffer ), hFile );
    snprintf( buffer, elcount( buffer ), "0.0000 HMI_CC_ActvComf_Tgl := %X\n", getValue( HMI_CC_ActvComf_Tgl ) );    filePutString( buffer, elcount( buffer ), hFile );
}

on timer _tCC_Rq_ActvComf_AR
{
    putValue( HMI__STMSG_CC_Rq_ActvComf_AR, 0 );
}

on EnvVar HMI__STMSG_CC_Rq_ActvComf_AR
{
    long tDelay;
    if( getValue( this ) == 2 )
    {
        tDelay = getValue( HMI__STMSGT_CC_Rq_ActvComf_AR );
        if( tDelay > 0)    
            setTimer( _tCC_Rq_ActvComf_AR, tDelay );
        else
            putValue( HMI__STMSG_CC_Rq_ActvComf_AR, 0 );
    }
}

on envVar HMI__STMSG_PO_CC_Rq_ActvComf_AR
{
    if( getValue( this ) )
        openPanel("CC_Rq_ActvComf_AR");
}

on EnvVar HMI_CC_ActvComf_Rq
{
    _mCC_Rq_ActvComf_AR.CC_ActvComf_Rq.phys = getValue(this);
    _CC_Rq_ActvComf_AR_CC_ActvComf_Rq_LastState = CC_Rq_ActvComf_AR_Change(_CC_Rq_ActvComf_AR_CC_ActvComf_Rq_LastState, _mCC_Rq_ActvComf_AR.CC_ActvComf_Rq, 0 );
}

on EnvVar HMI_CC_ActvComf_Tgl
{
    _mCC_Rq_ActvComf_AR.CC_ActvComf_Tgl.phys = getValue(this);
}

COMM_TGW_EIS_AR_check_output()
{
    if( !getValue( HMI__STMSG_COMM_TGW_EIS_AR ) )
    {
    //  message   COMM_TGW_EIS_AR ID: 187 --- Sendeart 1 spontanX --- 
        if( _COMM_TGW_EIS_AR_SpontanFlag )
        {
            COMM_TGW_EIS_AR_output(); // Nachricht wg. request ausgeben
            _COMM_TGW_EIS_AR_SpontanFlag = 0;
        }
    }
}

COMM_TGW_EIS_AR_getValue()
{
    _mCOMM_TGW_EIS_AR.byte( 0 ) = getValue( HMI_COMM_TGW_EIS_Data1 );
    _mCOMM_TGW_EIS_AR.byte( 1 ) = getValue( HMI_COMM_TGW_EIS_Data2 );
    _mCOMM_TGW_EIS_AR.byte( 2 ) = getValue( HMI_COMM_TGW_EIS_Data3 );
    _mCOMM_TGW_EIS_AR.byte( 3 ) = getValue( HMI_COMM_TGW_EIS_Data4 );
    _mCOMM_TGW_EIS_AR.byte( 4 ) = getValue( HMI_COMM_TGW_EIS_Data5 );
    _mCOMM_TGW_EIS_AR.byte( 5 ) = getValue( HMI_COMM_TGW_EIS_Data7 );
    _mCOMM_TGW_EIS_AR.byte( 6 ) = getValue( HMI_COMM_TGW_EIS_Data7 );
    _mCOMM_TGW_EIS_AR.byte( 7 ) = getValue( HMI_COMM_TGW_EIS_Data8 );
}

COMM_TGW_EIS_AR_init()
{   /* Botschaft COMM_TGW_EIS_AR ID: 187 --- Sendeart 1 spontanX --- 
BA_ "ApplMessage" BO_ 187 0;
BA_ "NmAsrMessage" BO_ 187 0;
BA_ "GenMsgMinAcceptLength" BO_ 187 8;
BA_ "GenMsgILSupport" BO_ 187 1;
BA_ "DiagState" BO_ 187 0;
BA_ "DiagRequest" BO_ 187 0;
BA_ "DiagResponse" BO_ 187 0;
BA_ "GenMsgStartValue" BO_ 187 "0";
BA_ "GenMsgDelayTime" BO_ 187 10;
BA_ "GenMsgNrOfRepetition" BO_ 187 0;
BA_ "GenMsgSendType" BO_ 187 1;
    */
    _COMM_TGW_EIS_AR_Timebase =        c_tDBKomTimer_5ms;
    _COMM_TGW_EIS_AR_SpontanFlag = 0;

    _mCOMM_TGW_EIS_AR.byte( 0 ) = getValue( HMI_COMM_TGW_EIS_Data1 );
    _mCOMM_TGW_EIS_AR.byte( 1 ) = getValue( HMI_COMM_TGW_EIS_Data2 );
    _mCOMM_TGW_EIS_AR.byte( 2 ) = getValue( HMI_COMM_TGW_EIS_Data3 );
    _mCOMM_TGW_EIS_AR.byte( 3 ) = getValue( HMI_COMM_TGW_EIS_Data4 );
    _mCOMM_TGW_EIS_AR.byte( 4 ) = getValue( HMI_COMM_TGW_EIS_Data5 );
    _mCOMM_TGW_EIS_AR.byte( 5 ) = getValue( HMI_COMM_TGW_EIS_Data6 );
    _mCOMM_TGW_EIS_AR.byte( 6 ) = getValue( HMI_COMM_TGW_EIS_Data7 );
    _mCOMM_TGW_EIS_AR.byte( 7 ) = getValue( HMI_COMM_TGW_EIS_Data8 );
}

COMM_TGW_EIS_AR_output(void)
{
    output( _mCOMM_TGW_EIS_AR );
}

COMM_TGW_EIS_AR_saveEnvVars( dword hFile )
{
    filePutString("\n// Knoten EIS: COMM_TGW_EIS_AR\n", 32, hFile );
    snprintf( buffer, elcount( buffer ), "0.0000 HMI__STMSG_COMM_TGW_EIS_AR := %X\n", getValue( HMI__STMSG_COMM_TGW_EIS_AR ) );    filePutString( buffer, elcount( buffer ), hFile );
    snprintf( buffer, elcount( buffer ), "0.0000 HMI__STMSGT_COMM_TGW_EIS_AR := %X\n", getValue( HMI__STMSGT_COMM_TGW_EIS_AR ) );    filePutString( buffer, elcount( buffer ), hFile );
    snprintf( buffer, elcount( buffer ), "0.0000 HMI_COMM_TGW_EIS_Data1 := %X\n", getValue( HMI_COMM_TGW_EIS_Data1 ) );    filePutString( buffer, elcount( buffer ), hFile );
    snprintf( buffer, elcount( buffer ), "0.0000 HMI_COMM_TGW_EIS_Data2 := %X\n", getValue( HMI_COMM_TGW_EIS_Data2 ) );    filePutString( buffer, elcount( buffer ), hFile );
    snprintf( buffer, elcount( buffer ), "0.0000 HMI_COMM_TGW_EIS_Data3 := %X\n", getValue( HMI_COMM_TGW_EIS_Data3 ) );    filePutString( buffer, elcount( buffer ), hFile );
    snprintf( buffer, elcount( buffer ), "0.0000 HMI_COMM_TGW_EIS_Data4 := %X\n", getValue( HMI_COMM_TGW_EIS_Data4 ) );    filePutString( buffer, elcount( buffer ), hFile );
    snprintf( buffer, elcount( buffer ), "0.0000 HMI_COMM_TGW_EIS_Data5 := %X\n", getValue( HMI_COMM_TGW_EIS_Data5 ) );    filePutString( buffer, elcount( buffer ), hFile );
    snprintf( buffer, elcount( buffer ), "0.0000 HMI_COMM_TGW_EIS_Data6 := %X\n", getValue( HMI_COMM_TGW_EIS_Data6 ) );    filePutString( buffer, elcount( buffer ), hFile );
    snprintf( buffer, elcount( buffer ), "0.0000 HMI_COMM_TGW_EIS_Data7 := %X\n", getValue( HMI_COMM_TGW_EIS_Data7 ) );    filePutString( buffer, elcount( buffer ), hFile );
    snprintf( buffer, elcount( buffer ), "0.0000 HMI_COMM_TGW_EIS_Data8 := %X\n", getValue( HMI_COMM_TGW_EIS_Data8 ) );    filePutString( buffer, elcount( buffer ), hFile );
}

on timer _tCOMM_TGW_EIS_AR
{
    putValue( HMI__STMSG_COMM_TGW_EIS_AR, 0 );
}

on EnvVar HMI__STMSG_COMM_TGW_EIS_AR
{
    long tDelay;
    if( getValue( this ) == 2 )
    {
        tDelay = getValue( HMI__STMSGT_COMM_TGW_EIS_AR );
        if( tDelay > 0)    
            setTimer( _tCOMM_TGW_EIS_AR, tDelay );
        else
            putValue( HMI__STMSG_COMM_TGW_EIS_AR, 0 );
    }
}

on EnvVar HMI_COMM_TGW_EIS_AR_Send
{
    if( getValue( this ) )
    {
        COMM_TGW_EIS_AR_getValue();
    }
}

COMM_WMI_EIS_AR_check_output()
{
    if( !getValue( HMI__STMSG_COMM_WMI_EIS_AR ) )
    {
        // Botschaft COMM_WMI_EIS_AR ID: 123 --- Sendeart 1 spontanX --- 
        if( _COMM_WMI_EIS_AR_SpontanFlag)
        {
            // Nachricht wg. spontaner Änderung ausgeben
            COMM_WMI_EIS_AR_output();
            // Spontan-Flag zurücksetzen
            _COMM_WMI_EIS_AR_SpontanFlag = 0;
        }
    }
}

void COMM_WMI_EIS_AR_getValue(void)
{
    _mCOMM_WMI_EIS_AR.COMM_WMI_EIS_Data1 = getValue( HMI_COMM_WMI_EIS_Data1 );
    _mCOMM_WMI_EIS_AR.COMM_WMI_EIS_Data2 = getValue( HMI_COMM_WMI_EIS_Data2 );
    _mCOMM_WMI_EIS_AR.COMM_WMI_EIS_Data3 = getValue( HMI_COMM_WMI_EIS_Data3 );
    _mCOMM_WMI_EIS_AR.COMM_WMI_EIS_Data4 = getValue( HMI_COMM_WMI_EIS_Data4 );
    _mCOMM_WMI_EIS_AR.COMM_WMI_EIS_Data5 = getValue( HMI_COMM_WMI_EIS_Data5 );
    _mCOMM_WMI_EIS_AR.COMM_WMI_EIS_Data6 = getValue( HMI_COMM_WMI_EIS_Data6 );
    _mCOMM_WMI_EIS_AR.COMM_WMI_EIS_Data7 = getValue( HMI_COMM_WMI_EIS_Data7 );
    _mCOMM_WMI_EIS_AR.COMM_WMI_EIS_Data8 = getValue( HMI_COMM_WMI_EIS_Data8 );
}

COMM_WMI_EIS_AR_init()
{   /* Botschaft COMM_WMI_EIS_AR ID: 123 --- Sendeart SpontanX --- 
BA_ "ApplMessage" BO_ 123 0;
BA_ "NmAsrMessage" BO_ 123 0;
BA_ "GenMsgMinAcceptLength" BO_ 123 8;
BA_ "GenMsgILSupport" BO_ 123 1;
BA_ "DiagState" BO_ 123 0;
BA_ "DiagRequest" BO_ 123 0;
BA_ "DiagResponse" BO_ 123 0;
BA_ "GenMsgStartValue" BO_ 123 "0";
BA_ "GenMsgDelayTime" BO_ 123 10;
BA_ "GenMsgNrOfRepetitions" BO_ 123 0;
BA_ "GenMsgSendType" BO_ 123 1;
    */
    _COMM_WMI_EIS_AR_Timebase =         c_tDBKomTimer_5ms ;
    _COMM_WMI_EIS_AR_SpontanFlag = 0;

    COMM_WMI_EIS_AR_getValue();
}

COMM_WMI_EIS_AR_output()
{
    output( _mCOMM_WMI_EIS_AR );
}

COMM_WMI_EIS_AR_saveEnvVars( dword hFile )
{
    filePutString("\n// Knoten TGW: COMM_WMI_EIS_AR\n", 23, hFile);
    snprintf( buffer, elcount(buffer), "0.0000 HMI__STMSG_COMM_WMI_EIS_AR := %X\n", getValue( HMI__STMSG_COMM_WMI_EIS_AR ));     filePutString( buffer, elcount(buffer), hFile);
    snprintf( buffer, elcount(buffer), "0.0000 HMI__STMSGT_COMM_WMI_EIS_AR := %X\n", getValue( HMI__STMSGT_COMM_WMI_EIS_AR ));   filePutString( buffer, elcount(buffer), hFile);
    snprintf( buffer, elcount(buffer), "0.0000 HMI_TP_TGW_IC_Tel_0 := %X\n", getValue( HMI_TP_TGW_IC_Tel_0 ) );    filePutString( buffer, elcount(buffer), hFile);
    snprintf( buffer, elcount(buffer), "0.0000 HMI_TP_TGW_IC_Tel_1 := %X\n", getValue( HMI_TP_TGW_IC_Tel_1 ) );    filePutString( buffer, elcount(buffer), hFile);
    snprintf( buffer, elcount(buffer), "0.0000 HMI_TP_TGW_IC_Tel_2 := %X\n", getValue( HMI_TP_TGW_IC_Tel_2 ) );    filePutString( buffer, elcount(buffer), hFile);
    snprintf( buffer, elcount(buffer), "0.0000 HMI_TP_TGW_IC_Tel_3 := %X\n", getValue( HMI_TP_TGW_IC_Tel_3 ) );    filePutString( buffer, elcount(buffer), hFile);
    snprintf( buffer, elcount(buffer), "0.0000 HMI_TP_TGW_IC_Tel_4 := %X\n", getValue( HMI_TP_TGW_IC_Tel_4 ) );    filePutString( buffer, elcount(buffer), hFile);
    snprintf( buffer, elcount(buffer), "0.0000 HMI_TP_TGW_IC_Tel_5 := %X\n", getValue( HMI_TP_TGW_IC_Tel_5 ) );    filePutString( buffer, elcount(buffer), hFile);
    snprintf( buffer, elcount(buffer), "0.0000 HMI_TP_TGW_IC_Tel_6 := %X\n", getValue( HMI_TP_TGW_IC_Tel_6 ) );    filePutString( buffer, elcount(buffer), hFile);
    snprintf( buffer, elcount(buffer), "0.0000 HMI_TP_TGW_IC_Tel_7 := %X\n", getValue( HMI_TP_TGW_IC_Tel_7 ) );    filePutString( buffer, elcount(buffer), hFile);
}

on timer _tCOMM_WMI_EIS_AR
{
    putValue( HMI__STMSG_COMM_WMI_EIS_AR, 0 );
}

on EnvVar HMI__STMSG_COMM_WMI_EIS_AR
{
    long tDelay;
    if( getValue( this ) == 2 )
    {
        tDelay = getValue( HMI__STMSGT_COMM_WMI_EIS_AR );
        if( tDelay > 0 )    
            setTimer( _tCOMM_WMI_EIS_AR, tDelay );
        else
            putValue( HMI__STMSG_COMM_WMI_EIS_AR, 0 );
    }
}

on EnvVar HMI_COMM_EIS_WMI_AR_Send
{
    COMM_WMI_EIS_AR_getValue();
    _COMM_WMI_EIS_AR_SpontanFlag = 1;
}

on envVar HMI__STMSG_PO_COMM_WMI_EIS_AR
{
    if( getValue( this ) )
        openPanel("COMM_WMI_EIS_AR");
}

Config_HU_AR_check_output()
{
    if( !getValue( HMI__STMSG_Config_HU_AR ))
    {
        // Botschaft Config_HU_AR ID: 1215 --- Sendeart cyclicAndSpontanWithDelay --- 
        _Config_HU_AR_Cnt--;
        if( _Config_HU_AR_Cnt < 1 )
        {
            // Nachricht wg. abgelaufenem Zyklus ausgeben
            output( _mConfig_HU_AR );
            _Config_HU_AR_Cnt = _Config_HU_AR_CycleCount; // Zyklus-Zähler zurücksetzen
             _Config_HU_AR_SpontanFlag = 0; // Spontan-Flag zurücksetzen
        }
        else if( _Config_HU_AR_SpontanFlag)
        {
            // Nachricht wg. spontaner Änderung ausgeben
            output( _mConfig_HU_AR );
             _Config_HU_AR_SpontanFlag = 0; // Spontan-Flag zurücksetzen
        }
    }
}

Config_HU_AR_init()
{   /* Botschaft Config_HU_AR ID: 1215 --- Sendeart cyclicAndSpontanWithDelay --- 
BA_ "ApplMessage" BO_ 1215 0;
BA_ "NmAsrMessage" BO_ 1215 0;
BA_ "GenMsgMinAcceptLength" BO_ 1215 8;
BA_ "GenMsgILSupport" BO_ 1215 1;
BA_ "DiagState" BO_ 1215 0;
BA_ "DiagRequest" BO_ 1215 0;
BA_ "DiagResponse" BO_ 1215 0;
BA_ "GenMsgStartValue" BO_ 1215 "0";
BA_ "GenMsgStartDelayTime" BO_ 1215 15;
BA_ "GenMsgDelayTime" BO_ 1215 5;
BA_ "GenMsgNrOfRepetitions" BO_ 1215 0;
BA_ "GenMsgCycleTime" BO_ 1215 1000;
BA_ "GenMsgSendType" BO_ 1215 5;
    */
    _Config_HU_AR_Timebase =               c_tDBKomTimer_20ms;
    _Config_HU_AR_CycleCount =           1000 / _Config_HU_AR_Timebase;
    _Config_HU_AR_StartDelay =             15 / _Config_HU_AR_Timebase;
    _Config_HU_AR_Cnt = _Config_HU_AR_StartDelay;
    _Config_HU_AR_SpontanFlag = 0;

    putValue( HMI__STMSGSD_Config_HU_AR, _Config_HU_AR_StartDelay * _Config_HU_AR_Timebase );

    _mConfig_HU_AR.AutoDrLk_Rq_HU.phys = getValue( HMI_AutoDrLk_Rq_HU );
    _mConfig_HU_AR.CLkS_Akust_Lk_Rq_Enbl_HU.phys = getValue( HMI_CLkS_Akust_Lk_Rq_Enbl_HU );
    _mConfig_HU_AR.CoronaLgt_Rq.phys = getValue( HMI_CoronaLgt_Rq );
    _mConfig_HU_AR.DL_Lim_Rq.phys = getValue( HMI_DL_Lim_Rq );
    _mConfig_HU_AR.EEH_SeatAdj_Rq.phys = getValue( HMI_EEH_SeatAdj_Rq );
    _mConfig_HU_AR.EEH_StW_Adj_Rq.phys = getValue( HMI_EEH_StW_Adj_Rq );
    _mConfig_HU_AR.MBContact_Rq.phys = getValue( HMI_MBContact_Rq );
    _mConfig_HU_AR.Mirr_Privacy_Rq.phys = getValue( HMI_Mirr_Privacy_Rq );
    _mConfig_HU_AR.MirrFldPk_Rq.phys = getValue( HMI_MirrFldPk_Rq );
    _mConfig_HU_AR.NS_IllDur_Rq.phys = getValue( HMI_NS_IllDur_Rq );
    _mConfig_HU_AR.SEAT_D_Ht_Blnc_Rq.phys = getValue( HMI_SEAT_D_Ht_Blnc_Rq );
    _mConfig_HU_AR.SEAT_P_Ht_Blnc_Rq.phys = getValue( HMI_SEAT_P_Ht_Blnc_Rq );
    _mConfig_HU_AR.SEAT_RL_Ht_Blnc_Rq.phys = getValue( HMI_SEAT_RL_Ht_Blnc_Rq );
    _mConfig_HU_AR.SEAT_RR_Ht_Blnc_Rq.phys = getValue( HMI_SEAT_RR_Ht_Blnc_Rq );
    _mConfig_HU_AR.SurrIll_Rq.phys = getValue( HMI_SurrIll_Rq );
    _mConfig_HU_AR.VTA_ITS_DsablSw_Stat.phys = getValue( HMI_VTA_ITS_DsablSw_Stat );
    _mConfig_HU_AR.VTA_TPS_DsablSw_Stat.phys = getValue( HMI_VTA_TPS_DsablSw_Stat );
}

Config_HU_AR_saveEnvVars( dword hFile )
{
    filePutString("\n// Knoten TGW: Config_HU_AR\n", 26, hFile);
    snprintf( buffer, elcount(buffer), "0.0000 HMI__STMSG_Config_HU_AR := %X\n", getValue( HMI__STMSG_Config_HU_AR ) );        filePutString( buffer, elcount(buffer), hFile);
    snprintf( buffer, elcount(buffer), "0.0000 HMI__STMSGT_Config_HU_AR := %X\n", getValue( HMI__STMSGT_Config_HU_AR ) );        filePutString( buffer, elcount(buffer), hFile);
    snprintf( buffer, elcount(buffer), "0.0000 HMI_AutoDrLk_Rq_HU := %X\n", getValue( HMI_AutoDrLk_Rq_HU ) );        filePutString( buffer, elcount(buffer), hFile);
    snprintf( buffer, elcount(buffer), "0.0000 HMI_CLkS_Akust_Lk_Rq_Enbl_HU := %X\n", getValue( HMI_CLkS_Akust_Lk_Rq_Enbl_HU ) );        filePutString( buffer, elcount(buffer), hFile);
    snprintf( buffer, elcount(buffer), "0.0000 HMI_CoronaLgt_Rq := %X\n", getValue( HMI_CoronaLgt_Rq ) );        filePutString( buffer, elcount(buffer), hFile);
    snprintf( buffer, elcount(buffer), "0.0000 HMI_DL_Lim_Rq := %X\n", getValue( HMI_DL_Lim_Rq ) );        filePutString( buffer, elcount(buffer), hFile);
    snprintf( buffer, elcount(buffer), "0.0000 HMI_EEH_SeatAdj_Rq := %X\n", getValue( HMI_EEH_SeatAdj_Rq ) );        filePutString( buffer, elcount(buffer), hFile);
    snprintf( buffer, elcount(buffer), "0.0000 HMI_EEH_StW_Adj_Rq := %X\n", getValue( HMI_EEH_StW_Adj_Rq ) );        filePutString( buffer, elcount(buffer), hFile);
    snprintf( buffer, elcount(buffer), "0.0000 HMI_MBContact_Rq := %X\n", getValue( HMI_MBContact_Rq ) );        filePutString( buffer, elcount(buffer), hFile);
    snprintf( buffer, elcount(buffer), "0.0000 HMI_Mirr_Privacy_Rq := %X\n", getValue( HMI_Mirr_Privacy_Rq ) );        filePutString( buffer, elcount(buffer), hFile);
    snprintf( buffer, elcount(buffer), "0.0000 HMI_MirrFldPk_Rq := %X\n", getValue( HMI_MirrFldPk_Rq ) );        filePutString( buffer, elcount(buffer), hFile);
    snprintf( buffer, elcount(buffer), "0.0000 HMI_NS_IllDur_Rq := %X\n", getValue( HMI_NS_IllDur_Rq ) );        filePutString( buffer, elcount(buffer), hFile);
    snprintf( buffer, elcount(buffer), "0.0000 HMI_SEAT_D_Ht_Blnc_Rq := %X\n", getValue( HMI_SEAT_D_Ht_Blnc_Rq ) );        filePutString( buffer, elcount(buffer), hFile);
    snprintf( buffer, elcount(buffer), "0.0000 HMI_SEAT_P_Ht_Blnc_Rq := %X\n", getValue( HMI_SEAT_P_Ht_Blnc_Rq ) );        filePutString( buffer, elcount(buffer), hFile);
    snprintf( buffer, elcount(buffer), "0.0000 HMI_SEAT_RL_Ht_Blnc_Rq := %X\n", getValue( HMI_SEAT_RL_Ht_Blnc_Rq ) );        filePutString( buffer, elcount(buffer), hFile);
    snprintf( buffer, elcount(buffer), "0.0000 HMI_SEAT_RR_Ht_Blnc_Rq := %X\n", getValue( HMI_SEAT_RR_Ht_Blnc_Rq ) );        filePutString( buffer, elcount(buffer), hFile);
    snprintf( buffer, elcount(buffer), "0.0000 HMI_SurrIll_Rq := %X\n", getValue( HMI_SurrIll_Rq ) );        filePutString( buffer, elcount(buffer), hFile);
    snprintf( buffer, elcount(buffer), "0.0000 HMI_VTA_ITS_DsablSw_Stat := %X\n", getValue( HMI_VTA_ITS_DsablSw_Stat ) );        filePutString( buffer, elcount(buffer), hFile);
    snprintf( buffer, elcount(buffer), "0.0000 HMI_VTA_TPS_DsablSw_Stat := %X\n", getValue( HMI_VTA_TPS_DsablSw_Stat ) );        filePutString( buffer, elcount(buffer), hFile);
}

on timer _tConfig_HU_AR
{
    putValue( HMI__STMSG_Config_HU_AR, 0 );
}

on EnvVar HMI__STMSG_Config_HU_AR
{
    long tDelay;
    if( getValue( this ) == 2 )
    {
        tDelay = getValue( HMI__STMSGT_Config_HU_AR );
        if( tDelay > 0 )    
            setTimer( _tConfig_HU_AR, tDelay );
        else
            putValue( HMI__STMSG_Config_HU_AR, 0 );
    }
}

on envVar HMI__STMSG_PO_Config_HU_AR
{
    if( getValue( this ) )
        openPanel("Config_HU_AR");
}

on EnvVar HMI_AutoDrLk_Rq_HU
{
    _mConfig_HU_AR.AutoDrLk_Rq_HU.phys = getValue(this);
    _Config_HU_AR_SpontanFlag = 1;
}

on EnvVar HMI_CLkS_Akust_Lk_Rq_Enbl_HU
{
    _mConfig_HU_AR.CLkS_Akust_Lk_Rq_Enbl_HU.phys = getValue(this);
    _Config_HU_AR_SpontanFlag = 1;
}

on EnvVar HMI_CoronaLgt_Rq
{
    _mConfig_HU_AR.CoronaLgt_Rq.phys = getValue(this);
    _Config_HU_AR_SpontanFlag = 1;
}

on EnvVar HMI_DL_Lim_Rq
{
    _mConfig_HU_AR.DL_Lim_Rq.phys = getValue(this);
    _Config_HU_AR_SpontanFlag = 1;
}

on EnvVar HMI_EEH_SeatAdj_Rq
{
    _mConfig_HU_AR.EEH_SeatAdj_Rq.phys = getValue(this);
    _Config_HU_AR_SpontanFlag = 1;
}

on EnvVar HMI_EEH_StW_Adj_Rq
{
    _mConfig_HU_AR.EEH_StW_Adj_Rq.phys = getValue(this);
    _Config_HU_AR_SpontanFlag = 1;
}

on EnvVar HMI_MBContact_Rq
{
    _mConfig_HU_AR.MBContact_Rq.phys = getValue(this);
    _Config_HU_AR_SpontanFlag = 1;
}

on EnvVar HMI_Mirr_Privacy_Rq
{
    _mConfig_HU_AR.Mirr_Privacy_Rq.phys = getValue(this);
    _Config_HU_AR_SpontanFlag = 1;
}

on EnvVar HMI_MirrFldPk_Rq
{
    _mConfig_HU_AR.MirrFldPk_Rq.phys = getValue(this);
    _Config_HU_AR_SpontanFlag = 1;
}

on EnvVar HMI_NS_IllDur_Rq
{
    _mConfig_HU_AR.NS_IllDur_Rq.phys = getValue(this);
    _Config_HU_AR_SpontanFlag = 1;
}

on EnvVar HMI_SEAT_D_Ht_Blnc_Rq
{
    _mConfig_HU_AR.SEAT_D_Ht_Blnc_Rq.phys = getValue(this);
    _Config_HU_AR_SpontanFlag = 1;
}

on EnvVar HMI_SEAT_P_Ht_Blnc_Rq
{
    _mConfig_HU_AR.SEAT_P_Ht_Blnc_Rq.phys = getValue(this);
    _Config_HU_AR_SpontanFlag = 1;
}

on EnvVar HMI_SEAT_RL_Ht_Blnc_Rq
{
    _mConfig_HU_AR.SEAT_RL_Ht_Blnc_Rq.phys = getValue(this);
    _Config_HU_AR_SpontanFlag = 1;
}

on EnvVar HMI_SEAT_RR_Ht_Blnc_Rq
{
    _mConfig_HU_AR.SEAT_RR_Ht_Blnc_Rq.phys = getValue(this);
    _Config_HU_AR_SpontanFlag = 1;
}

on EnvVar HMI_SurrIll_Rq
{
    _mConfig_HU_AR.SurrIll_Rq.phys = getValue(this);
    _Config_HU_AR_SpontanFlag = 1;
}

on EnvVar HMI_VTA_ITS_DsablSw_Stat
{
    _mConfig_HU_AR.VTA_ITS_DsablSw_Stat.phys = getValue(this);
    _Config_HU_AR_SpontanFlag = 1;
}

on EnvVar HMI_VTA_TPS_DsablSw_Stat
{
    _mConfig_HU_AR.VTA_TPS_DsablSw_Stat.phys = getValue(this);
    _Config_HU_AR_SpontanFlag = 1;
}

//Config_HU2_AR_check_output()
//{
//    if( !getValue( HMI__STMSG_Config_HU2_AR ))
//    {
//        // Botschaft Config_HU2_AR ID: 1123 --- Sendeart cyclicAndSpontanWithDelay --- 
//        _Config_HU2_AR_Cnt--;
//        if( _Config_HU2_AR_Cnt < 1 )
//        {
//            // Nachricht wg. abgelaufenem Zyklus ausgeben
//            output( _mConfig_HU2_AR );
//            _Config_HU2_AR_Cnt = _Config_HU2_AR_CycleCount; // Zyklus-Zähler zurücksetzen
//             _Config_HU2_AR_SpontanFlag = 0; // Spontan-Flag zurücksetzen
//        }
//        else if( _Config_HU2_AR_SpontanFlag)
//        {
//            // Nachricht wg. spontaner Änderung ausgeben
//            output( _mConfig_HU2_AR );
//             _Config_HU2_AR_SpontanFlag = 0; // Spontan-Flag zurücksetzen
//        }
//    }
//}
//
//Config_HU2_AR_init()
//{   /* Botschaft Config_HU2_AR ID: 1123 --- Sendeart cyclicAndSpontanWithDelay --- 
//BA_ "ApplMessage" BO_ 1123 0;
//BA_ "NmAsrMessage" BO_ 1123 0;
//BA_ "GenMsgMinAcceptLength" BO_ 1123 8;
//BA_ "GenMsgILSupport" BO_ 1123 1;
//BA_ "DiagState" BO_ 1123 0;
//BA_ "DiagRequest" BO_ 1123 0;
//BA_ "DiagResponse" BO_ 1123 0;
//BA_ "GenMsgStartValue" BO_ 1123 "0";
//BA_ "GenMsgStartDelayTime" BO_ 1123 155;
//BA_ "GenMsgDelayTime" BO_ 1123 50;
//BA_ "GenMsgNrOfRepetitions" BO_ 1123 0;
//BA_ "GenMsgCycleTime" BO_ 1123 1000;
//BA_ "GenMsgSendType" BO_ 1123 5;
//    */
//    _Config_HU2_AR_Timebase =                   c_tDBKomTimer_20ms;
//    _Config_HU2_AR_CycleCount =               1000 / _Config_HU2_AR_Timebase;
//    _Config_HU2_AR_StartDelay =                155 / _Config_HU2_AR_Timebase;
//    _Config_HU2_AR_MinDelay =                   50 / _Config_HU2_AR_Timebase;
//    _Config_HU2_AR_Cnt = _Config_HU2_AR_StartDelay;
//    _Config_HU2_AR_SpontanFlag = 0;
//    _Config_HU2_AR_DelayCnt = 0;
//
//    putValue( HMI__STMSGSD_Config_HU2_AR, _Config_HU2_AR_StartDelay * _Config_HU2_AR_Timebase);
//
//    _mConfig_HU2_AR.BltSlckDec_Md_Rq_HU.phys = getValue( HMI_BltSlckDec_Md_Rq_HU );
//    _mConfig_HU2_AR.DRLt_On_Rq_HU.phys = getValue( HMI_DRLt_On_Rq_HU );
//    _mConfig_HU2_AR.IL_AgDur_Rq.phys = getValue( HMI_IL_AgDur_Rq );
//    _mConfig_HU2_AR.PN14_Hibern_Md_Rq_HU.phys = getValue( HMI_PN14_Hibern_Md_Rq_HU );
//    _mConfig_HU2_AR.RoadsdCallSwLED_Rq_TGW.phys = getValue( HMI_RoadsdCallSwLED_Rq_TGW );
//    _mConfig_HU2_AR.ServCallSwLED_Rq_TGW.phys = getValue( HMI_ServCallSwLED_Rq_TGW );
//    _mConfig_HU2_AR.SOS_CallSwLED_Rq_TGW.phys = getValue( HMI_SOS_CallSwLED_Rq_TGW );
//    _mConfig_HU2_AR.TaxiRoofLmpMd_Rq_HU.phys = getValue( HMI_TaxiRoofLmpMd_Rq_HU );  
//    _mConfig_HU2_AR.BltLineIll_Rq.phys = getValue( HMI_BltLineIll_Rq );
//    _mConfig_HU2_AR.EmbIll_Rq.phys = getValue( HMI_EmbIll_Rq );
//    _mConfig_HU2_AR.Global_FactReset_Rq.phys = getValue( HMI_Global_FactReset_Rq );
//    _mConfig_HU2_AR.NightLineIll_Rq.phys = getValue( HMI_NightLineIll_Rq );
//    _mConfig_HU2_AR.RunBrdIll_Rq.phys = getValue( HMI_RunBrdIll_Rq );
//}
//
//Config_HU2_AR_saveEnvVars( dword hFile )
//{
//    filePutString("\n// Knoten TGW: Config_HU2_AR\n", 27, hFile);
//    snprintf( buffer, elcount(buffer), "0.0000 HMI__STMSG_Config_HU2_AR := %X\n", getValue( HMI__STMSG_Config_HU2_AR ) );        filePutString( buffer, elcount(buffer), hFile);
//    snprintf( buffer, elcount(buffer), "0.0000 HMI__STMSGT_Config_HU2_AR := %X\n", getValue( HMI__STMSGT_Config_HU2_AR ) );        filePutString( buffer, elcount(buffer), hFile);
//    snprintf( buffer, elcount(buffer), "0.0000 HMI_BltSlckDec_Md_Rq_HU := %X\n", getValue( HMI_BltSlckDec_Md_Rq_HU ) );    filePutString( buffer, elcount(buffer), hFile);
//    snprintf( buffer, elcount(buffer), "0.0000 HMI_DRLt_On_Rq_HU := %X\n", getValue( HMI_DRLt_On_Rq_HU ) );    filePutString( buffer, elcount(buffer), hFile);
//    snprintf( buffer, elcount(buffer), "0.0000 HMI_IL_AgDur_Rq := %X\n", getValue( HMI_IL_AgDur_Rq ) );    filePutString( buffer, elcount(buffer), hFile);
//    snprintf( buffer, elcount(buffer), "0.0000 HMI_PN14_Hibern_Md_Rq_HU := %X\n", getValue( HMI_PN14_Hibern_Md_Rq_HU ) );    filePutString( buffer, elcount(buffer), hFile);
//    snprintf( buffer, elcount(buffer), "0.0000 HMI_RoadsdCallSwLED_Rq_TGW := %X\n", getValue( HMI_RoadsdCallSwLED_Rq_TGW ) );    filePutString( buffer, elcount(buffer), hFile);
//    snprintf( buffer, elcount(buffer), "0.0000 HMI_ServCallSwLED_Rq_TGW := %X\n", getValue( HMI_ServCallSwLED_Rq_TGW ) );    filePutString( buffer, elcount(buffer), hFile);
//    snprintf( buffer, elcount(buffer), "0.0000 HMI_SOS_CallSwLED_Rq_TGW := %X\n", getValue( HMI_SOS_CallSwLED_Rq_TGW ) );    filePutString( buffer, elcount(buffer), hFile);
//    snprintf( buffer, elcount(buffer), "0.0000 HMI_TaxiRoofLmpMd_Rq_HU := %X\n", getValue( HMI_TaxiRoofLmpMd_Rq_HU ) );    filePutString( buffer, elcount(buffer), hFile);
//    snprintf( buffer, elcount(buffer), "0.0000 HMI_BltLineIll_Rq := %X\n", getValue( HMI_BltLineIll_Rq) );    filePutString( buffer, elcount(buffer), hFile);
//    snprintf( buffer, elcount(buffer), "0.0000 HMI_EmbIll_Rq := %X\n", getValue( HMI_EmbIll_Rq ) );    filePutString( buffer, elcount(buffer), hFile);
//    snprintf( buffer, elcount(buffer), "0.0000 HMI_Global_FactReset_Rq := %X\n", getValue( HMI_Global_FactReset_Rq ) );    filePutString( buffer, elcount(buffer), hFile);
//    snprintf( buffer, elcount(buffer), "0.0000 HMI_TaxiRoofLmpMd_Rq_HU := %X\n", getValue( HMI_TaxiRoofLmpMd_Rq_HU ) );    filePutString( buffer, elcount(buffer), hFile);
//    snprintf( buffer, elcount(buffer), "0.0000 HMI_NightLineIll_Rq := %X\n", getValue( HMI_NightLineIll_Rq ) );    filePutString( buffer, elcount(buffer), hFile);
//    snprintf( buffer, elcount(buffer), "0.0000 HMI_RunBrdIll_Rq := %X\n", getValue( HMI_RunBrdIll_Rq ) );    filePutString( buffer, elcount(buffer), hFile);
//}
//
//on timer _tConfig_HU2_AR
//{
//    putValue( HMI__STMSG_Config_HU2_AR, 0 );
//}
//
//on EnvVar HMI__STMSG_Config_HU2_AR
//{
//    long tDelay;
//    if( getValue( this ) == 2 )
//    {
//        tDelay = getValue( HMI__STMSGT_Config_HU2_AR );
//        if( tDelay > 0 )    
//            setTimer( _tConfig_HU2_AR, tDelay );
//        else
//            putValue( HMI__STMSG_Config_HU2_AR, 0 );
//    }
//}
//
//on envVar HMI__STMSG_PO_Config_HU2_AR
//{
//    if( getValue( this ) )
//        openPanel("Config_HU2_AR");
//}
//
//on EnvVar HMI_DRLt_On_Rq_HU
//{
//    _mConfig_HU2_AR.DRLt_On_Rq_HU.phys = getValue(this);
//    _Config_HU2_AR_SpontanFlag = 1;
//}
//
//on EnvVar HMI_PN14_Hibern_Md_Rq_HU
//{
//    _mConfig_HU2_AR.PN14_Hibern_Md_Rq_HU.phys = getValue(this);
//    _Config_HU2_AR_SpontanFlag = 1;
//}
//
//on EnvVar HMI_TaxiRoofLmpMd_Rq_HU
//{
//    _mConfig_HU2_AR.TaxiRoofLmpMd_Rq_HU.phys = getValue(this);
//    _Config_HU2_AR_SpontanFlag = 1;
//}
//
//on EnvVar HMI_BltSlckDec_Md_Rq_HU
//{
//    _mConfig_HU2_AR.BltSlckDec_Md_Rq_HU.phys = getValue(this);
//    _Config_HU2_AR_SpontanFlag = 1;
//}
//
//on EnvVar HMI_IL_AgDur_Rq
//{
//    _mConfig_HU2_AR.IL_AgDur_Rq.phys = getValue(this);
//    _Config_HU2_AR_SpontanFlag = 1;
//}
//
//on EnvVar HMI_RoadsdCallSwLED_Rq_TGW
//{
//    _mConfig_HU2_AR.RoadsdCallSwLED_Rq_TGW.phys = getValue(this);
//    _Config_HU2_AR_SpontanFlag = 1;
//}
//
//on EnvVar HMI_ServCallSwLED_Rq_TGW
//{
//    _mConfig_HU2_AR.ServCallSwLED_Rq_TGW.phys = getValue(this);
//    _Config_HU2_AR_SpontanFlag = 1;
//}
//
//on EnvVar HMI_SOS_CallSwLED_Rq_TGW
//{
//    _mConfig_HU2_AR.SOS_CallSwLED_Rq_TGW.phys = getValue(this);
//    _Config_HU2_AR_SpontanFlag = 1;
//}
//
//on EnvVar HMI_BltLineIll_Rq
//{
//    _mConfig_HU2_AR.BltLineIll_Rq.phys = getValue(this);
//    _Config_HU2_AR_SpontanFlag = 1;
//}
//
//on EnvVar HMI_EmbIll_Rq
//{
//    _mConfig_HU2_AR.EmbIll_Rq.phys = getValue(this);
//    _Config_HU2_AR_SpontanFlag = 1;
//}
//
//on EnvVar HMI_Global_FactReset_Rq
//{
//    _mConfig_HU2_AR.Global_FactReset_Rq.phys = getValue(this);
//    _Config_HU2_AR_SpontanFlag = 1;
//}
//
//on EnvVar HMI_NightLineIll_Rq
//{
//    _mConfig_HU2_AR.NightLineIll_Rq.phys = getValue(this);
//    _Config_HU2_AR_SpontanFlag = 1;
//}
//
//on EnvVar HMI_RunBrdIll_Rq
//{
//    _mConfig_HU2_AR.RunBrdIll_Rq.phys = getValue(this);
//    _Config_HU2_AR_SpontanFlag = 1;
//}

Config_HU3_AR_check_output()
{
    if( !getValue( HMI__STMSG_Config_HU3_AR ) )
    {
        // Botschaft Config_HU3_AR --- Sendeart 5 cyclicAndSpontanWithDelay
        _Config_HU3_AR_Cnt--;
        if( _Config_HU3_AR_Cnt < 1 )
        {
            Config_HU3_AR_output(); // Nachricht wg. abgelaufenem Zyklus ausgeben
            _Config_HU3_AR_Cnt = _Config_HU3_AR_CycleCount; // Zyklus-Zähler zurücksetzen
            _Config_HU3_AR_SpontanFlag = 0; // Spontan-Flag zurücksetzen
        }
        else if( _Config_HU3_AR_SpontanFlag)
        {
            Config_HU3_AR_output(); // Nachricht wg. spontaner Änderung ausgeben
            _Config_HU3_AR_SpontanFlag = 0; // Spontan-Flag zurücksetzen
        }
    }
}

Config_HU3_AR_init()
{   /* Botschaft Config_HU3_AR ID: 1188 --- Sendeart 5 cyclicAndSpontanWithDelay --- 
BA_ "ApplMessage" BO_ 1188 0;
BA_ "NmAsrMessage" BO_ 1188 0;
BA_ "GenMsgMinAcceptLength" BO_ 1188 8;
BA_ "GenMsgILSupport" BO_ 1188 1;
BA_ "DiagState" BO_ 1188 0;
BA_ "DiagRequest" BO_ 1188 0;
BA_ "DiagResponse" BO_ 1188 0;
BA_ "GenMsgStartValue" BO_ 1188 "0";
BA_ "GenMsgStartDelayTime" BO_ 1188 200;
BA_ "GenMsgDelayTime" BO_ 1188 20;
BA_ "GenMsgNrOfRepetitions" BO_ 1188 0;
BA_ "GenMsgCycleTime" BO_ 1188 1000;
BA_ "GenMsgSendType" BO_ 1188 5;
    */
    _Config_HU3_AR_Timebase =                c_tDBKomTimer_20ms;
    _Config_HU3_AR_CycleCount =            1000 / _Config_HU3_AR_Timebase;
    _Config_HU3_AR_StartDelay =             200 / _Config_HU3_AR_Timebase;
    _Config_HU3_AR_Cnt = _Config_HU3_AR_StartDelay;
    _Config_HU3_AR_SpontanFlag = 0;

    putValue( HMI__STMSGSD_Config_HU3_AR, _Config_HU3_AR_StartDelay * _Config_HU3_AR_Timebase );

    _mConfig_HU3_AR.AFS_Md_Rq_HU.phys = getValue( HMI_AFS_Md_Rq_HU );
    _mConfig_HU3_AR.HUD_Md_Rq_HU.phys = getValue( HMI_HUD_Md_Rq_HU );
    _mConfig_HU3_AR.IC_AddSpeedo_Rq.phys = getValue( HMI_IC_AddSpeedo_Rq );
    _mConfig_HU3_AR.IC_DesignVar_Rq.phys = getValue( HMI_IC_DesignVar_Rq );
    _mConfig_HU3_AR.IC_DistUnit_Rq.phys = getValue( HMI_IC_DistUnit_Rq );
    _mConfig_HU3_AR.IC_FactReset_Rq.phys = getValue( HMI_IC_FactReset_Rq );
    _mConfig_HU3_AR.IC_TempDisp_Rq.phys = getValue( HMI_IC_TempDisp_Rq );
    _mConfig_HU3_AR.ILS_TouristMd_Rq_HU.phys = getValue( HMI_ILS_TouristMd_Rq_HU );
    _mConfig_HU3_AR.NV_FactReset_Rq.phys = getValue( HMI_NV_FactReset_Rq );
    _mConfig_HU3_AR.NVP_DispMd_Rq.phys = getValue( HMI_NVP_DispMd_Rq );
    _mConfig_HU3_AR.NVP_SPL_Md_Rq.phys = getValue( HMI_NVP_SPL_Md_Rq );
    _mConfig_HU3_AR.PIP_HUD_Add2_Actv.phys = getValue( HMI_PIP_HUD_Add2_Actv );
    _mConfig_HU3_AR.PIP_HUD_Add3_Actv.phys = getValue( HMI_PIP_HUD_Add3_Actv );
    _mConfig_HU3_AR.PIP_HUD_Add4_Actv.phys = getValue( HMI_PIP_HUD_Add4_Actv );
    _mConfig_HU3_AR.PIP_HUD_AMG_RaceApp_Actv.phys = getValue( HMI_PIP_HUD_AMG_RaceApp_Actv );
    _mConfig_HU3_AR.PIP_HUD_Apps_Actv.phys = getValue( HMI_PIP_HUD_Apps_Actv );
    _mConfig_HU3_AR.PIP_HUD_Audio_Actv.phys = getValue( HMI_PIP_HUD_Audio_Actv );
    _mConfig_HU3_AR.PIP_HUD_Navi_Actv.phys = getValue( HMI_PIP_HUD_Navi_Actv );
    _mConfig_HU3_AR.PIP_HUD_Phone_Actv.phys = getValue( HMI_PIP_HUD_Phone_Actv );
    _mConfig_HU3_AR.PIP_IC_Add2_Actv.phys = getValue( HMI_PIP_IC_Add2_Actv );
    _mConfig_HU3_AR.PIP_IC_Add3_Actv.phys = getValue( HMI_PIP_IC_Add3_Actv );
    _mConfig_HU3_AR.PIP_IC_Add4_Actv.phys = getValue( HMI_PIP_IC_Add4_Actv );
    _mConfig_HU3_AR.PIP_IC_AMG_RaceApp_Actv.phys = getValue( HMI_PIP_IC_AMG_RaceApp_Actv );
    _mConfig_HU3_AR.PIP_IC_Apps_Actv.phys = getValue( HMI_PIP_IC_Apps_Actv );
    _mConfig_HU3_AR.PIP_IC_Audio_Actv.phys = getValue( HMI_PIP_IC_Audio_Actv );
    _mConfig_HU3_AR.PIP_IC_Navi_Actv.phys = getValue( HMI_PIP_IC_Navi_Actv );
    _mConfig_HU3_AR.PIP_IC_Phone_Actv.phys = getValue( HMI_PIP_IC_Phone_Actv );  
    _mConfig_HU3_AR.HUD_Assist_Rq.phys = getValue( HMI_HUD_Assist_Rq );
    _mConfig_HU3_AR.HUD_Audio_Rq.phys = getValue( HMI_HUD_Audio_Rq );
    _mConfig_HU3_AR.HUD_Linguatronic_Rq.phys = getValue( HMI_HUD_Linguatronic_Rq );
    _mConfig_HU3_AR.HUD_Msg_Rq.phys = getValue( HMI_HUD_Msg_Rq );
    _mConfig_HU3_AR.HUD_Tel_Rq.phys = getValue( HMI_HUD_Tel_Rq );
}

Config_HU3_AR_output()
{
    output( _mConfig_HU3_AR );
}

Config_HU3_AR_saveEnvVars( dword hFile )
{
    filePutString("\n// Knoten TGW: Config_HU3_AR\n", 26, hFile);
    snprintf( buffer, elcount(buffer), "0.0000 HMI__STMSG_Config_HU3_AR := %X\n", getValue( HMI__STMSG_Config_HU3_AR ) );        filePutString( buffer, elcount(buffer), hFile);
    snprintf( buffer, elcount(buffer), "0.0000 HMI__STMSGT_Config_HU3_AR := %X\n", getValue( HMI__STMSGT_Config_HU3_AR ) );        filePutString( buffer, elcount(buffer), hFile);
    snprintf( buffer, elcount(buffer), "0.0000 HMI_AFS_Md_Rq_HU := %X\n", getValue( HMI_AFS_Md_Rq_HU ) );        filePutString( buffer, elcount(buffer), hFile);
    snprintf( buffer, elcount(buffer), "0.0000 HMI_HUD_Md_Rq_HU := %X\n", getValue( HMI_HUD_Md_Rq_HU ) );        filePutString( buffer, elcount(buffer), hFile);
    snprintf( buffer, elcount(buffer), "0.0000 HMI_IC_AddSpeedo_Rq := %X\n", getValue( HMI_IC_AddSpeedo_Rq ) );        filePutString( buffer, elcount(buffer), hFile);
    snprintf( buffer, elcount(buffer), "0.0000 HMI_IC_DesignVar_Rq := %X\n", getValue( HMI_IC_DesignVar_Rq ) );        filePutString( buffer, elcount(buffer), hFile);
    snprintf( buffer, elcount(buffer), "0.0000 HMI_IC_DistUnit_Rq := %X\n", getValue( HMI_IC_DistUnit_Rq ) );        filePutString( buffer, elcount(buffer), hFile);
    snprintf( buffer, elcount(buffer), "0.0000 HMI_IC_FactReset_Rq := %X\n", getValue( HMI_IC_FactReset_Rq ) );        filePutString( buffer, elcount(buffer), hFile);
    snprintf( buffer, elcount(buffer), "0.0000 HMI_IC_TempDisp_Rq := %X\n", getValue( HMI_IC_TempDisp_Rq ) );        filePutString( buffer, elcount(buffer), hFile);
    snprintf( buffer, elcount(buffer), "0.0000 HMI_ILS_TouristMd_Rq_HU := %X\n", getValue( HMI_ILS_TouristMd_Rq_HU ) );        filePutString( buffer, elcount(buffer), hFile);
    snprintf( buffer, elcount(buffer), "0.0000 HMI_NV_FactReset_Rq := %X\n", getValue( HMI_NV_FactReset_Rq ) );        filePutString( buffer, elcount(buffer), hFile);
    snprintf( buffer, elcount(buffer), "0.0000 HMI_NVP_DispMd_Rq := %X\n", getValue( HMI_NVP_DispMd_Rq ) );        filePutString( buffer, elcount(buffer), hFile);
    snprintf( buffer, elcount(buffer), "0.0000 HMI_NVP_SPL_Md_Rq := %X\n", getValue( HMI_NVP_SPL_Md_Rq ) );        filePutString( buffer, elcount(buffer), hFile);
    snprintf( buffer, elcount(buffer), "0.0000 HMI_PIP_HUD_Add2_Actv := %X\n", getValue( HMI_PIP_HUD_Add2_Actv ) );        filePutString( buffer, elcount(buffer), hFile);
    snprintf( buffer, elcount(buffer), "0.0000 HMI_PIP_HUD_Add3_Actv := %X\n", getValue( HMI_PIP_HUD_Add3_Actv ) );        filePutString( buffer, elcount(buffer), hFile);
    snprintf( buffer, elcount(buffer), "0.0000 HMI_PIP_HUD_Add4_Actv := %X\n", getValue( HMI_PIP_HUD_Add4_Actv ) );        filePutString( buffer, elcount(buffer), hFile);
    snprintf( buffer, elcount(buffer), "0.0000 HMI_PIP_HUD_AMG_RaceApp_Actv := %X\n", getValue( HMI_PIP_HUD_AMG_RaceApp_Actv ) );        filePutString( buffer, elcount(buffer), hFile);
    snprintf( buffer, elcount(buffer), "0.0000 HMI_PIP_HUD_Apps_Actv := %X\n", getValue( HMI_PIP_HUD_Apps_Actv ) );        filePutString( buffer, elcount(buffer), hFile);
    snprintf( buffer, elcount(buffer), "0.0000 HMI_PIP_HUD_Audio_Actv := %X\n", getValue( HMI_PIP_HUD_Audio_Actv ) );        filePutString( buffer, elcount(buffer), hFile);
    snprintf( buffer, elcount(buffer), "0.0000 HMI_PIP_HUD_Navi_Actv := %X\n", getValue( HMI_PIP_HUD_Navi_Actv ) );        filePutString( buffer, elcount(buffer), hFile);
    snprintf( buffer, elcount(buffer), "0.0000 HMI_PIP_HUD_Phone_Actv := %X\n", getValue( HMI_PIP_HUD_Phone_Actv ) );        filePutString( buffer, elcount(buffer), hFile);
    snprintf( buffer, elcount(buffer), "0.0000 HMI_PIP_IC_Add2_Actv := %X\n", getValue( HMI_PIP_IC_Add2_Actv ) );        filePutString( buffer, elcount(buffer), hFile);
    snprintf( buffer, elcount(buffer), "0.0000 HMI_PIP_IC_Add3_Actv := %X\n", getValue( HMI_PIP_IC_Add3_Actv ) );        filePutString( buffer, elcount(buffer), hFile);
    snprintf( buffer, elcount(buffer), "0.0000 HMI_PIP_IC_Add4_Actv := %X\n", getValue( HMI_PIP_IC_Add4_Actv ) );        filePutString( buffer, elcount(buffer), hFile);
    snprintf( buffer, elcount(buffer), "0.0000 HMI_PIP_IC_AMG_RaceApp_Actv := %X\n", getValue( HMI_PIP_IC_AMG_RaceApp_Actv ) );        filePutString( buffer, elcount(buffer), hFile);
    snprintf( buffer, elcount(buffer), "0.0000 HMI_PIP_IC_Apps_Actv := %X\n", getValue( HMI_PIP_IC_Apps_Actv ) );        filePutString( buffer, elcount(buffer), hFile);
    snprintf( buffer, elcount(buffer), "0.0000 HMI_PIP_IC_Audio_Actv := %X\n", getValue( HMI_PIP_IC_Audio_Actv ) );        filePutString( buffer, elcount(buffer), hFile);
    snprintf( buffer, elcount(buffer), "0.0000 HMI_PIP_IC_Navi_Actv := %X\n", getValue( HMI_PIP_IC_Navi_Actv ) );        filePutString( buffer, elcount(buffer), hFile);
    snprintf( buffer, elcount(buffer), "0.0000 HMI_PIP_IC_Phone_Actv := %X\n", getValue( HMI_PIP_IC_Phone_Actv ) );        filePutString( buffer, elcount(buffer), hFile);
    snprintf( buffer, elcount(buffer), "0.0000 HMI_HUD_Assist_Rq := %X\n", getValue( HMI_HUD_Assist_Rq ) );        filePutString( buffer, elcount(buffer), hFile);
    snprintf( buffer, elcount(buffer), "0.0000 HMI_HUD_Audio_Rq := %X\n", getValue( HMI_HUD_Audio_Rq ) );        filePutString( buffer, elcount(buffer), hFile);
    snprintf( buffer, elcount(buffer), "0.0000 HMI_HUD_Linguatronic_Rq := %X\n", getValue( HMI_HUD_Linguatronic_Rq ) );        filePutString( buffer, elcount(buffer), hFile);
    snprintf( buffer, elcount(buffer), "0.0000 HMI_HUD_Msg_Rq := %X\n", getValue( HMI_HUD_Msg_Rq ) );        filePutString( buffer, elcount(buffer), hFile);
    snprintf( buffer, elcount(buffer), "0.0000 HMI_HUD_Tel_Rq := %X\n", getValue( HMI_HUD_Tel_Rq ) );        filePutString( buffer, elcount(buffer), hFile);
}

on timer _tConfig_HU3_AR
{
    putValue( HMI__STMSG_Config_HU3_AR, 0 );
}

on EnvVar HMI__STMSG_Config_HU3_AR
{
    long tDelay;
    if( getValue( this ) == 2 )
    {
        tDelay = getValue( HMI__STMSGT_Config_HU3_AR );
        if( tDelay > 0 )    
            setTimer( _tConfig_HU3_AR, tDelay );
        else
            putValue( HMI__STMSG_Config_HU3_AR, 0 );
    }
}

on envVar HMI__STMSG_PO_Config_HU3_AR
{
    if( getValue( this ) )
        openPanel("Config_HU3_AR");
}

on EnvVar HMI_AFS_Md_Rq_HU
{
    _mConfig_HU3_AR.AFS_Md_Rq_HU.phys = getValue(this);
    _Config_HU3_AR_SpontanFlag = 1;
}

on EnvVar HMI_HUD_Md_Rq_HU
{
    _mConfig_HU3_AR.HUD_Md_Rq_HU.phys = getValue(this);
    _Config_HU3_AR_SpontanFlag = 1;
}

on EnvVar HMI_IC_AddSpeedo_Rq
{
    _mConfig_HU3_AR.IC_AddSpeedo_Rq.phys = getValue(this);
    _Config_HU3_AR_SpontanFlag = 1;
}

on EnvVar HMI_IC_DesignVar_Rq
{
    _mConfig_HU3_AR.IC_DesignVar_Rq.phys = getValue(this);
    _Config_HU3_AR_SpontanFlag = 1;
}

on EnvVar HMI_IC_DistUnit_Rq
{
    _mConfig_HU3_AR.IC_DistUnit_Rq.phys = getValue(this);
    _Config_HU3_AR_SpontanFlag = 1;
}

on EnvVar HMI_IC_FactReset_Rq
{
    _mConfig_HU3_AR.IC_FactReset_Rq.phys = getValue(this);
    _Config_HU3_AR_SpontanFlag = 1;
}

on EnvVar HMI_IC_TempDisp_Rq
{
    _mConfig_HU3_AR.IC_TempDisp_Rq.phys = getValue(this);
    _Config_HU3_AR_SpontanFlag = 1;
}

on EnvVar HMI_ILS_TouristMd_Rq_HU
{
    _mConfig_HU3_AR.ILS_TouristMd_Rq_HU.phys = getValue(this);
    _Config_HU3_AR_SpontanFlag = 1;
}

on EnvVar HMI_NV_FactReset_Rq
{
    _mConfig_HU3_AR.NV_FactReset_Rq.phys = getValue(this);
    _Config_HU3_AR_SpontanFlag = 1;
}

on EnvVar HMI_NVP_DispMd_Rq
{
    _mConfig_HU3_AR.NVP_DispMd_Rq.phys = getValue(this);
    _Config_HU3_AR_SpontanFlag = 1;
}

on EnvVar HMI_NVP_SPL_Md_Rq
{
    _mConfig_HU3_AR.NVP_SPL_Md_Rq.phys = getValue(this);
    _Config_HU3_AR_SpontanFlag = 1;
}

on EnvVar HMI_PIP_HUD_Add2_Actv
{
    _mConfig_HU3_AR.PIP_HUD_Add2_Actv.phys = getValue(this);
    _Config_HU3_AR_SpontanFlag = 1;
}

on EnvVar HMI_PIP_HUD_Add3_Actv
{
    _mConfig_HU3_AR.PIP_HUD_Add3_Actv.phys = getValue(this);
    _Config_HU3_AR_SpontanFlag = 1;
}

on EnvVar HMI_PIP_HUD_Add4_Actv
{
    _mConfig_HU3_AR.PIP_HUD_Add4_Actv.phys = getValue(this);
    _Config_HU3_AR_SpontanFlag = 1;
}

on EnvVar HMI_PIP_HUD_AMG_RaceApp_Actv
{
    _mConfig_HU3_AR.PIP_HUD_AMG_RaceApp_Actv.phys = getValue(this);
    _Config_HU3_AR_SpontanFlag = 1;
}

on EnvVar HMI_PIP_HUD_Apps_Actv
{
    _mConfig_HU3_AR.PIP_HUD_Apps_Actv.phys = getValue(this);
    _Config_HU3_AR_SpontanFlag = 1;
}

on EnvVar HMI_PIP_HUD_Audio_Actv
{
    _mConfig_HU3_AR.PIP_HUD_Audio_Actv.phys = getValue(this);
    _Config_HU3_AR_SpontanFlag = 1;
}

on EnvVar HMI_PIP_HUD_Navi_Actv
{
    _mConfig_HU3_AR.PIP_HUD_Navi_Actv.phys = getValue(this);
    _Config_HU3_AR_SpontanFlag = 1;
}

on EnvVar HMI_PIP_HUD_Phone_Actv
{
    _mConfig_HU3_AR.PIP_HUD_Phone_Actv.phys = getValue(this);
    _Config_HU3_AR_SpontanFlag = 1;
}

on EnvVar HMI_PIP_IC_Add2_Actv
{
    _mConfig_HU3_AR.PIP_IC_Add2_Actv.phys = getValue(this);
    _Config_HU3_AR_SpontanFlag = 1;
}

on EnvVar HMI_PIP_IC_Add3_Actv
{
    _mConfig_HU3_AR.PIP_IC_Add3_Actv.phys = getValue(this);
    _Config_HU3_AR_SpontanFlag = 1;
}

on EnvVar HMI_PIP_IC_Add4_Actv
{
    _mConfig_HU3_AR.PIP_IC_Add4_Actv.phys = getValue(this);
    _Config_HU3_AR_SpontanFlag = 1;
}

on EnvVar HMI_PIP_IC_AMG_RaceApp_Actv
{
    _mConfig_HU3_AR.PIP_IC_AMG_RaceApp_Actv.phys = getValue(this);
    _Config_HU3_AR_SpontanFlag = 1;
}

on EnvVar HMI_PIP_IC_Apps_Actv
{
    _mConfig_HU3_AR.PIP_IC_Apps_Actv.phys = getValue(this);
    _Config_HU3_AR_SpontanFlag = 1;
}

on EnvVar HMI_PIP_IC_Audio_Actv
{
    _mConfig_HU3_AR.PIP_IC_Audio_Actv.phys = getValue(this);
    _Config_HU3_AR_SpontanFlag = 1;
}

on EnvVar HMI_PIP_IC_Navi_Actv
{
    _mConfig_HU3_AR.PIP_IC_Navi_Actv.phys = getValue(this);
    _Config_HU3_AR_SpontanFlag = 1;
}

on EnvVar HMI_PIP_IC_Phone_Actv
{
    _mConfig_HU3_AR.PIP_IC_Phone_Actv.phys = getValue(this);
    _Config_HU3_AR_SpontanFlag = 1;
}

on EnvVar HMI_HUD_Assist_Rq
{
    _mConfig_HU3_AR.HUD_Assist_Rq.phys = getValue(this);
    _Config_HU3_AR_SpontanFlag = 1;
}
on EnvVar HMI_HUD_Audio_Rq
{
    _mConfig_HU3_AR.HUD_Audio_Rq.phys = getValue(this);
    _Config_HU3_AR_SpontanFlag = 1;
}
on EnvVar HMI_HUD_Linguatronic_Rq
{
    _mConfig_HU3_AR.HUD_Linguatronic_Rq.phys = getValue(this);
    _Config_HU3_AR_SpontanFlag = 1;
}
on EnvVar HMI_HUD_Msg_Rq
{
    _mConfig_HU3_AR.HUD_Msg_Rq.phys = getValue(this);
    _Config_HU3_AR_SpontanFlag = 1;
}
on EnvVar HMI_HUD_Tel_Rq
{
    _mConfig_HU3_AR.HUD_Tel_Rq.phys = getValue(this);
    _Config_HU3_AR_SpontanFlag = 1;
}

Config_HU4_AR_check_output()
{
      if( !getValue( HMI__STMSG_Config_HU4_AR ) )
    {
        // Botschaft Config_HU4_AR ID: 1124 --- Sendeart 5 cyclicAndSpontanWithDelay --- 
        if( _Config_HU4_AR_DelayCnt > 0) _Config_HU4_AR_DelayCnt--; // Mindestsendeabstand
        _Config_HU4_AR_Cnt--;
        if( _Config_HU4_AR_Cnt < 1 )
        {
            if( _Config_HU4_AR_DelayCnt < 1 )
            {
                // Nachricht wg. abgelaufenem Zyklus ausgeben (Mindestsendeabstand eingehalten)
                Config_HU4_AR_output();
                _Config_HU4_AR_SpontanFlag = 0; // Spontan-Flag zurücksetzen
                _Config_HU4_AR_DelayCnt = _Config_HU4_AR_MinDelay;
            }
            else
            {
                // Spontanflag setzen damit nach Ablauf Mindestsendeabstand gesendet wird
                 _Config_HU4_AR_SpontanFlag = 1;
            }
            _Config_HU4_AR_Cnt = _Config_HU4_AR_CycleCount; // Zyklus-Zähler zurücksetzen
        }
        else if( _Config_HU4_AR_SpontanFlag)
        {
            if( _Config_HU4_AR_DelayCnt < 1 )
            {
                // Nachricht wg. spontaner Änderung ausgeben (Mindestsendeabstand eingehalten)
                Config_HU4_AR_output();
                _Config_HU4_AR_SpontanFlag = 0; // Spontan-Flag zurücksetzen
                _Config_HU4_AR_DelayCnt = _Config_HU4_AR_MinDelay;
            }
        }
    }
}

Config_HU4_AR_init()
{    /* Botschaft Config_HU4_AR ID: 1124 --- Sendeart 5 cyclicAndSpontanWithDelay --- 
BA_ "ApplMessage" BO_ 1124 0;
BA_ "NmAsrMessage" BO_ 1124 0;
BA_ "GenMsgMinAcceptLength" BO_ 1124 8;
BA_ "GenMsgILSupport" BO_ 1124 1;
BA_ "DiagState" BO_ 1124 0;
BA_ "DiagRequest" BO_ 1124 0;
BA_ "DiagResponse" BO_ 1124 0;
BA_ "GenMsgStartValue" BO_ 1124 "0";
BA_ "GenMsgStartDelayTime" BO_ 1124 260;
BA_ "GenMsgDelayTime" BO_ 1124 50;
BA_ "GenMsgNrOfRepetitions" BO_ 1124 0;
BA_ "GenMsgCycleTime" BO_ 1124 1000;
BA_ "GenMsgSendType" BO_ 1124 5;
        */
    
    _Config_HU4_AR_Timebase =            c_tDBKomTimer_20ms;
    _Config_HU4_AR_CycleCount =       1000 / _Config_HU4_AR_Timebase;
    _Config_HU4_AR_StartDelay =        260 / _Config_HU4_AR_Timebase;
    _Config_HU4_AR_MinDelay =           50 / _Config_HU4_AR_Timebase;
    _Config_HU4_AR_Cnt = _Config_HU4_AR_StartDelay;
    _Config_HU4_AR_DelayCnt = 0;
    _Config_HU4_AR_SpontanFlag = 0;

    putValue( HMI__STMSGSD_Config_HU4_AR, _Config_HU4_AR_StartDelay * _Config_HU4_AR_Timebase ); 

    _mConfig_HU4_AR.CNG_FuelMdChg_Rq_V2.phys = getValue( HMI_CNG_FuelMdChg_Rq_V2 );
    _mConfig_HU4_AR.HU_AC_Curr_Max_Rq.phys = getValue( HMI_HU_AC_Curr_Max_Rq );
    _mConfig_HU4_AR.HU_TouchAcousticsMd_Stat.phys = getValue( HMI_HU_TouchAcousticsMd_Stat );
    _mConfig_HU4_AR.Park_AccelMd_Rq_HU.phys = getValue( HMI_Park_AccelMd_Rq_HU );
    _mConfig_HU4_AR.Park_AttenuatMd_Rq_HU.phys = getValue( HMI_Park_AttenuatMd_Rq_HU );
    _mConfig_HU4_AR.Park_BrkMd_Rq_HU.phys = getValue( HMI_Park_BrkMd_Rq_HU );
    _mConfig_HU4_AR.Park_CTA_Md_Rq_HU.phys = getValue( HMI_Park_CTA_Md_Rq_HU );
    _mConfig_HU4_AR.Park_FactReset_Rq_HU.phys = getValue( HMI_Park_FactReset_Rq_HU );
    _mConfig_HU4_AR.Park_ObjDtctMd_Rq_HU.phys = getValue( HMI_Park_ObjDtctMd_Rq_HU );
    _mConfig_HU4_AR.Park_ParkSpaceSelSw_Psd_HU.phys = getValue( HMI_Park_ParkSpaceSelSw_Psd_HU );
    _mConfig_HU4_AR.Park_RevGrMd_Rq_HU.phys = getValue( HMI_Park_RevGrMd_Rq_HU );
    _mConfig_HU4_AR.Park_Sonar_Ft_Md_Rq_HU.phys = getValue( HMI_Park_Sonar_Ft_Md_Rq_HU );
    _mConfig_HU4_AR.Park_Sonar_R_Md_Rq_HU.phys = getValue( HMI_Park_Sonar_R_Md_Rq_HU );
    _mConfig_HU4_AR.Park_StMd_Rq_HU.phys = getValue( HMI_Park_StMd_Rq_HU );
    _mConfig_HU4_AR.Park_StyleMd_Rq_HU.phys = getValue( HMI_Park_StyleMd_Rq_HU );
    _mConfig_HU4_AR.Park_WarnFreq_Ft_Rq_HU.phys = getValue( HMI_Park_WarnFreq_Ft_Rq_HU );
    _mConfig_HU4_AR.Park_Sonar_Sd_Md_Rq_HU.phys = getValue( HMI_Park_Sonar_Sd_Md_Rq_HU );
    _mConfig_HU4_AR.Park_WarnVol_Ft_Rq_HU.phys = getValue( HMI_Park_WarnVol_Ft_Rq_HU );
    _mConfig_HU4_AR.Park_WarnVol_R_Rq_HU.phys = getValue( HMI_Park_WarnVol_R_Rq_HU );
    _mConfig_HU4_AR.PNHV_AC_Curr_Max_Lim_Rq_HU.phys = getValue( HMI_PNHV_AC_Curr_Max_Lim_Rq_HU );
    _mConfig_HU4_AR.StWhl_OFN_SnstyMd_Rq.phys = getValue( HMI_StWhl_OFN_SnstyMd_Rq );
}

Config_HU4_AR_output()
{
    output( _mConfig_HU4_AR );
}

Config_HU4_AR_saveEnvVars( dword hFile )
{
    filePutString("\n// Knoten TGW: Config_HU4_AR\n", 26, hFile);
    snprintf( buffer, elcount(buffer), "0.0000 HMI__STMSG_Config_HU4_AR := %X\n", getValue( HMI__STMSG_Config_HU4_AR ) );        filePutString( buffer, elcount(buffer), hFile);
    snprintf( buffer, elcount(buffer), "0.0000 HMI__STMSGT_Config_HU4_AR := %X\n", getValue( HMI__STMSGT_Config_HU4_AR ) );        filePutString( buffer, elcount(buffer), hFile);
    snprintf( buffer, elcount(buffer), "0.0000 HMI_CNG_FuelMdChg_Rq_V2 := %X\n", getValue( HMI_CNG_FuelMdChg_Rq_V2 ) );        filePutString( buffer, elcount(buffer), hFile);
    snprintf( buffer, elcount(buffer), "0.0000 HMI_HU_AC_Curr_Max_Rq := %X\n", getValue( HMI_HU_AC_Curr_Max_Rq ) );        filePutString( buffer, elcount(buffer), hFile);
    snprintf( buffer, elcount(buffer), "0.0000 HMI_HU_TouchAcousticsMd_Stat := %X\n", getValue( HMI_HU_TouchAcousticsMd_Stat ) );        filePutString( buffer, elcount(buffer), hFile);
    snprintf( buffer, elcount(buffer), "0.0000 HMI_Park_AccelMd_Rq_HU := %X\n", getValue( HMI_Park_AccelMd_Rq_HU ) );        filePutString( buffer, elcount(buffer), hFile);
    snprintf( buffer, elcount(buffer), "0.0000 HMI_Park_AttenuatMd_Rq_HU := %X\n", getValue( HMI_Park_AttenuatMd_Rq_HU ) );        filePutString( buffer, elcount(buffer), hFile);
    snprintf( buffer, elcount(buffer), "0.0000 HMI_Park_BrkMd_Rq_HU := %X\n", getValue( HMI_Park_BrkMd_Rq_HU ) );        filePutString( buffer, elcount(buffer), hFile);
    snprintf( buffer, elcount(buffer), "0.0000 HMI_Park_CTA_Md_Rq_HU := %X\n", getValue( HMI_Park_CTA_Md_Rq_HU ) );        filePutString( buffer, elcount(buffer), hFile);
    snprintf( buffer, elcount(buffer), "0.0000 HMI_Park_FactReset_Rq_HU := %X\n", getValue( HMI_Park_FactReset_Rq_HU ) );        filePutString( buffer, elcount(buffer), hFile);
    snprintf( buffer, elcount(buffer), "0.0000 HMI_Park_ObjDtctMd_Rq_HU := %X\n", getValue( HMI_Park_ObjDtctMd_Rq_HU ) );        filePutString( buffer, elcount(buffer), hFile);
    snprintf( buffer, elcount(buffer), "0.0000 HMI_Park_ParkSpaceSelSw_Psd_HU := %X\n", getValue( HMI_Park_ParkSpaceSelSw_Psd_HU ) );        filePutString( buffer, elcount(buffer), hFile);
    snprintf( buffer, elcount(buffer), "0.0000 HMI_Park_RevGrMd_Rq_HU := %X\n", getValue( HMI_Park_RevGrMd_Rq_HU ) );        filePutString( buffer, elcount(buffer), hFile);
    snprintf( buffer, elcount(buffer), "0.0000 HMI_Park_Sonar_Ft_Md_Rq_HU := %X\n", getValue( HMI_Park_Sonar_Ft_Md_Rq_HU ) );        filePutString( buffer, elcount(buffer), hFile);
    snprintf( buffer, elcount(buffer), "0.0000 HMI_Park_Sonar_R_Md_Rq_HU := %X\n", getValue( HMI_Park_Sonar_R_Md_Rq_HU ) );        filePutString( buffer, elcount(buffer), hFile);
    snprintf( buffer, elcount(buffer), "0.0000 HMI_Park_StMd_Rq_HU := %X\n", getValue( HMI_Park_StMd_Rq_HU ) );        filePutString( buffer, elcount(buffer), hFile);
    snprintf( buffer, elcount(buffer), "0.0000 HMI_Park_StyleMd_Rq_HU := %X\n", getValue( HMI_Park_StyleMd_Rq_HU ) );        filePutString( buffer, elcount(buffer), hFile);
    snprintf( buffer, elcount(buffer), "0.0000 HMI_Park_WarnFreq_Ft_Rq_HU := %X\n", getValue( HMI_Park_WarnFreq_Ft_Rq_HU ) );        filePutString( buffer, elcount(buffer), hFile);
    snprintf( buffer, elcount(buffer), "0.0000 HMI_Park_Sonar_Sd_Md_Rq_HU := %X\n", getValue( HMI_Park_Sonar_Sd_Md_Rq_HU ) );        filePutString( buffer, elcount(buffer), hFile);
    snprintf( buffer, elcount(buffer), "0.0000 HMI_Park_WarnVol_Ft_Rq_HU := %X\n", getValue( HMI_Park_WarnVol_Ft_Rq_HU ) );        filePutString( buffer, elcount(buffer), hFile);
    snprintf( buffer, elcount(buffer), "0.0000 HMI_Park_WarnVol_R_Rq_HU := %X\n", getValue( HMI_Park_WarnVol_R_Rq_HU ) );        filePutString( buffer, elcount(buffer), hFile);
    snprintf( buffer, elcount(buffer), "0.0000 HMI_PNHV_AC_Curr_Max_Lim_Rq_HU := %X\n", getValue( HMI_PNHV_AC_Curr_Max_Lim_Rq_HU ) );        filePutString( buffer, elcount(buffer), hFile);
    snprintf( buffer, elcount(buffer), "0.0000 HMI_StWhl_OFN_SnstyMd_Rq := %X\n", getValue( HMI_StWhl_OFN_SnstyMd_Rq ) );        filePutString( buffer, elcount(buffer), hFile);
}

on timer _tConfig_HU4_AR
{
    putValue( HMI__STMSG_Config_HU4_AR, 0 );
}

on EnvVar HMI__STMSG_Config_HU4_AR
{
    long tDelay;
    if( getValue( this ) == 2 )
    {
        tDelay = getValue( HMI__STMSGT_Config_HU4_AR );
        if( tDelay > 0 )    
            setTimer( _tConfig_HU4_AR, tDelay );
        else
            putValue( HMI__STMSG_Config_HU4_AR, 0 );
    }
}

on envVar HMI__STMSG_PO_Config_HU4_AR
{
    if( getValue( this ) )
        openPanel("Config_HU4_AR");
}

on EnvVar HMI_CNG_FuelMdChg_Rq_V2
{
    _mConfig_HU4_AR.CNG_FuelMdChg_Rq_V2.phys = getValue(this);
    _Config_HU4_AR_SpontanFlag = 1;
}

on EnvVar HMI_HU_AC_Curr_Max_Rq
{
    _mConfig_HU4_AR.HU_AC_Curr_Max_Rq.phys = getValue(this);
    _Config_HU4_AR_SpontanFlag = 1;
}

on EnvVar HMI_HU_TouchAcousticsMd_Stat
{
    _mConfig_HU4_AR.HU_TouchAcousticsMd_Stat.phys = getValue(this);
    _Config_HU4_AR_SpontanFlag = 1;
}

on EnvVar HMI_Park_AccelMd_Rq_HU
{
    _mConfig_HU4_AR.Park_AccelMd_Rq_HU.phys = getValue(this);
    _Config_HU4_AR_SpontanFlag = 1;
}

on EnvVar HMI_Park_AttenuatMd_Rq_HU
{
    _mConfig_HU4_AR.Park_AttenuatMd_Rq_HU.phys = getValue(this);
    _Config_HU4_AR_SpontanFlag = 1;
}

on EnvVar HMI_Park_BrkMd_Rq_HU
{
    _mConfig_HU4_AR.Park_BrkMd_Rq_HU.phys = getValue(this);
    _Config_HU4_AR_SpontanFlag = 1;
}

on EnvVar HMI_Park_CTA_Md_Rq_HU
{
    _mConfig_HU4_AR.Park_CTA_Md_Rq_HU.phys = getValue(this);
    _Config_HU4_AR_SpontanFlag = 1;
}

on EnvVar HMI_Park_FactReset_Rq_HU
{
    _mConfig_HU4_AR.Park_FactReset_Rq_HU.phys = getValue(this);
    _Config_HU4_AR_SpontanFlag = 1;
}

on EnvVar HMI_Park_ObjDtctMd_Rq_HU
{
    _mConfig_HU4_AR.Park_ObjDtctMd_Rq_HU.phys = getValue(this);
    _Config_HU4_AR_SpontanFlag = 1;
}

on EnvVar HMI_Park_ParkSpaceSelSw_Psd_HU
{
    _mConfig_HU4_AR.Park_ParkSpaceSelSw_Psd_HU.phys = getValue(this);
    _Config_HU4_AR_SpontanFlag = 1;
}

on EnvVar HMI_Park_RevGrMd_Rq_HU
{
    _mConfig_HU4_AR.Park_RevGrMd_Rq_HU.phys = getValue(this);
    _Config_HU4_AR_SpontanFlag = 1;
}

on EnvVar HMI_Park_Sonar_Ft_Md_Rq_HU
{
    _mConfig_HU4_AR.Park_Sonar_Ft_Md_Rq_HU.phys = getValue(this);
    _Config_HU4_AR_SpontanFlag = 1;
}

on EnvVar HMI_Park_Sonar_R_Md_Rq_HU
{
    _mConfig_HU4_AR.Park_Sonar_R_Md_Rq_HU.phys = getValue(this);
    _Config_HU4_AR_SpontanFlag = 1;
}

on EnvVar HMI_Park_StMd_Rq_HU
{
    _mConfig_HU4_AR.Park_StMd_Rq_HU.phys = getValue(this);
    _Config_HU4_AR_SpontanFlag = 1;
}

on EnvVar HMI_Park_StyleMd_Rq_HU
{
    _mConfig_HU4_AR.Park_StyleMd_Rq_HU.phys = getValue(this);
    _Config_HU4_AR_SpontanFlag = 1;
}

on EnvVar HMI_Park_WarnFreq_Ft_Rq_HU
{
    _mConfig_HU4_AR.Park_WarnFreq_Ft_Rq_HU.phys = getValue(this);
    _Config_HU4_AR_SpontanFlag = 1;
}

on EnvVar HMI_Park_Sonar_Sd_Md_Rq_HU
{
    _mConfig_HU4_AR.Park_Sonar_Sd_Md_Rq_HU.phys = getValue(this);
    _Config_HU4_AR_SpontanFlag = 1;
}

on EnvVar HMI_Park_WarnVol_Ft_Rq_HU
{
    _mConfig_HU4_AR.Park_WarnVol_Ft_Rq_HU.phys = getValue(this);
    _Config_HU4_AR_SpontanFlag = 1;
}

on EnvVar HMI_Park_WarnVol_R_Rq_HU
{
    _mConfig_HU4_AR.Park_WarnVol_R_Rq_HU.phys = getValue(this);
    _Config_HU4_AR_SpontanFlag = 1;
}

on EnvVar HMI_PNHV_AC_Curr_Max_Lim_Rq_HU
{
    _mConfig_HU4_AR.PNHV_AC_Curr_Max_Lim_Rq_HU.phys = getValue(this);
    _Config_HU4_AR_SpontanFlag = 1;
}

on EnvVar HMI_StWhl_OFN_SnstyMd_Rq
{
    _mConfig_HU4_AR.StWhl_OFN_SnstyMd_Rq.phys = getValue(this);
    _Config_HU4_AR_SpontanFlag = 1;
}

Config_HU5_AR_check_output()
{
      if( !getValue( HMI__STMSG_Config_HU5_AR ) )
    {
        // Botschaft Config_HU5_AR ID: 1168 --- Sendeart 5 cyclicAndSpontanWithDelay --- 
        if( _Config_HU5_AR_DelayCnt > 0) _Config_HU5_AR_DelayCnt--; // Mindestsendeabstand
        _Config_HU5_AR_Cnt--;
        if( _Config_HU5_AR_Cnt < 1 )
        {
            if( _Config_HU5_AR_DelayCnt < 1 )
            {
                // Nachricht wg. abgelaufenem Zyklus ausgeben (Mindestsendeabstand eingehalten)
                Config_HU5_AR_output();
                _Config_HU5_AR_SpontanFlag = 0; // Spontan-Flag zurücksetzen
                _Config_HU5_AR_DelayCnt = _Config_HU5_AR_MinDelay;
            }
            else
            {
                // Spontanflag setzen damit nach Ablauf Mindestsendeabstand gesendet wird
                 _Config_HU5_AR_SpontanFlag = 1;
            }
            _Config_HU5_AR_Cnt = _Config_HU5_AR_CycleCount; // Zyklus-Zähler zurücksetzen
        }
        else if( _Config_HU5_AR_SpontanFlag)
        {
            if( _Config_HU5_AR_DelayCnt < 1 )
            {
                // Nachricht wg. spontaner Änderung ausgeben (Mindestsendeabstand eingehalten)
                Config_HU5_AR_output();
                _Config_HU5_AR_SpontanFlag = 0; // Spontan-Flag zurücksetzen
                _Config_HU5_AR_DelayCnt = _Config_HU5_AR_MinDelay;
            }
        }
    }
}

Config_HU5_AR_init()
{   /* Botschaft Config_HU5_AR ID: 1168 ---- Sendeart 5 cyclicAndSpontanWithDelay --- 
BA_ "ApplMessage" BO_ 1168 0;
BA_ "NmAsrMessage" BO_ 1168 0;
BA_ "GenMsgMinAcceptLength" BO_ 1168 8;
BA_ "GenMsgILSupport" BO_ 1168 1;
BA_ "DiagState" BO_ 1168 0;
BA_ "DiagRequest" BO_ 1168 0;
BA_ "DiagResponse" BO_ 1168 0;
BA_ "GenMsgStartValue" BO_ 1168 "0";
BA_ "GenMsgStartDelayTime" BO_ 1168 35;
BA_ "GenMsgDelayTime" BO_ 1168 50;
BA_ "GenMsgNrOfRepetitions" BO_ 1168 0;
BA_ "GenMsgCycleTime" BO_ 1168 1000;
BA_ "GenMsgSendType" BO_ 1168 5;
    */

    
    _Config_HU5_AR_Timebase =          c_tDBKomTimer_20ms;
    _Config_HU5_AR_CycleCount =      1000 / _Config_HU5_AR_Timebase;
    _Config_HU5_AR_StartDelay =        35 / _Config_HU5_AR_Timebase;
    _Config_HU5_AR_MinDelay =          50 / _Config_HU5_AR_Timebase;
    _Config_HU5_AR_Cnt = _Config_HU5_AR_StartDelay;
    _Config_HU5_AR_DelayCnt = 0;
    _Config_HU5_AR_SpontanFlag = 0;

    putValue( HMI__STMSGSD_Config_HU5_AR, _Config_HU5_AR_StartDelay * _Config_HU5_AR_Timebase ); 

	_mConfig_HU5_AR.BSM_FactReset_Rq_HU.phys = getValue( HMI_BSM_FactReset_Rq_HU );
    _mConfig_HU5_AR.BSM_Md_Rq_HU.phys = getValue( HMI_BSM_Md_Rq_HU );
    _mConfig_HU5_AR.CMS_FactReset_Rq_HU.phys = getValue( HMI_CMS_FactReset_Rq_HU );
    _mConfig_HU5_AR.DrowDtct_Md_Rq_HU.phys = getValue( HMI_DrowDtct_Md_Rq_HU );	
	_mConfig_HU5_AR.DTQ_FactReset_Rq_HU.phys = getValue( HMI_DTQ_FactReset_Rq_HU );	
    _mConfig_HU5_AR.DTQ_Md_Rq_HU.phys = getValue( HMI_DTQ_Md_Rq_HU );
    _mConfig_HU5_AR.ESP_Md_Rq_HU.phys = getValue( HMI_ESP_Md_Rq_HU );
    _mConfig_HU5_AR.Language_Rq_V3.phys = getValue( HMI_Language_Rq_V3 );
    _mConfig_HU5_AR.LDC_CMS_Md_Rq_HU.phys = getValue( HMI_LDC_CMS_Md_Rq_HU );
    _mConfig_HU5_AR.LDC_SLA_SpdLmtTkOvr_Md_Rq_HU.phys = getValue( HMI_LDC_SLA_SpdLmtTkOvr_Md_Rq_HU );
    _mConfig_HU5_AR.LDC_SpdUnit_Rq_HU.phys = getValue( HMI_LDC_SpdUnit_Rq_HU );
    _mConfig_HU5_AR.LDC_WTSL_Spd_Max_Rq_HU.phys = getValue( HMI_LDC_WTSL_Spd_Max_Rq_HU );	
	_mConfig_HU5_AR.LDP_FactReset_Rq_HU.phys = getValue( HMI_LDP_FactReset_Rq_HU );	
    _mConfig_HU5_AR.LDP_Md_Rq_HU.phys = getValue( HMI_LDP_Md_Rq_HU );
    _mConfig_HU5_AR.SND_GEN_Md_Rq.phys = getValue( HMI_SND_GEN_Md_Rq );
    _mConfig_HU5_AR.TC_EEBBC_Rq.phys = getValue( HMI_TC_EEBBC_Rq );
    _mConfig_HU5_AR.TSA_FactReset_Rq_HU.phys = getValue( HMI_TSA_FactReset_Rq_HU );
    _mConfig_HU5_AR.TSA_HU_DispMd_Rq_HU.phys = getValue( HMI_TSA_HU_DispMd_Rq_HU );
    _mConfig_HU5_AR.TSA_IC_DispMd_Rq_HU.phys = getValue( HMI_TSA_IC_DispMd_Rq_HU );
    _mConfig_HU5_AR.TSA_SpdWarnMd_Rq_HU.phys = getValue( HMI_TSA_SpdWarnMd_Rq_HU );
    _mConfig_HU5_AR.TSA_SpdWarnOffset_Rq_HU.phys = getValue( HMI_TSA_SpdWarnOffset_Rq_HU );
    _mConfig_HU5_AR.TSA_WarnMd_Rq_HU.phys = getValue( HMI_TSA_WarnMd_Rq_HU );
}

Config_HU5_AR_output()
{
    output( _mConfig_HU5_AR );
}

Config_HU5_AR_saveEnvVars( dword hFile )
{
    filePutString("\n// Knoten TGW: Config_HU5_AR\n", 26, hFile);
    snprintf( buffer, elcount(buffer), "0.0000 HMI__STMSG_Config_HU5_AR := %X\n", getValue( HMI__STMSG_Config_HU5_AR ) );        filePutString( buffer, elcount(buffer), hFile);
    snprintf( buffer, elcount(buffer), "0.0000 HMI__STMSGT_Config_HU5_AR := %X\n", getValue( HMI__STMSGT_Config_HU5_AR ) );        filePutString( buffer, elcount(buffer), hFile);
	snprintf( buffer, elcount(buffer), "0.0000 HMI_BSM_FactReset_Rq_HU := %X\n", getValue( HMI_BSM_FactReset_Rq_HU ) );        filePutString( buffer, elcount(buffer), hFile);	
    snprintf( buffer, elcount(buffer), "0.0000 HMI_BSM_Md_Rq_HU := %X\n", getValue( HMI_BSM_Md_Rq_HU ) );        filePutString( buffer, elcount(buffer), hFile);
    snprintf( buffer, elcount(buffer), "0.0000 HMI_CMS_FactReset_Rq_HU := %X\n", getValue( HMI_CMS_FactReset_Rq_HU ) );        filePutString( buffer, elcount(buffer), hFile);
    snprintf( buffer, elcount(buffer), "0.0000 HMI_DrowDtct_Md_Rq_HU := %X\n", getValue( HMI_DrowDtct_Md_Rq_HU ) );        filePutString( buffer, elcount(buffer), hFile);
	snprintf( buffer, elcount(buffer), "0.0000 HMI_DTQ_FactReset_Rq_HU := %X\n", getValue( HMI_DTQ_FactReset_Rq_HU ) );        filePutString( buffer, elcount(buffer), hFile);
    snprintf( buffer, elcount(buffer), "0.0000 HMI_DTQ_Md_Rq_HU := %X\n", getValue( HMI_DTQ_Md_Rq_HU ) );        filePutString( buffer, elcount(buffer), hFile);
    snprintf( buffer, elcount(buffer), "0.0000 HMI_ESP_Md_Rq_HU := %X\n", getValue( HMI_ESP_Md_Rq_HU ) );        filePutString( buffer, elcount(buffer), hFile);
    snprintf( buffer, elcount(buffer), "0.0000 HMI_Language_Rq_V3 := %X\n", getValue( HMI_Language_Rq_V3 ) );        filePutString( buffer, elcount(buffer), hFile);
    snprintf( buffer, elcount(buffer), "0.0000 HMI_LDC_CMS_Md_Rq_HU := %X\n", getValue( HMI_LDC_CMS_Md_Rq_HU ) );        filePutString( buffer, elcount(buffer), hFile);
    snprintf( buffer, elcount(buffer), "0.0000 HMI_LDC_SLA_SpdLmtTkOvr_Md_Rq_HU := %X\n", getValue( HMI_LDC_SLA_SpdLmtTkOvr_Md_Rq_HU ) );        filePutString( buffer, elcount(buffer), hFile);
    snprintf( buffer, elcount(buffer), "0.0000 HMI_LDC_SpdUnit_Rq_HU := %X\n", getValue( HMI_LDC_SpdUnit_Rq_HU ) );        filePutString( buffer, elcount(buffer), hFile);
    snprintf( buffer, elcount(buffer), "0.0000 HMI_LDC_WTSL_Spd_Max_Rq_HU := %X\n", getValue( HMI_LDC_WTSL_Spd_Max_Rq_HU ) );        filePutString( buffer, elcount(buffer), hFile);
	snprintf( buffer, elcount(buffer), "0.0000 HMI_LDP_FactReset_Rq_HU := %X\n", getValue( HMI_LDP_FactReset_Rq_HU ) );        filePutString( buffer, elcount(buffer), hFile);
    snprintf( buffer, elcount(buffer), "0.0000 HMI_LDP_Md_Rq_HU := %X\n", getValue( HMI_LDP_Md_Rq_HU ) );        filePutString( buffer, elcount(buffer), hFile);
    snprintf( buffer, elcount(buffer), "0.0000 HMI_SND_GEN_Md_Rq := %X\n", getValue( HMI_SND_GEN_Md_Rq ) );        filePutString( buffer, elcount(buffer), hFile);
    snprintf( buffer, elcount(buffer), "0.0000 HMI_TC_EEBBC_Rq := %X\n", getValue( HMI_TC_EEBBC_Rq ) );        filePutString( buffer, elcount(buffer), hFile);
    snprintf( buffer, elcount(buffer), "0.0000 HMI_TSA_FactReset_Rq_HU := %X\n", getValue( HMI_TSA_FactReset_Rq_HU ) );        filePutString( buffer, elcount(buffer), hFile);
    snprintf( buffer, elcount(buffer), "0.0000 HMI_TSA_HU_DispMd_Rq_HU := %X\n", getValue( HMI_TSA_HU_DispMd_Rq_HU ) );        filePutString( buffer, elcount(buffer), hFile);
    snprintf( buffer, elcount(buffer), "0.0000 HMI_TSA_IC_DispMd_Rq_HU := %X\n", getValue( HMI_TSA_IC_DispMd_Rq_HU ) );        filePutString( buffer, elcount(buffer), hFile);
    snprintf( buffer, elcount(buffer), "0.0000 HMI_TSA_SpdWarnMd_Rq_HU := %X\n", getValue( HMI_TSA_SpdWarnMd_Rq_HU ) );        filePutString( buffer, elcount(buffer), hFile);
    snprintf( buffer, elcount(buffer), "0.0000 HMI_TSA_SpdWarnOffset_Rq_HU := %X\n", getValue( HMI_TSA_SpdWarnOffset_Rq_HU ) );        filePutString( buffer, elcount(buffer), hFile);
    snprintf( buffer, elcount(buffer), "0.0000 HMI_TSA_WarnMd_Rq_HU := %X\n", getValue( HMI_TSA_WarnMd_Rq_HU ) );        filePutString( buffer, elcount(buffer), hFile);
}

on timer _tConfig_HU5_AR
{
    putValue( HMI__STMSG_Config_HU5_AR, 0 );
}

on EnvVar HMI__STMSG_Config_HU5_AR
{
    long tDelay;
    if( getValue( this ) == 2 )
    {
        tDelay = getValue( HMI__STMSGT_Config_HU5_AR );
        if( tDelay > 0 )    
            setTimer( _tConfig_HU5_AR, tDelay );
        else
            putValue( HMI__STMSG_Config_HU5_AR, 0 );
    }
}

on envVar HMI__STMSG_PO_Config_HU5_AR
{
    if( getValue( this ) )
        openPanel("Config_HU5_AR");
}

on EnvVar HMI_CMS_FactReset_Rq_HU
{
    _mConfig_HU5_AR.CMS_FactReset_Rq_HU.phys = getValue(this);
    _Config_HU5_AR_SpontanFlag = 1;
}

on EnvVar HMI_BSM_FactReset_Rq_HU
{
    _mConfig_HU5_AR.BSM_FactReset_Rq_HU.phys = getValue(this);
    _Config_HU5_AR_SpontanFlag = 1;
}

on EnvVar HMI_BSM_Md_Rq_HU
{
    _mConfig_HU5_AR.BSM_Md_Rq_HU.phys = getValue(this);
    _Config_HU5_AR_SpontanFlag = 1;
}

on EnvVar HMI_DrowDtct_Md_Rq_HU
{
    _mConfig_HU5_AR.DrowDtct_Md_Rq_HU.phys = getValue(this);
    _Config_HU5_AR_SpontanFlag = 1;
}

on EnvVar HMI_DTQ_FactReset_Rq_HU
{
    _mConfig_HU5_AR.DTQ_FactReset_Rq_HU.phys = getValue(this);
    _Config_HU5_AR_SpontanFlag = 1;
}

on EnvVar HMI_DTQ_Md_Rq_HU
{
    _mConfig_HU5_AR.DTQ_Md_Rq_HU.phys = getValue(this);
    _Config_HU5_AR_SpontanFlag = 1;
}

on EnvVar HMI_ESP_Md_Rq_HU
{
    _mConfig_HU5_AR.ESP_Md_Rq_HU.phys = getValue(this);
    _Config_HU5_AR_SpontanFlag = 1;
}

on EnvVar HMI_Language_Rq_V3
{
    _mConfig_HU5_AR.Language_Rq_V3.phys = getValue(this);
    _Config_HU5_AR_SpontanFlag = 1;
}

on EnvVar HMI_LDC_CMS_Md_Rq_HU
{
    _mConfig_HU5_AR.LDC_CMS_Md_Rq_HU.phys = getValue(this);
    _Config_HU5_AR_SpontanFlag = 1;
}

on EnvVar HMI_LDC_SLA_SpdLmtTkOvr_Md_Rq_HU
{
    _mConfig_HU5_AR.LDC_SLA_SpdLmtTkOvr_Md_Rq_HU.phys = getValue(this);
    _Config_HU5_AR_SpontanFlag = 1;
}

on EnvVar HMI_LDC_SpdUnit_Rq_HU
{
    _mConfig_HU5_AR.LDC_SpdUnit_Rq_HU.phys = getValue(this);
    _Config_HU5_AR_SpontanFlag = 1;
}

on EnvVar HMI_LDC_WTSL_Spd_Max_Rq_HU
{
    _mConfig_HU5_AR.LDC_WTSL_Spd_Max_Rq_HU.phys = getValue(this);
    _Config_HU5_AR_SpontanFlag = 1;
}

on EnvVar HMI_LDP_FactReset_Rq_HU
{
    _mConfig_HU5_AR.LDP_FactReset_Rq_HU.phys = getValue(this);
    _Config_HU5_AR_SpontanFlag = 1;
}

on EnvVar HMI_LDP_Md_Rq_HU
{
    _mConfig_HU5_AR.LDP_Md_Rq_HU.phys = getValue(this);
    _Config_HU5_AR_SpontanFlag = 1;
}

on EnvVar HMI_SND_GEN_Md_Rq
{
    _mConfig_HU5_AR.SND_GEN_Md_Rq.phys = getValue(this);
    _Config_HU5_AR_SpontanFlag = 1;
}

on EnvVar HMI_TC_EEBBC_Rq
{
    _mConfig_HU5_AR.TC_EEBBC_Rq.phys = getValue(this);
    _Config_HU5_AR_SpontanFlag = 1;
}

on EnvVar HMI_TSA_FactReset_Rq_HU
{
    _mConfig_HU5_AR.TSA_FactReset_Rq_HU.phys = getValue(this);
    _Config_HU5_AR_SpontanFlag = 1;
}

on EnvVar HMI_TSA_HU_DispMd_Rq_HU
{
    _mConfig_HU5_AR.TSA_HU_DispMd_Rq_HU.phys = getValue(this);
    _Config_HU5_AR_SpontanFlag = 1;
}

on EnvVar HMI_TSA_IC_DispMd_Rq_HU
{
    _mConfig_HU5_AR.TSA_IC_DispMd_Rq_HU.phys = getValue(this);
    _Config_HU5_AR_SpontanFlag = 1;
}

on EnvVar HMI_TSA_SpdWarnMd_Rq_HU
{
    _mConfig_HU5_AR.TSA_SpdWarnMd_Rq_HU.phys = getValue(this);
    _Config_HU5_AR_SpontanFlag = 1;
}

on EnvVar HMI_TSA_SpdWarnOffset_Rq_HU
{
    _mConfig_HU5_AR.TSA_SpdWarnOffset_Rq_HU.phys = getValue(this);
    _Config_HU5_AR_SpontanFlag = 1;
}

on EnvVar HMI_TSA_WarnMd_Rq_HU
{
    _mConfig_HU5_AR.TSA_WarnMd_Rq_HU.phys = getValue(this);
    _Config_HU5_AR_SpontanFlag = 1;
}

Config_HU6_AR_check_output()
{
      if( !getValue( HMI__STMSG_Config_HU6_AR ) )
    {
        // Botschaft Config_HU6_AR ID: 1148 --- Sendeart 5 cyclicAndSpontanWithDelay --- 
        if( _Config_HU6_AR_DelayCnt > 0) _Config_HU6_AR_DelayCnt--; // Mindestsendeabstand
        _Config_HU6_AR_Cnt--;
        if( _Config_HU6_AR_Cnt < 1 )
        {
            if( _Config_HU6_AR_DelayCnt < 1 )
            {
                // Nachricht wg. abgelaufenem Zyklus ausgeben (Mindestsendeabstand eingehalten)
                Config_HU6_AR_output();
                _Config_HU6_AR_SpontanFlag = 0; // Spontan-Flag zurücksetzen
                _Config_HU6_AR_DelayCnt = _Config_HU6_AR_MinDelay;
            }
            else
            {
                // Spontanflag setzen damit nach Ablauf Mindestsendeabstand gesendet wird
                 _Config_HU6_AR_SpontanFlag = 1;
            }
            _Config_HU6_AR_Cnt = _Config_HU6_AR_CycleCount; // Zyklus-Zähler zurücksetzen
        }
        else if( _Config_HU6_AR_SpontanFlag)
        {
            if( _Config_HU6_AR_DelayCnt < 1 )
            {
                // Nachricht wg. spontaner Änderung ausgeben (Mindestsendeabstand eingehalten)
                Config_HU6_AR_output();
                _Config_HU6_AR_SpontanFlag = 0; // Spontan-Flag zurücksetzen
                _Config_HU6_AR_DelayCnt = _Config_HU6_AR_MinDelay;
            }
        }
    }
}

Config_HU6_AR_init()
{   /* Botschaft Config_HU6_AR ID: 1148 ---- Sendeart 5 cyclicAndSpontanWithDelay --- 
BA_ "ApplMessage" BO_ 1148 0;
BA_ "NmAsrMessage" BO_ 1148 0;
BA_ "GenMsgMinAcceptLength" BO_ 1148 8;
BA_ "GenMsgILSupport" BO_ 1148 1;
BA_ "DiagState" BO_ 1148 0;
BA_ "DiagRequest" BO_ 1148 0;
BA_ "DiagResponse" BO_ 1148 0;
BA_ "GenMsgStartValue" BO_ 1148 "0";
BA_ "GenMsgStartDelayTime" BO_ 1148 250;
BA_ "GenMsgDelayTime" BO_ 1148 50;
BA_ "GenMsgNrOfRepetition" BO_ 1148 0;
BA_ "GenMsgCycleTime" BO_ 1148 1000;
BA_ "GenMsgSendType" BO_ 1148 5;
    */

    
    _Config_HU6_AR_Timebase =          c_tDBKomTimer_20ms;
    _Config_HU6_AR_CycleCount =      1000 / _Config_HU6_AR_Timebase;
    _Config_HU6_AR_StartDelay =       250 / _Config_HU6_AR_Timebase;
    _Config_HU6_AR_MinDelay =          50 / _Config_HU6_AR_Timebase;
    _Config_HU6_AR_Cnt = _Config_HU6_AR_StartDelay;
    _Config_HU6_AR_DelayCnt = 0;
    _Config_HU6_AR_SpontanFlag = 0;

    putValue( HMI__STMSGSD_Config_HU6_AR, _Config_HU6_AR_StartDelay * _Config_HU6_AR_Timebase ); 

	  _mConfig_HU6_AR.DTQ_LaneChg_Md_Rq_HU.phys = getValue( HMI_DTQ_LaneChg_Md_Rq_HU );
    _mConfig_HU6_AR.DTR_Curve_Md_Rq_HU.phys = getValue( HMI_DTR_Curve_Md_Rq_HU);
    _mConfig_HU6_AR.DTR_FactReset_Rq_HU.phys = getValue( HMI_DTR_FactReset_Rq_HU );
    _mConfig_HU6_AR.RDOS_Md_Rq_HU.phys = getValue( HMI_RDOS_Md_Rq_HU );
    _mConfig_HU6_AR.LDC_CMS_PreWarn_Md_Rq_HU.phys = getValue( HMI_LDC_CMS_PreWarn_Md_Rq_HU );	
	  _mConfig_HU6_AR.SSA_Md_Rq_HU.phys = getValue( HMI_SSA_Md_Rq_HU );	
	  _mConfig_HU6_AR.DSR_Softkey_Psd.phys = getValue( HMI_DSR_Softkey_Psd );
    _mConfig_HU6_AR.TSA_SpdWarnOffset1_Rq_HU.phys = getValue( HMI_TSA_SpdWarnOffset1_Rq_HU );
    _mConfig_HU6_AR.TSA_SpdWarnOffset2_Rq_HU.phys = getValue( HMI_TSA_SpdWarnOffset2_Rq_HU );
    _mConfig_HU6_AR.TSA_SpdWarnOffset_Disp_Rq_HU.phys = getValue( HMI_TSA_SpdWarnOffset_Disp_Rq_HU );	
	  _mConfig_HU6_AR.TSA_SpdWarnOffset_Gen_Rq_HU.phys = getValue( HMI_TSA_SpdWarnOffset_Gen_Rq_HU );	
    _mConfig_HU6_AR.TSA_SpdWarnOffset_Unit_Rq_HU.phys = getValue( HMI_TSA_SpdWarnOffset_Unit_Rq_HU );
    _mConfig_HU6_AR.TSA_SpdWarnThrs_Rq_HU.phys = getValue( HMI_TSA_SpdWarnThrs_Rq_HU );
    _mConfig_HU6_AR.TSA_SpdWarnOffsetBase_Rq_HU.phys = getValue( HMI_TSA_SpdWarnOffsetBase_Rq_HU );
    _mConfig_HU6_AR.IndWhlAdj_Rq_HU.phys = getValue( HMI_IndWhlAdj_Rq_HU );
    _mConfig_HU6_AR.VehLvl_Offset_FL_Rq_HU.phys = getValue( HMI_VehLvl_Offset_FL_Rq_HU );
    _mConfig_HU6_AR.VehLvl_Offset_FR_Rq_HU.phys = getValue( HMI_VehLvl_Offset_FR_Rq_HU );
    _mConfig_HU6_AR.VehLvl_Offset_RL_Rq_HU.phys = getValue( HMI_VehLvl_Offset_RL_Rq_HU );
    _mConfig_HU6_AR.VehLvl_Offset_RR_Rq_HU.phys = getValue( HMI_VehLvl_Offset_RR_Rq_HU );
}

Config_HU6_AR_output()
{
    output( _mConfig_HU6_AR );
}

Config_HU6_AR_saveEnvVars( dword hFile )
{
    filePutString("\n// Knoten TGW: Config_HU6_AR\n", 26, hFile);
    snprintf( buffer, elcount(buffer), "0.0000 HMI__STMSG_Config_HU6_AR := %X\n", getValue( HMI__STMSG_Config_HU6_AR ) );        filePutString( buffer, elcount(buffer), hFile);
    snprintf( buffer, elcount(buffer), "0.0000 HMI__STMSGT_Config_HU6_AR := %X\n", getValue( HMI__STMSGT_Config_HU6_AR ) );        filePutString( buffer, elcount(buffer), hFile);
	  snprintf( buffer, elcount(buffer), "0.0000 HMI_DTQ_LaneChg_Md_Rq_HU := %X\n", getValue( HMI_DTQ_LaneChg_Md_Rq_HU ) );        filePutString( buffer, elcount(buffer), hFile);	
    snprintf( buffer, elcount(buffer), "0.0000 HMI_DTR_Curve_Md_Rq_HU := %X\n", getValue( HMI_DTR_Curve_Md_Rq_HU ) );        filePutString( buffer, elcount(buffer), hFile);
    snprintf( buffer, elcount(buffer), "0.0000 HMI_DTR_FactReset_Rq_HU := %X\n", getValue( HMI_DTR_FactReset_Rq_HU ) );        filePutString( buffer, elcount(buffer), hFile);
    snprintf( buffer, elcount(buffer), "0.0000 HMI_RDOS_Md_Rq_HU := %X\n", getValue( HMI_RDOS_Md_Rq_HU ) );        filePutString( buffer, elcount(buffer), hFile);
    snprintf( buffer, elcount(buffer), "0.0000 HMI_LDC_CMS_PreWarn_Md_Rq_HU := %X\n", getValue( HMI_LDC_CMS_PreWarn_Md_Rq_HU ) );        filePutString( buffer, elcount(buffer), hFile);
	  snprintf( buffer, elcount(buffer), "0.0000 HMI_SSA_Md_Rq_HU := %X\n", getValue( HMI_SSA_Md_Rq_HU ) );        filePutString( buffer, elcount(buffer), hFile);
	  snprintf( buffer, elcount(buffer), "0.0000 HMI_DSR_Softkey_Psd := %X\n", getValue( HMI_DSR_Softkey_Psd ) );        filePutString( buffer, elcount(buffer), hFile);	
    snprintf( buffer, elcount(buffer), "0.0000 HMI_TSA_SpdWarnOffset1_Rq_HU := %X\n", getValue( HMI_TSA_SpdWarnOffset1_Rq_HU ) );        filePutString( buffer, elcount(buffer), hFile);
    snprintf( buffer, elcount(buffer), "0.0000 HMI_TSA_SpdWarnOffset2_Rq_HU := %X\n", getValue( HMI_TSA_SpdWarnOffset2_Rq_HU ) );        filePutString( buffer, elcount(buffer), hFile);
    snprintf( buffer, elcount(buffer), "0.0000 HMI_TSA_SpdWarnOffset_Disp_Rq_HU := %X\n", getValue( HMI_TSA_SpdWarnOffset_Disp_Rq_HU ) );        filePutString( buffer, elcount(buffer), hFile);
	  snprintf( buffer, elcount(buffer), "0.0000 HMI_TSA_SpdWarnOffset_Gen_Rq_HU := %X\n", getValue( HMI_TSA_SpdWarnOffset_Gen_Rq_HU ) );        filePutString( buffer, elcount(buffer), hFile);
    snprintf( buffer, elcount(buffer), "0.0000 HMI_TSA_SpdWarnOffset_Unit_Rq_HU := %X\n", getValue( HMI_TSA_SpdWarnOffset_Unit_Rq_HU ) );        filePutString( buffer, elcount(buffer), hFile);
    snprintf( buffer, elcount(buffer), "0.0000 HMI_TSA_SpdWarnThrs_Rq_HU := %X\n", getValue( HMI_TSA_SpdWarnThrs_Rq_HU ) );        filePutString( buffer, elcount(buffer), hFile);
    snprintf( buffer, elcount(buffer), "0.0000 HMI_TSA_SpdWarnOffsetBase_Rq_HU := %X\n", getValue( HMI_TSA_SpdWarnOffsetBase_Rq_HU ) );        filePutString( buffer, elcount(buffer), hFile);
    snprintf( buffer, elcount(buffer), "0.0000 HMI_IndWhlAdj_Rq_HU := %X\n", getValue( HMI_IndWhlAdj_Rq_HU ) );        filePutString( buffer, elcount(buffer), hFile);
    snprintf( buffer, elcount(buffer), "0.0000 HMI_VehLvl_Offset_FL_Rq_HU := %X\n", getValue( HMI_VehLvl_Offset_FL_Rq_HU ) );        filePutString( buffer, elcount(buffer), hFile);
    snprintf( buffer, elcount(buffer), "0.0000 HMI_VehLvl_Offset_FR_Rq_HU := %X\n", getValue( HMI_VehLvl_Offset_FR_Rq_HU ) );        filePutString( buffer, elcount(buffer), hFile);
    snprintf( buffer, elcount(buffer), "0.0000 HMI_VehLvl_Offset_RL_Rq_HU := %X\n", getValue( HMI_VehLvl_Offset_RL_Rq_HU ) );        filePutString( buffer, elcount(buffer), hFile);
    snprintf( buffer, elcount(buffer), "0.0000 HMI_VehLvl_Offset_RR_Rq_HU := %X\n", getValue( HMI_VehLvl_Offset_RR_Rq_HU ) );        filePutString( buffer, elcount(buffer), hFile);
  
}

on timer _tConfig_HU6_AR
{
    putValue( HMI__STMSG_Config_HU6_AR, 0 );
}

on EnvVar HMI__STMSG_Config_HU6_AR
{
    long tDelay;
    if( getValue( this ) == 2 )
    {
        tDelay = getValue( HMI__STMSGT_Config_HU6_AR );
        if( tDelay > 0 )    
            setTimer( _tConfig_HU6_AR, tDelay );
        else
            putValue( HMI__STMSG_Config_HU6_AR, 0 );
    }
}

on envVar HMI__STMSG_PO_Config_HU6_AR
{
    if( getValue( this ) )
        openPanel("Config_HU6_AR");
}

on EnvVar HMI_DTQ_LaneChg_Md_Rq_HU
{
    _mConfig_HU6_AR.DTQ_LaneChg_Md_Rq_HU.phys = getValue(this);
    _Config_HU6_AR_SpontanFlag = 1;
}

on EnvVar HMI_DTR_Curve_Md_Rq_HU
{
    _mConfig_HU6_AR.DTR_Curve_Md_Rq_HU.phys = getValue(this);
    _Config_HU6_AR_SpontanFlag = 1;
}

on EnvVar HMI_DTR_FactReset_Rq_HU
{
    _mConfig_HU6_AR.DTR_FactReset_Rq_HU.phys = getValue(this);
    _Config_HU6_AR_SpontanFlag = 1;
}

on EnvVar HMI_RDOS_Md_Rq_HU
{
    _mConfig_HU6_AR.RDOS_Md_Rq_HU.phys = getValue(this);
    _Config_HU6_AR_SpontanFlag = 1;
}

on EnvVar HMI_LDC_CMS_PreWarn_Md_Rq_HU
{
    _mConfig_HU6_AR.LDC_CMS_PreWarn_Md_Rq_HU.phys = getValue(this);
    _Config_HU6_AR_SpontanFlag = 1;
}

on EnvVar HMI_SSA_Md_Rq_HU
{
    _mConfig_HU6_AR.SSA_Md_Rq_HU.phys = getValue(this);
    _Config_HU6_AR_SpontanFlag = 1;
}

on EnvVar HMI_TSA_SpdWarnOffset2_Rq_HU
{
    _mConfig_HU6_AR.TSA_SpdWarnOffset2_Rq_HU.phys = getValue(this);
    _Config_HU6_AR_SpontanFlag = 1;
}

on EnvVar HMI_DSR_Softkey_Psd
{
    _mConfig_HU6_AR.DSR_Softkey_Psd.phys = getValue(this);
    _Config_HU6_AR_SpontanFlag = 1;
}

on EnvVar HMI_TSA_SpdWarnOffset1_Rq_HU
{
    _mConfig_HU6_AR.TSA_SpdWarnOffset1_Rq_HU.phys = getValue(this);
    _Config_HU6_AR_SpontanFlag = 1;
}

on EnvVar HMI_TSA_SpdWarnOffset_Disp_Rq_HU
{
    _mConfig_HU6_AR.TSA_SpdWarnOffset_Disp_Rq_HU.phys = getValue(this);
    _Config_HU6_AR_SpontanFlag = 1;
}

on EnvVar HMI_TSA_SpdWarnOffset_Gen_Rq_HU
{
    _mConfig_HU6_AR.TSA_SpdWarnOffset_Gen_Rq_HU.phys = getValue(this);
    _Config_HU6_AR_SpontanFlag = 1;
}

on EnvVar HMI_TSA_SpdWarnOffset_Unit_Rq_HU
{
    _mConfig_HU6_AR.TSA_SpdWarnOffset_Unit_Rq_HU.phys = getValue(this);
    _Config_HU6_AR_SpontanFlag = 1;
}

on EnvVar HMI_TSA_SpdWarnThrs_Rq_HU
{
    _mConfig_HU6_AR.TSA_SpdWarnThrs_Rq_HU.phys = getValue(this);
    _Config_HU6_AR_SpontanFlag = 1;
}

on EnvVar HMI_TSA_SpdWarnOffsetBase_Rq_HU
{
    _mConfig_HU6_AR.TSA_SpdWarnOffsetBase_Rq_HU.phys = getValue(this);
    _Config_HU6_AR_SpontanFlag = 1;
}

on EnvVar HMI_IndWhlAdj_Rq_HU
{
    _mConfig_HU6_AR.IndWhlAdj_Rq_HU.phys = getValue(this);
    _Config_HU6_AR_SpontanFlag = 1;
}

on EnvVar HMI_VehLvl_Offset_FL_Rq_HU
{
    _mConfig_HU6_AR.VehLvl_Offset_FL_Rq_HU.phys = getValue(this);
    _Config_HU6_AR_SpontanFlag = 1;
}

on EnvVar HMI_VehLvl_Offset_FR_Rq_HU
{
    _mConfig_HU6_AR.VehLvl_Offset_FR_Rq_HU.phys = getValue(this);
    _Config_HU6_AR_SpontanFlag = 1;
}

on EnvVar HMI_VehLvl_Offset_RL_Rq_HU
{
    _mConfig_HU6_AR.VehLvl_Offset_RL_Rq_HU.phys = getValue(this);
    _Config_HU6_AR_SpontanFlag = 1;
}

on EnvVar HMI_VehLvl_Offset_RR_Rq_HU
{
    _mConfig_HU6_AR.VehLvl_Offset_RR_Rq_HU.phys = getValue(this);
    _Config_HU6_AR_SpontanFlag = 1;
}

Config_HU7_AR_check_output()
{
      if( !getValue( HMI__STMSG_Config_HU7_AR ) )
    {
        // Botschaft Config_HU7_AR ID: 820 --- Sendeart 5 cyclicAndSpontanWithDelay --- 
        if( _Config_HU7_AR_DelayCnt > 0) _Config_HU7_AR_DelayCnt--; // Mindestsendeabstand
        _Config_HU7_AR_Cnt--;
        if( _Config_HU7_AR_Cnt < 1 )
        {
            if( _Config_HU7_AR_DelayCnt < 1 )
            {
                // Nachricht wg. abgelaufenem Zyklus ausgeben (Mindestsendeabstand eingehalten)
                Config_HU7_AR_output();
                _Config_HU7_AR_SpontanFlag = 0; // Spontan-Flag zurücksetzen
                _Config_HU7_AR_DelayCnt = _Config_HU7_AR_MinDelay;
            }
            else
            {
                // Spontanflag setzen damit nach Ablauf Mindestsendeabstand gesendet wird
                 _Config_HU7_AR_SpontanFlag = 1;
            }
            _Config_HU7_AR_Cnt = _Config_HU7_AR_CycleCount; // Zyklus-Zähler zurücksetzen
        }
        else if( _Config_HU7_AR_SpontanFlag)
        {
            if( _Config_HU7_AR_DelayCnt < 1 )
            {
                // Nachricht wg. spontaner Änderung ausgeben (Mindestsendeabstand eingehalten)
                Config_HU7_AR_output();
                _Config_HU7_AR_SpontanFlag = 0; // Spontan-Flag zurücksetzen
                _Config_HU7_AR_DelayCnt = _Config_HU7_AR_MinDelay;
            }
        }
    }
}

Config_HU7_AR_init()
{   /* Botschaft Config_HU7_AR ID: 820 ---- Sendeart 5 cyclicAndSpontanWithDelay --- 
BA_ "ApplMessage" BO_ 820 0;
BA_ "NmAsrMessage" BO_ 820 0;
BA_ "GenMsgMinAcceptLength" BO_ 820 8;
BA_ "GenMsgILSupport" BO_ 820 1;
BA_ "DiagState" BO_ 820 0;
BA_ "DiagRequest" BO_ 820 0;
BA_ "DiagResponse" BO_ 820 0;
BA_ "GenMsgStartValue" BO_ 820 "0";
BA_ "GenMsgStartDelayTime" BO_ 820 290;
BA_ "GenMsgDelayTime" BO_ 820 100;
BA_ "GenMsgNrOfRepetition" BO_ 820 0;
BA_ "GenMsgCycleTime" BO_ 820 1000;
BA_ "GenMsgSendType" BO_ 820 5;
    */

    
    _Config_HU7_AR_Timebase =          c_tDBKomTimer_20ms;
    _Config_HU7_AR_CycleCount =      1000 / _Config_HU7_AR_Timebase;
    _Config_HU7_AR_StartDelay =       290 / _Config_HU7_AR_Timebase;
    _Config_HU7_AR_MinDelay =         100 / _Config_HU7_AR_Timebase;
    _Config_HU7_AR_Cnt = _Config_HU7_AR_StartDelay;
    _Config_HU7_AR_DelayCnt = 0;
    _Config_HU7_AR_SpontanFlag = 0;

    putValue( HMI__STMSGSD_Config_HU7_AR, _Config_HU7_AR_StartDelay * _Config_HU7_AR_Timebase ); 

	_mConfig_HU7_AR.RemUpdt_Boot_HU_Actv.phys = getValue( HMI_RemUpdt_Boot_HU_Actv );
  _mConfig_HU7_AR.Carwash_Rq_HU.phys = getValue( HMI_Carwash_Rq_HU );
}

Config_HU7_AR_output()
{
    output( _mConfig_HU7_AR );
}

Config_HU7_AR_saveEnvVars( dword hFile )
{
    filePutString("\n// Knoten TGW: Config_HU7_AR\n", 26, hFile);
    snprintf( buffer, elcount(buffer), "0.0000 HMI__STMSG_Config_HU7_AR := %X\n", getValue( HMI__STMSG_Config_HU7_AR ) );        filePutString( buffer, elcount(buffer), hFile);
}

on timer _tConfig_HU7_AR
{
    putValue( HMI__STMSG_Config_HU7_AR, 0 );
}

on EnvVar HMI__STMSG_Config_HU7_AR
{
    long tDelay;
    if( getValue( this ) == 2 )
    {
        tDelay = getValue( HMI__STMSGT_Config_HU7_AR );
        if( tDelay > 0 )    
            setTimer( _tConfig_HU7_AR, tDelay );
        else
            putValue( HMI__STMSG_Config_HU7_AR, 0 );
    }
}

on envVar HMI__STMSG_PO_Config_HU7_AR
{
    if( getValue( this ) )
        openPanel("Config_HU7_AR");
}

on EnvVar HMI_RemUpdt_Boot_HU_Actv
{
    _mConfig_HU7_AR.RemUpdt_Boot_HU_Actv.phys = getValue(this);
    _Config_HU7_AR_SpontanFlag = 1;
}

on EnvVar HMI_Carwash_Rq_HU
{
    _mConfig_HU7_AR.Carwash_Rq_HU.phys = getValue(this);
    _Config_HU7_AR_SpontanFlag = 1;
}

Config_HU_Disp_Rq_AR_check_output()
{
      if( !getValue( HMI__STMSG_Config_HU_Disp_Rq_AR ) )
    {
        // Botschaft Config_HU_Disp_Rq_AR ID: 1090 --- Sendeart 5 cyclicAndSpontanWithDelay --- 
        if( _Config_HU_Disp_Rq_AR_DelayCnt > 0) _Config_HU_Disp_Rq_AR_DelayCnt--; // Mindestsendeabstand
        _Config_HU_Disp_Rq_AR_Cnt--;
        if( _Config_HU_Disp_Rq_AR_Cnt < 1 )
        {
            if( _Config_HU_Disp_Rq_AR_DelayCnt < 1 )
            {
                // Nachricht wg. abgelaufenem Zyklus ausgeben (Mindestsendeabstand eingehalten)
                Config_HU_Disp_Rq_AR_output();
                 _Config_HU_Disp_Rq_AR_SpontanFlag = 0; // Spontan-Flag zurücksetzen
                _Config_HU_Disp_Rq_AR_DelayCnt = _Config_HU_Disp_Rq_AR_MinDelay;
            }
            else
            {
                // Spontanflag setzen damit nach Ablauf Mindestsendeabstand gesendet wird
                 _Config_HU_Disp_Rq_AR_SpontanFlag = 1;
            }
            _Config_HU_Disp_Rq_AR_Cnt = _Config_HU_Disp_Rq_AR_CycleCount; // Zyklus-Zähler zurücksetzen
        }
        else if( _Config_HU_Disp_Rq_AR_SpontanFlag)
        {
            if( _Config_HU_Disp_Rq_AR_DelayCnt < 1 )
            {
                // Nachricht wg. spontaner Änderung ausgeben (Mindestsendeabstand eingehalten)
                Config_HU_Disp_Rq_AR_output();
                _Config_HU_Disp_Rq_AR_SpontanFlag = 0; // Spontan-Flag zurücksetzen
                _Config_HU_Disp_Rq_AR_DelayCnt = _Config_HU_Disp_Rq_AR_MinDelay;
            }
        }
    }
}

Config_HU_Disp_Rq_AR_init()
{    /* Botschaft Config_HU_Disp_Rq_AR ID: 1090 ---- Sendeart 5 cyclicAndSpontanWithDelay --- 
BA_ "ApplMessage" BO_ 1090 0;
BA_ "NmAsrMessage" BO_ 1090 0;
BA_ "GenMsgMinAcceptLength" BO_ 1090 8;
BA_ "GenMsgILSupport" BO_ 1090 1;
BA_ "DiagState" BO_ 1090 0;
BA_ "DiagRequest" BO_ 1090 0;
BA_ "DiagResponse" BO_ 1090 0;
BA_ "GenMsgStartValue" BO_ 1090 "0";
BA_ "GenMsgStartDelayTime" BO_ 1090 230;
BA_ "GenMsgDelayTime" BO_ 1090 50;
BA_ "GenMsgNrOfRepetitions" BO_ 1090 0;
BA_ "GenMsgCycleTime" BO_ 1090 1000;
BA_ "GenMsgSendType" BO_ 1090 5;
    */

    _Config_HU_Disp_Rq_AR_Timebase =          c_tDBKomTimer_20ms;
    _Config_HU_Disp_Rq_AR_CycleCount =      1000 / _Config_HU_Disp_Rq_AR_Timebase;
    _Config_HU_Disp_Rq_AR_StartDelay =       230 / _Config_HU_Disp_Rq_AR_Timebase;
    _Config_HU_Disp_Rq_AR_MinDelay =          50 / _Config_HU_Disp_Rq_AR_Timebase;
    _Config_HU_Disp_Rq_AR_Cnt = _Config_HU_Disp_Rq_AR_StartDelay;
    _Config_HU_Disp_Rq_AR_DelayCnt = 0;
    _Config_HU_Disp_Rq_AR_SpontanFlag = 0;

    putValue( HMI__STMSGSD_Config_HU_Disp_Rq_AR, _Config_HU_Disp_Rq_AR_StartDelay * _Config_HU_Disp_Rq_AR_Timebase ); 

    _mConfig_HU_Disp_Rq_AR.AFS_Md_Cfg_Disp_Rq_HU.phys = getValue( HMI_AFS_Md_Cfg_Disp_Rq_HU );
    _mConfig_HU_Disp_Rq_AR.BSM_Md_Disp_Rq_HU.phys = getValue( HMI_BSM_Md_Disp_Rq_HU );
    _mConfig_HU_Disp_Rq_AR.CNG_FuelMdChg_Disp_Rq_HU.phys = getValue( HMI_CNG_FuelMdChg_Disp_Rq_HU );
    _mConfig_HU_Disp_Rq_AR.DrowDtct_Md_Disp_Rq_HU.phys = getValue( HMI_DrowDtct_Md_Disp_Rq_HU );
    _mConfig_HU_Disp_Rq_AR.DTQ_LaneChg_Md_Disp_Rq_HU.phys = getValue( HMI_DTQ_LaneChg_Md_Disp_Rq_HU );
	  _mConfig_HU_Disp_Rq_AR.DTQ_Md_Disp_Rq_HU.phys = getValue( HMI_DTQ_Md_Disp_Rq_HU );
	  _mConfig_HU_Disp_Rq_AR.DTR_Curve_Disp_Rq_HU.phys = getValue( HMI_DTR_Curve_Disp_Rq_HU );
    _mConfig_HU_Disp_Rq_AR.ILS_TouristMd_Disp_Rq_HU.phys = getValue( HMI_ILS_TouristMd_Disp_Rq_HU );
    _mConfig_HU_Disp_Rq_AR.LCMS_Md_Disp_Rq_HU.phys = getValue( HMI_LCMS_Md_Disp_Rq_HU );
    _mConfig_HU_Disp_Rq_AR.LDC_CMS_Md_Disp_Rq_HU.phys = getValue( HMI_LDC_CMS_Md_Disp_Rq_HU );
    _mConfig_HU_Disp_Rq_AR.LDC_WTSL_Spd_Max_Disp_Rq_HU.phys = getValue( HMI_LDC_WTSL_Spd_Max_Disp_Rq_HU );
    _mConfig_HU_Disp_Rq_AR.LDP_Md_Disp_Rq_HU.phys = getValue( HMI_LDP_Md_Disp_Rq_HU );
    _mConfig_HU_Disp_Rq_AR.NVP_SPL_Md_Disp_Rq_HU.phys = getValue( HMI_NVP_SPL_Md_Disp_Rq_HU );
    _mConfig_HU_Disp_Rq_AR.Park_BrkMd_Disp_Rq_HU.phys = getValue( HMI_Park_BrkMd_Disp_Rq_HU );
    _mConfig_HU_Disp_Rq_AR.DSR_Softkey_Disp_Rq_HU.phys = getValue( HMI_DSR_Softkey_Disp_Rq_HU );
    _mConfig_HU_Disp_Rq_AR.ILS_TouristMd_Disp_Rq_HU_V2.phys = getValue( HMI_ILS_TouristMd_Disp_Rq_HU_V2 );
    _mConfig_HU_Disp_Rq_AR.Park_Softkey_Disp_Rq_HU.phys = getValue( HMI_Park_Softkey_Disp_Rq_HU );
    _mConfig_HU_Disp_Rq_AR.VehDrvProg_M_Disp_Rq_HU.phys = getValue( HMI_VehDrvProg_M_Disp_Rq_HU );
    _mConfig_HU_Disp_Rq_AR.LDP_Sensitive_Md_Disp_Rq.phys = getValue( HMI_LDP_Sensitive_Md_Disp_Rq );  
    _mConfig_HU_Disp_Rq_AR.FDC_Md_Disp_Rq_HU.phys = getValue( HMI_FDC_Md_Disp_Rq_HU );
    _mConfig_HU_Disp_Rq_AR.SwIllLvl_Rq_HU_AMG.phys = getValue( HMI_SwIllLvl_Rq_HU_AMG );
}

Config_HU_Disp_Rq_AR_output()
{
    output( _mConfig_HU_Disp_Rq_AR );
}

Config_HU_Disp_Rq_AR_saveEnvVars( dword hFile )
{
    filePutString("\n// Knoten EIS: Config_HU_Disp_Rq_AR\n", 27, hFile );
    snprintf( buffer, elcount( buffer ), "0.0000 HMI__STMSG_Config_HU_Disp_Rq_AR := %X\n", getValue( HMI__STMSG_Config_HU_Disp_Rq_AR ) );        filePutString ( buffer, elcount( buffer ), hFile );
    snprintf( buffer, elcount( buffer ), "0.0000 HMI__STMSGT_Config_HU_Disp_Rq_AR := %X\n", getValue( HMI__STMSGT_Config_HU_Disp_Rq_AR ) );        filePutString ( buffer, elcount( buffer ), hFile );
    snprintf( buffer, elcount( buffer ), "0.0000 HMI_AFS_Md_Cfg_Disp_Rq_HU := %X\n", getValue( HMI_AFS_Md_Cfg_Disp_Rq_HU ) );        filePutString ( buffer, elcount( buffer ), hFile );
    snprintf( buffer, elcount( buffer ), "0.0000 HMI_BSM_Md_Disp_Rq_HU := %X\n", getValue( HMI_BSM_Md_Disp_Rq_HU ) );        filePutString ( buffer, elcount( buffer ), hFile );
    snprintf( buffer, elcount( buffer ), "0.0000 HMI_CNG_FuelMdChg_Disp_Rq_HU := %X\n", getValue( HMI_CNG_FuelMdChg_Disp_Rq_HU ) );        filePutString ( buffer, elcount( buffer ), hFile );
    snprintf( buffer, elcount( buffer ), "0.0000 HMI_DrowDtct_Md_Disp_Rq_HU := %X\n", getValue( HMI_DrowDtct_Md_Disp_Rq_HU ) );        filePutString ( buffer, elcount( buffer ), hFile );
    snprintf( buffer, elcount( buffer ), "0.0000 HMI_DTQ_LaneChg_Md_Disp_Rq_HU := %X\n", getValue( HMI_DTQ_LaneChg_Md_Disp_Rq_HU ) );        filePutString ( buffer, elcount( buffer ), hFile );
	  snprintf( buffer, elcount( buffer ), "0.0000 HMI_DTQ_Md_Disp_Rq_HU := %X\n", getValue( HMI_DTQ_Md_Disp_Rq_HU ) );        filePutString ( buffer, elcount( buffer ), hFile );
	  snprintf( buffer, elcount( buffer ), "0.0000 HMI_DTR_Curve_Disp_Rq_HU := %X\n", getValue( HMI_DTR_Curve_Disp_Rq_HU ) );        filePutString ( buffer, elcount( buffer ), hFile );
    snprintf( buffer, elcount( buffer ), "0.0000 HMI_ILS_TouristMd_Disp_Rq_HU := %X\n", getValue( HMI_ILS_TouristMd_Disp_Rq_HU ) );        filePutString ( buffer, elcount( buffer ), hFile );
    snprintf( buffer, elcount( buffer ), "0.0000 HMI_LCMS_Md_Disp_Rq_HU := %X\n", getValue( HMI_LCMS_Md_Disp_Rq_HU ) );        filePutString ( buffer, elcount( buffer ), hFile );
    snprintf( buffer, elcount( buffer ), "0.0000 HMI_LDC_CMS_Md_Disp_Rq_HU := %X\n", getValue( HMI_LDC_CMS_Md_Disp_Rq_HU ) );        filePutString ( buffer, elcount( buffer ), hFile );
    snprintf( buffer, elcount( buffer ), "0.0000 HMI_LDC_WTSL_Spd_Max_Disp_Rq_HU := %X\n", getValue( HMI_LDC_WTSL_Spd_Max_Disp_Rq_HU ) );        filePutString ( buffer, elcount( buffer ), hFile );
    snprintf( buffer, elcount( buffer ), "0.0000 HMI_LDP_Md_Disp_Rq_HU := %X\n", getValue( HMI_LDP_Md_Disp_Rq_HU ) );        filePutString ( buffer, elcount( buffer ), hFile );
    snprintf( buffer, elcount( buffer ), "0.0000 HMI_NVP_SPL_Md_Disp_Rq_HU := %X\n", getValue( HMI_NVP_SPL_Md_Disp_Rq_HU ) );        filePutString ( buffer, elcount( buffer ), hFile );
    snprintf( buffer, elcount( buffer ), "0.0000 HMI_Park_BrkMd_Disp_Rq_HU := %X\n", getValue( HMI_Park_BrkMd_Disp_Rq_HU ) );        filePutString ( buffer, elcount( buffer ), hFile );
    snprintf( buffer, elcount( buffer ), "0.0000 HMI_DSR_Softkey_Disp_Rq_HU := %X\n", getValue( HMI_DSR_Softkey_Disp_Rq_HU ) );        filePutString ( buffer, elcount( buffer ), hFile );
    snprintf( buffer, elcount( buffer ), "0.0000 HMI_ILS_TouristMd_Disp_Rq_HU_V2 := %X\n", getValue( HMI_ILS_TouristMd_Disp_Rq_HU_V2 ) );        filePutString ( buffer, elcount( buffer ), hFile );
    snprintf( buffer, elcount( buffer ), "0.0000 HMI_Park_Softkey_Disp_Rq_HU := %X\n", getValue( HMI_Park_Softkey_Disp_Rq_HU ) );        filePutString ( buffer, elcount( buffer ), hFile );
    snprintf( buffer, elcount( buffer ), "0.0000 HMI_VehDrvProg_M_Disp_Rq_HU := %X\n", getValue( HMI_VehDrvProg_M_Disp_Rq_HU ) );        filePutString ( buffer, elcount( buffer ), hFile );
    snprintf( buffer, elcount(buffer), "0.0000 HMI_LDP_Sensitive_Md_Disp_Rq := %X\n", getValue( HMI_LDP_Sensitive_Md_Disp_Rq ) );        filePutString( buffer, elcount(buffer), hFile);
    snprintf( buffer, elcount(buffer), "0.0000 HMI_FDC_Md_Disp_Rq_HU := %X\n", getValue( HMI_FDC_Md_Disp_Rq_HU ) );        filePutString( buffer, elcount(buffer), hFile);
    snprintf( buffer, elcount(buffer), "0.0000 HMI_SwIllLvl_Rq_HU_AMG := %X\n", getValue( HMI_SwIllLvl_Rq_HU_AMG ) );        filePutString( buffer, elcount(buffer), hFile);

}

on timer _tConfig_HU_Disp_Rq_AR
{
    putValue( HMI__STMSG_Config_HU_Disp_Rq_AR, 0 );
}

on EnvVar HMI__STMSG_Config_HU_Disp_Rq_AR
{
    long tDelay;
    if( getValue( this ) == 2 )
    {
        tDelay = getValue( HMI__STMSGT_Config_HU_Disp_Rq_AR );
        if( tDelay > 0)    
            setTimer( _tConfig_HU_Disp_Rq_AR, tDelay );
        else
            putValue( HMI__STMSG_Config_HU_Disp_Rq_AR, 0 );
    }
}

on envVar HMI__STMSG_PO_Config_HU_Disp_Rq_AR
{
    if( getValue( this ) )
        openPanel("Config_HU_Disp_Rq_AR");
}

on EnvVar HMI_AFS_Md_Cfg_Disp_Rq_HU
{
    _mConfig_HU_Disp_Rq_AR.AFS_Md_Cfg_Disp_Rq_HU.phys = getValue(this);
    _Config_HU_Disp_Rq_AR_SpontanFlag = 1;
}

on EnvVar HMI_BSM_Md_Disp_Rq_HU
{
    _mConfig_HU_Disp_Rq_AR.BSM_Md_Disp_Rq_HU.phys = getValue(this);
    _Config_HU_Disp_Rq_AR_SpontanFlag = 1;
}

on EnvVar HMI_CNG_FuelMdChg_Disp_Rq_HU
{
    _mConfig_HU_Disp_Rq_AR.CNG_FuelMdChg_Disp_Rq_HU.phys = getValue(this);
    _Config_HU_Disp_Rq_AR_SpontanFlag = 1;
}

on EnvVar HMI_DrowDtct_Md_Disp_Rq_HU
{
    _mConfig_HU_Disp_Rq_AR.DrowDtct_Md_Disp_Rq_HU.phys = getValue(this);
    _Config_HU_Disp_Rq_AR_SpontanFlag = 1;
}

on EnvVar HMI_DTQ_LaneChg_Md_Disp_Rq_HU
{
    _mConfig_HU_Disp_Rq_AR.DTQ_LaneChg_Md_Disp_Rq_HU.phys = getValue(this);
    _Config_HU_Disp_Rq_AR_SpontanFlag = 1;
}

on EnvVar HMI_DTQ_Md_Disp_Rq_HU
{
    _mConfig_HU_Disp_Rq_AR.DTQ_Md_Disp_Rq_HU.phys = getValue(this);
    _Config_HU_Disp_Rq_AR_SpontanFlag = 1;
}

on EnvVar HMI_DTR_Curve_Disp_Rq_HU
{
    _mConfig_HU_Disp_Rq_AR.DTR_Curve_Disp_Rq_HU.phys = getValue(this);
    _Config_HU_Disp_Rq_AR_SpontanFlag = 1;
}

on EnvVar HMI_ILS_TouristMd_Disp_Rq_HU
{
    _mConfig_HU_Disp_Rq_AR.ILS_TouristMd_Disp_Rq_HU.phys = getValue(this);
    _Config_HU_Disp_Rq_AR_SpontanFlag = 1;
}

on EnvVar HMI_LCMS_Md_Disp_Rq_HU
{
    _mConfig_HU_Disp_Rq_AR.LCMS_Md_Disp_Rq_HU.phys = getValue(this);
    _Config_HU_Disp_Rq_AR_SpontanFlag = 1;
}

on EnvVar HMI_LDC_CMS_Md_Disp_Rq_HU
{
    _mConfig_HU_Disp_Rq_AR.LDC_CMS_Md_Disp_Rq_HU.phys = getValue(this);
    _Config_HU_Disp_Rq_AR_SpontanFlag = 1;
}

on EnvVar HMI_LDC_WTSL_Spd_Max_Disp_Rq_HU
{
    _mConfig_HU_Disp_Rq_AR.LDC_WTSL_Spd_Max_Disp_Rq_HU.phys = getValue(this);
    _Config_HU_Disp_Rq_AR_SpontanFlag = 1;
}

on EnvVar HMI_LDP_Md_Disp_Rq_HU
{
    _mConfig_HU_Disp_Rq_AR.LDP_Md_Disp_Rq_HU.phys = getValue(this);
    _Config_HU_Disp_Rq_AR_SpontanFlag = 1;
}

on EnvVar HMI_NVP_SPL_Md_Disp_Rq_HU
{
    _mConfig_HU_Disp_Rq_AR.NVP_SPL_Md_Disp_Rq_HU.phys = getValue(this);
    _Config_HU_Disp_Rq_AR_SpontanFlag = 1;
}

on EnvVar HMI_Park_BrkMd_Disp_Rq_HU
{
    _mConfig_HU_Disp_Rq_AR.Park_BrkMd_Disp_Rq_HU.phys = getValue(this);
    _Config_HU_Disp_Rq_AR_SpontanFlag = 1;
}

on EnvVar HMI_DSR_Softkey_Disp_Rq_HU
{
    _mConfig_HU_Disp_Rq_AR.DSR_Softkey_Disp_Rq_HU.phys = getValue(this);
    _Config_HU_Disp_Rq_AR_SpontanFlag = 1;
}

on EnvVar HMI_ILS_TouristMd_Disp_Rq_HU_V2
{
    _mConfig_HU_Disp_Rq_AR.ILS_TouristMd_Disp_Rq_HU_V2.phys = getValue(this);
    _Config_HU_Disp_Rq_AR_SpontanFlag = 1;
}
on EnvVar HMI_Park_Softkey_Disp_Rq_HU
{
    _mConfig_HU_Disp_Rq_AR.Park_Softkey_Disp_Rq_HU.phys = getValue(this);
    _Config_HU_Disp_Rq_AR_SpontanFlag = 1;
}
on EnvVar HMI_VehDrvProg_M_Disp_Rq_HU
{
    _mConfig_HU_Disp_Rq_AR.VehDrvProg_M_Disp_Rq_HU.phys = getValue(this);
    _Config_HU_Disp_Rq_AR_SpontanFlag = 1;
}

on EnvVar HMI_LDP_Sensitive_Md_Disp_Rq
{
    _mConfig_HU_Disp_Rq_AR.LDP_Sensitive_Md_Disp_Rq.phys = getValue(this);
    _Config_HU_Disp_Rq_AR_SpontanFlag = 1;
}

on EnvVar HMI_FDC_Md_Disp_Rq_HU
{
    _mConfig_HU_Disp_Rq_AR.FDC_Md_Disp_Rq_HU.phys = getValue(this);
    _Config_HU_Disp_Rq_AR_SpontanFlag = 1;
}

on EnvVar HMI_SwIllLvl_Rq_HU_AMG
{
    _mConfig_HU_Disp_Rq_AR.SwIllLvl_Rq_HU_AMG.phys = getValue(this);
    _Config_HU_Disp_Rq_AR_SpontanFlag = 1;
}

Ctrl_C_Stat2_AR_check_output()
{
    if( !getValue( HMI__STMSG_Ctrl_C_Stat2_AR))
    {
        // Botschaft Ctrl_C_Stat2_AR ID: 501 --- Sendeart cyclicAndSpontanWithDelay --- 
        _Ctrl_C_Stat2_AR_Cnt--;
        if( _Ctrl_C_Stat2_AR_Cnt < 1 )
        {
            output( _mCtrl_C_Stat2_AR ); // Nachricht wg. abgelaufenem Zyklus ausgeben
            _Ctrl_C_Stat2_AR_Cnt = _Ctrl_C_Stat2_AR_CycleCount; // Zyklus-Zähler zurücksetzen
            _Ctrl_C_Stat2_AR_SpontanFlag = 0; // Spontan-Flag zurücksetzen
        }
        else if( _Ctrl_C_Stat2_AR_SpontanFlag)
        {
            output( _mCtrl_C_Stat2_AR ); // Nachricht wg. spontaner Änderung ausgeben
            _Ctrl_C_Stat2_AR_SpontanFlag = 0; // Spontan-Flag zurücksetzen
        }
    }
}

Ctrl_C_Stat2_AR_init()
{   /* Botschaft Ctrl_C_Stat2_AR ID: 501 --- Sendeart 5 cyclicAndSpontanWithDelay --- 
BA_ "ApplMessage" BO_ 501 0;
BA_ "NmAsrMessage" BO_ 501 0;
BA_ "GenMsgMinAcceptLength" BO_ 501 6;
BA_ "GenMsgILSupport" BO_ 501 1;
BA_ "DiagState" BO_ 501 0;
BA_ "DiagRequest" BO_ 501 0;
BA_ "DiagResponse" BO_ 501 0;
BA_ "GenMsgStartValue" BO_ 501 "0";
BA_ "GenMsgStartDelayTime" BO_ 501 0;
BA_ "GenMsgDelayTime" BO_ 501 10;
BA_ "GenMsgNrOfRepetition" BO_ 501 0;
BA_ "GenMsgCycleTime" BO_ 501 100;
BA_ "GenMsgSendType" BO_ 501 5;
    */
    _Ctrl_C_Stat2_AR_Timebase =                   c_tDBKomTimer_20ms;
    _Ctrl_C_Stat2_AR_CycleCount =                 100 / _Ctrl_C_Stat2_AR_Timebase;
    _Ctrl_C_Stat2_AR_StartDelay =                   5 / _Ctrl_C_Stat2_AR_Timebase;
    _Ctrl_C_Stat2_AR_Cnt = _Ctrl_C_Stat2_AR_StartDelay;
    _Ctrl_C_Stat2_AR_SpontanFlag = 0;

    putValue( HMI__STMSGSD_Ctrl_C_Stat2_AR, _Ctrl_C_Stat2_AR_StartDelay * _Ctrl_C_Stat2_AR_Timebase );

    _mCtrl_C_Stat2_AR.NumPadKey0_Psd.phys = getValue( HMI_NumPadKey0_Psd );
    _mCtrl_C_Stat2_AR.NumPadKey1_Psd.phys = getValue( HMI_NumPadKey1_Psd );
    _mCtrl_C_Stat2_AR.NumPadKey2_Psd.phys = getValue( HMI_NumPadKey2_Psd );
    _mCtrl_C_Stat2_AR.NumPadKey3_Psd.phys = getValue( HMI_NumPadKey3_Psd );
    _mCtrl_C_Stat2_AR.NumPadKey4_Psd.phys = getValue( HMI_NumPadKey4_Psd );
    _mCtrl_C_Stat2_AR.NumPadKey5_Psd.phys = getValue( HMI_NumPadKey5_Psd );
    _mCtrl_C_Stat2_AR.NumPadKey6_Psd.phys = getValue( HMI_NumPadKey6_Psd );
    _mCtrl_C_Stat2_AR.NumPadKey7_Psd.phys = getValue( HMI_NumPadKey7_Psd );
    _mCtrl_C_Stat2_AR.NumPadKey8_Psd.phys = getValue( HMI_NumPadKey8_Psd );
    _mCtrl_C_Stat2_AR.NumPadKey9_Psd.phys = getValue( HMI_NumPadKey9_Psd );
    _mCtrl_C_Stat2_AR.NumPadKeyClr_Psd.phys = getValue( HMI_NumPadKeyClr_Psd );
    _mCtrl_C_Stat2_AR.NumPadKeyEnd_Psd.phys = getValue( HMI_NumPadKeyEnd_Psd );
    _mCtrl_C_Stat2_AR.NumPadKeyFav_Psd.phys = getValue( HMI_NumPadKeyFav_Psd );
    _mCtrl_C_Stat2_AR.NumPadKeyPound_Psd.phys = getValue( HMI_NumPadKeyPound_Psd );
    _mCtrl_C_Stat2_AR.NumPadKeySend_Psd.phys = getValue( HMI_NumPadKeySend_Psd );
    _mCtrl_C_Stat2_AR.NumPadKeyStar_Psd.phys = getValue( HMI_NumPadKeyStar_Psd );
    _mCtrl_C_Stat2_AR.TPAD_KeyBkGrndAudio_Psd.phys = getValue( HMI_TPAD_KeyBkGrndAudio_Psd );
    _mCtrl_C_Stat2_AR.TPAD_KeyMenu_Psd.phys = getValue( HMI_TPAD_KeyMenu_Psd );
	_mCtrl_C_Stat2_AR.TPAD_KeyMenu_Psd.phys = getValue( HMI_TPAD_KeyMenu_Psd );
    _mCtrl_C_Stat2_AR.TPAD_KeyReturn_Psd.phys = getValue( HMI_TPAD_KeyReturn_Psd );
    _mCtrl_C_Stat2_AR.TPAD_Psd.phys = getValue( HMI_TPAD_Psd );
    _mCtrl_C_Stat2_AR.TPAD_SensArea_Psd.phys = getValue( HMI_TPAD_SensArea_Psd );
}

Ctrl_C_Stat2_AR_output()
{
    output( _mCtrl_C_Stat2_AR );
}

Ctrl_C_Stat2_AR_saveEnvVars( dword hFile )
{
    filePutString("\n// Knoten TGW: Ctrl_C_Stat2_AR\n", 26, hFile);
    snprintf( buffer, elcount(buffer), "0.0000 HMI__STMSG_Ctrl_C_Stat2_AR := %X\n", getValue( HMI__STMSG_Ctrl_C_Stat2_AR ));        filePutString( buffer, elcount(buffer), hFile);
    snprintf( buffer, elcount(buffer), "0.0000 HMI__STMSGT_Ctrl_C_Stat2_AR := %X\n", getValue( HMI__STMSGT_Ctrl_C_Stat2_AR ));        filePutString( buffer, elcount(buffer), hFile);
    snprintf( buffer, elcount(buffer), "0.0000 HMI_NumPadKey0_Psd := %X\n", getValue( HMI_NumPadKey0_Psd ) );        filePutString( buffer, elcount(buffer), hFile);
    snprintf( buffer, elcount(buffer), "0.0000 HMI_NumPadKey1_Psd := %X\n", getValue( HMI_NumPadKey1_Psd ) );        filePutString( buffer, elcount(buffer), hFile);
    snprintf( buffer, elcount(buffer), "0.0000 HMI_NumPadKey2_Psd := %X\n", getValue( HMI_NumPadKey2_Psd ) );        filePutString( buffer, elcount(buffer), hFile);
    snprintf( buffer, elcount(buffer), "0.0000 HMI_NumPadKey3_Psd := %X\n", getValue( HMI_NumPadKey3_Psd ) );        filePutString( buffer, elcount(buffer), hFile);
    snprintf( buffer, elcount(buffer), "0.0000 HMI_NumPadKey4_Psd := %X\n", getValue( HMI_NumPadKey4_Psd ) );        filePutString( buffer, elcount(buffer), hFile);
    snprintf( buffer, elcount(buffer), "0.0000 HMI_NumPadKey5_Psd := %X\n", getValue( HMI_NumPadKey5_Psd ) );        filePutString( buffer, elcount(buffer), hFile);
    snprintf( buffer, elcount(buffer), "0.0000 HMI_NumPadKey6_Psd := %X\n", getValue( HMI_NumPadKey6_Psd ) );        filePutString( buffer, elcount(buffer), hFile);
    snprintf( buffer, elcount(buffer), "0.0000 HMI_NumPadKey7_Psd := %X\n", getValue( HMI_NumPadKey7_Psd ) );        filePutString( buffer, elcount(buffer), hFile);
    snprintf( buffer, elcount(buffer), "0.0000 HMI_NumPadKey8_Psd := %X\n", getValue( HMI_NumPadKey8_Psd ) );        filePutString( buffer, elcount(buffer), hFile);
    snprintf( buffer, elcount(buffer), "0.0000 HMI_NumPadKey9_Psd := %X\n", getValue( HMI_NumPadKey9_Psd ) );        filePutString( buffer, elcount(buffer), hFile);
    snprintf( buffer, elcount(buffer), "0.0000 HMI_NumPadKeyClr_Psd := %X\n", getValue( HMI_NumPadKeyClr_Psd ) );        filePutString( buffer, elcount(buffer), hFile);
    snprintf( buffer, elcount(buffer), "0.0000 HMI_NumPadKeyEnd_Psd := %X\n", getValue( HMI_NumPadKeyEnd_Psd ) );        filePutString( buffer, elcount(buffer), hFile);
    snprintf( buffer, elcount(buffer), "0.0000 HMI_NumPadKeyFav_Psd := %X\n", getValue( HMI_NumPadKeyFav_Psd ) );        filePutString( buffer, elcount(buffer), hFile);
    snprintf( buffer, elcount(buffer), "0.0000 HMI_NumPadKeyPound_Psd := %X\n", getValue( HMI_NumPadKeyPound_Psd ) );        filePutString( buffer, elcount(buffer), hFile);
    snprintf( buffer, elcount(buffer), "0.0000 HMI_NumPadKeySend_Psd := %X\n", getValue( HMI_NumPadKeySend_Psd ) );        filePutString( buffer, elcount(buffer), hFile);
    snprintf( buffer, elcount(buffer), "0.0000 HMI_NumPadKeyStar_Psd := %X\n", getValue( HMI_NumPadKeyStar_Psd ) );        filePutString( buffer, elcount(buffer), hFile);
    snprintf( buffer, elcount(buffer), "0.0000 HMI_TPAD_KeyBkGrndAudio_Psd_LastState := %X\n", getValue( HMI_TPAD_KeyBkGrndAudio_Psd ) );        filePutString( buffer, elcount(buffer), hFile);
    snprintf( buffer, elcount(buffer), "0.0000 HMI_TPAD_KeyMenu_Psd := %X\n", getValue( HMI_TPAD_KeyMenu_Psd ) );        filePutString( buffer, elcount(buffer), hFile);
    snprintf( buffer, elcount(buffer), "0.0000 HMI_TPAD_KeyNtfcn_Psd := %X\n", getValue( HMI_TPAD_KeyNtfcn_Psd ) );        filePutString( buffer, elcount(buffer), hFile);
	snprintf( buffer, elcount(buffer), "0.0000 HMI_TPAD_KeyReturn_Psd := %X\n", getValue( HMI_TPAD_KeyReturn_Psd ) );        filePutString( buffer, elcount(buffer), hFile);
    snprintf( buffer, elcount(buffer), "0.0000 HMI_TPAD_Psd := %X\n", getValue( HMI_TPAD_Psd ) );        filePutString( buffer, elcount(buffer), hFile);
    snprintf( buffer, elcount(buffer), "0.0000 HMI_TPAD_SensArea_Psd := %X\n", getValue( HMI_TPAD_SensArea_Psd ) );        filePutString( buffer, elcount(buffer), hFile);
}

on timer _tCtrl_C_Stat2_AR
{
    putValue( HMI__STMSG_Ctrl_C_Stat2_AR, 0 );
}

on EnvVar HMI__STMSG_Ctrl_C_Stat2_AR
{
    long tDelay;
    if( getValue( this ) == 2 )
    {
        tDelay = getValue( HMI__STMSGT_Ctrl_C_Stat2_AR );
        if( tDelay > 0 )    
            setTimer( _tCtrl_C_Stat2_AR, tDelay );
        else
            putValue( HMI__STMSG_Ctrl_C_Stat2_AR, 0 );
    }
}

on EnvVar HMI__ALLDEF_Ctrl_C_Stat2_AR
{
    if( getValue(this))
    {
        // alle signale auf default einstellen
        putValue( HMI_NumPadKey0_Psd, 0);
        putValue( HMI_NumPadKey1_Psd, 0);
        putValue( HMI_NumPadKey2_Psd, 0);
        putValue( HMI_NumPadKey3_Psd, 0);
        putValue( HMI_NumPadKey4_Psd, 0);
        putValue( HMI_NumPadKey5_Psd, 0);
        putValue( HMI_NumPadKey6_Psd, 0);
        putValue( HMI_NumPadKey7_Psd, 0);
        putValue( HMI_NumPadKey8_Psd, 0);
        putValue( HMI_NumPadKey9_Psd, 0);
        putValue( HMI_NumPadKeyClr_Psd, 0);
        putValue( HMI_NumPadKeyEnd_Psd, 0);
        putValue( HMI_NumPadKeyFav_Psd, 0);
        putValue( HMI_NumPadKeyPound_Psd, 0);
        putValue( HMI_NumPadKeySend_Psd, 0);
        putValue( HMI_NumPadKeyStar_Psd, 0);
        putValue( HMI_TPAD_KeyBkGrndAudio_Psd, 0);
        putValue( HMI_TPAD_KeyMenu_Psd, 0);
        putValue( HMI_TPAD_KeyReturn_Psd, 0);
        putValue( HMI_TPAD_Psd, 0);
        putValue( HMI_TPAD_SensArea_Psd, 0);
    }
}

on envVar HMI__STMSG_PO_Ctrl_C_Stat2_AR
{
    if( getValue( this ) )
        openPanel("Ctrl_C_Stat2_AR");
}

on EnvVar HMI_NumPadKey0_Psd
{
    _mCtrl_C_Stat2_AR.NumPadKey0_Psd.phys = getValue(this);
    _Ctrl_C_Stat2_AR_SpontanFlag = 1;
}

on EnvVar HMI_NumPadKey1_Psd
{
    _mCtrl_C_Stat2_AR.NumPadKey1_Psd.phys = getValue(this);
    _Ctrl_C_Stat2_AR_SpontanFlag = 1;
}

on EnvVar HMI_NumPadKey2_Psd
{
    _mCtrl_C_Stat2_AR.NumPadKey2_Psd.phys = getValue(this);
    _Ctrl_C_Stat2_AR_SpontanFlag = 1;
}

on EnvVar HMI_NumPadKey3_Psd
{
    _mCtrl_C_Stat2_AR.NumPadKey3_Psd.phys = getValue(this);
    _Ctrl_C_Stat2_AR_SpontanFlag = 1;
}

on EnvVar HMI_NumPadKey4_Psd
{
    _mCtrl_C_Stat2_AR.NumPadKey4_Psd.phys = getValue(this);
    _Ctrl_C_Stat2_AR_SpontanFlag = 1;
}

on EnvVar HMI_NumPadKey5_Psd
{
    _mCtrl_C_Stat2_AR.NumPadKey5_Psd.phys = getValue(this);
    _Ctrl_C_Stat2_AR_SpontanFlag = 1;
}

on EnvVar HMI_NumPadKey6_Psd
{
    _mCtrl_C_Stat2_AR.NumPadKey6_Psd.phys = getValue(this);
    _Ctrl_C_Stat2_AR_SpontanFlag = 1;
}

on EnvVar HMI_NumPadKey7_Psd
{
    _mCtrl_C_Stat2_AR.NumPadKey7_Psd.phys = getValue(this);
    _Ctrl_C_Stat2_AR_SpontanFlag = 1;
}

on EnvVar HMI_NumPadKey8_Psd
{
    _mCtrl_C_Stat2_AR.NumPadKey8_Psd.phys = getValue(this);
    _Ctrl_C_Stat2_AR_SpontanFlag = 1;
}

on EnvVar HMI_NumPadKey9_Psd
{
    _mCtrl_C_Stat2_AR.NumPadKey9_Psd.phys = getValue(this);
    _Ctrl_C_Stat2_AR_SpontanFlag = 1;
}

on EnvVar HMI_NumPadKeyClr_Psd
{
    _mCtrl_C_Stat2_AR.NumPadKeyClr_Psd.phys = getValue(this);
    _Ctrl_C_Stat2_AR_SpontanFlag = 1;
}

on EnvVar HMI_NumPadKeyEnd_Psd
{
    _mCtrl_C_Stat2_AR.NumPadKeyEnd_Psd.phys = getValue(this);
    _Ctrl_C_Stat2_AR_SpontanFlag = 1;
}

on EnvVar HMI_NumPadKeyFav_Psd
{
    _mCtrl_C_Stat2_AR.NumPadKeyFav_Psd.phys = getValue(this);
    _Ctrl_C_Stat2_AR_SpontanFlag = 1;
}

on EnvVar HMI_NumPadKeyPound_Psd
{
    _mCtrl_C_Stat2_AR.NumPadKeyPound_Psd.phys = getValue(this);
    _Ctrl_C_Stat2_AR_SpontanFlag = 1;
}

on EnvVar HMI_NumPadKeySend_Psd
{
    _mCtrl_C_Stat2_AR.NumPadKeySend_Psd.phys = getValue(this);
    _Ctrl_C_Stat2_AR_SpontanFlag = 1;
}

on EnvVar HMI_NumPadKeyStar_Psd
{
    _mCtrl_C_Stat2_AR.NumPadKeyStar_Psd.phys = getValue(this);
    _Ctrl_C_Stat2_AR_SpontanFlag = 1;
}

on EnvVar HMI_TPAD_KeyNtfcn_Psd
{
    _mCtrl_C_Stat2_AR.TPAD_KeyNtfcn_Psd.phys = getValue(this);
    _Ctrl_C_Stat2_AR_SpontanFlag = 1;
}

on EnvVar HMI_TPAD_KeyBkGrndAudio_Psd
{
    _mCtrl_C_Stat2_AR.TPAD_KeyBkGrndAudio_Psd.phys = getValue(this);
    _Ctrl_C_Stat2_AR_SpontanFlag = 1;
}

on EnvVar HMI_TPAD_KeyMenu_Psd
{
    _mCtrl_C_Stat2_AR.TPAD_KeyMenu_Psd.phys = getValue(this);
    _Ctrl_C_Stat2_AR_SpontanFlag = 1;
}

on EnvVar HMI_TPAD_KeyReturn_Psd
{
    _mCtrl_C_Stat2_AR.TPAD_KeyReturn_Psd.phys = getValue(this);
    _Ctrl_C_Stat2_AR_SpontanFlag = 1;
}

on EnvVar HMI_TPAD_Psd
{
    _mCtrl_C_Stat2_AR.TPAD_KeyReturn_Psd.phys = getValue(this);
    _Ctrl_C_Stat2_AR_SpontanFlag = 1;
}

on EnvVar HMI_TPAD_SensArea_Psd
{
    _mCtrl_C_Stat2_AR.TPAD_SensArea_Psd.phys = getValue(this);
    _Ctrl_C_Stat2_AR_SpontanFlag = 1;
}

Ctrl_C_Stat3_AR_check_output()
{
    if( !getValue( HMI__STMSG_Ctrl_C_Stat3_AR ) )
    {
        // Botschaft Ctrl_C_Stat3_AR ID: 627 --- Sendeart 5 cyclicAndSpontanWithDelay --- 
        _Ctrl_C_Stat3_AR_Cnt--;
        if( _Ctrl_C_Stat3_AR_Cnt < 1 )
        {
            // Nachricht wg. abgelaufenem Zyklus ausgeben
            Ctrl_C_Stat3_AR_output();
            _Ctrl_C_Stat3_AR_Cnt = _Ctrl_C_Stat3_AR_CycleCount; // Zyklus-Zähler zurücksetzen
            _Ctrl_C_Stat3_AR_SpontanFlag = 0; // Spontan-Flag zurücksetzen
        }
        else if( _Ctrl_C_Stat3_AR_SpontanFlag)
        {
            // Nachricht wg. spontaner Änderung ausgeben
            Ctrl_C_Stat3_AR_output();
            _Ctrl_C_Stat3_AR_SpontanFlag = 0; // Spontan-Flag zurücksetzen
        }
    }
}

Ctrl_C_Stat3_AR_init()
{   /* Botschaft Ctrl_C_Stat3_AR ID: 627 --- Sendeart 5 cyclicAndSpontanWithDelay --- 
BA_ "ApplMessage" BO_ 627 0;
BA_ "NmAsrMessage" BO_ 627 0;
BA_ "GenMsgMinAcceptLength" BO_ 627 8;
BA_ "GenMsgILSupport" BO_ 627 1;
BA_ "DiagState" BO_ 627 0;
BA_ "DiagRequest" BO_ 627 0;
BA_ "DiagResponse" BO_ 627 0;
BA_ "GenMsgStartValue" BO_ 627 "0";
BA_ "GenMsgDelayTime" BO_ 627 10;
BA_ "GenMsgNrOfRepetitions" BO_ 627 0;
BA_ "GenMsgCycleTime" BO_ 627 100;
BA_ "GenMsgSendType" BO_ 627 5;
    */
    _Ctrl_C_Stat3_AR_Timebase =      c_tDBKomTimer_20ms;
    _Ctrl_C_Stat3_AR_CycleCount =    100 / _Ctrl_C_Stat3_AR_Timebase;
    _Ctrl_C_Stat3_AR_StartDelay =     10 / _Ctrl_C_Stat3_AR_Timebase;
    _Ctrl_C_Stat3_AR_Cnt = _Ctrl_C_Stat3_AR_StartDelay;
    _Ctrl_C_Stat3_AR_SpontanFlag = 0;

    putValue( HMI__STMSGSD_Ctrl_C_Stat3_AR, _Ctrl_C_Stat3_AR_StartDelay * _Ctrl_C_Stat3_AR_Timebase );

    _mCtrl_C_Stat3_AR.Airbag_P_LED_On_Stat.phys = getValue( HMI_Airbag_P_LED_On_Stat );
    _mCtrl_C_Stat3_AR.Airbag_LED_Stat_UB.phys = getValue( HMI_Airbag_LED_Stat_UB );
    _mCtrl_C_Stat3_AR.AltDrvScreenSw_Psd.phys = getValue( HMI_AltDrvScreenSw_Psd );
    _mCtrl_C_Stat3_AR.AMG_Sw_Psd.phys = getValue( HMI_AMG_Sw_Psd );
	_mCtrl_C_Stat3_AR.ASX_ESS_Boost_Sw_Psd.phys = getValue( HMI_ASX_ESS_Boost_Sw_Psd);
    _mCtrl_C_Stat3_AR.COD_Ind_LED_Stat.phys = getValue( HMI_COD_Ind_LED_Stat );
    _mCtrl_C_Stat3_AR.DeleteKey_Psd_V2.phys = getValue( HMI_DeleteKey_Psd_V2 );
    _mCtrl_C_Stat3_AR.DispOffKey_Psd.phys = getValue( HMI_DispOffKey_Psd );
    _mCtrl_C_Stat3_AR.Emotion_Sw_Psd.phys = getValue( HMI_Emotion_Sw_Psd );
	_mCtrl_C_Stat3_AR.eSuspMenuSw_Psd.phys = getValue( HMI_eSuspMenuSw_Psd );
    _mCtrl_C_Stat3_AR.Fav1_Sw_Psd.phys = getValue( HMI_Fav1_Sw_Psd );
    _mCtrl_C_Stat3_AR.Fav2_Sw_Psd.phys = getValue( HMI_Fav2_Sw_Psd );
    _mCtrl_C_Stat3_AR.KeyBkGrndAudio_Psd.phys = getValue( HMI_KeyBkGrndAudio_Psd );
    _mCtrl_C_Stat3_AR.MenuFav_Sw_Psd.phys = getValue( HMI_MenuFav_Sw_Psd );
	_mCtrl_C_Stat3_AR.LoRng_Sw_Psd.phys = getValue( HMI_LoRng_Sw_Psd );
    _mCtrl_C_Stat3_AR.Rsrv1_Airbag_LED_Stat.phys = getValue( HMI_Rsrv1_Airbag_LED_Stat );
    _mCtrl_C_Stat3_AR.Text_LED_Stat.phys = getValue( HMI_Text_LED_Stat );
    _mCtrl_C_Stat3_AR.EQ_Sw_Psd.phys = getValue( HMI_EQ_Sw_Psd );
}

Ctrl_C_Stat3_AR_output(void)
{
    output( _mCtrl_C_Stat3_AR );
}

Ctrl_C_Stat3_AR_saveEnvVars( dword hFile )
{
    filePutString("\n// Knoten EIS: Ctrl_C_Stat3_AR\n", 27, hFile );
    snprintf( buffer, elcount( buffer ), "0.0000 HMI__STMSG_Ctrl_C_Stat3_AR := %X\n", getValue( HMI__STMSG_Ctrl_C_Stat3_AR ) );        filePutString ( buffer, elcount( buffer ), hFile );
    snprintf( buffer, elcount( buffer ), "0.0000 HMI__STMSGT_Ctrl_C_Stat3_AR := %X\n", getValue( HMI__STMSGT_Ctrl_C_Stat3_AR ) );        filePutString ( buffer, elcount( buffer ), hFile );
    snprintf( buffer, elcount( buffer ), "0.0000 HMI_Airbag_P_LED_On_Stat := %X\n", getValue( HMI_Airbag_P_LED_On_Stat ) );        filePutString ( buffer, elcount( buffer ), hFile );
    snprintf( buffer, elcount( buffer ), "0.0000 HMI_AltDrvScreenSw_Psd := %X\n", getValue( HMI_AltDrvScreenSw_Psd ) );        filePutString ( buffer, elcount( buffer ), hFile );
    snprintf( buffer, elcount( buffer ), "0.0000 HMI_Airbag_LED_Stat_UB := %X\n", getValue( HMI_Airbag_LED_Stat_UB ) );        filePutString ( buffer, elcount( buffer ), hFile );
    snprintf( buffer, elcount( buffer ), "0.0000 HMI_AMG_Sw_Psd := %X\n", getValue( HMI_AMG_Sw_Psd ) );        filePutString ( buffer, elcount( buffer ), hFile );
    snprintf( buffer, elcount( buffer ), "0.0000 HMI_ASX_ESS_Boost_Sw_Psd := %X\n", getValue( HMI_ASX_ESS_Boost_Sw_Psd ) );		filePutString( buffer, elcount( buffer ), hFile );
	snprintf( buffer, elcount( buffer ), "0.0000 HMI_COD_Ind_LED_Stat := %X\n", getValue( HMI_COD_Ind_LED_Stat ) );        filePutString ( buffer, elcount( buffer ), hFile );
    snprintf( buffer, elcount( buffer ), "0.0000 HMI_CRC_Airbag_LED_Stat := %X\n", getValue( HMI_CRC_Airbag_LED_Stat ) );        filePutString ( buffer, elcount( buffer ), hFile );
    snprintf( buffer, elcount( buffer ), "0.0000 HMI_CRC_Airbag_LED_Stat_Auto := %X\n", getValue( HMI_CRC_Airbag_LED_Stat_Auto ) );        filePutString ( buffer, elcount( buffer ), hFile );
    snprintf( buffer, elcount( buffer ), "0.0000 HMI_CRC_Airbag_LED_Stat_Profile_02 := %X\n", getValue( HMI_CRC_Airbag_LED_Stat_Profile_02 ) );        filePutString ( buffer, elcount( buffer ), hFile );
    snprintf( buffer, elcount( buffer ), "0.0000 HMI_DeleteKey_Psd_V2 := %X\n", getValue( HMI_DeleteKey_Psd_V2 ) );        filePutString ( buffer, elcount( buffer ), hFile );
    snprintf( buffer, elcount( buffer ), "0.0000 HMI_DispOffKey_Psd := %X\n", getValue( HMI_DispOffKey_Psd ) );        filePutString ( buffer, elcount( buffer ), hFile );
    snprintf( buffer, elcount( buffer ), "0.0000 HMI_Emotion_Sw_Psd := %X\n", getValue( HMI_Emotion_Sw_Psd ) );        filePutString ( buffer, elcount( buffer ), hFile );
    snprintf( buffer, elcount( buffer ), "0.0000 HMI_eSuspMenuSw_Psd := %X\n", getValue( HMI_eSuspMenuSw_Psd ) );        filePutString ( buffer, elcount( buffer ), hFile );
	snprintf( buffer, elcount( buffer ), "0.0000 HMI_Fav1_Sw_Psd := %X\n", getValue( HMI_Fav1_Sw_Psd ) );        filePutString ( buffer, elcount( buffer ), hFile );
    snprintf( buffer, elcount( buffer ), "0.0000 HMI_Fav2_Sw_Psd := %X\n", getValue( HMI_Fav2_Sw_Psd ) );        filePutString ( buffer, elcount( buffer ), hFile );
    snprintf( buffer, elcount( buffer ), "0.0000 HMI_KeyBkGrndAudio_Psd := %X\n", getValue( HMI_KeyBkGrndAudio_Psd ) );        filePutString ( buffer, elcount( buffer ), hFile );
    snprintf( buffer, elcount( buffer ), "0.0000 HMI_LoRng_Sw_Psd := %X\n", getValue( HMI_LoRng_Sw_Psd ) );        filePutString ( buffer, elcount( buffer ), hFile );
	snprintf( buffer, elcount( buffer ), "0.0000 HMI_MenuFav_Sw_Psd := %X\n", getValue( HMI_MenuFav_Sw_Psd ) );        filePutString ( buffer, elcount( buffer ), hFile );
    snprintf( buffer, elcount( buffer ), "0.0000 HMI_Rsrv1_Airbag_LED_Stat := %X\n", getValue( HMI_Rsrv1_Airbag_LED_Stat ) );        filePutString ( buffer, elcount( buffer ), hFile );
    snprintf( buffer, elcount( buffer ), "0.0000 HMI_SQC_Airbag_LED_Stat := %X\n", getValue( HMI_SQC_Airbag_LED_Stat ) );        filePutString ( buffer, elcount( buffer ), hFile );
    snprintf( buffer, elcount( buffer ), "0.0000 HMI_SQC_Airbag_LED_Stat_Auto := %X\n", getValue( HMI_SQC_Airbag_LED_Stat_Auto ) );        filePutString ( buffer, elcount( buffer ), hFile );
    snprintf( buffer, elcount( buffer ), "0.0000 HMI_Text_LED_Stat := %X\n", getValue( HMI_Text_LED_Stat ) );        filePutString ( buffer, elcount( buffer ), hFile );
    snprintf( buffer, elcount( buffer ), "0.0000 HMI_EQ_Sw_Psd := %X\n", getValue( HMI_EQ_Sw_Psd ) );        filePutString ( buffer, elcount( buffer ), hFile );
}

on timer _tCtrl_C_Stat3_AR
{
    putValue( HMI__STMSG_Ctrl_C_Stat3_AR, 0 );
}

on EnvVar HMI__STMSG_Ctrl_C_Stat3_AR
{
    long tDelay;
    if( getValue( this ) == 2 )
    {
        tDelay = getValue( HMI__STMSGT_Ctrl_C_Stat3_AR );
        if( tDelay > 0)    
            setTimer( _tCtrl_C_Stat3_AR, tDelay );
        else
            putValue( HMI__STMSG_Ctrl_C_Stat3_AR, 0 );
    }
}

on envVar HMI__STMSG_PO_Ctrl_C_Stat3_AR
{
    if( getValue( this ) )
        openPanel("Ctrl_C_Stat3_AR");
}

on EnvVar HMI_Airbag_P_LED_On_Stat
{
    _mCtrl_C_Stat3_AR.Airbag_P_LED_On_Stat.phys = getValue(this);
    _Ctrl_C_Stat3_AR_SpontanFlag = 1;
}

on EnvVar HMI_Airbag_LED_Stat_UB
{
    _mCtrl_C_Stat3_AR.Airbag_LED_Stat_UB.phys = getValue(this);
    _Ctrl_C_Stat3_AR_SpontanFlag = 1;
}

on EnvVar HMI_ASX_ESS_Boost_Sw_Psd
{
	_mCtrl_C_Stat3_AR.ASX_ESS_Boost_Sw_Psd.phys = getValue(this);
	_Ctrl_C_Stat3_AR_SpontanFlag = 1;
}

on EnvVar HMI_LoRng_Sw_Psd
{
	_mCtrl_C_Stat3_AR.LoRng_Sw_Psd.phys = getValue(this);
	_Ctrl_C_Stat3_AR_SpontanFlag = 1;
}

on EnvVar HMI_AltDrvScreenSw_Psd
{
    _mCtrl_C_Stat3_AR.AltDrvScreenSw_Psd.phys = getValue(this);
    _Ctrl_C_Stat3_AR_SpontanFlag = 1;
}

on EnvVar HMI_AMG_Sw_Psd
{
    _mCtrl_C_Stat3_AR.AMG_Sw_Psd.phys = getValue(this);
    _Ctrl_C_Stat3_AR_SpontanFlag = 1;
}

on EnvVar HMI_COD_Ind_LED_Stat
{
    _mCtrl_C_Stat3_AR.COD_Ind_LED_Stat.phys = getValue(this);
    _Ctrl_C_Stat3_AR_SpontanFlag = 1;
}

on EnvVar HMI_DeleteKey_Psd_V2
{
    _mCtrl_C_Stat3_AR.DeleteKey_Psd_V2.phys = getValue(this);
    _Ctrl_C_Stat3_AR_SpontanFlag = 1;
}

on EnvVar HMI_DispOffKey_Psd
{
    _mCtrl_C_Stat3_AR.DispOffKey_Psd.phys = getValue(this);
    _Ctrl_C_Stat3_AR_SpontanFlag = 1;
}

on EnvVar HMI_Emotion_Sw_Psd
{
    _mCtrl_C_Stat3_AR.Emotion_Sw_Psd.phys = getValue(this);
    _Ctrl_C_Stat3_AR_SpontanFlag = 1;
}

on EnvVar HMI_eSuspMenuSw_Psd
{
    _mCtrl_C_Stat3_AR.eSuspMenuSw_Psd.phys = getValue(this);
    _Ctrl_C_Stat3_AR_SpontanFlag = 1;
}

on EnvVar HMI_Fav1_Sw_Psd
{
    _mCtrl_C_Stat3_AR.Fav1_Sw_Psd.phys = getValue(this);
    _Ctrl_C_Stat3_AR_SpontanFlag = 1;
}

on EnvVar HMI_Fav2_Sw_Psd
{
    _mCtrl_C_Stat3_AR.Fav2_Sw_Psd.phys = getValue(this);
    _Ctrl_C_Stat3_AR_SpontanFlag = 1;
}

on EnvVar HMI_KeyBkGrndAudio_Psd
{
    _mCtrl_C_Stat3_AR.KeyBkGrndAudio_Psd.phys = getValue(this);
    _Ctrl_C_Stat3_AR_SpontanFlag = 1;
}

on EnvVar HMI_MenuFav_Sw_Psd
{
    _mCtrl_C_Stat3_AR.MenuFav_Sw_Psd.phys = getValue(this);
    _Ctrl_C_Stat3_AR_SpontanFlag = 1;
}

on EnvVar HMI_Rsrv1_Airbag_LED_Stat
{
    _mCtrl_C_Stat3_AR.Rsrv1_Airbag_LED_Stat.phys = getValue(this);
    _Ctrl_C_Stat3_AR_SpontanFlag = 1;
}

on EnvVar HMI_Text_LED_Stat
{
    _mCtrl_C_Stat3_AR.Text_LED_Stat.phys = getValue(this);
    _Ctrl_C_Stat3_AR_SpontanFlag = 1;
}

on EnvVar HMI_EQ_Sw_Psd
{
    _mCtrl_C_Stat3_AR.EQ_Sw_Psd.phys = getValue(this);
    _Ctrl_C_Stat3_AR_SpontanFlag = 1;
}

Ctrl_C_Stat4_AR_check_output()
{
    if( !getValue( HMI__STMSG_Ctrl_C_Stat4_AR ) )
    {
        // Botschaft Ctrl_C_Stat4_AR ID: 627 --- Sendeart 5 cyclicAndSpontanWithDelay --- 
        _Ctrl_C_Stat4_AR_Cnt--;
        if( _Ctrl_C_Stat4_AR_Cnt < 1 )
        {
            // Nachricht wg. abgelaufenem Zyklus ausgeben
            Ctrl_C_Stat4_AR_output();
            _Ctrl_C_Stat4_AR_Cnt = _Ctrl_C_Stat4_AR_CycleCount; // Zyklus-Zähler zurücksetzen
            _Ctrl_C_Stat4_AR_SpontanFlag = 0; // Spontan-Flag zurücksetzen
        }
        else if( _Ctrl_C_Stat4_AR_SpontanFlag)
        {
            // Nachricht wg. spontaner Änderung ausgeben
            Ctrl_C_Stat4_AR_output();
            _Ctrl_C_Stat4_AR_SpontanFlag = 0; // Spontan-Flag zurücksetzen
        }
    }
}

Ctrl_C_Stat4_AR_init()
{   /* Botschaft Ctrl_C_Stat4_AR ID: 438 --- Sendeart 5 cyclicAndSpontanWithDelay --- 
BA_ "ApplMessage" BO_ 438 0;
BA_ "NmAsrMessage" BO_ 438 0;
BA_ "GenMsgMinAcceptLength" BO_ 438 8;
BA_ "GenMsgILSupport" BO_ 438 1;
BA_ "DiagState" BO_ 438 0;
BA_ "DiagRequest" BO_ 438 0;
BA_ "DiagResponse" BO_ 438 0;
BA_ "GenMsgStartValue" BO_ 438 "0";
BA_ "GenMsgStartDelayTime" BO_ 438 35;
BA_ "GenMsgDelayTime" BO_ 438 10;
BA_ "GenMsgNrOfRepetitions" BO_ 438 0;
BA_ "GenMsgCycleTime" BO_ 438 100;
BA_ "GenMsgSendType" BO_ 438 5;
    */
    _Ctrl_C_Stat4_AR_Timebase =      c_tDBKomTimer_20ms;
    _Ctrl_C_Stat4_AR_CycleCount =    100 / _Ctrl_C_Stat4_AR_Timebase;
    _Ctrl_C_Stat4_AR_StartDelay =     35 / _Ctrl_C_Stat4_AR_Timebase;
    _Ctrl_C_Stat4_AR_Cnt = _Ctrl_C_Stat4_AR_StartDelay;
    _Ctrl_C_Stat4_AR_SpontanFlag = 0;

    putValue( HMI__STMSGSD_Ctrl_C_Stat4_AR, _Ctrl_C_Stat4_AR_StartDelay * _Ctrl_C_Stat4_AR_Timebase );

    _mCtrl_C_Stat4_AR.CRC_CTRL_L_Stat.phys = getValue( HMI_CRC_CTRL_L_Stat );
    _mCtrl_C_Stat4_AR.CTRL_L_Stat_UB.phys = getValue( HMI_CTRL_L_Stat_UB );
    _mCtrl_C_Stat4_AR.Park_APC_Sw_Psd_CTRL_L.phys = getValue( HMI_Park_APC_Sw_Psd_CTRL_L );
    _mCtrl_C_Stat4_AR.Rsrv1_CTRL_L_Stat.phys = getValue( HMI_Rsrv1_CTRL_L_Stat );
    _mCtrl_C_Stat4_AR.SQC_CTRL_L_Stat.phys = getValue( HMI_SQC_CTRL_L_Stat );
    _mCtrl_C_Stat4_AR.CTRL_L2_Stat_UB.phys = getValue( HMI_CTRL_L2_Stat_UB );	
	  _mCtrl_C_Stat4_AR.CRC_CTRL_L2_Stat.phys = getValue( HMI_CRC_CTRL_L2_Stat );
	  _mCtrl_C_Stat4_AR.Park_APC_Sw_Psd_CTRL_L2.phys = getValue( HMI_Park_APC_Sw_Psd_CTRL_L2 );
	  _mCtrl_C_Stat4_AR.Rsrv1_CTRL_L2_Stat.phys = getValue( HMI_Rsrv1_CTRL_L2_Stat );
	  _mCtrl_C_Stat4_AR.SQC_CTRL_L2_Stat.phys = getValue( HMI_SQC_CTRL_L2_Stat );    
    _mCtrl_C_Stat4_AR.Prox_Dtct_AMG.phys = getValue( HMI_Prox_Dtct_AMG );
    _mCtrl_C_Stat4_AR.Prox_Dtct_AMG_UB.phys = getValue( HMI_Prox_Dtct_AMG_UB );
    _mCtrl_C_Stat4_AR.TouchKey_Approach_AMG.phys = getValue( HMI_TouchKey_Approach_AMG );
    _mCtrl_C_Stat4_AR.TouchKey_Approach_AMG_UB.phys = getValue( HMI_TouchKey_Approach_AMG_UB );
	_mCtrl_C_Stat4_AR.Skip_Lt_Sw_Psd.phys = getValue( HMI_Skip_Lt_Sw_Psd );
    _mCtrl_C_Stat4_AR.Skip_Rt_Sw_Psd.phys = getValue( HMI_Skip_Rt_Sw_Psd );
}

Ctrl_C_Stat4_AR_output(void)
{
    output( _mCtrl_C_Stat4_AR );
}

Ctrl_C_Stat4_AR_saveEnvVars( dword hFile )
{
    filePutString("\n// Knoten EIS: Ctrl_C_Stat4_AR\n", 27, hFile );
    snprintf( buffer, elcount( buffer ), "0.0000 HMI__STMSG_Ctrl_C_Stat4_AR := %X\n", getValue( HMI__STMSG_Ctrl_C_Stat4_AR ) );        filePutString ( buffer, elcount( buffer ), hFile );
    snprintf( buffer, elcount( buffer ), "0.0000 HMI__STMSGT_Ctrl_C_Stat4_AR := %X\n", getValue( HMI__STMSGT_Ctrl_C_Stat4_AR ) );        filePutString ( buffer, elcount( buffer ), hFile );
    snprintf( buffer, elcount( buffer ), "0.0000 HMI_CRC_CTRL_L_Stat := %X\n", getValue( HMI_CRC_CTRL_L_Stat ) );        filePutString ( buffer, elcount( buffer ), hFile );
    //snprintf( buffer, elcount( buffer ), "0.0000 HMI_CRC_CTRL_L_Stat_Auto := %X\n", getValue( HMI_CRC_CTRL_L_Stat_Auto ) );        filePutString ( buffer, elcount( buffer ), hFile );
    //snprintf( buffer, elcount( buffer ), "0.0000 HMI_CRC_CTRL_L_Stat_Profile_02 := %X\n", getValue( HMI_CRC_CTRL_L_Stat_Profile_02 ) );        filePutString ( buffer, elcount( buffer ), hFile );
    snprintf( buffer, elcount( buffer ), "0.0000 HMI_CRC_CTRL_L2_Stat := %X\n", getValue( HMI_CRC_CTRL_L2_Stat ) );        filePutString ( buffer, elcount( buffer ), hFile );
    //snprintf( buffer, elcount( buffer ), "0.0000 HMI_CRC_CTRL_L2_Stat_Auto := %X\n", getValue( HMI_CRC_CTRL_L2_Stat_Auto ) );        filePutString ( buffer, elcount( buffer ), hFile );
    //snprintf( buffer, elcount( buffer ), "0.0000 HMI_CRC_CTRL_L2_Stat_Profile_02 := %X\n", getValue( HMI_CRC_CTRL_L2_Stat_Profile_02 ) );        filePutString ( buffer, elcount( buffer ), hFile );
    snprintf( buffer, elcount( buffer ), "0.0000 HMI_CTRL_L_Stat_UB := %X\n", getValue( HMI_CTRL_L_Stat_UB ) );        filePutString ( buffer, elcount( buffer ), hFile );
    snprintf( buffer, elcount( buffer ), "0.0000 HMI_CTRL_L2_Stat_UB := %X\n", getValue( HMI_CTRL_L2_Stat_UB ) );        filePutString ( buffer, elcount( buffer ), hFile );
    snprintf( buffer, elcount( buffer ), "0.0000 HMI_Park_APC_Sw_Psd_CTRL_L := %X\n", getValue( HMI_Park_APC_Sw_Psd_CTRL_L ) );        filePutString ( buffer, elcount( buffer ), hFile );
    snprintf( buffer, elcount( buffer ), "0.0000 HMI_Park_APC_Sw_Psd_CTRL_L2 := %X\n", getValue( HMI_Park_APC_Sw_Psd_CTRL_L2 ) );        filePutString ( buffer, elcount( buffer ), hFile );
    snprintf( buffer, elcount( buffer ), "0.0000 HMI_Rsrv1_CTRL_L_Stat := %X\n", getValue( HMI_Rsrv1_CTRL_L_Stat ) );        filePutString ( buffer, elcount( buffer ), hFile );
    snprintf( buffer, elcount( buffer ), "0.0000 HMI_Rsrv1_CTRL_L2_Stat := %X\n", getValue( HMI_Rsrv1_CTRL_L2_Stat ) );        filePutString ( buffer, elcount( buffer ), hFile );
    snprintf( buffer, elcount( buffer ), "0.0000 HMI_SQC_CTRL_L_Stat := %X\n", getValue( HMI_SQC_CTRL_L_Stat ) );        filePutString ( buffer, elcount( buffer ), hFile );
    //snprintf( buffer, elcount( buffer ), "0.0000 HMI_SQC_CTRL_L_Stat_Auto := %X\n", getValue( HMI_SQC_CTRL_L_Stat_Auto ) );        filePutString ( buffer, elcount( buffer ), hFile );
    snprintf( buffer, elcount( buffer ), "0.0000 HMI_SQC_CTRL_L2_Stat := %X\n", getValue( HMI_SQC_CTRL_L2_Stat ) );        filePutString ( buffer, elcount( buffer ), hFile );
    //snprintf( buffer, elcount( buffer ), "0.0000 HMI_SQC_CTRL_L2_Stat_Auto := %X\n", getValue( HMI_SQC_CTRL_L2_Stat_Auto ) );        filePutString ( buffer, elcount( buffer ), hFile );
    snprintf( buffer, elcount( buffer ), "0.0000 HMI_Prox_Dtct_AMG := %X\n", getValue( HMI_Prox_Dtct_AMG ) );        filePutString ( buffer, elcount( buffer ), hFile );
    snprintf( buffer, elcount( buffer ), "0.0000 HMI_Prox_Dtct_AMG_UB := %X\n", getValue( HMI_Prox_Dtct_AMG_UB ) );        filePutString ( buffer, elcount( buffer ), hFile );
    snprintf( buffer, elcount( buffer ), "0.0000 HMI_TouchKey_Approach_AMG := %X\n", getValue( HMI_TouchKey_Approach_AMG ) );        filePutString ( buffer, elcount( buffer ), hFile );
    snprintf( buffer, elcount( buffer ), "0.0000 HMI_TouchKey_Approach_AMG_UB := %X\n", getValue( HMI_TouchKey_Approach_AMG_UB ) );        filePutString ( buffer, elcount( buffer ), hFile );
	snprintf( buffer, elcount( buffer ), "0.0000 HMI_Skip_Lt_Sw_Psd := %X\n", getValue( HMI_Skip_Lt_Sw_Psd ) );        filePutString ( buffer, elcount( buffer ), hFile );
    snprintf( buffer, elcount( buffer ), "0.0000 HMI_Skip_Rt_Sw_Psd := %X\n", getValue( HMI_Skip_Rt_Sw_Psd ) );        filePutString ( buffer, elcount( buffer ), hFile );
}

on timer _tCtrl_C_Stat4_AR
{
    putValue( HMI__STMSG_Ctrl_C_Stat4_AR, 0 );
}

on EnvVar HMI__STMSG_Ctrl_C_Stat4_AR
{
    long tDelay;
    if( getValue( this ) == 2 )
    {
        tDelay = getValue( HMI__STMSGT_Ctrl_C_Stat4_AR );
        if( tDelay > 0)    
            setTimer( _tCtrl_C_Stat4_AR, tDelay );
        else
            putValue( HMI__STMSG_Ctrl_C_Stat4_AR, 0 );
    }
}

on envVar HMI__STMSG_PO_Ctrl_C_Stat4_AR
{
    if( getValue( this ) )
        openPanel("Ctrl_C_Stat4_AR");
}

on EnvVar HMI_CTRL_L_Stat_UB
{
    _mCtrl_C_Stat4_AR.CTRL_L_Stat_UB.phys = getValue(this);
    _Ctrl_C_Stat4_AR_SpontanFlag = 1;
}

on EnvVar HMI_CTRL_L2_Stat_UB
{
    _mCtrl_C_Stat4_AR.CTRL_L2_Stat_UB.phys = getValue(this);
    _Ctrl_C_Stat4_AR_SpontanFlag = 1;
}

on EnvVar HMI_Park_APC_Sw_Psd_CTRL_L
{
    _mCtrl_C_Stat4_AR.Park_APC_Sw_Psd_CTRL_L.phys = getValue(this);
    _Ctrl_C_Stat4_AR_SpontanFlag = 1;
}

on EnvVar HMI_Park_APC_Sw_Psd_CTRL_L2
{
    _mCtrl_C_Stat4_AR.Park_APC_Sw_Psd_CTRL_L2.phys = getValue(this);
    _Ctrl_C_Stat4_AR_SpontanFlag = 1;
}

on EnvVar HMI_Rsrv1_CTRL_L_Stat
{
    _mCtrl_C_Stat4_AR.Rsrv1_CTRL_L_Stat.phys = getValue(this);
    _Ctrl_C_Stat4_AR_SpontanFlag = 1;
}

on EnvVar HMI_Rsrv1_CTRL_L2_Stat
{
    _mCtrl_C_Stat4_AR.Rsrv1_CTRL_L2_Stat.phys = getValue(this);
    _Ctrl_C_Stat4_AR_SpontanFlag = 1;
}

on EnvVar HMI_SQC_CTRL_L_Stat
{
    _mCtrl_C_Stat4_AR.SQC_CTRL_L_Stat.phys = getValue(this);
    _Ctrl_C_Stat4_AR_SpontanFlag = 1;
}

on EnvVar HMI_SQC_CTRL_L2_Stat
{
    _mCtrl_C_Stat4_AR.SQC_CTRL_L2_Stat.phys = getValue(this);
    _Ctrl_C_Stat4_AR_SpontanFlag = 1;
}

on EnvVar HMI_CRC_CTRL_L_Stat
{
    _mCtrl_C_Stat4_AR.CRC_CTRL_L_Stat.phys = getValue(this);
    _Ctrl_C_Stat4_AR_SpontanFlag = 1;
}

on EnvVar HMI_CRC_CTRL_L2_Stat
{
    _mCtrl_C_Stat4_AR.CRC_CTRL_L2_Stat.phys = getValue(this);
    _Ctrl_C_Stat4_AR_SpontanFlag = 1;
}

on EnvVar HMI_Prox_Dtct_AMG
{
    _mCtrl_C_Stat4_AR.Prox_Dtct_AMG.phys = getValue(this);
    _Ctrl_C_Stat4_AR_SpontanFlag = 1;
}

on EnvVar HMI_Prox_Dtct_AMG_UB
{
    _mCtrl_C_Stat4_AR.Prox_Dtct_AMG_UB.phys = getValue(this);
    _Ctrl_C_Stat4_AR_SpontanFlag = 1;
}

on EnvVar HMI_TouchKey_Approach_AMG
{
    _mCtrl_C_Stat4_AR.TouchKey_Approach_AMG.phys = getValue(this);
    _Ctrl_C_Stat4_AR_SpontanFlag = 1;
}

on EnvVar HMI_TouchKey_Approach_AMG_UB
{
    _mCtrl_C_Stat4_AR.TouchKey_Approach_AMG_UB.phys = getValue(this);
    _Ctrl_C_Stat4_AR_SpontanFlag = 1;
}

on EnvVar HMI_Skip_Lt_Sw_Psd
{
    _mCtrl_C_Stat4_AR.Skip_Lt_Sw_Psd.phys = getValue(this);
    _Ctrl_C_Stat4_AR_SpontanFlag = 1;
}

on EnvVar HMI_Skip_Rt_Sw_Psd
{
    _mCtrl_C_Stat4_AR.Skip_Rt_Sw_Psd.phys = getValue(this);
    _Ctrl_C_Stat4_AR_SpontanFlag = 1;
}

DISP_C_Stat_AR_check_output()
{
    if( !getValue( HMI__STMSG_DISP_C_Stat_AR ) )
    {
        // Botschaft DISP_C_Stat_AR ID: 505 --- Sendeart 5 cyclicAndSpontanWithDelay --- 
        _DISP_C_Stat_AR_Cnt--;
        if( _DISP_C_Stat_AR_Cnt < 1 )
        {
            // Nachricht wg. abgelaufenem Zyklus ausgeben
            DISP_C_Stat_AR_output();
            _DISP_C_Stat_AR_Cnt = _DISP_C_Stat_AR_CycleCount; // Zyklus-Zähler zurücksetzen
            _DISP_C_Stat_AR_SpontanFlag = 0; // Spontan-Flag zurücksetzen
        }
        else if( _DISP_C_Stat_AR_SpontanFlag)
        {
            // Nachricht wg. spontaner Änderung ausgeben
            DISP_C_Stat_AR_output();
            _DISP_C_Stat_AR_SpontanFlag = 0; // Spontan-Flag zurücksetzen
        }
    }
}

DISP_C_Stat_AR_init()
{   /* Botschaft DISP_C_Stat_AR ID: 505 --- Sendeart 5 cyclicAndSpontanWithDelay --- 
BA_ "ApplMessage" BO_ 505 0;
BA_ "NmAsrMessage" BO_ 505 0;
BA_ "GenMsgMinAcceptLength" BO_ 505 5;
BA_ "GenMsgILSupport" BO_ 505 1;
BA_ "DiagState" BO_ 505 0;
BA_ "DiagRequest" BO_ 505 0;
BA_ "DiagResponse" BO_ 505 0;
BA_ "GenMsgStartValue" BO_ 505 "0";
BA_ "GenMsgDelayTime" BO_ 505 20;
BA_ "GenMsgNrOfRepetition" BO_ 505 0;
BA_ "GenMsgCycleTime" BO_ 505 100;
BA_ "GenMsgSendType" BO_ 505 5;
    */
    _DISP_C_Stat_AR_Timebase =      c_tDBKomTimer_20ms;
    _DISP_C_Stat_AR_CycleCount =    100 / _DISP_C_Stat_AR_Timebase;
    _DISP_C_Stat_AR_StartDelay =      0 / _DISP_C_Stat_AR_Timebase;
    _DISP_C_Stat_AR_Cnt = _DISP_C_Stat_AR_StartDelay;
    _DISP_C_Stat_AR_SpontanFlag = 0;

    putValue( HMI__STMSGSD_DISP_C_Stat_AR, _DISP_C_Stat_AR_StartDelay * _DISP_C_Stat_AR_Timebase );

    _mDISP_C_Stat_AR.AuxFanRPM_Rq.phys = getValue( HMI_AuxFanRPM_Rq );
    _mDISP_C_Stat_AR.DISP_C_AudioFade_Stat.phys = getValue( HMI_DISP_C_AudioFade_Stat );
    _mDISP_C_Stat_AR.DISP_C_BackLgt_Stat.phys = getValue( HMI_DISP_C_BackLgt_Stat );
    _mDISP_C_Stat_AR.DISP_C_Heat_Mgtm.phys = getValue( HMI_DISP_C_Heat_Mgtm );
    _mDISP_C_Stat_AR.DISP_C_On_Stat.phys = getValue( HMI_DISP_C_On_Stat );
    _mDISP_C_Stat_AR.DISP_IC_BackLgt_Stat.phys = getValue( HMI_DISP_IC_BackLgt_Stat );
    _mDISP_C_Stat_AR.DISP_IC_On_Stat.phys = getValue( HMI_DISP_IC_On_Stat );
    _mDISP_C_Stat_AR.HeadPhone_Stat_DISP_C.phys = getValue( HMI_HeadPhone_Stat_DISP_C );
    _mDISP_C_Stat_AR.HeadPhoneMute_Actv_DISP_C.phys = getValue( HMI_HeadPhoneMute_Actv_DISP_C );
    _mDISP_C_Stat_AR.IP_Brt_DispCluster.phys = getValue( HMI_IP_Brt_DispCluster );
    _mDISP_C_Stat_AR.Park_Disp_Stat.phys = getValue( HMI_Park_Disp_Stat );
    _mDISP_C_Stat_AR.SPV_Rem_Mute.phys = getValue( HMI_SPV_Rem_Mute );
    _mDISP_C_Stat_AR.SPV_Rem_Vol_Psd1.phys = getValue( HMI_SPV_Rem_Vol_Psd1 );
    _mDISP_C_Stat_AR.SPV_Rem_Vol_Psd2.phys = getValue( HMI_SPV_Rem_Vol_Psd2 );
}

DISP_C_Stat_AR_output(void)
{
    output( _mDISP_C_Stat_AR );
}

DISP_C_Stat_AR_saveEnvVars( dword hFile )
{
    filePutString("\n// Knoten EIS: DISP_C_Stat_AR\n", 27, hFile );
    snprintf( buffer, elcount( buffer ), "0.0000 HMI__STMSG_DISP_C_Stat_AR := %X\n", getValue( HMI__STMSG_DISP_C_Stat_AR ) );        filePutString ( buffer, elcount( buffer ), hFile );
    snprintf( buffer, elcount( buffer ), "0.0000 HMI__STMSGT_DISP_C_Stat_AR := %X\n", getValue( HMI__STMSGT_DISP_C_Stat_AR ) );        filePutString ( buffer, elcount( buffer ), hFile );
    snprintf( buffer, elcount( buffer ), "0.0000 HMI_AuxFanRPM_Rq := %X\n", getValue( HMI_AuxFanRPM_Rq ) );        filePutString ( buffer, elcount( buffer ), hFile );
    snprintf( buffer, elcount( buffer ), "0.0000 HMI_DISP_C_AudioFade_Stat := %X\n", getValue( HMI_DISP_C_AudioFade_Stat ) );        filePutString ( buffer, elcount( buffer ), hFile );
    snprintf( buffer, elcount( buffer ), "0.0000 HMI_DISP_C_BackLgt_Stat := %X\n", getValue( HMI_DISP_C_BackLgt_Stat ) );        filePutString ( buffer, elcount( buffer ), hFile );
    snprintf( buffer, elcount( buffer ), "0.0000 HMI_DISP_C_Heat_Mgtm := %X\n", getValue( HMI_DISP_C_Heat_Mgtm ) );        filePutString ( buffer, elcount( buffer ), hFile );
    snprintf( buffer, elcount( buffer ), "0.0000 HMI_DISP_C_On_Stat := %X\n", getValue( HMI_DISP_C_On_Stat ) );        filePutString ( buffer, elcount( buffer ), hFile );
    snprintf( buffer, elcount( buffer ), "0.0000 HMI_DISP_IC_BackLgt_Stat := %X\n", getValue( HMI_DISP_IC_BackLgt_Stat ) );        filePutString ( buffer, elcount( buffer ), hFile );
    snprintf( buffer, elcount( buffer ), "0.0000 HMI_DISP_IC_On_Stat := %X\n", getValue( HMI_DISP_IC_On_Stat ) );        filePutString ( buffer, elcount( buffer ), hFile );
    snprintf( buffer, elcount( buffer ), "0.0000 HMI_HeadPhone_Stat_DISP_C := %X\n", getValue( HMI_HeadPhone_Stat_DISP_C ) );        filePutString ( buffer, elcount( buffer ), hFile );
    snprintf( buffer, elcount( buffer ), "0.0000 HMI_HeadPhoneMute_Actv_DISP_C := %X\n", getValue( HMI_HeadPhoneMute_Actv_DISP_C ) );        filePutString ( buffer, elcount( buffer ), hFile );
    snprintf( buffer, elcount( buffer ), "0.0000 HMI_IP_Brt_DispCluster := %X\n", getValue( HMI_IP_Brt_DispCluster ) );        filePutString ( buffer, elcount( buffer ), hFile );
    snprintf( buffer, elcount( buffer ), "0.0000 HMI_Park_Disp_Stat := %X\n", getValue( HMI_Park_Disp_Stat ) );        filePutString ( buffer, elcount( buffer ), hFile );
    snprintf( buffer, elcount( buffer ), "0.0000 HMI_SPV_Rem_Mute := %X\n", getValue( HMI_SPV_Rem_Mute ) );        filePutString ( buffer, elcount( buffer ), hFile );
    snprintf( buffer, elcount( buffer ), "0.0000 HMI_SPV_Rem_Vol_Psd1 := %X\n", getValue( HMI_SPV_Rem_Vol_Psd1 ) );        filePutString ( buffer, elcount( buffer ), hFile );
    snprintf( buffer, elcount( buffer ), "0.0000 HMI_SPV_Rem_Vol_Psd2 := %X\n", getValue( HMI_SPV_Rem_Vol_Psd2 ) );        filePutString ( buffer, elcount( buffer ), hFile );
}

on timer _tDISP_C_Stat_AR
{
    putValue( HMI__STMSG_DISP_C_Stat_AR, 0 );
}

on EnvVar HMI__STMSG_DISP_C_Stat_AR
{
    long tDelay;
    if( getValue( this ) == 2 )
    {
        tDelay = getValue( HMI__STMSGT_DISP_C_Stat_AR );
        if( tDelay > 0)    
            setTimer( _tDISP_C_Stat_AR, tDelay );
        else
            putValue( HMI__STMSG_DISP_C_Stat_AR, 0 );
    }
}

on envVar HMI__STMSG_PO_DISP_C_Stat_AR
{
    if( getValue( this ) )
        openPanel("DISP_C_Stat_AR");
}

on EnvVar HMI_AuxFanRPM_Rq
{
    _mDISP_C_Stat_AR.AuxFanRPM_Rq.phys = getValue(this);
    _DISP_C_Stat_AR_SpontanFlag = 1;
}

on EnvVar HMI_DISP_C_AudioFade_Stat
{
    _mDISP_C_Stat_AR.DISP_C_AudioFade_Stat.phys = getValue(this);
    _DISP_C_Stat_AR_SpontanFlag = 1;
}

on EnvVar HMI_DISP_C_BackLgt_Stat
{
    _mDISP_C_Stat_AR.DISP_C_BackLgt_Stat.phys = getValue(this);
    _DISP_C_Stat_AR_SpontanFlag = 1;
}

on EnvVar HMI_DISP_C_Heat_Mgtm
{
    _mDISP_C_Stat_AR.DISP_C_Heat_Mgtm.phys = getValue(this);
    _DISP_C_Stat_AR_SpontanFlag = 1;
}

on EnvVar HMI_DISP_C_On_Stat
{
    _mDISP_C_Stat_AR.DISP_C_On_Stat.phys = getValue(this);
    _DISP_C_Stat_AR_SpontanFlag = 1;
}

on EnvVar HMI_DISP_IC_BackLgt_Stat
{
    _mDISP_C_Stat_AR.DISP_IC_BackLgt_Stat.phys = getValue(this);
    _DISP_C_Stat_AR_SpontanFlag = 1;
}

on EnvVar HMI_DISP_IC_On_Stat
{
    _mDISP_C_Stat_AR.DISP_IC_On_Stat.phys = getValue(this);
    _DISP_C_Stat_AR_SpontanFlag = 1;
}

on EnvVar HMI_HeadPhone_Stat_DISP_C
{
    _mDISP_C_Stat_AR.HeadPhone_Stat_DISP_C.phys = getValue(this);
    _DISP_C_Stat_AR_SpontanFlag = 1;
}

on EnvVar HMI_HeadPhoneMute_Actv_DISP_C
{
    _mDISP_C_Stat_AR.HeadPhoneMute_Actv_DISP_C.phys = getValue(this);
    _DISP_C_Stat_AR_SpontanFlag = 1;
}

on EnvVar HMI_IP_Brt_DispCluster
{
    _mDISP_C_Stat_AR.IP_Brt_DispCluster.phys = getValue(this);
    _DISP_C_Stat_AR_SpontanFlag = 1;
}

on EnvVar HMI_Park_Disp_Stat_DISP_C_Stat_AR
{
    _mDISP_C_Stat_AR.Park_Disp_Stat.phys = getValue(this);
    _DISP_C_Stat_AR_SpontanFlag = 1;
}

on EnvVar HMI_SPV_Rem_Mute
{
    _mDISP_C_Stat_AR.SPV_Rem_Mute.phys = getValue(this);
    _DISP_C_Stat_AR_SpontanFlag = 1;
}

on EnvVar HMI_SPV_Rem_Vol_Psd1
{
    _mDISP_C_Stat_AR.SPV_Rem_Vol_Psd1.phys = getValue(this);
    _DISP_C_Stat_AR_SpontanFlag = 1;
}

on EnvVar HMI_SPV_Rem_Vol_Psd2
{
    _mDISP_C_Stat_AR.SPV_Rem_Vol_Psd2.phys = getValue(this);
    _DISP_C_Stat_AR_SpontanFlag = 1;
}

DPC_IndMd_Rq_AR_check_output()
{
    if( !getValue( HMI__STMSG_DPC_IndMd_Rq_AR ) )
    {
        // Botschaft DPC_IndMd_Rq_AR ID: 631 --- Sendeart cyclicAndSpontanWithDelay --- 
        if( _DPC_IndMd_Rq_AR_DelayCnt > 0) _DPC_IndMd_Rq_AR_DelayCnt--; // Mindestsendeabstand
        _DPC_IndMd_Rq_AR_Cnt--;
        if( _DPC_IndMd_Rq_AR_Cnt < 1 )
        {
            if( _DPC_IndMd_Rq_AR_DelayCnt < 1 )
            {
                // Nachricht wg. abgelaufenem Zyklus ausgeben (Mindestsendeabstand eingehalten)
                DPC_IndMd_Rq_AR_output();
                _DPC_IndMd_Rq_AR_SpontanFlag = 0; // Spontan-Flag zurücksetzen
                _DPC_IndMd_Rq_AR_DelayCnt = _DPC_IndMd_Rq_AR_MinDelay;
            }
            else
            {
                // Spontanflag setzen damit nach Ablauf Mindestsendeabstand gesendet wird
                 _DPC_IndMd_Rq_AR_SpontanFlag = 1;
            }
            _DPC_IndMd_Rq_AR_Cnt = _DPC_IndMd_Rq_AR_CycleCount; // Zyklus-Zähler zurücksetzen
        }
        else if( _DPC_IndMd_Rq_AR_SpontanFlag)
        {
            if( _DPC_IndMd_Rq_AR_DelayCnt < 1 )
            {
                // Nachricht wg. spontaner Änderung ausgeben (Mindestsendeabstand eingehalten)
                DPC_IndMd_Rq_AR_output();
                _DPC_IndMd_Rq_AR_SpontanFlag = 0; // Spontan-Flag zurücksetzen
                _DPC_IndMd_Rq_AR_DelayCnt = _DPC_IndMd_Rq_AR_MinDelay;
            }
        }
    }
}

DPC_IndMd_Rq_AR_init()
{   /* message DPC_IndMd_Rq_AR ID: 631 --- Sendeart cyclicAndSpontanWithDelay --- 
BA_ "ApplMessage" BO_ 631 0;
BA_ "NmAsrMessage" BO_ 631 0;
BA_ "GenMsgMinAcceptLength" BO_ 631 8;
BA_ "GenMsgILSupport" BO_ 631 1;
BA_ "DiagState" BO_ 631 0;
BA_ "DiagRequest" BO_ 631 0;
BA_ "DiagResponse" BO_ 631 0;
BA_ "GenMsgStartValue" BO_ 631 "0";
BA_ "GenMsgStartDelayTime" BO_ 631 20;
BA_ "GenMsgDelayTime" BO_ 631 20;
BA_ "GenMsgNrOfRepetitions" BO_ 631 0;
BA_ "GenMsgCycleTime" BO_ 631 100;
BA_ "GenMsgSendType" BO_ 631 5;
    */
    _DPC_IndMd_Rq_AR_Timebase =         c_tDBKomTimer_20ms;
    _DPC_IndMd_Rq_AR_CycleCount =      100 / _DPC_IndMd_Rq_AR_Timebase;
    _DPC_IndMd_Rq_AR_MinDelay =         20 / _DPC_IndMd_Rq_AR_Timebase;
    _DPC_IndMd_Rq_AR_StartDelay =       20 / _DPC_IndMd_Rq_AR_Timebase;
    _DPC_IndMd_Rq_AR_Cnt = _DPC_IndMd_Rq_AR_StartDelay;
    _DPC_IndMd_Rq_AR_SpontanFlag = 0;
    _DPC_IndMd_Rq_AR_DelayCnt = 0;

    putValue( HMI__STMSGSD_DPC_IndMd_Rq_AR, _DPC_IndMd_Rq_AR_StartDelay * _DPC_IndMd_Rq_AR_Timebase );

    _mDPC_IndMd_Rq_AR.DPC_IndMd_AC_Rq.phys = getValue( HMI_DPC_IndMd_AC_Rq );
    _mDPC_IndMd_Rq_AR.DPC_IndMd_DrvDyn_Rq.phys = getValue( HMI_DPC_IndMd_DrvDyn_Rq );
    _mDPC_IndMd_Rq_AR.DPC_IndMd_ECO_Assist_Rq.phys = getValue( HMI_DPC_IndMd_ECO_Assist_Rq );
    _mDPC_IndMd_Rq_AR.DPC_IndMd_eDrv_Rq.phys = getValue( HMI_DPC_IndMd_eDrv_Rq );
    _mDPC_IndMd_Rq_AR.DPC_IndMd_ESP_Rq.phys = getValue( HMI_DPC_IndMd_ESP_Rq );
    _mDPC_IndMd_Rq_AR.DPC_IndMd_ExhstFlap_Rq.phys = getValue( HMI_DPC_IndMd_ExhstFlap_Rq );
    _mDPC_IndMd_Rq_AR.DPC_IndMd_Ht_Rq.phys = getValue( HMI_DPC_IndMd_Ht_Rq );
    _mDPC_IndMd_Rq_AR.DPC_IndMd_PT_Rq.phys = getValue( HMI_DPC_IndMd_PT_Rq );
    _mDPC_IndMd_Rq_AR.DPC_IndMd_PwrFreeD_Plus_Rq.phys = getValue( HMI_DPC_IndMd_PwrFreeD_Plus_Rq );
    _mDPC_IndMd_Rq_AR.DPC_IndMd_SSA_Rq.phys = getValue( HMI_DPC_IndMd_SSA_Rq );
    _mDPC_IndMd_Rq_AR.DPC_IndMd_St_Rq.phys = getValue( HMI_DPC_IndMd_St_Rq );
    _mDPC_IndMd_Rq_AR.DPC_IndMd_Susp_Rq.phys = getValue( HMI_DPC_IndMd_Susp_Rq );
    _mDPC_IndMd_Rq_AR.DPC_IndMd_Tx_Rq.phys = getValue( HMI_DPC_IndMd_Tx_Rq );
    _mDPC_IndMd_Rq_AR.DPC_OffroadMd_Rq.phys = getValue( HMI_DPC_OffroadMd_Rq );
}

void DPC_IndMd_Rq_AR_output(void)
{
    output( _mDPC_IndMd_Rq_AR );
}

DPC_IndMd_Rq_AR_saveEnvVars( dword hFile )
{
    filePutString("\n// Knoten TGW: DPC_IndMd_Rq_AR\n", 25, hFile);
    snprintf( buffer, elcount(buffer), "0.0000 HMI__STMSG_DPC_IndMd_Rq_AR := %X\n", getValue( HMI__STMSG_DPC_IndMd_Rq_AR ));        filePutString( buffer, elcount(buffer), hFile);
    snprintf( buffer, elcount(buffer), "0.0000 HMI__STMSGT_DPC_IndMd_Rq_AR := %X\n", getValue( HMI__STMSGT_DPC_IndMd_Rq_AR ));        filePutString( buffer, elcount(buffer), hFile);
    snprintf( buffer, elcount(buffer), "0.0000 HMI_DPC_IndMd_ABC_Rq := %X\n", getValue( HMI_DPC_IndMd_ABC_Rq ) );        filePutString( buffer, elcount(buffer), hFile);
    snprintf( buffer, elcount(buffer), "0.0000 HMI_DPC_IndMd_AC_Rq := %X\n", getValue( HMI_DPC_IndMd_AC_Rq ) );        filePutString( buffer, elcount(buffer), hFile);
    snprintf( buffer, elcount(buffer), "0.0000 HMI_DPC_IndMd_AS_Rq := %X\n", getValue( HMI_DPC_IndMd_DrvDyn_Rq ) );        filePutString( buffer, elcount(buffer), hFile);
    snprintf( buffer, elcount(buffer), "0.0000 HMI_DPC_IndMd_ECO_Assist_Rq := %X\n", getValue( HMI_DPC_IndMd_ECO_Assist_Rq ) );        filePutString( buffer, elcount(buffer), hFile);
    snprintf( buffer, elcount(buffer), "0.0000 HMI_DPC_IndMd_eDrv_Rq := %X\n", getValue( HMI_DPC_IndMd_eDrv_Rq ) );        filePutString( buffer, elcount(buffer), hFile);
    snprintf( buffer, elcount(buffer), "0.0000 HMI_DPC_IndMd_ESP_Rq := %X\n", getValue( HMI_DPC_IndMd_ESP_Rq ) );        filePutString( buffer, elcount(buffer), hFile);
    snprintf( buffer, elcount(buffer), "0.0000 HMI_DPC_IndMd_ExhstFlap_Rq := %X\n", getValue( HMI_DPC_IndMd_ExhstFlap_Rq ) );        filePutString( buffer, elcount(buffer), hFile);
    snprintf( buffer, elcount(buffer), "0.0000 HMI_DPC_IndMd_Ht_Rq := %X\n", getValue( HMI_DPC_IndMd_Ht_Rq ) );        filePutString( buffer, elcount(buffer), hFile);
    snprintf( buffer, elcount(buffer), "0.0000 HMI_DPC_IndMd_PT_Rq := %X\n", getValue( HMI_DPC_IndMd_PT_Rq ) );        filePutString( buffer, elcount(buffer), hFile);
    snprintf( buffer, elcount(buffer), "0.0000 HMI_DPC_IndMd_PwrFreeD_Plus_Rq := %X\n", getValue( HMI_DPC_IndMd_PwrFreeD_Plus_Rq ) );        filePutString( buffer, elcount(buffer), hFile);
    snprintf( buffer, elcount(buffer), "0.0000 HMI_DPC_IndMd_SSA_Rq := %X\n", getValue( HMI_DPC_IndMd_SSA_Rq ) );        filePutString( buffer, elcount(buffer), hFile);
    snprintf( buffer, elcount(buffer), "0.0000 HMI_DPC_IndMd_St_Rq := %X\n", getValue( HMI_DPC_IndMd_St_Rq ) );        filePutString( buffer, elcount(buffer), hFile);
    snprintf( buffer, elcount(buffer), "0.0000 HMI_DPC_IndMd_Susp_Rq := %X\n", getValue( HMI_DPC_IndMd_Susp_Rq ) );        filePutString( buffer, elcount(buffer), hFile);
    snprintf( buffer, elcount(buffer), "0.0000 HMI_DPC_IndMd_Tx_Rq := %X\n", getValue( HMI_DPC_IndMd_Tx_Rq ) );        filePutString( buffer, elcount(buffer), hFile);
    snprintf( buffer, elcount(buffer), "0.0000 HMI_DPC_OffroadMd_Rq := %X\n", getValue( HMI_DPC_OffroadMd_Rq ) );        filePutString( buffer, elcount(buffer), hFile);
}

on timer _tDPC_IndMd_Rq_AR
{
    putValue( HMI__STMSG_DPC_IndMd_Rq_AR, 0 );
}

on EnvVar HMI__STMSG_DPC_IndMd_Rq_AR
{
    long tDelay;
    if( getValue( this ) == 2 )
    {
        tDelay = getValue( HMI__STMSGT_DPC_IndMd_Rq_AR );
        if( tDelay > 0 )    
            setTimer( _tDPC_IndMd_Rq_AR, tDelay );
        else
            putValue( HMI__STMSG_DPC_IndMd_Rq_AR, 0 );
    }
}

on envVar HMI__STMSG_PO_DPC_IndMd_Rq_AR
{
    if( getValue( this ) )
        openPanel("DPC_IndMd_Rq_AR");
}

on EnvVar HMI_DPC_IndMd_ABC_Rq
{
    _mDPC_IndMd_Rq_AR.DPC_IndMd_ABC_Rq.phys = getValue(this);
    _DPC_IndMd_Rq_AR_SpontanFlag = 1;
}

on EnvVar HMI_DPC_IndMd_AC_Rq
{
    _mDPC_IndMd_Rq_AR.DPC_IndMd_AC_Rq.phys = getValue(this);
    _DPC_IndMd_Rq_AR_SpontanFlag = 1;
}

on EnvVar HMI_DPC_IndMd_DrvDyn_Rq
{
    _mDPC_IndMd_Rq_AR.DPC_IndMd_DrvDyn_Rq.phys = getValue(this);
    _DPC_IndMd_Rq_AR_SpontanFlag = 1;
}

on EnvVar HMI_DPC_IndMd_ECO_Assist_Rq
{
    _mDPC_IndMd_Rq_AR.DPC_IndMd_ECO_Assist_Rq.phys = getValue(this);
    _DPC_IndMd_Rq_AR_SpontanFlag = 1;
}

on EnvVar HMI_DPC_IndMd_eDrv_Rq
{
    _mDPC_IndMd_Rq_AR.DPC_IndMd_eDrv_Rq.phys = getValue(this);
    _DPC_IndMd_Rq_AR_SpontanFlag = 1;
}

on EnvVar HMI_DPC_IndMd_ESP_Rq
{
    _mDPC_IndMd_Rq_AR.DPC_IndMd_ESP_Rq.phys = getValue(this);
    _DPC_IndMd_Rq_AR_SpontanFlag = 1;
}

on EnvVar HMI_DPC_IndMd_ExhstFlap_Rq
{
    _mDPC_IndMd_Rq_AR.DPC_IndMd_ExhstFlap_Rq.phys = getValue(this);
    _DPC_IndMd_Rq_AR_SpontanFlag = 1;
}

on EnvVar HMI_DPC_IndMd_Ht_Rq
{
    _mDPC_IndMd_Rq_AR.DPC_IndMd_Ht_Rq.phys = getValue(this);
    _DPC_IndMd_Rq_AR_SpontanFlag = 1;
}

on EnvVar HMI_DPC_IndMd_PT_Rq
{
    _mDPC_IndMd_Rq_AR.DPC_IndMd_PT_Rq.phys = getValue(this);
    _DPC_IndMd_Rq_AR_SpontanFlag = 1;
}

on EnvVar HMI_DPC_IndMd_PwrFreeD_Plus_Rq
{
    _mDPC_IndMd_Rq_AR.DPC_IndMd_PwrFreeD_Plus_Rq.phys = getValue(this);
    _DPC_IndMd_Rq_AR_SpontanFlag = 1;
}

on EnvVar HMI_DPC_IndMd_SSA_Rq
{
    _mDPC_IndMd_Rq_AR.DPC_IndMd_SSA_Rq.phys = getValue(this);
    _DPC_IndMd_Rq_AR_SpontanFlag = 1;
}

on EnvVar HMI_DPC_IndMd_St_Rq
{
    _mDPC_IndMd_Rq_AR.DPC_IndMd_St_Rq.phys = getValue(this);
    _DPC_IndMd_Rq_AR_SpontanFlag = 1;
}

on EnvVar HMI_DPC_IndMd_Susp_Rq
{
    _mDPC_IndMd_Rq_AR.DPC_IndMd_Susp_Rq.phys = getValue(this);
    _DPC_IndMd_Rq_AR_SpontanFlag = 1;
}

on EnvVar HMI_DPC_IndMd_Tx_Rq
{
    _mDPC_IndMd_Rq_AR.DPC_IndMd_Tx_Rq.phys = getValue(this);
    _DPC_IndMd_Rq_AR_SpontanFlag = 1;
}

on EnvVar HMI_DPC_OffroadMd_Rq
{
    _mDPC_IndMd_Rq_AR.DPC_OffroadMd_Rq.phys = getValue(this);
    _DPC_IndMd_Rq_AR_SpontanFlag = 1;
}

DPC_MdSel_Rq_AR_check_output()
{
    if( !getValue( HMI__STMSG_DPC_MdSel_Rq_AR ) )
    {
        // message DPC_MdSel_Rq_AR ID: 1056 --- Sendeart cyclicAndSpontanWithDelay --- 
        if( _DPC_MdSel_Rq_AR_DelayCnt > 0) _DPC_MdSel_Rq_AR_DelayCnt--; // Mindestsendeabstand
        _DPC_MdSel_Rq_AR_Cnt--;
        if( _DPC_MdSel_Rq_AR_Cnt < 1 )
        {
            if( _DPC_MdSel_Rq_AR_DelayCnt < 1 )
            {
                // Nachricht wg. abgelaufenem Zyklus ausgeben (Mindestsendeabstand eingehalten)
                DPC_MdSel_Rq_AR_output();
                _DPC_MdSel_Rq_AR_SpontanFlag = 0; // Spontan-Flag zurücksetzen
                _DPC_MdSel_Rq_AR_DelayCnt = _DPC_MdSel_Rq_AR_MinDelay;
            }
            else
            {
                // Spontanflag setzen damit nach Ablauf Mindestsendeabstand gesendet wird
                 _DPC_MdSel_Rq_AR_SpontanFlag = 1;
            }
            _DPC_MdSel_Rq_AR_Cnt = _DPC_MdSel_Rq_AR_CycleCount; // Zyklus-Zähler zurücksetzen
        }
        else if( _DPC_MdSel_Rq_AR_SpontanFlag)
        {
            if( _DPC_MdSel_Rq_AR_DelayCnt < 1 )
            {
                // Nachricht wg. spontaner Änderung ausgeben (Mindestsendeabstand eingehalten)
                DPC_MdSel_Rq_AR_output();
                _DPC_MdSel_Rq_AR_SpontanFlag = 0; // Spontan-Flag zurücksetzen
                _DPC_MdSel_Rq_AR_DelayCnt = _DPC_MdSel_Rq_AR_MinDelay;
            }
        }
    }
}

DPC_MdSel_Rq_AR_init()
{   /* message DPC_MdSel_Rq_AR ID: 1056 --- Sendeart cyclicAndSpontanWithDelay --- 
BA_ "ApplMessage" BO_ 1056 0;
BA_ "NmAsrMessage" BO_ 1056 0;
BA_ "GenMsgMinAcceptLength" BO_ 1056 8;
BA_ "GenMsgILSupport" BO_ 1056 1;
BA_ "DiagState" BO_ 1056 0;
BA_ "DiagRequest" BO_ 1056 0;
BA_ "DiagResponse" BO_ 1056 0;
BA_ "GenMsgStartValue" BO_ 1056 "0";
BA_ "GenMsgStartDelayTime" BO_ 1056 280;
BA_ "GenMsgDelayTime" BO_ 1056 20;
BA_ "GenMsgNrOfRepetition" BO_ 1056 0;
BA_ "GenMsgCycleTime" BO_ 1056 500;
BA_ "GenMsgSendType" BO_ 1056 5;
    */
    _DPC_MdSel_Rq_AR_Timebase =              c_tDBKomTimer_20ms;
    _DPC_MdSel_Rq_AR_CycleCount =          500 / _DPC_MdSel_Rq_AR_Timebase;
    _DPC_MdSel_Rq_AR_StartDelay =          280 / _DPC_MdSel_Rq_AR_Timebase;
    _DPC_MdSel_Rq_AR_MinDelay =             20 / _DPC_MdSel_Rq_AR_Timebase;
    _DPC_MdSel_Rq_AR_Cnt = _DPC_MdSel_Rq_AR_StartDelay;
    _DPC_MdSel_Rq_AR_SpontanFlag = 0;
    _DPC_MdSel_Rq_AR_DelayCnt = 0;
   
    putValue( HMI__STMSGSD_DPC_MdSel_Rq_AR, _DPC_MdSel_Rq_AR_StartDelay * _DPC_MdSel_Rq_AR_Timebase );
    
    _mDPC_MdSel_Rq_AR.DPC_DefaultMd_Rq_HU.phys = getValue( HMI_DPC_DefaultMd_Rq_HU );
    _mDPC_MdSel_Rq_AR.DPC_GlobalMd_Rq_HU.phys = getValue( HMI_DPC_GlobalMd_Rq_HU );
    _mDPC_MdSel_Rq_AR.DPC_GlobalMd_TrgRq_HU.phys = getValue( HMI_DPC_GlobalMd_TrgRq_HU );
    _mDPC_MdSel_Rq_AR.DPC_Md_AS_Rq_HU.phys = getValue( HMI_DPC_Md_AS_Rq_HU );
    _mDPC_MdSel_Rq_AR.DPC_Md_ASX_Rq_HU.phys = getValue( HMI_DPC_Md_ASX_Rq_HU );
    _mDPC_MdSel_Rq_AR.DPC_Md_Hybrid_Rq_HU.phys = getValue( HMI_DPC_Md_Hybrid_Rq_HU );
	_mDPC_MdSel_Rq_AR.DPC_Md_PT_BatLvl_SOC_Rq_HU.phys = getValue( HMI_DPC_Md_PT_BatLvl_SOC_Rq_HU );
    _mDPC_MdSel_Rq_AR.DPC_Md_ESP_Rq_HU.phys = getValue( HMI_DPC_Md_ESP_Rq_HU );
    _mDPC_MdSel_Rq_AR.DPC_Md_ExhstFlap_Rq_HU.phys = getValue( HMI_DPC_Md_ExhstFlap_Rq_HU );
    _mDPC_MdSel_Rq_AR.DPC_Md_PT_Rq_HU.phys = getValue( HMI_DPC_Md_PT_Rq_HU );
    _mDPC_MdSel_Rq_AR.DPC_Md_PwrFreeD_Plus_Rq_HU.phys = getValue( HMI_DPC_Md_PwrFreeD_Plus_Rq_HU );
    _mDPC_MdSel_Rq_AR.DPC_Md_SSA_Rq_HU.phys = getValue( HMI_DPC_Md_SSA_Rq_HU );
    _mDPC_MdSel_Rq_AR.DPC_Md_St_Rq_HU.phys = getValue( HMI_DPC_Md_St_Rq_HU );
    _mDPC_MdSel_Rq_AR.DPC_Md_Susp_Rq_HU.phys = getValue( HMI_DPC_Md_Susp_Rq_HU );
    _mDPC_MdSel_Rq_AR.DPC_Md_SuspLvl_Rq_HU.phys = getValue( HMI_DPC_Md_SuspLvl_Rq_HU );
    _mDPC_MdSel_Rq_AR.DPC_Md_Tx_Rq_HU.phys = getValue( HMI_DPC_Md_Tx_Rq_HU );	
	_mDPC_MdSel_Rq_AR.DPC_PopUpBtn_Psd_HU.phys = getValue( HMI_DPC_PopUpBtn_Psd_HU );
	_mDPC_MdSel_Rq_AR.DPC_SelDpc_Stat_HU.phys = getValue( HMI_DPC_SelDpc_Stat_HU );
	_mDPC_MdSel_Rq_AR.VehDrvProg_M_Rq_HU.phys = getValue( HMI_VehDrvProg_M_Rq_HU );
}

DPC_MdSel_Rq_AR_output()
{
    output( _mDPC_MdSel_Rq_AR );
}

DPC_MdSel_Rq_AR_saveEnvVars( dword hFile )
{
    filePutString("\n// Knoten DPC_MdSel_Rq_AR\n", 33, hFile );
    snprintf( buffer, elcount( buffer ), "0.0000 HMI__STMSG_DPC_MdSel_Rq_AR := %X\n", getValue( HMI__STMSG_DPC_MdSel_Rq_AR ) );        filePutString( buffer, elcount( buffer ), hFile );
    snprintf( buffer, elcount( buffer ), "0.0000 HMI__STMSGT_DPC_MdSel_Rq_AR := %X\n", getValue( HMI__STMSGT_DPC_MdSel_Rq_AR ) );        filePutString( buffer, elcount( buffer ), hFile );
    snprintf( buffer, elcount( buffer ), "0.0000 HMI_DPC_DefaultMd_Rq_HU := %X\n", getValue( HMI_DPC_DefaultMd_Rq_HU ) );        filePutString( buffer, elcount( buffer ), hFile );
    snprintf( buffer, elcount( buffer ), "0.0000 HMI_DPC_GlobalMd_Rq_HU := %X\n", getValue( HMI_DPC_GlobalMd_Rq_HU ) );        filePutString( buffer, elcount( buffer ), hFile );
    snprintf( buffer, elcount( buffer ), "0.0000 HMI_DPC_GlobalMd_TrgRq_HU := %X\n", getValue( HMI_DPC_GlobalMd_TrgRq_HU ) );        filePutString( buffer, elcount( buffer ), hFile );
    snprintf( buffer, elcount( buffer ), "0.0000 HMI_DPC_Md_AS_Rq_HU := %X\n", getValue( HMI_DPC_Md_AS_Rq_HU ) );        filePutString( buffer, elcount( buffer ), hFile );
    snprintf( buffer, elcount( buffer ), "0.0000 HMI_DPC_Md_ASX_Rq_HU := %X\n", getValue( HMI_DPC_Md_ASX_Rq_HU ) );        filePutString( buffer, elcount( buffer ), hFile );
    snprintf( buffer, elcount( buffer ), "0.0000 HMI_DPC_Md_PT_BatLvl_SOC_Rq_HU := %X\n", getValue( HMI_DPC_Md_PT_BatLvl_SOC_Rq_HU ) );        filePutString( buffer, elcount( buffer ), hFile );
	snprintf( buffer, elcount( buffer ), "0.0000 HMI_DPC_Md_Hybrid_Rq_HU := %X\n", getValue( HMI_DPC_Md_Hybrid_Rq_HU ) );        filePutString( buffer, elcount( buffer ), hFile );
    snprintf( buffer, elcount( buffer ), "0.0000 HMI_DPC_Md_ESP_Rq_HU := %X\n", getValue( HMI_DPC_Md_ESP_Rq_HU ) );        filePutString( buffer, elcount( buffer ), hFile );
    snprintf( buffer, elcount( buffer ), "0.0000 HMI_DPC_Md_ExhstFlap_Rq_HU := %X\n", getValue( HMI_DPC_Md_ExhstFlap_Rq_HU ) );        filePutString( buffer, elcount( buffer ), hFile );
    snprintf( buffer, elcount( buffer ), "0.0000 HMI_DPC_Md_PT_Rq_HU := %X\n", getValue( HMI_DPC_Md_PT_Rq_HU ) );        filePutString( buffer, elcount( buffer ), hFile );
    snprintf( buffer, elcount( buffer ), "0.0000 HMI_DPC_Md_PwrFreeD_Plus_Rq_HU := %X\n", getValue( HMI_DPC_Md_PwrFreeD_Plus_Rq_HU ) );        filePutString( buffer, elcount( buffer ), hFile );
    snprintf( buffer, elcount( buffer ), "0.0000 HMI_DPC_Md_SSA_Rq_HU := %X\n", getValue( HMI_DPC_Md_SSA_Rq_HU ) );        filePutString( buffer, elcount( buffer ), hFile );
    snprintf( buffer, elcount( buffer ), "0.0000 HMI_DPC_Md_St_Rq_HU := %X\n", getValue( HMI_DPC_Md_St_Rq_HU ) );        filePutString( buffer, elcount( buffer ), hFile );
    snprintf( buffer, elcount( buffer ), "0.0000 HMI_DPC_Md_Susp_Rq_HU := %X\n", getValue( HMI_DPC_Md_Susp_Rq_HU ) );        filePutString( buffer, elcount( buffer ), hFile );
    snprintf( buffer, elcount( buffer ), "0.0000 HMI_DPC_Md_SuspLvl_Rq_HU := %X\n", getValue( HMI_DPC_Md_SuspLvl_Rq_HU ) );        filePutString( buffer, elcount( buffer ), hFile );
    snprintf( buffer, elcount( buffer ), "0.0000 HMI_DPC_Md_Tx_Rq_HU := %X\n", getValue( HMI_DPC_Md_Tx_Rq_HU ) );        filePutString( buffer, elcount( buffer ), hFile );
	snprintf( buffer, elcount( buffer ), "0.0000 HMI_DPC_PopUpBtn_Psd_HU := %X\n", getValue( HMI_DPC_PopUpBtn_Psd_HU ) );        filePutString( buffer, elcount( buffer ), hFile );
	snprintf( buffer, elcount( buffer ), "0.0000 HMI_DPC_SelDpc_Stat_HU := %X\n", getValue( HMI_DPC_SelDpc_Stat_HU ) );        filePutString( buffer, elcount( buffer ), hFile );
	snprintf( buffer, elcount( buffer ), "0.0000 HMI_VehDrvProg_M_Rq_HU := %X\n", getValue( HMI_VehDrvProg_M_Rq_HU ) );        filePutString( buffer, elcount( buffer ), hFile );
}

on timer _tDPC_MdSel_Rq_AR
{
    putValue( HMI__STMSG_DPC_MdSel_Rq_AR, 0 );
}

on EnvVar HMI__STMSG_DPC_MdSel_Rq_AR
{
    long tDelay;
    if( getValue( this ) == 2 )
    {
        tDelay = getValue( HMI__STMSGT_DPC_MdSel_Rq_AR );
        if( tDelay > 0)    
            setTimer( _tDPC_MdSel_Rq_AR, tDelay );
        else
            putValue( HMI__STMSG_DPC_MdSel_Rq_AR, 0 );
    }
}

on envVar HMI__STMSG_PO_DPC_MdSel_Rq_AR
{
    if( getValue( this ) )
        openPanel("DPC_MdSel_Rq_AR");
}

on EnvVar HMI_DPC_DefaultMd_Rq_HU
{
    _mDPC_MdSel_Rq_AR.DPC_DefaultMd_Rq_HU.phys = getValue(this);
    _DPC_MdSel_Rq_AR_SpontanFlag = 1;
}

on EnvVar HMI_DPC_GlobalMd_Rq_HU
{
    _mDPC_MdSel_Rq_AR.DPC_GlobalMd_Rq_HU.phys = getValue(this);
    _DPC_MdSel_Rq_AR_SpontanFlag = 1;
}

on EnvVar HMI_DPC_GlobalMd_TrgRq_HU
{
    _mDPC_MdSel_Rq_AR.DPC_GlobalMd_TrgRq_HU.phys = getValue(this);
    _DPC_MdSel_Rq_AR_SpontanFlag = 1;
}

on EnvVar HMI_DPC_Md_AS_Rq_HU
{
    _mDPC_MdSel_Rq_AR.DPC_Md_AS_Rq_HU.phys = getValue(this);
    _DPC_MdSel_Rq_AR_SpontanFlag = 1;
}

on EnvVar HMI_DPC_Md_PT_BatLvl_SOC_Rq_HU
{
    _mDPC_MdSel_Rq_AR.DPC_Md_PT_BatLvl_SOC_Rq_HU.phys = getValue(this);
    _DPC_MdSel_Rq_AR_SpontanFlag = 1;
}

on EnvVar HMI_DPC_Md_ASX_Rq_HU
{
    _mDPC_MdSel_Rq_AR.DPC_Md_ASX_Rq_HU.phys = getValue(this);
    _DPC_MdSel_Rq_AR_SpontanFlag = 1;
}

on EnvVar HMI_DPC_Md_Hybrid_Rq_HU
{
    _mDPC_MdSel_Rq_AR.DPC_Md_Hybrid_Rq_HU.phys = getValue(this);
    _DPC_MdSel_Rq_AR_SpontanFlag = 1;
}

on EnvVar HMI_DPC_Md_ESP_Rq_HU
{
    _mDPC_MdSel_Rq_AR.DPC_Md_ESP_Rq_HU.phys = getValue(this);
    _DPC_MdSel_Rq_AR_SpontanFlag = 1;
}

on EnvVar HMI_DPC_Md_ExhstFlap_Rq_HU
{
    _mDPC_MdSel_Rq_AR.DPC_Md_ExhstFlap_Rq_HU.phys = getValue(this);
    _DPC_MdSel_Rq_AR_SpontanFlag = 1;
}

on EnvVar HMI_DPC_Md_PT_Rq_HU
{
    _mDPC_MdSel_Rq_AR.DPC_Md_PT_Rq_HU.phys = getValue(this);
    _DPC_MdSel_Rq_AR_SpontanFlag = 1;
}

on EnvVar HMI_DPC_Md_PwrFreeD_Plus_Rq_HU
{
    _mDPC_MdSel_Rq_AR.DPC_Md_PwrFreeD_Plus_Rq_HU.phys = getValue(this);
    _DPC_MdSel_Rq_AR_SpontanFlag = 1;
}

on EnvVar HMI_DPC_Md_SSA_Rq_HU
{
    _mDPC_MdSel_Rq_AR.DPC_Md_SSA_Rq_HU.phys = getValue(this);
    _DPC_MdSel_Rq_AR_SpontanFlag = 1;
}

on EnvVar HMI_DPC_Md_St_Rq_HU
{
    _mDPC_MdSel_Rq_AR.DPC_Md_St_Rq_HU.phys = getValue(this);
    _DPC_MdSel_Rq_AR_SpontanFlag = 1;
}

on EnvVar HMI_DPC_Md_Susp_Rq_HU
{
    _mDPC_MdSel_Rq_AR.DPC_Md_Susp_Rq_HU.phys = getValue(this);
    _DPC_MdSel_Rq_AR_SpontanFlag = 1;
}

on EnvVar HMI_DPC_Md_SuspLvl_Rq_HU
{
    _mDPC_MdSel_Rq_AR.DPC_Md_SuspLvl_Rq_HU.phys = getValue(this);
    _DPC_MdSel_Rq_AR_SpontanFlag = 1;
}

on EnvVar HMI_DPC_Md_Tx_Rq_HU
{
    _mDPC_MdSel_Rq_AR.DPC_Md_Tx_Rq_HU.phys = getValue(this);
    _DPC_MdSel_Rq_AR_SpontanFlag = 1;
}

on EnvVar HMI_DPC_PopUpBtn_Psd_HU
{
    _mDPC_MdSel_Rq_AR.DPC_PopUpBtn_Psd_HU.phys = getValue(this);
    _DPC_MdSel_Rq_AR_SpontanFlag = 1;
}

on EnvVar HMI_DPC_SelDpc_Stat_HU
{
    _mDPC_MdSel_Rq_AR.DPC_SelDpc_Stat_HU.phys = getValue(this);
    _DPC_MdSel_Rq_AR_SpontanFlag = 1;
}

on EnvVar HMI_VehDrvProg_M_Rq_HU
{
    _mDPC_MdSel_Rq_AR.VehDrvProg_M_Rq_HU.phys = getValue(this);
    _DPC_MdSel_Rq_AR_SpontanFlag = 1;
}

FlashOverTheAir_Rq_AR_check_output()
{
    if( !getValue( HMI__STMSG_FlashOverTheAir_Rq_AR ) )
    {
        // message FlashOverTheAir_Rq_AR --- Sendeart 5 cyclicAndSpontanWithDelay --- 
        if( _FlashOverTheAir_Rq_AR_DelayCnt > 0) _FlashOverTheAir_Rq_AR_DelayCnt--; // Mindestsendeabstand
        _FlashOverTheAir_Rq_AR_Cnt--;
        if( _FlashOverTheAir_Rq_AR_Cnt < 1 )
        {
            if( _FlashOverTheAir_Rq_AR_DelayCnt < 1 )
            {
                // Nachricht wg. abgelaufenem Zyklus ausgeben (Mindestsendeabstand eingehalten)
                FlashOverTheAir_Rq_AR_output();
                _FlashOverTheAir_Rq_AR_SpontanFlag = 0; // Spontan-Flag zurücksetzen
                _FlashOverTheAir_Rq_AR_DelayCnt = _FlashOverTheAir_Rq_AR_MinDelay;
            }
            else
            {
                // Spontanflag setzen damit nach Ablauf Mindestsendeabstand gesendet wird
                 _FlashOverTheAir_Rq_AR_SpontanFlag = 1;
            }
            _FlashOverTheAir_Rq_AR_Cnt = _FlashOverTheAir_Rq_AR_CycleCount; // Zyklus-Zähler zurücksetzen
        }
        else if( _FlashOverTheAir_Rq_AR_SpontanFlag)
        {
            if( _FlashOverTheAir_Rq_AR_DelayCnt < 1 )
            {
                // Nachricht wg. spontaner Änderung ausgeben (Mindestsendeabstand eingehalten)
                FlashOverTheAir_Rq_AR_output();
                _FlashOverTheAir_Rq_AR_SpontanFlag = 0; // Spontan-Flag zurücksetzen
                _FlashOverTheAir_Rq_AR_DelayCnt = _FlashOverTheAir_Rq_AR_MinDelay;
            }
        }
    }
}

FlashOverTheAir_Rq_AR_init()
{   /* Botschaft FlashOverTheAir_Rq_AR ID: 1166 --- Sendeart 5 cyclicAndSpontanWithDelay --- 
BA_ "ApplMessage" BO_ 1166 0;
BA_ "NmAsrMessage" BO_ 1166 0;
BA_ "GenMsgMinAcceptLength" BO_ 1166 2;
BA_ "GenMsgILSupport" BO_ 1166 1;
BA_ "DiagState" BO_ 1166 0;
BA_ "DiagRequest" BO_ 1166 0;
BA_ "DiagResponse" BO_ 1166 0;
BA_ "GenMsgStartValue" BO_ 1166 "0";
BA_ "GenMsgStartDelayTime" BO_ 1166 220;
BA_ "GenMsgDelayTime" BO_ 1166 100;
BA_ "GenMsgNrOfRepetition" BO_ 1166 0;
BA_ "GenMsgCycleTime" BO_ 1166 1000;
BA_ "GenMsgSendType" BO_ 1166 5;
    */
    _FlashOverTheAir_Rq_AR_Timebase =              c_tDBKomTimer_20ms;
    _FlashOverTheAir_Rq_AR_CycleCount =         1000 / _FlashOverTheAir_Rq_AR_Timebase;
    _FlashOverTheAir_Rq_AR_StartDelay =          220 / _FlashOverTheAir_Rq_AR_Timebase;
    _FlashOverTheAir_Rq_AR_MinDelay =            100 / _FlashOverTheAir_Rq_AR_Timebase;
    _FlashOverTheAir_Rq_AR_Cnt = _FlashOverTheAir_Rq_AR_StartDelay;
    _FlashOverTheAir_Rq_AR_SpontanFlag = 0;
    _FlashOverTheAir_Rq_AR_DelayCnt = 0;
   
    putValue( HMI__STMSGSD_FlashOverTheAir_Rq_AR, _FlashOverTheAir_Rq_AR_StartDelay * _FlashOverTheAir_Rq_AR_Timebase );
    
    _mFlashOverTheAir_Rq_AR.FOTA_Rq.phys = getValue( HMI_FOTA_Rq );
}

FlashOverTheAir_Rq_AR_output()
{
    output( _mFlashOverTheAir_Rq_AR );
}

FlashOverTheAir_Rq_AR_saveEnvVars( dword hFile )
{
    filePutString("\n// Knoten EIS: HEADUNIT_HMI_R1\n", 33, hFile );
    snprintf( buffer, elcount( buffer ), "0.0000 HMI__STMSG_FlashOverTheAir_Rq_AR := %X\n", getValue( HMI__STMSG_FlashOverTheAir_Rq_AR ) );        filePutString( buffer, elcount( buffer ), hFile );
    snprintf( buffer, elcount( buffer ), "0.0000 HMI__STMSGT_FlashOverTheAir_Rq_AR := %X\n", getValue( HMI__STMSGT_FlashOverTheAir_Rq_AR ) );        filePutString( buffer, elcount( buffer ), hFile );
    snprintf( buffer, elcount( buffer ), "0.0000 HMI_FOTA_Rq := %X\n", getValue( HMI_FOTA_Rq ) );        filePutString( buffer, elcount( buffer ), hFile );
}

on timer _tFlashOverTheAir_Rq_AR
{
    putValue( HMI__STMSG_FlashOverTheAir_Rq_AR, 0 );
}

on EnvVar HMI__STMSG_FlashOverTheAir_Rq_AR
{
    long tDelay;
    if( getValue( this ) == 2 )
    {
        tDelay = getValue( HMI__STMSGT_FlashOverTheAir_Rq_AR );
        if( tDelay > 0)    
            setTimer( _tFlashOverTheAir_Rq_AR, tDelay );
        else
            putValue( HMI__STMSG_FlashOverTheAir_Rq_AR, 0 );
    }
}

on envVar HMI__STMSG_PO_FlashOverTheAir_Rq_AR
{
    if( getValue( this ) )
        openPanel("FlashOverTheAir_Rq_AR");
}

on EnvVar HMI_FOTA_Rq
{
    _mFlashOverTheAir_Rq_AR.FOTA_Rq.phys = getValue(this);
    _FlashOverTheAir_Rq_AR_SpontanFlag = 1;
}

HEADUNIT_HMI_R1_AR_check_output()
{
    if( !getValue( HMI__STMSG_HEADUNIT_HMI_R1_AR ) )
    {
        // Botschaft HEADUNIT_HMI_R1_AR --- Sendeart 5 cyclicAndSpontanWithDelay --- 
        if( _HEADUNIT_HMI_R1_AR_DelayCnt > 0) _HEADUNIT_HMI_R1_AR_DelayCnt--; // Mindestsendeabstand
        _HEADUNIT_HMI_R1_AR_Cnt--;
        if( _HEADUNIT_HMI_R1_AR_Cnt < 1 )
        {
            if( _HEADUNIT_HMI_R1_AR_DelayCnt < 1 )
            {
                // Nachricht wg. abgelaufenem Zyklus ausgeben (Mindestsendeabstand eingehalten)
                HEADUNIT_HMI_R1_AR_output();
                _HEADUNIT_HMI_R1_AR_SpontanFlag = 0; // Spontan-Flag zurücksetzen
                _HEADUNIT_HMI_R1_AR_DelayCnt = _HEADUNIT_HMI_R1_AR_MinDelay;
            }
            else
            {
                // Spontanflag setzen damit nach Ablauf Mindestsendeabstand gesendet wird
                 _HEADUNIT_HMI_R1_AR_SpontanFlag = 1;
            }
            _HEADUNIT_HMI_R1_AR_Cnt = _HEADUNIT_HMI_R1_AR_CycleCount; // Zyklus-Zähler zurücksetzen
        }
        else if( _HEADUNIT_HMI_R1_AR_SpontanFlag)
        {
            if( _HEADUNIT_HMI_R1_AR_DelayCnt < 1 )
            {
                // Nachricht wg. spontaner Änderung ausgeben (Mindestsendeabstand eingehalten)
                HEADUNIT_HMI_R1_AR_output();
                _HEADUNIT_HMI_R1_AR_SpontanFlag = 0; // Spontan-Flag zurücksetzen
                _HEADUNIT_HMI_R1_AR_DelayCnt = _HEADUNIT_HMI_R1_AR_MinDelay;
            }
        }
    }
}

HEADUNIT_HMI_R1_AR_init()
{   /* Botschaft HEADUNIT_HMI_R1_AR ID: 772 --- Sendeart 5 cyclicAndSpontanWithDelay --- 
BA_ "ApplMessage" BO_ 772 0;
BA_ "NmAsrMessage" BO_ 772 0;
BA_ "GenMsgMinAcceptLength" BO_ 772 4;
BA_ "GenMsgILSupport" BO_ 772 1;
BA_ "DiagState" BO_ 772 0;
BA_ "DiagRequest" BO_ 772 0;
BA_ "DiagResponse" BO_ 772 0;
BA_ "GenMsgStartValue" BO_ 772 "0";
BA_ "GenMsgStartDelayTime" BO_ 772 85;
BA_ "GenMsgDelayTime" BO_ 772 50;
BA_ "GenMsgNrOfRepetitions" BO_ 772 0;
BA_ "GenMsgCycleTime" BO_ 772 200;
BA_ "GenMsgSendType" BO_ 772 5;
    */
    _HEADUNIT_HMI_R1_AR_Timebase =              c_tDBKomTimer_20ms;
    _HEADUNIT_HMI_R1_AR_CycleCount =          200 / _HEADUNIT_HMI_R1_AR_Timebase;
    _HEADUNIT_HMI_R1_AR_StartDelay =           85 / _HEADUNIT_HMI_R1_AR_Timebase;
    _HEADUNIT_HMI_R1_AR_MinDelay =             50 / _HEADUNIT_HMI_R1_AR_Timebase;
    _HEADUNIT_HMI_R1_AR_Cnt = _HEADUNIT_HMI_R1_AR_StartDelay;
    _HEADUNIT_HMI_R1_AR_SpontanFlag = 0;
    _HEADUNIT_HMI_R1_AR_DelayCnt = 0;
   
    putValue( HMI__STMSGSD_HEADUNIT_HMI_R1_AR, _HEADUNIT_HMI_R1_AR_StartDelay * _HEADUNIT_HMI_R1_AR_Timebase );
    
    _mHEADUNIT_HMI_R1_AR.DISP_RL_On_Stat.phys = getValue( HMI_DISP_RL_On_Stat );
    _mHEADUNIT_HMI_R1_AR.DISP_RL_On_Stat_UB.phys = getValue( HMI_DISP_RL_On_Stat_UB );
    _mHEADUNIT_HMI_R1_AR.DISP_RR_On_Stat.phys = getValue( HMI_DISP_RR_On_Stat );
    _mHEADUNIT_HMI_R1_AR.DISP_RR_On_Stat_UB.phys = getValue( HMI_DISP_RR_On_Stat_UB );
    _mHEADUNIT_HMI_R1_AR.Mobile_Chrg_Stat.phys = getValue( HMI_Mobile_Chrg_Stat );
    _mHEADUNIT_HMI_R1_AR.Mobile_Chrg_Stat_UB.phys = getValue( HMI_Mobile_Chrg_Stat_UB );
    _mHEADUNIT_HMI_R1_AR.Park_Disp_Stat.phys = getValue( HMI_Park_Disp_Stat );
    _mHEADUNIT_HMI_R1_AR.Park_Disp_Stat_UB.phys = getValue( HMI_Park_Disp_Stat_UB );
}

HEADUNIT_HMI_R1_AR_output()
{
    output( _mHEADUNIT_HMI_R1_AR );
}

HEADUNIT_HMI_R1_AR_saveEnvVars( dword hFile )
{
    filePutString("\n// Knoten EIS: HEADUNIT_HMI_R1\n", 33, hFile );
    snprintf( buffer, elcount( buffer ), "0.0000 HMI__STMSG_HEADUNIT_HMI_R1_AR := %X\n", getValue( HMI__STMSG_HEADUNIT_HMI_R1_AR ) );        filePutString( buffer, elcount( buffer ), hFile );
    snprintf( buffer, elcount( buffer ), "0.0000 HMI__STMSGT_HEADUNIT_HMI_R1_AR := %X\n", getValue( HMI__STMSGT_HEADUNIT_HMI_R1_AR ) );        filePutString( buffer, elcount( buffer ), hFile );
    snprintf( buffer, elcount( buffer ), "0.0000 HMI_DISP_RL_On_Stat := %X\n", getValue( HMI_DISP_RL_On_Stat ) );        filePutString( buffer, elcount( buffer ), hFile );
    snprintf( buffer, elcount( buffer ), "0.0000 HMI_DISP_RL_On_Stat_UB := %X\n", getValue( HMI_DISP_RL_On_Stat_UB ) );        filePutString( buffer, elcount( buffer ), hFile );
    snprintf( buffer, elcount( buffer ), "0.0000 HMI_DISP_RR_On_Stat := %X\n", getValue( HMI_DISP_RR_On_Stat ) );        filePutString( buffer, elcount( buffer ), hFile );
    snprintf( buffer, elcount( buffer ), "0.0000 HMI_DISP_RR_On_Stat_UB := %X\n", getValue( HMI_DISP_RR_On_Stat_UB ) );        filePutString( buffer, elcount( buffer ), hFile );
    snprintf( buffer, elcount( buffer ), "0.0000 HMI_Mobile_Chrg_Stat := %X\n", getValue( HMI_Mobile_Chrg_Stat ) );        filePutString( buffer, elcount( buffer ), hFile );
    snprintf( buffer, elcount( buffer ), "0.0000 HMI_Mobile_Chrg_Stat_UB := %X\n", getValue( HMI_Mobile_Chrg_Stat_UB ) );        filePutString( buffer, elcount( buffer ), hFile );
    snprintf( buffer, elcount( buffer ), "0.0000 HMI_Park_Disp_Stat := %X\n", getValue( HMI_Park_Disp_Stat ) );        filePutString( buffer, elcount( buffer ), hFile );
    snprintf( buffer, elcount( buffer ), "0.0000 HMI_Park_Disp_Stat_UB := %X\n", getValue( HMI_Park_Disp_Stat_UB ) );        filePutString( buffer, elcount( buffer ), hFile );
}

on timer _tHEADUNIT_HMI_R1_AR
{
    putValue( HMI__STMSG_HEADUNIT_HMI_R1_AR, 0 );
}

on EnvVar HMI__STMSG_HEADUNIT_HMI_R1_AR
{
    long tDelay;
    if( getValue( this ) == 2 )
    {
        tDelay = getValue( HMI__STMSGT_HEADUNIT_HMI_R1_AR );
        if( tDelay > 0)    
            setTimer( _tHEADUNIT_HMI_R1_AR, tDelay );
        else
            putValue( HMI__STMSG_HEADUNIT_HMI_R1_AR, 0 );
    }
}

on envVar HMI__STMSG_PO_HEADUNIT_HMI_R1_AR
{
    if( getValue( this ) )
        openPanel("HEADUNIT_HMI_R1_AR");
}

on EnvVar HMI_DISP_RL_On_Stat
{
    _mHEADUNIT_HMI_R1_AR.DISP_RL_On_Stat.phys = getValue(this);
    _HEADUNIT_HMI_R1_AR_SpontanFlag = 1;
}

on EnvVar HMI_DISP_RL_On_Stat_UB
{
    _mHEADUNIT_HMI_R1_AR.DISP_RL_On_Stat_UB.phys = getValue(this);
    _HEADUNIT_HMI_R1_AR_SpontanFlag = 1;
}

on EnvVar HMI_DISP_RR_On_Stat
{
    _mHEADUNIT_HMI_R1_AR.DISP_RR_On_Stat.phys = getValue(this);
    _HEADUNIT_HMI_R1_AR_SpontanFlag = 1;
}

on EnvVar HMI_DISP_RR_On_Stat_UB
{
    _mHEADUNIT_HMI_R1_AR.DISP_RR_On_Stat_UB.phys = getValue(this);
    _HEADUNIT_HMI_R1_AR_SpontanFlag = 1;
}

on EnvVar HMI_Mobile_Chrg_Stat
{
    _mHEADUNIT_HMI_R1_AR.Mobile_Chrg_Stat.phys = getValue(this);
    _HEADUNIT_HMI_R1_AR_SpontanFlag = 1;
}

on EnvVar HMI_Mobile_Chrg_Stat_UB
{
    _mHEADUNIT_HMI_R1_AR.Mobile_Chrg_Stat_UB.phys = getValue(this);
    _HEADUNIT_HMI_R1_AR_SpontanFlag = 1;
}

on EnvVar HMI_Park_Disp_Stat
{
    _mHEADUNIT_HMI_R1_AR.Park_Disp_Stat.phys = getValue(this);
    _HEADUNIT_HMI_R1_AR_SpontanFlag = 1;
}

on EnvVar HMI_Park_Disp_Stat_UB
{
    _mHEADUNIT_HMI_R1_AR.Park_Disp_Stat_UB.phys = getValue(this);
    _HEADUNIT_HMI_R1_AR_SpontanFlag = 1;
}

HU_Comf_Rq_AR_check_output()
{
    if( !getValue( HMI__STMSG_HU_Comf_Rq_AR ))
    {
        // Botschaft HU_Comf_Rq_AR ID: 1150 --- Sendeart 5 cyclicAndSpontanWithDelay --- 
        if( _HU_Comf_Rq_AR_DelayCnt > 0) _HU_Comf_Rq_AR_DelayCnt--; // Mindestsendeabstand
        _HU_Comf_Rq_AR_Cnt--;
        if( _HU_Comf_Rq_AR_Cnt < 1 )
        {
            if( _HU_Comf_Rq_AR_DelayCnt < 1 )
            {
                HU_Comf_Rq_AR_output(); // Nachricht wg. abgelaufenem Zyklus ausgeben (Mindestsendeabstand eingehalten)
                _HU_Comf_Rq_AR_SpontanFlag = 0; // Spontan-Flag zurücksetzen
                _HU_Comf_Rq_AR_DelayCnt = _HU_Comf_Rq_AR_MinDelay;
            }
            else
            {
                _HU_Comf_Rq_AR_SpontanFlag = 1; // Spontanflag setzen damit nach Ablauf Mindestsendeabstand gesendet wird
            }
            _HU_Comf_Rq_AR_Cnt = _HU_Comf_Rq_AR_CycleCount; // Zyklus-Zähler zurücksetzen
        }
        else if( _HU_Comf_Rq_AR_SpontanFlag)
        {
            if( _HU_Comf_Rq_AR_DelayCnt < 1 )
            {
                // Nachricht wg. spontaner Änderung ausgeben (Mindestsendeabstand eingehalten)
                HU_Comf_Rq_AR_output();
                _HU_Comf_Rq_AR_SpontanFlag = 0; // Spontan-Flag zurücksetzen
                _HU_Comf_Rq_AR_DelayCnt = _HU_Comf_Rq_AR_MinDelay;
            }
        }
    }
}

HU_Comf_Rq_AR_init()
{   /* Botschaft HU_Comf_Rq_AR ID: 1150 --- Sendeart 5 cyclicAndSpontanWithDelay --- 
BA_ "ApplMessage" BO_ 1150 0;
BA_ "NmAsrMessage" BO_ 1150 0;
BA_ "GenMsgMinAcceptLength" BO_ 1150 8;
BA_ "GenMsgILSupport" BO_ 1150 1;
BA_ "DiagState" BO_ 1150 0;
BA_ "DiagRequest" BO_ 1150 0;
BA_ "DiagResponse" BO_ 1150 0;
BA_ "GenMsgStartValue" BO_ 1150 "0";
BA_ "GenMsgStartDelayTime" BO_ 1150 205;
BA_ "GenMsgDelayTime" BO_ 1150 100;
BA_ "GenMsgNrOfRepetition" BO_ 1150 0;
BA_ "GenMsgCycleTime" BO_ 1150 1000;
BA_ "GenMsgSendType" BO_ 1150 5;
    */
    _HU_Comf_Rq_AR_Timebase =             c_tDBKomTimer_20ms;
    _HU_Comf_Rq_AR_CycleCount =         1000 / _HU_Comf_Rq_AR_Timebase;
    _HU_Comf_Rq_AR_StartDelay =          175 / _HU_Comf_Rq_AR_Timebase;
    _HU_Comf_Rq_AR_MinDelay =            100 / _HU_Comf_Rq_AR_Timebase;
    _HU_Comf_Rq_AR_Cnt = _HU_Comf_Rq_AR_StartDelay;
    _HU_Comf_Rq_AR_SpontanFlag = 0;
    _HU_Comf_Rq_AR_DelayCnt = 0;

    putValue( HMI__STMSGSD_HU_Comf_Rq_AR, _HU_Comf_Rq_AR_StartDelay * _HU_Comf_Rq_AR_Timebase );

    _mHU_Comf_Rq_AR.StWhl_Cond_Rq_HU.phys = getValue( HMI_StWhl_Cond_Rq_HU );
    _mHU_Comf_Rq_AR.CPD_UsrActn_Rq_CI.phys = getValue( HMI_CPD_UsrActn_Rq_CI );
}

HU_Comf_Rq_AR_output()
{
    output( _mHU_Comf_Rq_AR );
}

HU_Comf_Rq_AR_saveEnvVars( dword hFile )
{
    filePutString("\n// Knoten TGW: HU_Comf_Rq_AR\n", 30, hFile);
    snprintf( buffer, elcount(buffer), "0.0000 HMI__STMSG_HU_Comf_Rq_AR := %X\n", getValue( HMI__STMSG_HU_Comf_Rq_AR ) );        filePutString( buffer, elcount(buffer), hFile);
    snprintf( buffer, elcount(buffer), "0.0000 HMI__STMSGT_HU_Comf_Rq_AR := %X\n", getValue( HMI__STMSGT_HU_Comf_Rq_AR ) );        filePutString( buffer, elcount(buffer), hFile);
    snprintf( buffer, elcount(buffer), "0.0000 HMI_StWhl_Cond_Rq_HU := %X\n", getValue( HMI_StWhl_Cond_Rq_HU ) );        filePutString( buffer, elcount(buffer), hFile);
    snprintf( buffer, elcount(buffer), "0.0000 HMI_CPD_UsrActn_Rq_CI := %X\n", getValue( HMI_CPD_UsrActn_Rq_CI ) );        filePutString( buffer, elcount(buffer), hFile);
}

on timer _tHU_Comf_Rq_AR
{
    putValue( HMI__STMSG_HU_Comf_Rq_AR, 0 );
}

on EnvVar HMI__STMSG_HU_Comf_Rq_AR
{
    long tDelay;
    if( getValue( this ) == 2 )
    {
        tDelay = getValue( HMI__STMSGT_HU_Comf_Rq_AR );
        if( tDelay > 0 )    
            setTimer( _tHU_Comf_Rq_AR, tDelay );
        else
            putValue( HMI__STMSG_HU_Comf_Rq_AR, 0 );
    }
}

on envVar HMI__STMSG_PO_HU_Comf_Rq_AR
{
    if( getValue( this ) )
        openPanel("HU_Comf_Rq_AR");
}

on EnvVar HMI_StWhl_Cond_Rq_HU
{
    _mHU_Comf_Rq_AR.StWhl_Cond_Rq_HU.phys = getValue(this);
    _HU_Comf_Rq_AR_SpontanFlag = 1;
}

on EnvVar HMI_CPD_UsrActn_Rq_CI
{
    _mHU_Comf_Rq_AR.CPD_UsrActn_Rq_CI.phys = getValue(this);
    _HU_Comf_Rq_AR_SpontanFlag = 1;
}

HU_DateTm_Rq_AR_check_output()
{
    if( !getValue( HMI__STMSG_HU_DateTm_Rq_AR ))
    {
        // Botschaft HU_DateTm_Rq_AR ID: 1019 --- Sendeart 5 cyclicAndSpontanWithDelay --- 
        if( _HU_DateTm_Rq_AR_DelayCnt > 0) _HU_DateTm_Rq_AR_DelayCnt--; // Mindestsendeabstand
        _HU_DateTm_Rq_AR_Cnt--;
        if( _HU_DateTm_Rq_AR_Cnt < 1 )
        {
            if( _HU_DateTm_Rq_AR_DelayCnt < 1 )
            {
                HU_DateTm_Rq_AR_output(); // Nachricht wg. abgelaufenem Zyklus ausgeben (Mindestsendeabstand eingehalten)
                _HU_DateTm_Rq_AR_SpontanFlag = 0; // Spontan-Flag zurücksetzen
                _HU_DateTm_Rq_AR_DelayCnt = _HU_DateTm_Rq_AR_MinDelay;
            }
            else
            {
                // Spontanflag setzen damit nach Ablauf Mindestsendeabstand gesendet wird
                 _HU_DateTm_Rq_AR_SpontanFlag = 1;
            }
            _HU_DateTm_Rq_AR_Cnt = _HU_DateTm_Rq_AR_CycleCount; // Zyklus-Zähler zurücksetzen
        }
        else if( _HU_DateTm_Rq_AR_SpontanFlag)
        {
            if( _HU_DateTm_Rq_AR_DelayCnt < 1 )
            {
                // Nachricht wg. spontaner Änderung ausgeben (Mindestsendeabstand eingehalten)
                HU_DateTm_Rq_AR_output();
                _HU_DateTm_Rq_AR_SpontanFlag = 0; // Spontan-Flag zurücksetzen
                _HU_DateTm_Rq_AR_DelayCnt = _HU_DateTm_Rq_AR_MinDelay;
            }
        }
    }
}

HU_DateTm_Rq_AR_init()
{   /* Botschaft HU_DateTm_Rq_AR ID: 1019 --- Sendeart 5 cyclicAndSpontanWithDelay --- 
BA_ "ApplMessage" BO_ 1019 0;
BA_ "NmAsrMessage" BO_ 1019 0;
BA_ "GenMsgMinAcceptLength" BO_ 1019 8;
BA_ "GenMsgILSupport" BO_ 1019 1;
BA_ "DiagState" BO_ 1019 0;
BA_ "DiagRequest" BO_ 1019 0;
BA_ "DiagResponse" BO_ 1019 0;
BA_ "GenMsgStartValue" BO_ 1019 "0";
BA_ "GenMsgStartDelayTime" BO_ 1019 175;
BA_ "GenMsgDelayTime" BO_ 1019 100;
BA_ "GenMsgNrOfRepetition" BO_ 1019 0;
BA_ "GenMsgCycleTime" BO_ 1019 1000;
BA_ "GenMsgSendType" BO_ 1019 5;
    */
    _HU_DateTm_Rq_AR_Timebase =             c_tDBKomTimer_20ms;
    _HU_DateTm_Rq_AR_CycleCount =         1000 / _HU_DateTm_Rq_AR_Timebase;
    _HU_DateTm_Rq_AR_StartDelay =          175 / _HU_DateTm_Rq_AR_Timebase;
    _HU_DateTm_Rq_AR_MinDelay =            100 / _HU_DateTm_Rq_AR_Timebase;
    _HU_DateTm_Rq_AR_Cnt = _HU_DateTm_Rq_AR_StartDelay;
    _HU_DateTm_Rq_AR_SpontanFlag = 0;
    _HU_DateTm_Rq_AR_DelayCnt = 0;

    putValue( HMI__STMSGSD_HU_DateTm_Rq_AR, _HU_DateTm_Rq_AR_StartDelay * _HU_DateTm_Rq_AR_Timebase );

    _mHU_DateTm_Rq_AR.DateTmClkFormat.phys = getValue( HMI_DateTmClkFormat );
    _mHU_DateTm_Rq_AR.DateTmDateFormat.phys = getValue( HMI_DateTmDateFormat );
    _mHU_DateTm_Rq_AR.DateTmDay_Rq.phys = getValue( HMI_DateTmDay_Rq );
    _mHU_DateTm_Rq_AR.DateTmHour_Rq.phys = getValue( HMI_DateTmHour_Rq );
    _mHU_DateTm_Rq_AR.DateTmMinute_Rq.phys = getValue( HMI_DateTmMinute_Rq );
    _mHU_DateTm_Rq_AR.DateTmMonth_Rq.phys = getValue( HMI_DateTmMonth_Rq );
    _mHU_DateTm_Rq_AR.DateTmMonthStyle.phys = getValue( HMI_DateTmMonthStyle );
    _mHU_DateTm_Rq_AR.DateTmSecond_Rq.phys = getValue( HMI_DateTmSecond_Rq );
    _mHU_DateTm_Rq_AR.DateTmStat_Rq.phys = getValue( HMI_DateTmStat_Rq );
    _mHU_DateTm_Rq_AR.DateTmSyncRsn_V2.phys = getValue( HMI_DateTmSyncRsn_V2 );
    _mHU_DateTm_Rq_AR.DateTmWeekday_Rq.phys = getValue( HMI_DateTmWeekday_Rq );
    _mHU_DateTm_Rq_AR.DateTmYear_Rq.phys = getValue( HMI_DateTmYear_Rq );
}

HU_DateTm_Rq_AR_output()
{
    output( _mHU_DateTm_Rq_AR );
}

HU_DateTm_Rq_AR_saveEnvVars( dword hFile )
{
    filePutString("\n// Knoten TGW: HU_DateTm_Rq_AR\n", 30, hFile);
    snprintf( buffer, elcount(buffer), "0.0000 HMI__STMSG_HU_DateTm_Rq_AR := %X\n", getValue( HMI__STMSG_HU_DateTm_Rq_AR ) );        filePutString( buffer, elcount(buffer), hFile);
    snprintf( buffer, elcount(buffer), "0.0000 HMI__STMSGT_HU_DateTm_Rq_AR := %X\n", getValue( HMI__STMSGT_HU_DateTm_Rq_AR ) );        filePutString( buffer, elcount(buffer), hFile);
    snprintf( buffer, elcount(buffer), "0.0000 HMI_DateTmClkFormat := %X\n", getValue( HMI_DateTmClkFormat ) );        filePutString( buffer, elcount(buffer), hFile);
    snprintf( buffer, elcount(buffer), "0.0000 HMI_DateTmDateFormat := %X\n", getValue( HMI_DateTmDateFormat ) );        filePutString( buffer, elcount(buffer), hFile);
    snprintf( buffer, elcount(buffer), "0.0000 HMI_DateTmDay_Rq := %X\n", getValue( HMI_DateTmDay_Rq ) );        filePutString( buffer, elcount(buffer), hFile);
    snprintf( buffer, elcount(buffer), "0.0000 HMI_DateTmHour_Rq := %X\n", getValue( HMI_DateTmHour_Rq ) );        filePutString( buffer, elcount(buffer), hFile);
    snprintf( buffer, elcount(buffer), "0.0000 HMI_DateTmMinute_Rq := %X\n", getValue( HMI_DateTmMinute_Rq ) );        filePutString( buffer, elcount(buffer), hFile);
    snprintf( buffer, elcount(buffer), "0.0000 HMI_DateTmMonth_Rq := %X\n", getValue( HMI_DateTmMonth_Rq ) );        filePutString( buffer, elcount(buffer), hFile);
    snprintf( buffer, elcount(buffer), "0.0000 HMI_DateTmMonthStyle := %X\n", getValue( HMI_DateTmMonthStyle ) );        filePutString( buffer, elcount(buffer), hFile);
    snprintf( buffer, elcount(buffer), "0.0000 HMI_DateTmSecond_Rq := %X\n", getValue( HMI_DateTmSecond_Rq ) );        filePutString( buffer, elcount(buffer), hFile);
    snprintf( buffer, elcount(buffer), "0.0000 HMI_DateTmStat_Rq := %X\n", getValue( HMI_DateTmStat_Rq ) );        filePutString( buffer, elcount(buffer), hFile);
    snprintf( buffer, elcount(buffer), "0.0000 HMI_DateTmSyncRsn_V2 := %X\n", getValue( HMI_DateTmSyncRsn_V2 ) );        filePutString( buffer, elcount(buffer), hFile);
    snprintf( buffer, elcount(buffer), "0.0000 HMI_DateTmWeekday_Rq := %X\n", getValue( HMI_DateTmWeekday_Rq ) );        filePutString( buffer, elcount(buffer), hFile);
    snprintf( buffer, elcount(buffer), "0.0000 HMI_DateTmYear_Rq := %X\n", getValue( HMI_DateTmYear_Rq ) );        filePutString( buffer, elcount(buffer), hFile);
}

on timer _tHU_DateTm_Rq_AR
{
    putValue( HMI__STMSG_HU_DateTm_Rq_AR, 0 );
}

on EnvVar HMI__STMSG_HU_DateTm_Rq_AR
{
    long tDelay;
    if( getValue( this ) == 2 )
    {
        tDelay = getValue( HMI__STMSGT_HU_DateTm_Rq_AR );
        if( tDelay > 0 )    
            setTimer( _tHU_DateTm_Rq_AR, tDelay );
        else
            putValue( HMI__STMSG_HU_DateTm_Rq_AR, 0 );
    }
}

on envVar HMI__STMSG_PO_HU_DateTm_Rq_AR
{
    if( getValue( this ) )
        openPanel("HU_DateTm_Rq_AR");
}

on EnvVar HMI_DateTmClkFormat
{
    _mHU_DateTm_Rq_AR.DateTmClkFormat.phys = getValue(this);
    _HU_DateTm_Rq_AR_SpontanFlag = 1;
}

on EnvVar HMI_DateTmDateFormat
{
    _mHU_DateTm_Rq_AR.DateTmDateFormat.phys = getValue(this);
    _HU_DateTm_Rq_AR_SpontanFlag = 1;
}

on EnvVar HMI_DateTmDay_Rq
{
    _mHU_DateTm_Rq_AR.DateTmDay_Rq.phys = getValue(this);
    _HU_DateTm_Rq_AR_SpontanFlag = 1;
}

on EnvVar HMI_DateTmHour_Rq
{
    _mHU_DateTm_Rq_AR.DateTmHour_Rq.phys = getValue(this);
    _HU_DateTm_Rq_AR_SpontanFlag = 1;
}

on EnvVar HMI_DateTmMinute_Rq
{
    _mHU_DateTm_Rq_AR.DateTmMinute_Rq.phys = getValue(this);
    _HU_DateTm_Rq_AR_SpontanFlag = 1;
}

on EnvVar HMI_DateTmMonth_Rq
{
    _mHU_DateTm_Rq_AR.DateTmMonth_Rq.phys = getValue(this);
    _HU_DateTm_Rq_AR_SpontanFlag = 1;
}

on EnvVar HMI_DateTmMonthStyle
{
    _mHU_DateTm_Rq_AR.DateTmMonthStyle.phys = getValue(this);
    _HU_DateTm_Rq_AR_SpontanFlag = 1;
}

on EnvVar HMI_DateTmSecond_Rq
{
    _mHU_DateTm_Rq_AR.DateTmSecond_Rq.phys = getValue(this);
    _HU_DateTm_Rq_AR_SpontanFlag = 1;
}

on EnvVar HMI_DateTmStat_Rq
{
    _mHU_DateTm_Rq_AR.DateTmStat_Rq.phys = getValue(this);
    _HU_DateTm_Rq_AR_SpontanFlag = 1;
}

on EnvVar HMI_DateTmSyncRsn_V2
{
    _mHU_DateTm_Rq_AR.DateTmSyncRsn_V2.phys = getValue(this);
    _HU_DateTm_Rq_AR_SpontanFlag = 1;
}

on EnvVar HMI_DateTmWeekday_Rq
{
    _mHU_DateTm_Rq_AR.DateTmWeekday_Rq.phys = getValue(this);
    _HU_DateTm_Rq_AR_SpontanFlag = 1;
}

on EnvVar HMI_DateTmYear_Rq
{
    _mHU_DateTm_Rq_AR.DateTmYear_Rq.phys = getValue(this);
    _HU_DateTm_Rq_AR_SpontanFlag = 1;
}

HU_SDS_Rq_AR_check_output()
{
    if( !getValue( HMI__STMSG_HU_SDS_Rq_AR ))
    {
        // Botschaft HU_SDS_Rq_AR ID: 1126 --- Sendeart 5 cyclicAndSpontanWithDelay --- 
        if( _HU_SDS_Rq_AR_DelayCnt > 0) _HU_SDS_Rq_AR_DelayCnt--; // Mindestsendeabstand
        _HU_SDS_Rq_AR_Cnt--;
        if( _HU_SDS_Rq_AR_Cnt < 1 )
        {
            if( _HU_SDS_Rq_AR_DelayCnt < 1 )
            {
                HU_SDS_Rq_AR_output(); // Nachricht wg. abgelaufenem Zyklus ausgeben (Mindestsendeabstand eingehalten)
                _HU_SDS_Rq_AR_SpontanFlag = 0; // Spontan-Flag zurücksetzen
                _HU_SDS_Rq_AR_DelayCnt = _HU_SDS_Rq_AR_MinDelay;
            }
            else
            {
                // Spontanflag setzen damit nach Ablauf Mindestsendeabstand gesendet wird
                 _HU_SDS_Rq_AR_SpontanFlag = 1;
            }
            _HU_SDS_Rq_AR_Cnt = _HU_SDS_Rq_AR_CycleCount; // Zyklus-Zähler zurücksetzen
        }
        else if( _HU_SDS_Rq_AR_SpontanFlag)
        {
            if( _HU_SDS_Rq_AR_DelayCnt < 1 )
            {
                // Nachricht wg. spontaner Änderung ausgeben (Mindestsendeabstand eingehalten)
                HU_SDS_Rq_AR_output();
                _HU_SDS_Rq_AR_SpontanFlag = 0; // Spontan-Flag zurücksetzen
                _HU_SDS_Rq_AR_DelayCnt = _HU_SDS_Rq_AR_MinDelay;
            }
        }
    }
}

HU_SDS_Rq_AR_init()
{   /* Botschaft HU_SDS_Rq_AR ID: 1126 --- Sendeart 5 cyclicAndSpontanWithDelay --- 
BA_ "ApplMessage" BO_ 1126 0;
BA_ "NmAsrMessage" BO_ 1126 0;
BA_ "GenMsgMinAcceptLength" BO_ 1126 8;
BA_ "GenMsgILSupport" BO_ 1126 1;
BA_ "DiagState" BO_ 1126 0;
BA_ "DiagRequest" BO_ 1126 0;
BA_ "DiagResponse" BO_ 1126 0;
BA_ "GenMsgStartValue" BO_ 1126 "0";
BA_ "GenMsgStartDelayTime" BO_ 1126 280;
BA_ "GenMsgDelayTime" BO_ 1126 100;
BA_ "GenMsgNrOfRepetition" BO_ 1126 0;
BA_ "GenMsgCycleTime" BO_ 1126 1000;
BA_ "GenMsgSendType" BO_ 1126 5;
    */
    _HU_SDS_Rq_AR_Timebase =             c_tDBKomTimer_20ms;
    _HU_SDS_Rq_AR_CycleCount =         1000 / _HU_SDS_Rq_AR_Timebase;
    _HU_SDS_Rq_AR_StartDelay =          280 / _HU_SDS_Rq_AR_Timebase;
    _HU_SDS_Rq_AR_MinDelay =            100 / _HU_SDS_Rq_AR_Timebase;
    _HU_SDS_Rq_AR_Cnt = _HU_SDS_Rq_AR_StartDelay;
    _HU_SDS_Rq_AR_SpontanFlag = 0;
    _HU_SDS_Rq_AR_DelayCnt = 0;

    putValue( HMI__STMSGSD_HU_SDS_Rq_AR, _HU_SDS_Rq_AR_StartDelay * _HU_SDS_Rq_AR_Timebase );

    _mHU_SDS_Rq_AR.AirScarf_FL_Rq_HU.phys = getValue( HMI_AirScarf_FL_Rq_HU );
    _mHU_SDS_Rq_AR.AirScarf_FR_Rq_HU.phys = getValue( HMI_AirScarf_FR_Rq_HU );
    _mHU_SDS_Rq_AR.EBL_Md_Rq_HU.phys = getValue( HMI_EBL_Md_Rq_HU );
    _mHU_SDS_Rq_AR.IL_R_Md_Rq_HU.phys = getValue( HMI_IL_R_Md_Rq_HU );
    _mHU_SDS_Rq_AR.IL_RdLgt_FL_Md_Rq_HU.phys = getValue( HMI_IL_RdLgt_FL_Md_Rq_HU );
    _mHU_SDS_Rq_AR.IL_RdLgt_FR_Md_Rq_HU.phys = getValue( HMI_IL_RdLgt_FR_Md_Rq_HU );
    _mHU_SDS_Rq_AR.SeatHt_FL_Rq_HU.phys = getValue( HMI_SeatHt_FL_Rq_HU );
    _mHU_SDS_Rq_AR.SeatHt_FR_Rq_HU.phys = getValue( HMI_SeatHt_FR_Rq_HU );
    _mHU_SDS_Rq_AR.SeatVn_FL_Rq_HU.phys = getValue( HMI_SeatVn_FL_Rq_HU );
    _mHU_SDS_Rq_AR.SeatVn_FR_Rq_HU.phys = getValue( HMI_SeatVn_FR_Rq_HU );
	_mHU_SDS_Rq_AR.SRB_Quar_Win_Lt_Rq_HU.phys = getValue( HMI_SRB_Quar_Win_Lt_Rq_HU );
	_mHU_SDS_Rq_AR.SRB_Quar_Win_Rt_Rq_HU.phys = getValue( HMI_SRB_Quar_Win_Rt_Rq_HU );
}

HU_SDS_Rq_AR_output()
{
    output( _mHU_SDS_Rq_AR );
}

HU_SDS_Rq_AR_saveEnvVars( dword hFile )
{
    filePutString("\n// Knoten TGW: HU_DateTm_Rq_AR\n", 30, hFile);
    snprintf( buffer, elcount(buffer), "0.0000 HMI__STMSG_HU_SDS_Rq_AR := %X\n", getValue( HMI__STMSG_HU_SDS_Rq_AR ) );        filePutString( buffer, elcount(buffer), hFile);
    snprintf( buffer, elcount(buffer), "0.0000 HMI__STMSGT_HU_SDS_Rq_AR := %X\n", getValue( HMI__STMSGT_HU_SDS_Rq_AR ) );        filePutString( buffer, elcount(buffer), hFile);
    snprintf( buffer, elcount(buffer), "0.0000 HMI_AirScarf_FL_Rq_HU := %X\n", getValue( HMI_AirScarf_FL_Rq_HU ) );        filePutString( buffer, elcount(buffer), hFile);
    snprintf( buffer, elcount(buffer), "0.0000 HMI_AirScarf_FR_Rq_HU := %X\n", getValue( HMI_AirScarf_FR_Rq_HU ) );        filePutString( buffer, elcount(buffer), hFile);
    snprintf( buffer, elcount(buffer), "0.0000 HMI_EBL_Md_Rq_HU := %X\n", getValue( HMI_EBL_Md_Rq_HU ) );        filePutString( buffer, elcount(buffer), hFile);
    snprintf( buffer, elcount(buffer), "0.0000 HMI_IL_R_Md_Rq_HU := %X\n", getValue( HMI_IL_R_Md_Rq_HU ) );        filePutString( buffer, elcount(buffer), hFile);
    snprintf( buffer, elcount(buffer), "0.0000 HMI_IL_RdLgt_FL_Md_Rq_HU := %X\n", getValue( HMI_IL_RdLgt_FL_Md_Rq_HU ) );        filePutString( buffer, elcount(buffer), hFile);
    snprintf( buffer, elcount(buffer), "0.0000 HMI_IL_RdLgt_FR_Md_Rq_HU := %X\n", getValue( HMI_IL_RdLgt_FR_Md_Rq_HU ) );        filePutString( buffer, elcount(buffer), hFile);
    snprintf( buffer, elcount(buffer), "0.0000 HMI_SeatHt_FL_Rq_HU := %X\n", getValue( HMI_SeatHt_FL_Rq_HU ) );        filePutString( buffer, elcount(buffer), hFile);
    snprintf( buffer, elcount(buffer), "0.0000 HMI_SeatHt_FR_Rq_HU := %X\n", getValue( HMI_SeatHt_FR_Rq_HU ) );        filePutString( buffer, elcount(buffer), hFile);
    snprintf( buffer, elcount(buffer), "0.0000 HMI_SeatVn_FL_Rq_HU := %X\n", getValue( HMI_SeatVn_FL_Rq_HU ) );        filePutString( buffer, elcount(buffer), hFile);
    snprintf( buffer, elcount(buffer), "0.0000 HMI_SeatVn_FR_Rq_HU := %X\n", getValue( HMI_SeatVn_FR_Rq_HU ) );        filePutString( buffer, elcount(buffer), hFile);
	snprintf( buffer, elcount(buffer), "0.0000 HMI_SRB_Quar_Win_Lt_Rq_HU := %X\n", getValue( HMI_SRB_Quar_Win_Lt_Rq_HU ) );        filePutString( buffer, elcount(buffer), hFile);
	snprintf( buffer, elcount(buffer), "0.0000 HMI_SRB_Quar_Win_Rt_Rq_HU := %X\n", getValue( HMI_SRB_Quar_Win_Rt_Rq_HU ) );        filePutString( buffer, elcount(buffer), hFile);
}

on timer _tHU_SDS_Rq_AR
{
    putValue( HMI__STMSG_HU_SDS_Rq_AR, 0 );
}

on EnvVar HMI__STMSG_HU_SDS_Rq_AR
{
    long tDelay;
    if( getValue( this ) == 2 )
    {
        tDelay = getValue( HMI__STMSGT_HU_SDS_Rq_AR );
        if( tDelay > 0 )    
            setTimer( _tHU_SDS_Rq_AR, tDelay );
        else
            putValue( HMI__STMSG_HU_SDS_Rq_AR, 0 );
    }
}

on envVar HMI__STMSG_PO_HU_SDS_Rq_AR
{
    if( getValue( this ) )
        openPanel("HU_SDS_Rq_AR");
}

on EnvVar HMI_AirScarf_FL_Rq_HU
{
    _mHU_SDS_Rq_AR.AirScarf_FL_Rq_HU.phys = getValue(this);
    _HU_SDS_Rq_AR_SpontanFlag = 1;
}

on EnvVar HMI_AirScarf_FR_Rq_HU
{
    _mHU_SDS_Rq_AR.AirScarf_FR_Rq_HU.phys = getValue(this);
    _HU_SDS_Rq_AR_SpontanFlag = 1;
}

on EnvVar HMI_EBL_Md_Rq_HU
{
    _mHU_SDS_Rq_AR.EBL_Md_Rq_HU.phys = getValue(this);
    _HU_SDS_Rq_AR_SpontanFlag = 1;
}

on EnvVar HMI_IL_R_Md_Rq_HU
{
    _mHU_SDS_Rq_AR.IL_R_Md_Rq_HU.phys = getValue(this);
    _HU_SDS_Rq_AR_SpontanFlag = 1;
}

on EnvVar HMI_IL_RdLgt_FL_Md_Rq_HU
{
    _mHU_SDS_Rq_AR.IL_RdLgt_FL_Md_Rq_HU.phys = getValue(this);
    _HU_SDS_Rq_AR_SpontanFlag = 1;
}

on EnvVar HMI_IL_RdLgt_FR_Md_Rq_HU
{
    _mHU_SDS_Rq_AR.IL_RdLgt_FR_Md_Rq_HU.phys = getValue(this);
    _HU_SDS_Rq_AR_SpontanFlag = 1;
}

on EnvVar HMI_SeatHt_FL_Rq_HU
{
    _mHU_SDS_Rq_AR.SeatHt_FL_Rq_HU.phys = getValue(this);
    _HU_SDS_Rq_AR_SpontanFlag = 1;
}

on EnvVar HMI_SeatHt_FR_Rq_HU
{
    _mHU_SDS_Rq_AR.SeatHt_FR_Rq_HU.phys = getValue(this);
    _HU_SDS_Rq_AR_SpontanFlag = 1;
}

on EnvVar HMI_SeatVn_FL_Rq_HU
{
    _mHU_SDS_Rq_AR.SeatVn_FL_Rq_HU.phys = getValue(this);
    _HU_SDS_Rq_AR_SpontanFlag = 1;
}

on EnvVar HMI_SeatVn_FR_Rq_HU
{
    _mHU_SDS_Rq_AR.SeatVn_FR_Rq_HU.phys = getValue(this);
    _HU_SDS_Rq_AR_SpontanFlag = 1;
}

on EnvVar HMI_SRB_Quar_Win_Lt_Rq_HU
{
    _mHU_SDS_Rq_AR.SRB_Quar_Win_Lt_Rq_HU.phys = getValue(this);
    _HU_SDS_Rq_AR_SpontanFlag = 1;
}

on EnvVar HMI_SRB_Quar_Win_Rt_Rq_HU
{
    _mHU_SDS_Rq_AR.SRB_Quar_Win_Rt_Rq_HU.phys = getValue(this);
    _HU_SDS_Rq_AR_SpontanFlag = 1;
}

HU_State_AR_check_output()
{
    if( !getValue( HMI__STMSG_HU_State_AR))
    {
        // Botschaft HU_State_AR ID: 993 --- Sendeart cyclicAndSpontanWithDelay --- 
        _HU_State_AR_Cnt--;
        if( _HU_State_AR_Cnt < 1 )
        {
            // Nachricht wg. abgelaufenem Zyklus ausgeben
            output( _mHU_State_AR );
            _HU_State_AR_Cnt = _HU_State_AR_CycleCount; // Zyklus-Zähler zurücksetzen
             _HU_State_AR_SpontanFlag = 0; // Spontan-Flag zurücksetzen
        }
        else if( _HU_State_AR_SpontanFlag)
        {
            // Nachricht wg. spontaner Änderung ausgeben
            output( _mHU_State_AR );
             _HU_State_AR_SpontanFlag = 0; // Spontan-Flag zurücksetzen
        }
    }
}

HU_State_AR_init()
{   /* Botschaft HU_State_AR ID: 993 --- Sendeart cyclicAndSpontanWithDelay --- 
BA_ "ApplMessage" BO_ 993 0;
BA_ "NmAsrMessage" BO_ 993 0;
BA_ "GenMsgMinAcceptLength" BO_ 993 8;
BA_ "GenMsgILSupport" BO_ 993 1;
BA_ "DiagState" BO_ 993 0;
BA_ "DiagRequest" BO_ 993 0;
BA_ "DiagResponse" BO_ 993 0;
BA_ "GenMsgStartValue" BO_ 993 "0";
BA_ "GenMsgStartDelayTime" BO_ 993 5;
BA_ "GenMsgDelayTime" BO_ 993 20;
BA_ "GenMsgNrOfRepetitions" BO_ 993 0;
BA_ "GenMsgCycleTime" BO_ 993 200;
BA_ "GenMsgSendType" BO_ 993 5;
    */
    _HU_State_AR_Timebase =             c_tDBKomTimer_20ms;
    _HU_State_AR_CycleCount =           200 / _HU_State_AR_Timebase;
    _HU_State_AR_StartDelay =             5 / _HU_State_AR_Timebase;
    _HU_State_AR_MinDelay =              20 / _HU_State_AR_Timebase;
    _HU_State_AR_Cnt = _HU_State_AR_StartDelay;
    _HU_State_AR_SpontanFlag = 0;
    _HU_State_AR_DelayCnt = 0;

    _HU_State_AR_Cnt = 0;
    _HU_State_AR_StartDelay = 0;
    _HU_State_AR_SpontanFlag = 0;

    putValue( HMI__STMSGSD_HU_State_AR, _HU_State_AR_StartDelay * _HU_State_AR_Timebase );

    _mHU_State_AR.ADAS_LongRng_Avl.phys = getValue( HMI_ADAS_LongRng_Avl );
	  _mHU_State_AR.ADAS_Md.phys = getValue( HMI_ADAS_Md );
	  _mHU_State_AR.Audio_TwoCabSrc_Stat.phys = getValue( HMI_Audio_TwoCabSrc_Stat );
	  _mHU_State_AR.CardletId_Rq.phys = getValue( HMI_CardletId_Rq );
    _mHU_State_AR.CI_DI_Actv.phys = getValue( HMI_CI_DI_Actv );
    _mHU_State_AR.Disp_R_Adj_Dn_Rq.phys = getValue( HMI_Disp_R_Adj_Dn_Rq );
    _mHU_State_AR.Disp_R_Adj_Up_Rq.phys = getValue( HMI_Disp_R_Adj_Up_Rq );
    _mHU_State_AR.SPC_LowLvl_Softkey_Psd.phys = getValue( HMI_SPC_LowLvl_Stat );
    _mHU_State_AR.FBAS_Video_Stat.phys = getValue( HMI_FBAS_Video_Stat );
    _mHU_State_AR.HU_DayNightMd_Stat.phys = getValue( HMI_HU_DayNightMd_Stat );
    _mHU_State_AR.HU_MPM_Msg_Stat.phys = getValue( HMI_HU_MPM_Msg_Stat );
    _mHU_State_AR.HU_On_Stat.phys = getValue( HMI_HU_On_Stat );
    _mHU_State_AR.InfoCall_Call_Stat.phys = getValue( HMI_InfoCall_Call_Stat );
    _mHU_State_AR.PhoneCall_Actv.phys = getValue( HMI_PhoneCall_Actv );
    _mHU_State_AR.Phonecall_SDS_Actv.phys = getValue( HMI_Phonecall_SDS_Actv );
    _mHU_State_AR.PT_DispLrnMax_Rq.phys = getValue( HMI_PT_DispLrnMax_Rq );
    _mHU_State_AR.Radio_NumPad_Stat.phys = getValue( HMI_Radio_NumPad_Stat );
    _mHU_State_AR.RemDev_CtrlEv.phys = getValue( HMI_RemDev_CtrlEv );
    _mHU_State_AR.RemDev_CtrlEv_Type.phys = getValue( HMI_RemDev_CtrlEv_Type );
    _mHU_State_AR.SDS_Actv.phys = getValue( HMI_SDS_Actv );
    _mHU_State_AR.ServiceCall_Call_Stat.phys = getValue( HMI_ServiceCall_Call_Stat );
	_mHU_State_AR.SPC_CarvProg_Rq_HU.phys = getValue( HMI_SPC_CarvProg_Rq_HU );
	_mHU_State_AR.SPC_RockingFree_Rq.phys = getValue( HMI_SPC_RockingFree_Rq );
    _mHU_State_AR.SPV_Rem_UI_Stat.phys = getValue( HMI_SPV_Rem_UI_Stat );
    _mHU_State_AR.TGW_TP_Alive.phys = getValue( HMI_TGW_TP_Alive );
    _mHU_State_AR.Tlm_Sw_Psd.phys = getValue( HMI_Tlm_Sw_Psd );
    _mHU_State_AR.Tweeter_Ft_Posn_Rq.phys = getValue( HMI_Tweeter_Ft_Posn_Rq );
    _mHU_State_AR.Tweeter_R_Posn_Rq.phys = getValue( HMI_Tweeter_R_Posn_Rq );
    _mHU_State_AR.VTA_Park_Event_Disp_Ack.phys = getValue( HMI_VTA_Park_Event_Disp_Ack );
    _mHU_State_AR.DTQ_Acust_Md_Rq_HU.phys = getValue( HMI_DTQ_Acust_Md_Rq_HU );
    _mHU_State_AR.Navi_RouteGuidance_Stat.phys = getValue( HMI_Navi_RouteGuidance_Stat );
	_mHU_State_AR.NaviActv_Stat.phys = getValue( HMI_NaviActv_Stat );
}

HU_State_AR_saveEnvVars( dword hFile )
{
    filePutString("\n// Knoten TGW: HU_State_AR\n", 25, hFile);
    snprintf( buffer, elcount(buffer), "0.0000 HMI__STMSG_HU_State_AR := %X\n", getValue( HMI__STMSG_HU_State_AR ));        filePutString( buffer, elcount(buffer), hFile);
    snprintf( buffer, elcount(buffer), "0.0000 HMI__STMSGT_HU_State_AR := %X\n", getValue( HMI__STMSGT_HU_State_AR ));        filePutString( buffer, elcount(buffer), hFile);
	  snprintf( buffer, elcount(buffer), "0.0000 HMI_ADAS_LongRng_Avl := %X\n", getValue( HMI_ADAS_LongRng_Avl ) );        filePutString( buffer, elcount(buffer), hFile);
	  snprintf( buffer, elcount(buffer), "0.0000 HMI_ADAS_Md := %X\n", getValue( HMI_ADAS_Md ) );        filePutString( buffer, elcount(buffer), hFile);
    snprintf( buffer, elcount(buffer), "0.0000 HMI_Audio_TwoCabSrc_Stat := %X\n", getValue( HMI_Audio_TwoCabSrc_Stat ) );        filePutString( buffer, elcount(buffer), hFile);
	  snprintf( buffer, elcount(buffer), "0.0000 HMI_CardletId_Rq := %X\n", getValue( HMI_CardletId_Rq ) );        filePutString( buffer, elcount(buffer), hFile);
    snprintf( buffer, elcount(buffer), "0.0000 HMI_CI_DI_Actv := %X\n", getValue( HMI_CI_DI_Actv ) );        filePutString( buffer, elcount(buffer), hFile);
    snprintf( buffer, elcount(buffer), "0.0000 HMI_Disp_R_Adj_Dn_Rq := %X\n", getValue( HMI_Disp_R_Adj_Dn_Rq ) );        filePutString( buffer, elcount(buffer), hFile);
    snprintf( buffer, elcount(buffer), "0.0000 HMI_Disp_R_Adj_Up_Rq := %X\n", getValue( HMI_Disp_R_Adj_Up_Rq ) );        filePutString( buffer, elcount(buffer), hFile);
    snprintf( buffer, elcount(buffer), "0.0000 HMI_SPC_LowLvl_Stat := %X\n", getValue( HMI_SPC_LowLvl_Softkey_Psd ) );        filePutString( buffer, elcount(buffer), hFile);
    snprintf( buffer, elcount(buffer), "0.0000 HMI_FBAS_Video_Stat := %X\n", getValue( HMI_FBAS_Video_Stat ) );        filePutString( buffer, elcount(buffer), hFile);
    snprintf( buffer, elcount(buffer), "0.0000 HMI_HU_DayNightMd_Stat := %X\n", getValue( HMI_HU_DayNightMd_Stat ) );        filePutString( buffer, elcount(buffer), hFile);
    snprintf( buffer, elcount(buffer), "0.0000 HMI_HU_MPM_Msg_Stat := %X\n", getValue( HMI_HU_MPM_Msg_Stat ) );        filePutString( buffer, elcount(buffer), hFile);
    snprintf( buffer, elcount(buffer), "0.0000 HMI_HU_On_Stat := %X\n", getValue( HMI_HU_On_Stat ) );        filePutString( buffer, elcount(buffer), hFile);
    snprintf( buffer, elcount(buffer), "0.0000 HMI_PhoneCall_Actv := %X\n", getValue( HMI_PhoneCall_Actv ) );        filePutString( buffer, elcount(buffer), hFile);
    snprintf( buffer, elcount(buffer), "0.0000 HMI_Phonecall_SDS_Actv := %X\n", getValue( HMI_Phonecall_SDS_Actv ) );        filePutString( buffer, elcount(buffer), hFile);
    snprintf( buffer, elcount(buffer), "0.0000 HMI_PT_DispLrnMax_Rq := %X\n", getValue( HMI_PT_DispLrnMax_Rq ) );        filePutString( buffer, elcount(buffer), hFile);
    snprintf( buffer, elcount(buffer), "0.0000 HMI_Radio_NumPad_Stat := %X\n", getValue( HMI_Radio_NumPad_Stat ) );        filePutString( buffer, elcount(buffer), hFile);
    snprintf( buffer, elcount(buffer), "0.0000 HMI_RemDev_CtrlEv := %X\n", getValue( HMI_RemDev_CtrlEv ) );        filePutString( buffer, elcount(buffer), hFile);
    snprintf( buffer, elcount(buffer), "0.0000 HMI_RemDev_CtrlEv_Type := %X\n", getValue( HMI_RemDev_CtrlEv_Type ) );        filePutString( buffer, elcount(buffer), hFile);
    snprintf( buffer, elcount(buffer), "0.0000 HMI_SDS_Actv := %X\n", getValue( HMI_SDS_Actv ) );        filePutString( buffer, elcount(buffer), hFile);
    snprintf( buffer, elcount(buffer), "0.0000 HMI_ServiceCall_Call_Stat := %X\n", getValue( HMI_ServiceCall_Call_Stat ) );        filePutString( buffer, elcount(buffer), hFile);
	  snprintf( buffer, elcount(buffer), "0.0000 HMI_SPC_CarvProg_Rq_HU := %X\n", getValue( HMI_SPC_CarvProg_Rq_HU ) );        filePutString( buffer, elcount(buffer), hFile);
	  snprintf( buffer, elcount(buffer), "0.0000 HMI_SPC_RockingFree_Rq := %X\n", getValue( HMI_SPC_RockingFree_Rq ) );        filePutString( buffer, elcount(buffer), hFile);
    snprintf( buffer, elcount(buffer), "0.0000 HMI_SPV_Rem_UI_Stat := %X\n", getValue( HMI_SPV_Rem_UI_Stat ) );        filePutString( buffer, elcount(buffer), hFile);
    snprintf( buffer, elcount(buffer), "0.0000 HMI_TGW_TP_Alive := %X\n", getValue( HMI_TGW_TP_Alive ) );        filePutString( buffer, elcount(buffer), hFile);
    snprintf( buffer, elcount(buffer), "0.0000 HMI_Tlm_Sw_Psd := %X\n", getValue( HMI_Tlm_Sw_Psd ) );        filePutString( buffer, elcount(buffer), hFile);
    snprintf( buffer, elcount(buffer), "0.0000 HMI_Tweeter_Ft_Posn_Rq := %X\n", getValue( HMI_Tweeter_Ft_Posn_Rq ) );        filePutString( buffer, elcount(buffer), hFile);
    snprintf( buffer, elcount(buffer), "0.0000 HMI_Tweeter_R_Posn_Rq := %X\n", getValue( HMI_Tweeter_R_Posn_Rq ) );        filePutString( buffer, elcount(buffer), hFile);
    snprintf( buffer, elcount(buffer), "0.0000 HMI_VTA_Park_Event_Disp_Ack := %X\n", getValue( HMI_VTA_Park_Event_Disp_Ack ) );        filePutString( buffer, elcount(buffer), hFile);
    snprintf( buffer, elcount(buffer), "0.0000 HMI_DTQ_Acust_Md_Rq_HU := %X\n", getValue( HMI_DTQ_Acust_Md_Rq_HU ) );        filePutString( buffer, elcount(buffer), hFile);
    snprintf( buffer, elcount(buffer), "0.0000 HMI_Navi_RouteGuidance_Stat := %X\n", getValue( HMI_Navi_RouteGuidance_Stat ) );        filePutString( buffer, elcount(buffer), hFile);
	snprintf( buffer, elcount(buffer), "0.0000 HMI_NaviActv_Stat := %X\n", getValue( HMI_NaviActv_Stat ) );        filePutString( buffer, elcount(buffer), hFile);
	}

on timer _tHU_State_AR
{
    putValue( HMI__STMSG_HU_State_AR, 0 );
}

on EnvVar HMI__STMSG_HU_State_AR
{
    long tDelay;
    if( getValue( this ) == 2 )
    {
        tDelay = getValue( HMI__STMSGT_HU_State_AR );
        if( tDelay > 0 )    
            setTimer( _tHU_State_AR, tDelay );
        else
            putValue( HMI__STMSG_HU_State_AR, 0 );
    }
}

on envVar HMI__STMSG_PO_HU_State_AR
{
    if( getValue( this ) )
        openPanel("HU_State_AR");
}

on EnvVar HMI_ADAS_LongRng_Avl
{
    _mHU_State_AR.ADAS_LongRng_Avl.phys = getValue(this);
    _HU_State_AR_SpontanFlag = 1;
}

on EnvVar HMI_ADAS_Md
{
    _mHU_State_AR.ADAS_Md.phys = getValue(this);
    _HU_State_AR_SpontanFlag = 1;
}

on EnvVar HMI_Audio_TwoCabSrc_Stat
{
    _mHU_State_AR.Audio_TwoCabSrc_Stat.phys = getValue(this);
    _HU_State_AR_SpontanFlag = 1;
}

on EnvVar HMI_CardletId_Rq
{
    _mHU_State_AR.CardletId_Rq.phys = getValue(this);
    _HU_State_AR_SpontanFlag = 1;
}

on EnvVar HMI_CI_DI_Actv
{
    _mHU_State_AR.CI_DI_Actv.phys = getValue(this);
    _HU_State_AR_SpontanFlag = 1;
}

on EnvVar HMI_Disp_R_Adj_Dn_Rq
{
    _mHU_State_AR.Disp_R_Adj_Dn_Rq.phys = getValue(this);
    _HU_State_AR_SpontanFlag = 1;
}

on EnvVar HMI_Disp_R_Adj_Up_Rq
{
    _mHU_State_AR.Disp_R_Adj_Up_Rq.phys = getValue(this);
    _HU_State_AR_SpontanFlag = 1;
}

on EnvVar HMI_NaviActv_Stat
{
    _mHU_State_AR.NaviActv_Stat.phys = getValue(this);
    _HU_State_AR_SpontanFlag = 1;
}

on EnvVar HMI_SPC_LowLvl_Softkey_Psd
{
    _mHU_State_AR.SPC_LowLvl_Softkey_Psd.phys = getValue(this);
    _HU_State_AR_SpontanFlag = 1;
}

on EnvVar HMI_FBAS_Video_Stat
{
    _mHU_State_AR.FBAS_Video_Stat.phys = getValue(this);
    _HU_State_AR_SpontanFlag = 1;
}

on EnvVar HMI_HU_DayNightMd_Stat
{
    _mHU_State_AR.HU_DayNightMd_Stat.phys = getValue(this);
    _HU_State_AR_SpontanFlag = 1;
}

on EnvVar HMI_HU_MPM_Msg_Stat
{
    _mHU_State_AR.HU_MPM_Msg_Stat.phys = getValue(this);
    _HU_State_AR_SpontanFlag = 1;
}

on EnvVar HMI_HU_On_Stat
{
    _mHU_State_AR.HU_On_Stat.phys = getValue(this);
    _HU_State_AR_SpontanFlag = 1;
}

on EnvVar HMI_InfoCall_Call_Stat
{
    _mHU_State_AR.InfoCall_Call_Stat.phys = getValue(this);
    _HU_State_AR_SpontanFlag = 1;
}

on EnvVar HMI_SPC_CarvProg_Rq_HU
{
    _mHU_State_AR.SPC_CarvProg_Rq_HU.phys = getValue(this);
    _HU_State_AR_SpontanFlag = 1;
}

on EnvVar HMI_SPC_RockingFree_Rq
{
    _mHU_State_AR.SPC_RockingFree_Rq.phys = getValue(this);
    _HU_State_AR_SpontanFlag = 1;
}

on EnvVar HMI_PhoneCall_Actv
{
    _mHU_State_AR.PhoneCall_Actv.phys = getValue(this);
    _HU_State_AR_SpontanFlag = 1;
}

on EnvVar HMI_Phonecall_SDS_Actv
{
    _mHU_State_AR.Phonecall_SDS_Actv.phys = getValue(this);
    _HU_State_AR_SpontanFlag = 1;
}

on EnvVar HMI_PT_DispLrnMax_Rq
{
    _mHU_State_AR.PT_DispLrnMax_Rq.phys = getValue(this);
    _HU_State_AR_SpontanFlag = 1;
}

on EnvVar HMI_Radio_NumPad_Stat
{
    _mHU_State_AR.Radio_NumPad_Stat.phys = getValue(this);
    _HU_State_AR_SpontanFlag = 1;
}

on EnvVar HMI_RemDev_CtrlEv
{
    _mHU_State_AR.RemDev_CtrlEv.phys = getValue(this);
    _HU_State_AR_SpontanFlag = 1;
}

on EnvVar HMI_RemDev_CtrlEv_Type
{
    _mHU_State_AR.RemDev_CtrlEv_Type.phys = getValue(this);
    _HU_State_AR_SpontanFlag = 1;
}

on EnvVar HMI_SDS_Actv
{
    _mHU_State_AR.SDS_Actv.phys = getValue(this);
    _HU_State_AR_SpontanFlag = 1;
}

on EnvVar HMI_ServiceCall_Call_Stat
{
    _mHU_State_AR.ServiceCall_Call_Stat.phys = getValue(this);
    _HU_State_AR_SpontanFlag = 1;
}

on EnvVar HMI_SPV_Rem_UI_Stat
{
    _mHU_State_AR.SPV_Rem_UI_Stat.phys = getValue(this);
    _HU_State_AR_SpontanFlag = 1;
}

on EnvVar HMI_TGW_TP_Alive
{
    _mHU_State_AR.TGW_TP_Alive.phys = getValue(this);
    _HU_State_AR_SpontanFlag = 1;
}

on EnvVar HMI_Tlm_Sw_Psd
{
    _mHU_State_AR.Tlm_Sw_Psd.phys = getValue(this);
    _HU_State_AR_SpontanFlag = 1;
}

on EnvVar HMI_Tweeter_Ft_Posn_Rq
{
    _mHU_State_AR.Tweeter_Ft_Posn_Rq.phys = getValue(this);
    _HU_State_AR_SpontanFlag = 1;
}

on EnvVar HMI_Tweeter_R_Posn_Rq
{
    _mHU_State_AR.Tweeter_R_Posn_Rq.phys = getValue(this);
    _HU_State_AR_SpontanFlag = 1;
}

on EnvVar HMI_VTA_Park_Event_Disp_Ack
{
    _mHU_State_AR.VTA_Park_Event_Disp_Ack.phys = getValue(this);
    _HU_State_AR_SpontanFlag = 1;
}

on EnvVar HMI_DTQ_Acust_Md_Rq_HU
{
    _mHU_State_AR.DTQ_Acust_Md_Rq_HU.phys = getValue(this);
    _HU_State_AR_SpontanFlag = 1;
}

on EnvVar HMI_Navi_RouteGuidance_Stat
{
    _mHU_State_AR.Navi_RouteGuidance_Stat.phys = getValue(this);
    _HU_State_AR_SpontanFlag = 1;
}

void HU_TELEAID_CONF_AR_Activity(int active)
{
    if( active)
    {
        if( _HU_TELEAID_CONF_AR_SigActivity == 0 )
            _HU_TELEAID_CONF_AR_Cnt = 1;
        _HU_TELEAID_CONF_AR_SigActivity++;
    }
    else
    {
        _HU_TELEAID_CONF_AR_SigActivity--;
    }
}

int HU_TELEAID_CONF_AR_Change(int lastValue, int sigValue, int inActValue)
{
    bActiveHelper = (sigValue != inActValue);
      if( !lastValue && bActiveHelper)
        HU_TELEAID_CONF_AR_Activity(1 );
      else if( lastValue && !bActiveHelper)
        HU_TELEAID_CONF_AR_Activity(0 );
    return bActiveHelper;
}

HU_TELEAID_CONF_AR_check_output()
{
    if( !getValue( HMI__STMSG_HU_TELEAID_CONF_AR ) )
    {
        // Botschaft HU_TELEAID_CONF_AR ID: 693 --- Sendeart 2 cyclicIfActiveX --- 
        if( _HU_TELEAID_CONF_AR_SigActivity )
            _HU_TELEAID_CONF_AR_Cnt--;
        if( _HU_TELEAID_CONF_AR_Cnt < 1 )
        {
            HU_TELEAID_CONF_AR_output(); // Zyklus abgelaufen, Nachricht senden
            _HU_TELEAID_CONF_AR_Cnt = _HU_TELEAID_CONF_AR_CycleCount;
        }
    }
}

HU_TELEAID_CONF_AR_init()
{   /* Botschaft HU_TELEAID_CONF_AR ID: 693 --- Sendeart 2 cyclicIfActiveX --- 
BA_ "ApplMessage" BO_ 693 0;
BA_ "NmAsrMessage" BO_ 693 0;
BA_ "GenMsgMinAcceptLength" BO_ 693 4;
BA_ "GenMsgILSupport" BO_ 693 1;
BA_ "DiagState" BO_ 693 0;
BA_ "DiagRequest" BO_ 693 0;
BA_ "DiagResponse" BO_ 693 0;
BA_ "GenMsgStartValue" BO_ 693 "0";
BA_ "GenMsgStartDelayTime" BO_ 693 0;
BA_ "GenMsgDelayTime" BO_ 693 5;
BA_ "GenMsgCycleTime" BO_ 693 0;
BA_ "GenMsgCycleTimeActive" BO_ 693 50;
BA_ "GenMsgSendType" BO_ 693 2;
    */
    _HU_TELEAID_CONF_AR_Timebase =            c_tDBKomTimer_20ms;
    _HU_TELEAID_CONF_AR_CycleCount =          50 / _HU_TELEAID_CONF_AR_Timebase;
    _HU_TELEAID_CONF_AR_StartDelay =           0 / _HU_TELEAID_CONF_AR_Timebase;
    _HU_TELEAID_CONF_AR_Cnt = 0;
    _HU_TELEAID_CONF_AR_SigActivity = 0;

    putValue( HMI__STMSGSD_HU_TELEAID_CONF_AR, _HU_TELEAID_CONF_AR_StartDelay * _HU_TELEAID_CONF_AR_Timebase );

    _mHU_TELEAID_CONF_AR.HU_Teleaid_CO_A.phys = getValue( HMI_HU_Teleaid_CO_A );                  _HU_TELEAID_CONF_AR_HU_Teleaid_CO_A_LastState = HU_TELEAID_CONF_AR_Change( _HU_TELEAID_CONF_AR_HU_Teleaid_CO_A_LastState, _mHU_TELEAID_CONF_AR.HU_Teleaid_CO_A, 7);
    _mHU_TELEAID_CONF_AR.HU_Teleaid_CO_ID.phys = getValue( HMI_HU_Teleaid_CO_ID );                  _HU_TELEAID_CONF_AR_HU_Teleaid_CO_ID_LastState = HU_TELEAID_CONF_AR_Change( _HU_TELEAID_CONF_AR_HU_Teleaid_CO_ID_LastState, _mHU_TELEAID_CONF_AR.HU_Teleaid_CO_ID, 31 );
    _mHU_TELEAID_CONF_AR.HU_Teleaid_CO_TID.phys = getValue( HMI_HU_Teleaid_CO_ID );                  _HU_TELEAID_CONF_AR_HU_Teleaid_CO_TID_LastState = HU_TELEAID_CONF_AR_Change( _HU_TELEAID_CONF_AR_HU_Teleaid_CO_TID_LastState, _mHU_TELEAID_CONF_AR.HU_Teleaid_CO_TID, 31 );
    _mHU_TELEAID_CONF_AR.INET_RQ.phys = getValue (HMI_INET_RQ );                  _HU_TELEAID_CONF_AR_INET_RQ_LastState = HU_TELEAID_CONF_AR_Change( _HU_TELEAID_CONF_AR_INET_RQ_LastState, _mHU_TELEAID_CONF_AR.INET_RQ, 3);
}

HU_TELEAID_CONF_AR_output()
{
    output( _mHU_TELEAID_CONF_AR );
}

HU_TELEAID_CONF_AR_saveEnvVars( dword hFile )
{
    filePutString("\n// Knoten TGW: HU_TELEAID_CONF_AR\n", 32, hFile);
    snprintf( buffer, elcount(buffer), "0.0000 HMI__STMSG_HU_TELEAID_CONF := %X\n", getValue( HMI__STMSG_HU_TELEAID_CONF_AR ));        filePutString( buffer, elcount(buffer), hFile);
    snprintf( buffer, elcount(buffer), "0.0000 HMI__STMSGT_HU_TELEAID_CONF := %X\n", getValue( HMI__STMSGT_HU_TELEAID_CONF_AR ));        filePutString( buffer, elcount(buffer), hFile);
    snprintf( buffer, elcount(buffer), "0.0000 HMI_HU_Teleaid_CO_A := %X\n", getValue( HMI_HU_Teleaid_CO_A ) );        filePutString( buffer, elcount(buffer), hFile);
    snprintf( buffer, elcount(buffer), "0.0000 HMI_HU_Teleaid_CO_ID := %X\n", getValue( HMI_HU_Teleaid_CO_ID ) );        filePutString( buffer, elcount(buffer), hFile);
    snprintf( buffer, elcount(buffer), "0.0000 HMI_HU_Teleaid_CO_TID := %X\n", getValue( HMI_HU_Teleaid_CO_TID ) );        filePutString( buffer, elcount(buffer), hFile);
    snprintf( buffer, elcount(buffer), "0.0000 HMI_INET_RQ := %X\n", getValue( HMI_INET_RQ ) );        filePutString( buffer, elcount(buffer), hFile);
}

on timer _tHU_TELEAID_CONF_AR
{
    putValue( HMI__STMSG_HU_TELEAID_CONF_AR, 0 );
}

on EnvVar HMI__STMSG_HU_TELEAID_CONF_AR
{
    long tDelay;
    if( getValue( this ) == 2 )
    {
        tDelay = getValue( HMI__STMSGT_HU_TELEAID_CONF_AR );
        if( tDelay > 0 )    
            setTimer( _tHU_TELEAID_CONF_AR, tDelay );
        else
            putValue( HMI__STMSG_HU_TELEAID_CONF_AR, 0 );
    }
}

on EnvVar HMI__ALLDEF_HU_TELEAID_CONF_AR
{
    if( getValue(this))
    {
        // alle signale auf default einstellen
        putValue( HMI_HU_Teleaid_CO_TID, 31 );
        putValue( HMI_HU_Teleaid_CO_A, 7);
    }
}

on envVar HMI__STMSG_PO_HU_TELEAID_CONF_AR
{
    if( getValue( this ) )
        openPanel("HU_TELEAID_CONF_AR");
}

on EnvVar HMI_HU_Teleaid_CO_A
{

   _mHU_TELEAID_CONF_AR.HU_Teleaid_CO_A.phys = getValue(this);
   _HU_TELEAID_CONF_AR_HU_Teleaid_CO_A_LastState = HU_TELEAID_CONF_AR_Change(_HU_TELEAID_CONF_AR_HU_Teleaid_CO_A_LastState, _mHU_TELEAID_CONF_AR.HU_Teleaid_CO_A, 7);
}

on EnvVar HMI_HU_Teleaid_CO_ID
{

   _mHU_TELEAID_CONF_AR.HU_Teleaid_CO_ID.phys = getValue(this);
   _HU_TELEAID_CONF_AR_HU_Teleaid_CO_ID_LastState = HU_TELEAID_CONF_AR_Change(_HU_TELEAID_CONF_AR_HU_Teleaid_CO_ID_LastState, _mHU_TELEAID_CONF_AR.HU_Teleaid_CO_ID, 31 );
}

on EnvVar HMI_HU_Teleaid_CO_TID
{
    _mHU_TELEAID_CONF_AR.HU_Teleaid_CO_TID.phys = getValue(this);
    _HU_TELEAID_CONF_AR_HU_Teleaid_CO_TID_LastState = HU_TELEAID_CONF_AR_Change(_HU_TELEAID_CONF_AR_HU_Teleaid_CO_TID_LastState, _mHU_TELEAID_CONF_AR.HU_Teleaid_CO_TID, 31 );
}

on EnvVar HMI_INET_RQ
{

   _mHU_TELEAID_CONF_AR.INET_RQ.phys = getValue(this);
   _HU_TELEAID_CONF_AR_INET_RQ_LastState = HU_TELEAID_CONF_AR_Change(_HU_TELEAID_CONF_AR_INET_RQ_LastState, _mHU_TELEAID_CONF_AR.INET_RQ, 31 );
}

HU_TunerFreq_AR_check_output()
{
    if( !getValue( HMI__STMSG_HU_TunerFreq_AR ) )
    {
        // Botschaft HU_TunerFreq_AR ID: 890 --- Sendeart 0 cyclicX --- 
        _HU_TunerFreq_AR_Cnt--;
        if( _HU_TunerFreq_AR_Cnt < 1 )
        {
            HU_TunerFreq_AR_output(); // Nachricht wg. abgelaufenem Zyklus ausgeben
            _HU_TunerFreq_AR_Cnt = _HU_TunerFreq_AR_CycleCount; // Zyklus-Zähler zurücksetzen
        }
    }
}

HU_TunerFreq_AR_init()
{   /* Botschaft HU_TunerFreq_AR ID: 890 --- Sendeart 0 cyclicX --- 
BA_ "ApplMessage" BO_ 890 0;
BA_ "NmAsrMessage" BO_ 890 0;
BA_ "GenMsgMinAcceptLength" BO_ 890 8;
BA_ "GenMsgILSupport" BO_ 890 0;
BA_ "DiagState" BO_ 890 0;
BA_ "DiagRequest" BO_ 890 0;
BA_ "DiagResponse" BO_ 890 0;
BA_ "GenMsgStartValue" BO_ 890 "0";
BA_ "GenMsgStartDelayTime" BO_ 890 65;
BA_ "GenMsgCycleTime" BO_ 890 1000;
BA_ "GenMsgSendType" BO_ 890 0;
    */
    _HU_TunerFreq_AR_Timebase =           c_tDBKomTimer_20ms;
    _HU_TunerFreq_AR_CycleCount =       1000 / _HU_TunerFreq_AR_Timebase;
    _HU_TunerFreq_AR_StartDelay =         65 / _HU_TunerFreq_AR_Timebase;
    _HU_TunerFreq_AR_Cnt = _HU_TunerFreq_AR_StartDelay;
    _HU_TunerFreq_AR_SpontanFlag = 0;

    putValue( HMI__STMSGSD_HU_TunerFreq_AR, _HU_TunerFreq_AR_StartDelay * _HU_TunerFreq_AR_Timebase );

    _mHU_TunerFreq_AR.TunerFreq_MdSel.phys = getValue( HMI_TunerFreq_MdSel );
    _mHU_TunerFreq_AR.TunerFreq1.phys = getValue( HMI_TunerFreq1 );
    _mHU_TunerFreq_AR.TunerFreq2.phys = getValue( HMI_TunerFreq2 );
    _mHU_TunerFreq_AR.TunerFreq3.phys = getValue( HMI_TunerFreq3 );
    _mHU_TunerFreq_AR.TunerFreq4.phys = getValue( HMI_TunerFreq4 );
    _mHU_TunerFreq_AR.TunerFreq5.phys = getValue( HMI_TunerFreq5 );
    _mHU_TunerFreq_AR.TunerFreq6.phys = getValue( HMI_TunerFreq6 );
    _mHU_TunerFreq_AR.TunerFreq7.phys = getValue( HMI_TunerFreq7 );
    _mHU_TunerFreq_AR.TunerFreq8.phys = getValue( HMI_TunerFreq8 );
}

HU_TunerFreq_AR_output()
{
   output( _mHU_TunerFreq_AR );
}

HU_TunerFreq_AR_saveEnvVars( dword hFile )
{
    filePutString("\n// Knoten EIS: HU_TunerFreq_AR\n", 33, hFile );
    snprintf( buffer, elcount( buffer ), "0.0000 HMI__STMSG_HU_TunerFreq_AR := %X\n", getValue( HMI__STMSG_HU_TunerFreq_AR ) );    filePutString( buffer, elcount( buffer ), hFile );
    snprintf( buffer, elcount( buffer ), "0.0000 HMI__STMSGT_HU_TunerFreq_AR := %X\n", getValue( HMI__STMSGT_HU_TunerFreq_AR ) );    filePutString( buffer, elcount( buffer ), hFile );
    snprintf( buffer, elcount( buffer ), "0.0000 HMI_TunerFreq_MdSel := %X\n", getValue( HMI_TunerFreq_MdSel ) );    filePutString( buffer, elcount( buffer ), hFile );
    snprintf( buffer, elcount( buffer ), "0.0000 HMI_TunerFreq1 := %X\n", getValue( HMI_TunerFreq1 ) );    filePutString( buffer, elcount( buffer ), hFile );
    snprintf( buffer, elcount( buffer ), "0.0000 HMI_TunerFreq2 := %X\n", getValue( HMI_TunerFreq2 ) );    filePutString( buffer, elcount( buffer ), hFile );
    snprintf( buffer, elcount( buffer ), "0.0000 HMI_TunerFreq3 := %X\n", getValue( HMI_TunerFreq3 ) );    filePutString( buffer, elcount( buffer ), hFile );
    snprintf( buffer, elcount( buffer ), "0.0000 HMI_TunerFreq4 := %X\n", getValue( HMI_TunerFreq4 ) );    filePutString( buffer, elcount( buffer ), hFile );
    snprintf( buffer, elcount( buffer ), "0.0000 HMI_TunerFreq5 := %X\n", getValue( HMI_TunerFreq5 ) );    filePutString( buffer, elcount( buffer ), hFile );
    snprintf( buffer, elcount( buffer ), "0.0000 HMI_TunerFreq6 := %X\n", getValue( HMI_TunerFreq6 ) );    filePutString( buffer, elcount( buffer ), hFile );
    snprintf( buffer, elcount( buffer ), "0.0000 HMI_TunerFreq7 := %X\n", getValue( HMI_TunerFreq7 ) );    filePutString( buffer, elcount( buffer ), hFile );
    snprintf( buffer, elcount( buffer ), "0.0000 HMI_TunerFreq8 := %X\n", getValue( HMI_TunerFreq8 ) );    filePutString( buffer, elcount( buffer ), hFile );
}

on timer _tHU_TunerFreq_AR
{
    putValue( HMI__STMSG_HU_TunerFreq_AR, 0 );
}

on EnvVar HMI__STMSG_HU_TunerFreq_AR
{
    long tDelay;
    if( getValue( this ) == 2 )
    {
        tDelay = getValue( HMI__STMSGT_HU_TunerFreq_AR );
        if( tDelay > 0)    
            setTimer( _tHU_TunerFreq_AR, tDelay );
        else
            putValue( HMI__STMSG_HU_TunerFreq_AR, 0 );
    }
}

on envVar HMI__STMSG_PO_HU_TunerFreq_AR
{
    if( getValue( this ) )
        openPanel("HU_TunerFreq_AR");
}

on EnvVar HMI_TunerFreq_MdSel
{
    _mHU_TunerFreq_AR.TunerFreq_MdSel.phys = getValue(this);
}

on EnvVar HMI_TunerFreq1
{
    _mHU_TunerFreq_AR.TunerFreq1.phys = getValue(this);
}

on EnvVar HMI_TunerFreq2
{
    _mHU_TunerFreq_AR.TunerFreq2.phys = getValue(this);
}

on EnvVar HMI_TunerFreq3
{
    _mHU_TunerFreq_AR.TunerFreq3.phys = getValue(this);
}

on EnvVar HMI_TunerFreq4
{
    _mHU_TunerFreq_AR.TunerFreq4.phys = getValue(this);
}

on EnvVar HMI_TunerFreq5
{
    _mHU_TunerFreq_AR.TunerFreq5.phys = getValue(this);
}

on EnvVar HMI_TunerFreq6
{
    _mHU_TunerFreq_AR.TunerFreq6.phys = getValue(this);
}

on EnvVar HMI_TunerFreq7
{
    _mHU_TunerFreq_AR.TunerFreq7.phys = getValue(this);
}

on EnvVar HMI_TunerFreq8
{
    _mHU_TunerFreq_AR.TunerFreq8.phys = getValue(this);
}

HVAC_Ft_Rq_HU_AR_check_output()
{
    if( !getValue( HMI__STMSG_HVAC_Ft_Rq_HU_AR ))
    {
        // Botschaft HVAC_Ft_Rq_HU_AR ID: 773 --- Sendeart cyclicAndSpontanWithDelay --- 
        _HVAC_Ft_Rq_HU_AR_Cnt--;
        if( _HVAC_Ft_Rq_HU_AR_Cnt < 1 )
        {
            // Nachricht wg. abgelaufenem Zyklus ausgeben
            output( _mHVAC_Ft_Rq_HU_AR );
            _HVAC_Ft_Rq_HU_AR_Cnt = _HVAC_Ft_Rq_HU_AR_CycleCount; // Zyklus-Zähler zurücksetzen
             _HVAC_Ft_Rq_HU_AR_SpontanFlag = 0; // Spontan-Flag zurücksetzen
        }
        else if( _HVAC_Ft_Rq_HU_AR_SpontanFlag)
        {
            // Nachricht wg. spontaner Änderung ausgeben
            output( _mHVAC_Ft_Rq_HU_AR );
             _HVAC_Ft_Rq_HU_AR_SpontanFlag = 0; // Spontan-Flag zurücksetzen
        }
    }
}

HVAC_Ft_Rq_HU_AR_init()
{   /* Botschaft HVAC_Ft_Rq_HU_AR ID: 773 --- Sendeart 5 cyclicAndSpontanWithDelay --- 
BA_ "ApplMessage" BO_ 773 0;
BA_ "NmAsrMessage" BO_ 773 0;
BA_ "GenMsgMinAcceptLength" BO_ 773 8;
BA_ "GenMsgILSupport" BO_ 773 1;
BA_ "DiagState" BO_ 773 0;
BA_ "DiagRequest" BO_ 773 0;
BA_ "DiagResponse" BO_ 773 0;
BA_ "GenMsgStartValue" BO_ 773 "0";
BA_ "GenMsgStartDelayTime" BO_ 773 60;
BA_ "GenMsgDelayTime" BO_ 773 20;
BA_ "GenMsgNrOfRepetitions" BO_ 773 0;
BA_ "GenMsgCycleTime" BO_ 773 1000;
BA_ "GenMsgSendType" BO_ 773 5;
    */
    _HVAC_Ft_Rq_HU_AR_Timebase =       c_tDBKomTimer_20ms;
    _HVAC_Ft_Rq_HU_AR_CycleCount =    1000 / _HVAC_Ft_Rq_HU_AR_Timebase;
    _HVAC_Ft_Rq_HU_AR_Cnt = 0;
    _HVAC_Ft_Rq_HU_AR_StartDelay =      60 / _HVAC_Ft_Rq_HU_AR_Timebase;
    _HVAC_Ft_Rq_HU_AR_SpontanFlag = 0;

    putValue( HMI__STMSGSD_HVAC_Ft_Rq_HU_AR, _HVAC_Ft_Rq_HU_AR_StartDelay * _HVAC_Ft_Rq_HU_AR_Timebase );

    _mHVAC_Ft_Rq_HU_AR.HVAC_AC_Ft_Rq_HU.phys = getValue( HMI_HVAC_AC_Ft_Rq_HU );
    _mHVAC_Ft_Rq_HU_AR.HVAC_AirDist_FL_Rq_HU.phys = getValue( HMI_HVAC_AirDist_FL_Rq_HU );
    _mHVAC_Ft_Rq_HU_AR.HVAC_AirDist_FR_Rq_HU.phys = getValue( HMI_HVAC_AirDist_FR_Rq_HU );
    _mHVAC_Ft_Rq_HU_AR.HVAC_Airflow_FL_Rq_HU.phys = getValue( HMI_HVAC_Airflow_FL_Rq_HU );
    _mHVAC_Ft_Rq_HU_AR.HVAC_Airflow_FR_Rq_HU.phys = getValue( HMI_HVAC_Airflow_FR_Rq_HU );
    _mHVAC_Ft_Rq_HU_AR.HVAC_Auto_FL_Rq_HU.phys = getValue( HMI_HVAC_Auto_FL_Rq_HU );
    _mHVAC_Ft_Rq_HU_AR.HVAC_Auto_FR_Rq_HU.phys = getValue( HMI_HVAC_Auto_FR_Rq_HU );
    _mHVAC_Ft_Rq_HU_AR.HVAC_Dfrst_Ft_Rq_HU.phys = getValue( HMI_HVAC_Dfrst_Ft_Rq_HU );
    _mHVAC_Ft_Rq_HU_AR.HVAC_FanLvl_FL_Rq_HU.phys = getValue( HMI_HVAC_FanLvl_FL_Rq_HU );
    _mHVAC_Ft_Rq_HU_AR.HVAC_FanLvl_FR_Rq_HU.phys = getValue( HMI_HVAC_FanLvl_FR_Rq_HU );
    _mHVAC_Ft_Rq_HU_AR.HVAC_FtwInc_FL_Rq_HU.phys = getValue( HMI_HVAC_FtwInc_FL_Rq_HU );
    _mHVAC_Ft_Rq_HU_AR.HVAC_FtwInc_FR_Rq_HU.phys = getValue( HMI_HVAC_FtwInc_FR_Rq_HU );
    _mHVAC_Ft_Rq_HU_AR.HVAC_Ionzr_Md_Rq.phys = getValue( HMI_HVAC_Ionzr_Md_Rq );
    _mHVAC_Ft_Rq_HU_AR.HVAC_Ionzr_On_Rq_HU.phys = getValue( HMI_HVAC_Ionzr_On_Rq_HU );
    _mHVAC_Ft_Rq_HU_AR.HVAC_Menu_Ft_Actv_HU.phys = getValue( HMI_HVAC_Menu_Ft_Actv_HU );
    _mHVAC_Ft_Rq_HU_AR.HVAC_MonoMd_Ft_Rq_HU.phys = getValue( HMI_HVAC_MonoMd_Ft_Rq_HU );
    _mHVAC_Ft_Rq_HU_AR.HVAC_Off_Ft_Rq_HU.phys = getValue( HMI_HVAC_Off_Ft_Rq_HU );
    _mHVAC_Ft_Rq_HU_AR.HVAC_Recirc_Rq_HU.phys = getValue( HMI_HVAC_Recirc_Rq_HU );
    _mHVAC_Ft_Rq_HU_AR.HVAC_Rem_Ft_Rq_HU.phys = getValue( HMI_HVAC_Rem_Ft_Rq_HU );
    _mHVAC_Ft_Rq_HU_AR.HVAC_SGEN_Insty_Rq.phys = getValue( HMI_HVAC_SGEN_Insty_Rq );
//    _mHVAC_Ft_Rq_HU_AR.HVAC_SGEN_Lk_Rq.phys = getValue( HMI_HVAC_SGEN_Lk_Rq );
    _mHVAC_Ft_Rq_HU_AR.HVAC_SGEN_On_Rq_HU.phys = getValue( HMI_HVAC_SGEN_On_Rq_HU );
    _mHVAC_Ft_Rq_HU_AR.HVAC_Temp_FL_Rq_HU.phys = getValue( HMI_HVAC_Temp_FL_Rq_HU );
    _mHVAC_Ft_Rq_HU_AR.HVAC_Temp_FR_Rq_HU.phys = getValue( HMI_HVAC_Temp_FR_Rq_HU );
    _mHVAC_Ft_Rq_HU_AR.HVAC_WShHtKey_Psd_TGW.phys = getValue( HMI_HVAC_WShHtKey_Psd_TGW );
    _mHVAC_Ft_Rq_HU_AR.HVAC_Recirc_Max_Rq_HU.phys = getValue( HMI_HVAC_Recirc_Max_Rq_HU );
}

HVAC_Ft_Rq_HU_AR_saveEnvVars( dword hFile )
{
    filePutString("\n// Knoten TGW: HVAC_Ft_Rq_HU_AR\n", 30, hFile);
    snprintf( buffer, elcount(buffer), "0.0000 HMI__STMSG_HVAC_Ft_Rq_HU := %X\n", getValue( HMI__STMSG_HVAC_Ft_Rq_HU_AR ));        filePutString( buffer, elcount(buffer), hFile);
    snprintf( buffer, elcount(buffer), "0.0000 HMI__STMSGT_HVAC_Ft_Rq_HU := %X\n", getValue( HMI__STMSGT_HVAC_Ft_Rq_HU_AR ));        filePutString( buffer, elcount(buffer), hFile);
    snprintf( buffer, elcount(buffer), "0.0000 HMI_HVAC_AC_Ft_Rq_HU := %f\n", getValue( HMI_HVAC_AC_Ft_Rq_HU ) );        filePutString( buffer, elcount(buffer), hFile);
    snprintf( buffer, elcount(buffer), "0.0000 HMI_HVAC_AirDist_FL_Rq_HU := %f\n", getValue( HMI_HVAC_AirDist_FL_Rq_HU ) );        filePutString( buffer, elcount(buffer), hFile);
    snprintf( buffer, elcount(buffer), "0.0000 HMI_HVAC_AirDist_FR_Rq_HU := %f\n", getValue( HMI_HVAC_AirDist_FR_Rq_HU ) );        filePutString( buffer, elcount(buffer), hFile);
    snprintf( buffer, elcount(buffer), "0.0000 HMI_HVAC_Airflow_FL_Rq_HU := %f\n", getValue( HMI_HVAC_Airflow_FL_Rq_HU ) );        filePutString( buffer, elcount(buffer), hFile);
    snprintf( buffer, elcount(buffer), "0.0000 HMI_HVAC_Airflow_FR_Rq_HU := %f\n", getValue( HMI_HVAC_Airflow_FR_Rq_HU ) );        filePutString( buffer, elcount(buffer), hFile);
    snprintf( buffer, elcount(buffer), "0.0000 HMI_HVAC_Auto_FL_Rq_HU := %f\n", getValue( HMI_HVAC_Auto_FL_Rq_HU ) );        filePutString( buffer, elcount(buffer), hFile);
    snprintf( buffer, elcount(buffer), "0.0000 HMI_HVAC_Auto_FR_Rq_HU := %f\n", getValue( HMI_HVAC_Auto_FR_Rq_HU ) );        filePutString( buffer, elcount(buffer), hFile);
    snprintf( buffer, elcount(buffer), "0.0000 HMI_HVAC_Dfrst_Ft_Rq_HU := %f\n", getValue( HMI_HVAC_Dfrst_Ft_Rq_HU ) );        filePutString( buffer, elcount(buffer), hFile);
    snprintf( buffer, elcount(buffer), "0.0000 HMI_HVAC_FanLvl_FL_Rq_HU := %f\n", getValue( HMI_HVAC_FanLvl_FL_Rq_HU ) );        filePutString( buffer, elcount(buffer), hFile);
    snprintf( buffer, elcount(buffer), "0.0000 HMI_HVAC_FanLvl_FR_Rq_HU := %f\n", getValue( HMI_HVAC_FanLvl_FR_Rq_HU ) );        filePutString( buffer, elcount(buffer), hFile);
    snprintf( buffer, elcount(buffer), "0.0000 HMI_HVAC_FtwInc_FL_Rq_HU := %f\n", getValue( HMI_HVAC_FtwInc_FL_Rq_HU ) );        filePutString( buffer, elcount(buffer), hFile);
    snprintf( buffer, elcount(buffer), "0.0000 HMI_HVAC_FtwInc_FR_Rq_HU := %f\n", getValue( HMI_HVAC_FtwInc_FR_Rq_HU ) );        filePutString( buffer, elcount(buffer), hFile);
    snprintf( buffer, elcount(buffer), "0.0000 HMI_HVAC_Ionzr_Md_Rq := %f\n", getValue( HMI_HVAC_Ionzr_Md_Rq ) );        filePutString( buffer, elcount(buffer), hFile);
    snprintf( buffer, elcount(buffer), "0.0000 HMI_HVAC_Ionzr_On_Rq_HU := %f\n", getValue( HMI_HVAC_Ionzr_On_Rq_HU ) );        filePutString( buffer, elcount(buffer), hFile);
    snprintf( buffer, elcount(buffer), "0.0000 HMI_HVAC_Menu_Ft_Actv_HU := %f\n", getValue( HMI_HVAC_Menu_Ft_Actv_HU ) );        filePutString( buffer, elcount(buffer), hFile);
    snprintf( buffer, elcount(buffer), "0.0000 HMI_HVAC_MonoMd_Ft_Rq_HU := %f\n", getValue( HMI_HVAC_MonoMd_Ft_Rq_HU ) );        filePutString( buffer, elcount(buffer), hFile);
    snprintf( buffer, elcount(buffer), "0.0000 HMI_HVAC_Off_Ft_Rq_HU := %f\n", getValue( HMI_HVAC_Off_Ft_Rq_HU ) );        filePutString( buffer, elcount(buffer), hFile);
    snprintf( buffer, elcount(buffer), "0.0000 HMI_HVAC_Recirc_Rq_HU := %f\n", getValue( HMI_HVAC_Recirc_Rq_HU ) );        filePutString( buffer, elcount(buffer), hFile);
    snprintf( buffer, elcount(buffer), "0.0000 HMI_HVAC_Rem_Ft_Rq_HU := %f\n", getValue( HMI_HVAC_Rem_Ft_Rq_HU ) );        filePutString( buffer, elcount(buffer), hFile);
    snprintf( buffer, elcount(buffer), "0.0000 HMI_HVAC_SGEN_Insty_Rq := %f\n", getValue( HMI_HVAC_SGEN_Insty_Rq ) );        filePutString( buffer, elcount(buffer), hFile);
//    snprintf( buffer, elcount(buffer), "0.0000 HMI_HVAC_SGEN_Lk_Rq := %f\n", getValue( HMI_HVAC_SGEN_Lk_Rq ) );        filePutString( buffer, elcount(buffer), hFile);
    snprintf( buffer, elcount(buffer), "0.0000 HMI_HVAC_SGEN_On_Rq_HU := %f\n", getValue( HMI_HVAC_SGEN_On_Rq_HU ) );        filePutString( buffer, elcount(buffer), hFile);
    snprintf( buffer, elcount(buffer), "0.0000 HMI_HVAC_Temp_FL_Rq_HU := %f\n", getValue( HMI_HVAC_Temp_FL_Rq_HU ) );        filePutString( buffer, elcount(buffer), hFile);
    snprintf( buffer, elcount(buffer), "0.0000 HMI_HVAC_Temp_FR_Rq_HU := %f\n", getValue( HMI_HVAC_Temp_FR_Rq_HU ) );        filePutString( buffer, elcount(buffer), hFile);
    snprintf( buffer, elcount(buffer), "0.0000 HMI_HVAC_WShHtKey_Psd_TGW := %f\n", getValue( HMI_HVAC_WShHtKey_Psd_TGW ) );        filePutString( buffer, elcount(buffer), hFile);
    snprintf( buffer, elcount(buffer), "0.0000 HMI_HVAC_Recirc_Max_Rq_HU := %f\n", getValue( HMI_HVAC_Recirc_Max_Rq_HU ) );        filePutString( buffer, elcount(buffer), hFile);
}

on timer _tHVAC_Ft_Rq_HU_AR
{
    putValue( HMI__STMSG_HVAC_Ft_Rq_HU_AR, 0 );
}

on EnvVar HMI__STMSG_HVAC_Ft_Rq_HU_AR
{
    long tDelay;
    if( getValue( this ) == 2 )
    {
        tDelay = getValue( HMI__STMSGT_HVAC_Ft_Rq_HU_AR );
        if( tDelay > 0 )    
            setTimer( _tHVAC_Ft_Rq_HU_AR, tDelay );
        else
            putValue( HMI__STMSG_HVAC_Ft_Rq_HU_AR, 0 );
    }
}

on envVar HMI__STMSG_PO_HVAC_Ft_Rq_HU_AR
{
    if( getValue( this ) )
        openPanel("HVAC_Ft_Rq_HU_AR");
}

on EnvVar HMI_HVAC_AC_Ft_Rq_HU
{
    _mHVAC_Ft_Rq_HU_AR.HVAC_AC_Ft_Rq_HU.phys = getValue(this);
    _HVAC_Ft_Rq_HU_AR_SpontanFlag = 1;
}

on EnvVar HMI_HVAC_AirDist_FL_Rq_HU
{
    _mHVAC_Ft_Rq_HU_AR.HVAC_AirDist_FL_Rq_HU.phys = getValue(this);
    _HVAC_Ft_Rq_HU_AR_SpontanFlag = 1;
}

on EnvVar HMI_HVAC_AirDist_FR_Rq_HU
{
    _mHVAC_Ft_Rq_HU_AR.HVAC_AirDist_FR_Rq_HU.phys = getValue(this);
    _HVAC_Ft_Rq_HU_AR_SpontanFlag = 1;
}

on EnvVar HMI_HVAC_Airflow_FL_Rq_HU
{
    _mHVAC_Ft_Rq_HU_AR.HVAC_Airflow_FL_Rq_HU.phys = getValue(this);
    _HVAC_Ft_Rq_HU_AR_SpontanFlag = 1;
}

on EnvVar HMI_HVAC_Airflow_FR_Rq_HU
{
    _mHVAC_Ft_Rq_HU_AR.HVAC_Airflow_FR_Rq_HU.phys = getValue(this);
    _HVAC_Ft_Rq_HU_AR_SpontanFlag = 1;
}

on EnvVar HMI_HVAC_Auto_FL_Rq_HU
{
    _mHVAC_Ft_Rq_HU_AR.HVAC_Auto_FL_Rq_HU.phys = getValue(this);
    _HVAC_Ft_Rq_HU_AR_SpontanFlag = 1;
}

on EnvVar HMI_HVAC_Auto_FR_Rq_HU
{
    _mHVAC_Ft_Rq_HU_AR.HVAC_Auto_FR_Rq_HU.phys = getValue(this);
    _HVAC_Ft_Rq_HU_AR_SpontanFlag = 1;
}

on EnvVar HMI_HVAC_Dfrst_Ft_Rq_HU
{
    _mHVAC_Ft_Rq_HU_AR.HVAC_Dfrst_Ft_Rq_HU.phys = getValue(this);
    _HVAC_Ft_Rq_HU_AR_SpontanFlag = 1;
}

on EnvVar HMI_HVAC_FanLvl_FL_Rq_HU
{
    _mHVAC_Ft_Rq_HU_AR.HVAC_FanLvl_FL_Rq_HU.phys = getValue(this);
    _HVAC_Ft_Rq_HU_AR_SpontanFlag = 1;
}

on EnvVar HMI_HVAC_FanLvl_FR_Rq_HU
{
    _mHVAC_Ft_Rq_HU_AR.HVAC_FanLvl_FR_Rq_HU.phys = getValue(this);
    _HVAC_Ft_Rq_HU_AR_SpontanFlag = 1;
}

on EnvVar HMI_HVAC_FtwInc_FL_Rq_HU
{
    _mHVAC_Ft_Rq_HU_AR.HVAC_FtwInc_FL_Rq_HU.phys = getValue(this);
    _HVAC_Ft_Rq_HU_AR_SpontanFlag = 1;
}

on EnvVar HMI_HVAC_FtwInc_FR_Rq_HU
{
    _mHVAC_Ft_Rq_HU_AR.HVAC_FtwInc_FR_Rq_HU.phys = getValue(this);
    _HVAC_Ft_Rq_HU_AR_SpontanFlag = 1;
}

on EnvVar HMI_HVAC_Ionzr_Md_Rq
{
    _mHVAC_Ft_Rq_HU_AR.HVAC_Ionzr_Md_Rq.phys = getValue(this);
    _HVAC_Ft_Rq_HU_AR_SpontanFlag = 1;
}

on EnvVar HMI_HVAC_Ionzr_On_Rq_HU
{
    _mHVAC_Ft_Rq_HU_AR.HVAC_Ionzr_On_Rq_HU.phys = getValue(this);
    _HVAC_Ft_Rq_HU_AR_SpontanFlag = 1;
}

on EnvVar HMI_HVAC_Menu_Ft_Actv_HU
{
    _mHVAC_Ft_Rq_HU_AR.HVAC_Menu_Ft_Actv_HU.phys = getValue(this);
    _HVAC_Ft_Rq_HU_AR_SpontanFlag = 1;
}

on EnvVar HMI_HVAC_MonoMd_Ft_Rq_HU
{
    _mHVAC_Ft_Rq_HU_AR.HVAC_MonoMd_Ft_Rq_HU.phys = getValue(this);
    _HVAC_Ft_Rq_HU_AR_SpontanFlag = 1;
}

on EnvVar HMI_HVAC_Off_Ft_Rq_HU
{
    _mHVAC_Ft_Rq_HU_AR.HVAC_Off_Ft_Rq_HU.phys = getValue(this);
    _HVAC_Ft_Rq_HU_AR_SpontanFlag = 1;
}

on EnvVar HMI_HVAC_Recirc_Rq_HU
{
    _mHVAC_Ft_Rq_HU_AR.HVAC_Recirc_Rq_HU.phys = getValue(this);
    _HVAC_Ft_Rq_HU_AR_SpontanFlag = 1;
}

on EnvVar HMI_HVAC_Rem_Ft_Rq_HU
{
    _mHVAC_Ft_Rq_HU_AR.HVAC_Rem_Ft_Rq_HU.phys = getValue(this);
    _HVAC_Ft_Rq_HU_AR_SpontanFlag = 1;
}

on EnvVar HMI_HVAC_SGEN_Insty_Rq
{
    _mHVAC_Ft_Rq_HU_AR.HVAC_SGEN_Insty_Rq.phys = getValue(this);
    _HVAC_Ft_Rq_HU_AR_SpontanFlag = 1;
}

/*on EnvVar HMI_HVAC_SGEN_Lk_Rq
{
    _mHVAC_Ft_Rq_HU_AR.HVAC_SGEN_Lk_Rq.phys = getValue(this);
    _HVAC_Ft_Rq_HU_AR_SpontanFlag = 1;
}*/

on EnvVar HMI_HVAC_SGEN_On_Rq_HU
{
    _mHVAC_Ft_Rq_HU_AR.HVAC_SGEN_On_Rq_HU.phys = getValue(this);
    _HVAC_Ft_Rq_HU_AR_SpontanFlag = 1;
}

on EnvVar HMI_HVAC_Temp_FL_Rq_HU
{
    _mHVAC_Ft_Rq_HU_AR.HVAC_Temp_FL_Rq_HU.phys = getValue(this);
    _HVAC_Ft_Rq_HU_AR_SpontanFlag = 1;
}

on EnvVar HMI_HVAC_Temp_FR_Rq_HU
{
    _mHVAC_Ft_Rq_HU_AR.HVAC_Temp_FR_Rq_HU.phys = getValue(this);
    _HVAC_Ft_Rq_HU_AR_SpontanFlag = 1;
}

on EnvVar HMI_HVAC_WShHtKey_Psd_TGW
{
    _mHVAC_Ft_Rq_HU_AR.HVAC_WShHtKey_Psd_TGW.phys = getValue(this);
    _HVAC_Ft_Rq_HU_AR_SpontanFlag = 1;
}

on EnvVar HMI_HVAC_Recirc_Max_Rq_HU
{
    _mHVAC_Ft_Rq_HU_AR.HVAC_Recirc_Max_Rq_HU.phys = getValue(this);
    _HVAC_Ft_Rq_HU_AR_SpontanFlag = 1;
}

HVAC_R_Rq_HU_AR_check_output()
{
    if( !getValue( HMI__STMSG_HVAC_R_Rq_HU_AR ))
    {
        // Botschaft HVAC_R_Rq_HU_AR ID: 1121 --- Sendeart cyclicAndSpontanWithDelay --- 
        _HVAC_R_Rq_HU_AR_Cnt--;
        if( _HVAC_R_Rq_HU_AR_Cnt < 1 )
        {
            // Nachricht wg. abgelaufenem Zyklus ausgeben
            output( _mHVAC_R_Rq_HU_AR );
            _HVAC_R_Rq_HU_AR_Cnt = _HVAC_R_Rq_HU_AR_CycleCount; // Zyklus-Zähler zurücksetzen
             _HVAC_R_Rq_HU_AR_SpontanFlag = 0; // Spontan-Flag zurücksetzen
        }
        else if( _HVAC_R_Rq_HU_AR_SpontanFlag)
        {
            // Nachricht wg. spontaner Änderung ausgeben
            output( _mHVAC_R_Rq_HU_AR );
             _HVAC_R_Rq_HU_AR_SpontanFlag = 0; // Spontan-Flag zurücksetzen
        }
    }
}

HVAC_R_Rq_HU_AR_init()
{   /* Botschaft HVAC_R_Rq_HU_AR ID: 1121 --- Sendeart cyclicAndSpontanWithDelay --- 
BA_ "ApplMessage" BO_ 1121 0;
BA_ "NmAsrMessage" BO_ 1121 0;
BA_ "GenMsgMinAcceptLength" BO_ 1121 8;
BA_ "GenMsgILSupport" BO_ 1121 1;
BA_ "DiagState" BO_ 1121 0;
BA_ "DiagRequest" BO_ 1121 0;
BA_ "DiagResponse" BO_ 1121 0;
BA_ "GenMsgStartValue" BO_ 1121 "0";
BA_ "GenMsgStartDelayTime" BO_ 1121 195;
BA_ "GenMsgDelayTime" BO_ 1121 5;
BA_ "GenMsgNrOfRepetitions" BO_ 1121 0;
BA_ "GenMsgCycleTime" BO_ 1121 1000;
BA_ "GenMsgSendType" BO_ 1121 5;
    */
    _HVAC_R_Rq_HU_AR_Timebase =       c_tDBKomTimer_20ms;
    _HVAC_R_Rq_HU_AR_CycleCount = 1000 / _HVAC_R_Rq_HU_AR_Timebase;
    _HVAC_R_Rq_HU_AR_Cnt = 0;
    _HVAC_R_Rq_HU_AR_StartDelay =  195 / _HVAC_R_Rq_HU_AR_Timebase;
    _HVAC_R_Rq_HU_AR_SpontanFlag = 0;

    putValue( HMI__STMSGSD_HVAC_R_Rq_HU_AR, _HVAC_R_Rq_HU_AR_StartDelay * _HVAC_R_Rq_HU_AR_Timebase );

    _mHVAC_R_Rq_HU_AR.HVAC_AC_R_Rq_HU.phys = getValue( HMI_HVAC_AC_R_Rq_HU );
    _mHVAC_R_Rq_HU_AR.HVAC_AirDist_RL_Rq_HU.phys = getValue( HMI_HVAC_AirDist_RL_Rq_HU );
    _mHVAC_R_Rq_HU_AR.HVAC_AirDist_RR_Rq_HU.phys = getValue( HMI_HVAC_AirDist_RR_Rq_HU );
    _mHVAC_R_Rq_HU_AR.HVAC_Auto_RL_Rq_HU.phys = getValue( HMI_HVAC_Auto_RL_Rq_HU );
    _mHVAC_R_Rq_HU_AR.HVAC_Auto_RR_Rq_HU.phys = getValue( HMI_HVAC_Auto_RR_Rq_HU );
    _mHVAC_R_Rq_HU_AR.HVAC_FanLvl_RL_Rq_HU.phys = getValue( HMI_HVAC_FanLvl_RL_Rq_HU );
    _mHVAC_R_Rq_HU_AR.HVAC_FanLvl_RR_Rq_HU.phys = getValue( HMI_HVAC_FanLvl_RR_Rq_HU );
    _mHVAC_R_Rq_HU_AR.HVAC_Off_R_Rq_HU.phys = getValue( HMI_HVAC_Off_R_Rq_HU );
    _mHVAC_R_Rq_HU_AR.HVAC_Temp_RL_Rq_HU.phys = getValue( HMI_HVAC_Temp_RL_Rq_HU );
    _mHVAC_R_Rq_HU_AR.HVAC_Temp_RR_Rq_HU.phys = getValue( HMI_HVAC_Temp_RR_Rq_HU );
    _mHVAC_R_Rq_HU_AR.HVAC_Airflow_RL_Rq_HU.phys = getValue( HMI_HVAC_Airflow_RL_Rq_HU );
    _mHVAC_R_Rq_HU_AR.HVAC_Airflow_RR_Rq_HU.phys = getValue( HMI_HVAC_Airflow_RR_Rq_HU );
}

HVAC_R_Rq_HU_AR_saveEnvVars( dword hFile )
{
    filePutString("\n// Knoten TGW: HVAC_R_Rq_HU_AR\n", 29, hFile);
    snprintf( buffer, elcount(buffer), "0.0000 HMI__STMSG_HVAC_R_Rq_HU := %X\n", getValue( HMI__STMSG_HVAC_R_Rq_HU_AR ));        filePutString( buffer, elcount(buffer), hFile);
    snprintf( buffer, elcount(buffer), "0.0000 HMI__STMSGT_HVAC_R_Rq_HU := %X\n", getValue( HMI__STMSGT_HVAC_R_Rq_HU_AR ));        filePutString( buffer, elcount(buffer), hFile);
    snprintf( buffer, elcount(buffer), "0.0000 HMI_HVAC_AC_R_Rq_HU := %f\n", getValue( HMI_HVAC_AC_R_Rq_HU ) );        filePutString( buffer, elcount(buffer), hFile);
    snprintf( buffer, elcount(buffer), "0.0000 HMI_HVAC_AirDist_RL_Rq_HU := %f\n", getValue( HMI_HVAC_AirDist_RL_Rq_HU ) );        filePutString( buffer, elcount(buffer), hFile);
    snprintf( buffer, elcount(buffer), "0.0000 HMI_HVAC_AirDist_RR_Rq_HU := %f\n", getValue( HMI_HVAC_AirDist_RR_Rq_HU ) );        filePutString( buffer, elcount(buffer), hFile);
    snprintf( buffer, elcount(buffer), "0.0000 HMI_HVAC_Auto_RL_Rq_HU := %f\n", getValue( HMI_HVAC_Auto_RL_Rq_HU ) );        filePutString( buffer, elcount(buffer), hFile);
    snprintf( buffer, elcount(buffer), "0.0000 HMI_HVAC_Auto_RR_Rq_HU := %f\n", getValue( HMI_HVAC_Auto_RR_Rq_HU ) );        filePutString( buffer, elcount(buffer), hFile);
    snprintf( buffer, elcount(buffer), "0.0000 HMI_HVAC_FanLvl_RL_Rq_HU := %f\n", getValue( HMI_HVAC_FanLvl_RL_Rq_HU ) );        filePutString( buffer, elcount(buffer), hFile);
    snprintf( buffer, elcount(buffer), "0.0000 HMI_HVAC_FanLvl_RR_Rq_HU := %f\n", getValue( HMI_HVAC_FanLvl_RR_Rq_HU ) );        filePutString( buffer, elcount(buffer), hFile);
    snprintf( buffer, elcount(buffer), "0.0000 HMI_HVAC_Off_R_Rq_HU := %f\n", getValue( HMI_HVAC_Off_R_Rq_HU ) );        filePutString( buffer, elcount(buffer), hFile);
    snprintf( buffer, elcount(buffer), "0.0000 HMI_HVAC_Temp_RL_Rq_HU := %f\n", getValue( HMI_HVAC_Temp_RL_Rq_HU ) );        filePutString( buffer, elcount(buffer), hFile);
    snprintf( buffer, elcount(buffer), "0.0000 HMI_HVAC_Temp_RR_Rq_HU := %f\n", getValue( HMI_HVAC_Temp_RR_Rq_HU ) );        filePutString( buffer, elcount(buffer), hFile);
    snprintf( buffer, elcount(buffer), "0.0000 HMI_HVAC_Airflow_RL_Rq_HU := %f\n", getValue( HMI_HVAC_Airflow_RL_Rq_HU ) );        filePutString( buffer, elcount(buffer), hFile);
    snprintf( buffer, elcount(buffer), "0.0000 HMI_HVAC_Airflow_RR_Rq_HU := %f\n", getValue( HMI_HVAC_Airflow_RR_Rq_HU ) );        filePutString( buffer, elcount(buffer), hFile);
}

on timer _tHVAC_R_Rq_HU_AR
{
    putValue( HMI__STMSG_HVAC_R_Rq_HU_AR, 0 );
}

on EnvVar HMI__STMSG_HVAC_R_Rq_HU_AR
{
    long tDelay;
    if( getValue( this ) == 2 )
    {
        tDelay = getValue( HMI__STMSGT_HVAC_R_Rq_HU_AR );
        if( tDelay > 0 )    
            setTimer( _tHVAC_R_Rq_HU_AR, tDelay );
        else
            putValue( HMI__STMSG_HVAC_R_Rq_HU_AR, 0 );
    }
}

on envVar HMI__STMSG_PO_HVAC_R_Rq_HU_AR
{
    if( getValue( this ) )
        openPanel("HVAC_R_Rq_HU_AR");
}

on EnvVar HMI_HVAC_AC_R_Rq_HU
{
    _mHVAC_R_Rq_HU_AR.HVAC_AC_R_Rq_HU.phys = getValue(this);
    _HVAC_R_Rq_HU_AR_SpontanFlag = 1;
}

on EnvVar HMI_HVAC_AirDist_RL_Rq_HU
{
    _mHVAC_R_Rq_HU_AR.HVAC_AirDist_RL_Rq_HU.phys = getValue(this);
    _HVAC_R_Rq_HU_AR_SpontanFlag = 1;
}

on EnvVar HMI_HVAC_AirDist_RR_Rq_HU
{
    _mHVAC_R_Rq_HU_AR.HVAC_AirDist_RR_Rq_HU.phys = getValue(this);
    _HVAC_R_Rq_HU_AR_SpontanFlag = 1;
}

on EnvVar HMI_HVAC_Auto_RL_Rq_HU
{
    _mHVAC_R_Rq_HU_AR.HVAC_Auto_RL_Rq_HU.phys = getValue(this);
    _HVAC_R_Rq_HU_AR_SpontanFlag = 1;
}

on EnvVar HMI_HVAC_Auto_RR_Rq_HU
{
    _mHVAC_R_Rq_HU_AR.HVAC_Auto_RR_Rq_HU.phys = getValue(this);
    _HVAC_R_Rq_HU_AR_SpontanFlag = 1;
}

on EnvVar HMI_HVAC_FanLvl_RL_Rq_HU
{
    _mHVAC_R_Rq_HU_AR.HVAC_FanLvl_RL_Rq_HU.phys = getValue(this);
    _HVAC_R_Rq_HU_AR_SpontanFlag = 1;
}

on EnvVar HMI_HVAC_FanLvl_RR_Rq_HU
{
    _mHVAC_R_Rq_HU_AR.HVAC_FanLvl_RR_Rq_HU.phys = getValue(this);
    _HVAC_R_Rq_HU_AR_SpontanFlag = 1;
}

on EnvVar HMI_HVAC_Off_R_Rq_HU
{
    _mHVAC_R_Rq_HU_AR.HVAC_Off_R_Rq_HU.phys = getValue(this);
    _HVAC_R_Rq_HU_AR_SpontanFlag = 1;
}

on EnvVar HMI_HVAC_Temp_RL_Rq_HU
{
    _mHVAC_R_Rq_HU_AR.HVAC_Temp_RL_Rq_HU.phys = getValue(this);
    _HVAC_R_Rq_HU_AR_SpontanFlag = 1;
}

on EnvVar HMI_HVAC_Temp_RR_Rq_HU
{
    _mHVAC_R_Rq_HU_AR.HVAC_Temp_RR_Rq_HU.phys = getValue(this);
    _HVAC_R_Rq_HU_AR_SpontanFlag = 1;
}

on EnvVar HMI_HVAC_Airflow_RL_Rq_HU
{
    _mHVAC_R_Rq_HU_AR.HVAC_Airflow_RL_Rq_HU.phys = getValue(this);
    _HVAC_R_Rq_HU_AR_SpontanFlag = 1;
}

on EnvVar HMI_HVAC_Airflow_RR_Rq_HU
{
    _mHVAC_R_Rq_HU_AR.HVAC_Airflow_RR_Rq_HU.phys = getValue(this);
    _HVAC_R_Rq_HU_AR_SpontanFlag = 1;
}

HVAC_Z5_Rq_HU_AR_check_output()
{
    if( !getValue( HMI__STMSG_HVAC_Z5_Rq_HU_AR ) )
    {
    //  message   HVAC_Z5_Rq_HU_AR ID: 1040 --- Sendeart 5 cyclicAndSpontanWithDelay --- 
        if( _HVAC_Z5_Rq_HU_AR_DelayCnt > 0) _HVAC_Z5_Rq_HU_AR_DelayCnt--; // Mindestsendeabstand
        _HVAC_Z5_Rq_HU_AR_Cnt--;
        if( _HVAC_Z5_Rq_HU_AR_Cnt < 1 )
        {
            if( _HVAC_Z5_Rq_HU_AR_DelayCnt < 1 )
            {
                HVAC_Z5_Rq_HU_AR_output(); // Nachricht wg. abgelaufenem Zyklus ausgeben (Mindestsendeabstand eingehalten)
                 _HVAC_Z5_Rq_HU_AR_SpontanFlag = 0; // Spontan-Flag zurücksetzen
                _HVAC_Z5_Rq_HU_AR_DelayCnt = _HVAC_Z5_Rq_HU_AR_MinDelay;
            }
            else
            {
                 _HVAC_Z5_Rq_HU_AR_SpontanFlag = 1; // Spontanflag setzen damit nach Ablauf Mindestsendeabstand gesendet wird
            }
            _HVAC_Z5_Rq_HU_AR_Cnt = _HVAC_Z5_Rq_HU_AR_CycleCount; // Zyklus-Zähler zurücksetzen
        }
        else if( _HVAC_Z5_Rq_HU_AR_SpontanFlag)
        {
            if( _HVAC_Z5_Rq_HU_AR_DelayCnt < 1 )
            {
                HVAC_Z5_Rq_HU_AR_output(); // Nachricht wg. spontaner Änderung ausgeben (Mindestsendeabstand eingehalten)
                _HVAC_Z5_Rq_HU_AR_SpontanFlag = 0; // Spontan-Flag zurücksetzen
                _HVAC_Z5_Rq_HU_AR_DelayCnt = _HVAC_Z5_Rq_HU_AR_MinDelay;
            }
        }
    }
}

HVAC_Z5_Rq_HU_AR_init()
{   /* Botschaft HVAC_Z5_Rq_HU_AR ID: 1040 --- Sendeart 5 cyclicAndSpontanWithDelay --- 
BA_ "ApplMessage" BO_ 1172 0;
BA_ "NmAsrMessage" BO_ 1172 0;
BA_ "GenMsgMinAcceptLength" BO_ 1172 8;
BA_ "GenMsgILSupport" BO_ 1172 1;
BA_ "DiagState" BO_ 1172 0;
BA_ "DiagRequest" BO_ 1172 0;
BA_ "DiagResponse" BO_ 1172 0;
BA_ "GenMsgStartValue" BO_ 1172 "0";
BA_ "GenMsgStartDelayTime" BO_ 1172 80;
BA_ "GenMsgDelayTime" BO_ 1172 20;
BA_ "GenMsgNrOfRepetition" BO_ 1172 0;
BA_ "GenMsgCycleTime" BO_ 1172 100;
BA_ "GenMsgSendType" BO_ 1172 5;
    */
	  _HVAC_Z5_Rq_HU_AR_Timebase =              c_tDBKomTimer_20ms;
    _HVAC_Z5_Rq_HU_AR_CycleCount =            200 / _HVAC_Z5_Rq_HU_AR_Timebase;
    _HVAC_Z5_Rq_HU_AR_StartDelay =             80 / _HVAC_Z5_Rq_HU_AR_Timebase;
	  _HVAC_Z5_Rq_HU_AR_MinDelay =          	   20 / _HVAC_Z5_Rq_HU_AR_Timebase;
    _HVAC_Z5_Rq_HU_AR_Cnt = _HVAC_Z5_Rq_HU_AR_StartDelay;
    _HVAC_Z5_Rq_HU_AR_SpontanFlag = 0;
    _HVAC_Z5_Rq_HU_AR_DelayCnt = 0;

    putValue( HMI__STMSGSD_HVAC_Z5_Rq_HU_AR, _HVAC_Z5_Rq_HU_AR_StartDelay * _HVAC_Z5_Rq_HU_AR_Timebase );

    _mHVAC_Z5_Rq_HU_AR.HVAC_AC_Z5_Rq_HU.phys = getValue( HMI_HVAC_AC_Z5_Rq_HU );
    _mHVAC_Z5_Rq_HU_AR.HVAC_AirDist_Zone5_Rq_HU.phys = getValue( HMI_HVAC_AirDist_Zone5_Rq_HU );
    _mHVAC_Z5_Rq_HU_AR.HVAC_Airflow_Zone5_Rq_HU.phys = getValue( HMI_HVAC_Airflow_Zone5_Rq_HU );
    _mHVAC_Z5_Rq_HU_AR.HVAC_Auto_Zone5_Rq_HU.phys = getValue( HMI_HVAC_Auto_Zone5_Rq_HU );
    _mHVAC_Z5_Rq_HU_AR.HVAC_Fan_Zone5_Rq_HU.phys = getValue( HMI_HVAC_Fan_Zone5_Rq_HU );
    _mHVAC_Z5_Rq_HU_AR.HVAC_FtwInc_Zone5_Rq_HU.phys = getValue( HMI_HVAC_FtwInc_Zone5_Rq_HU );
	_mHVAC_Z5_Rq_HU_AR.HVAC_Off_Z5_Rq_HU.phys = getValue( HMI_HVAC_Off_Z5_Rq_HU );
	_mHVAC_Z5_Rq_HU_AR.HVAC_Temp_Zone5_Rq_HU.phys = getValue( HMI_HVAC_Temp_Zone5_Rq_HU );
}

HVAC_Z5_Rq_HU_AR_output(void)
{
    output( _mHVAC_Z5_Rq_HU_AR );
}

HVAC_Z5_Rq_HU_AR_saveEnvVars( dword hFile )
{
    filePutString("\n// Knoten EIS: HVAC_Z5_Rq_HU_AR\n", 25, hFile );
    snprintf( buffer, elcount( buffer ), "0.0000 HMI__STMSG_HVAC_Z5_Rq_HU_AR := %X\n", getValue( HMI__STMSG_HVAC_Z5_Rq_HU_AR ) );        filePutString( buffer, elcount( buffer ), hFile );
    snprintf( buffer, elcount( buffer ), "0.0000 HMI__STMSGT_HVAC_Z5_Rq_HU_AR := %X\n", getValue( HMI__STMSGT_HVAC_Z5_Rq_HU_AR ) );        filePutString( buffer, elcount( buffer ), hFile );
    snprintf( buffer, elcount( buffer ), "0.0000 HMI_HVAC_AC_Z5_Rq_HU := %X\n", getValue( HMI_HVAC_AC_Z5_Rq_HU ) );        filePutString( buffer, elcount( buffer ), hFile );
    snprintf( buffer, elcount( buffer ), "0.0000 HMI_HVAC_AirDist_Zone5_Rq_HU := %X\n", getValue( HMI_HVAC_AirDist_Zone5_Rq_HU ) );        filePutString( buffer, elcount( buffer ), hFile );
    snprintf( buffer, elcount( buffer ), "0.0000 HMI_HVAC_Airflow_Zone5_Rq_HU := %X\n", getValue( HMI_HVAC_Airflow_Zone5_Rq_HU ) );        filePutString( buffer, elcount( buffer ), hFile );
    snprintf( buffer, elcount( buffer ), "0.0000 HMI_HVAC_Auto_Zone5_Rq_HU := %X\n", getValue( HMI_HVAC_Auto_Zone5_Rq_HU ) );        filePutString( buffer, elcount( buffer ), hFile );
    snprintf( buffer, elcount( buffer ), "0.0000 HMI_HVAC_Fan_Zone5_Rq_HU := %X\n", getValue( HMI_HVAC_Fan_Zone5_Rq_HU ) );        filePutString( buffer, elcount( buffer ), hFile );
    snprintf( buffer, elcount( buffer ), "0.0000 HMI_HVAC_FtwInc_Zone5_Rq_HU := %X\n", getValue( HMI_HVAC_FtwInc_Zone5_Rq_HU ) );        filePutString( buffer, elcount( buffer ), hFile );
	snprintf( buffer, elcount( buffer ), "0.0000 HMI_HVAC_HVAC_Off_Z5_Rq_HU := %X\n", getValue( HMI_HVAC_Off_Z5_Rq_HU ) );        filePutString( buffer, elcount( buffer ), hFile );
	snprintf( buffer, elcount( buffer ), "0.0000 HMI_HVAC_Temp_Zone5_Rq_HU := %X\n", getValue( HMI_HVAC_Temp_Zone5_Rq_HU ) );        filePutString( buffer, elcount( buffer ), hFile );
}

on timer _tHVAC_Z5_Rq_HU_AR
{
    putValue( HMI__STMSG_HVAC_Z5_Rq_HU_AR, 0 );
}

on EnvVar HMI__STMSG_HVAC_Z5_Rq_HU_AR
{
    long tDelay;
    if( getValue( this ) == 2 )
    {
        tDelay = getValue( HMI__STMSGT_HVAC_Z5_Rq_HU_AR );
        if( tDelay > 0)    
            setTimer( _tHVAC_Z5_Rq_HU_AR, tDelay );
        else
            putValue( HMI__STMSG_HVAC_Z5_Rq_HU_AR, 0 );
    }
}

on envVar HMI__STMSG_PO_HVAC_Z5_Rq_HU_AR
{
    if( getValue( this ) )
        openPanel("HVAC_Z5_Rq_HU_AR");
}

on EnvVar HMI_HVAC_AC_Z5_Rq_HU
{
    _mHVAC_Z5_Rq_HU_AR.HVAC_AC_Z5_Rq_HU.phys = getValue(this);
    _HVAC_Z5_Rq_HU_AR_SpontanFlag = 1;
}

on EnvVar HMI_HVAC_AirDist_Zone5_Rq_HU
{
    _mHVAC_Z5_Rq_HU_AR.HVAC_AirDist_Zone5_Rq_HU.phys = getValue(this);
    _HVAC_Z5_Rq_HU_AR_SpontanFlag = 1;
}

on EnvVar HMI_HVAC_Airflow_Zone5_Rq_HU
{
    _mHVAC_Z5_Rq_HU_AR.HVAC_Airflow_Zone5_Rq_HU.phys = getValue(this);
    _HVAC_Z5_Rq_HU_AR_SpontanFlag = 1;
}

on EnvVar HMI_HVAC_Auto_Zone5_Rq_HU
{
    _mHVAC_Z5_Rq_HU_AR.HVAC_Auto_Zone5_Rq_HU.phys = getValue(this);
    _HVAC_Z5_Rq_HU_AR_SpontanFlag = 1;
}

on EnvVar HMI_HVAC_Fan_Zone5_Rq_HU
{
    _mHVAC_Z5_Rq_HU_AR.HVAC_Fan_Zone5_Rq_HU.phys = getValue(this);
    _HVAC_Z5_Rq_HU_AR_SpontanFlag = 1;
}

on EnvVar HMI_HVAC_FtwInc_Zone5_Rq_HU
{
    _mHVAC_Z5_Rq_HU_AR.HVAC_FtwInc_Zone5_Rq_HU.phys = getValue(this);
    _HVAC_Z5_Rq_HU_AR_SpontanFlag = 1;
}

on EnvVar HMI_HVAC_Off_Z5_Rq_HU
{
    _mHVAC_Z5_Rq_HU_AR.HVAC_Off_Z5_Rq_HU.phys = getValue(this);
    _HVAC_Z5_Rq_HU_AR_SpontanFlag = 1;
}

on EnvVar HMI_HVAC_Temp_Zone5_Rq_HU
{
    _mHVAC_Z5_Rq_HU_AR.HVAC_Temp_Zone5_Rq_HU.phys = getValue(this);
    _HVAC_Z5_Rq_HU_AR_SpontanFlag = 1;
}

ICH_Rq_HU_AR_check_output()
{
    if( !getValue( HMI__STMSG_ICH_Rq_HU_AR))
    {
        // Botschaft ICH_Rq_HU_AR ID: 995 --- Sendeart cyclicAndSpontanWithDelay --- 
        _ICH_Rq_HU_AR_Cnt--;
        if( _ICH_Rq_HU_AR_Cnt < 1 )
        {
            // Nachricht wg. abgelaufenem Zyklus ausgeben
            output( _mICH_Rq_HU_AR );
            _ICH_Rq_HU_AR_Cnt = _ICH_Rq_HU_AR_CycleCount; // Zyklus-Zähler zurücksetzen
             _ICH_Rq_HU_AR_SpontanFlag = 0; // Spontan-Flag zurücksetzen
        }
        else if( _ICH_Rq_HU_AR_SpontanFlag)
        {
            // Nachricht wg. spontaner Änderung ausgeben
            output( _mICH_Rq_HU_AR );
             _ICH_Rq_HU_AR_SpontanFlag = 0; // Spontan-Flag zurücksetzen
        }
    }
}

ICH_Rq_HU_AR_init()
{   /* Botschaft ICH_Rq_HU_AR ID: 995 --- Sendeart cyclicAndSpontanWithDelay --- 
BA_ "ApplMessage" BO_ 995 0;
BA_ "NmAsrMessage" BO_ 995 0;
BA_ "GenMsgMinAcceptLength" BO_ 995 8;
BA_ "GenMsgILSupport" BO_ 995 1;
BA_ "DiagState" BO_ 995 0;
BA_ "DiagRequest" BO_ 995 0;
BA_ "DiagResponse" BO_ 995 0;
BA_ "GenMsgStartValue" BO_ 995 "0";
BA_ "GenMsgStartDelayTime" BO_ 995 75;
BA_ "GenMsgDelayTime" BO_ 995 5;
BA_ "GenMsgNrOfRepetitions" BO_ 995 0;
BA_ "GenMsgCycleTime" BO_ 995 1000;
BA_ "GenMsgSendType" BO_ 995 5;
    */
    _ICH_Rq_HU_AR_Timebase =          c_tDBKomTimer_20ms;
    _ICH_Rq_HU_AR_CycleCount =      1000 / _ICH_Rq_HU_AR_Timebase;
    _ICH_Rq_HU_AR_Cnt = 0;
    _ICH_Rq_HU_AR_StartDelay =        75 / _ICH_Rq_HU_AR_Timebase;
    _ICH_Rq_HU_AR_SpontanFlag = 0;

    putValue( HMI__STMSGSD_ICH_Rq_HU_AR, _ICH_Rq_HU_AR_StartDelay * _ICH_Rq_HU_AR_Timebase );

    _mICH_Rq_HU_AR.ICH_PreTm1_Hour_Rq.phys = getValue( HMI_ICH_PreTm1_Hour_Rq );
    _mICH_Rq_HU_AR.ICH_PreTm1_Minute_Rq.phys = getValue( HMI_ICH_PreTm1_Minute_Rq );
    _mICH_Rq_HU_AR.ICH_PreTm2_Hour_Rq.phys = getValue( HMI_ICH_PreTm2_Hour_Rq );
    _mICH_Rq_HU_AR.ICH_PreTm2_Minute_Rq.phys = getValue( HMI_ICH_PreTm2_Minute_Rq );
    _mICH_Rq_HU_AR.ICH_PreTm3_Hour_Rq.phys = getValue( HMI_ICH_PreTm3_Hour_Rq );
    _mICH_Rq_HU_AR.ICH_PreTm3_Minute_Rq.phys = getValue( HMI_ICH_PreTm3_Minute_Rq );
    _mICH_Rq_HU_AR.ICH_PreTm_Rq.phys = getValue( HMI_ICH_PreTm_Rq );
}

ICH_Rq_HU_AR_saveEnvVars( dword hFile )
{
    filePutString("\n// Knoten TGW: ICH_Rq_HU_AR\n", 26, hFile);
    snprintf( buffer, elcount(buffer), "0.0000 HMI__STMSG_ICH_Rq_HU := %X\n", getValue( HMI__STMSG_ICH_Rq_HU_AR ));        filePutString( buffer, elcount(buffer), hFile);
    snprintf( buffer, elcount(buffer), "0.0000 HMI__STMSGT_ICH_Rq_HU := %X\n", getValue( HMI__STMSGT_ICH_Rq_HU_AR ));        filePutString( buffer, elcount(buffer), hFile);
    snprintf( buffer, elcount(buffer), "0.0000 HMI_ICH_PreTm1_Hour_Rq := %X\n", getValue( HMI_ICH_PreTm1_Hour_Rq ) );        filePutString( buffer, elcount(buffer), hFile);
    snprintf( buffer, elcount(buffer), "0.0000 HMI_ICH_PreTm1_Minute_Rq := %X\n", getValue( HMI_ICH_PreTm1_Minute_Rq ) );        filePutString( buffer, elcount(buffer), hFile);
    snprintf( buffer, elcount(buffer), "0.0000 HMI_ICH_PreTm2_Hour_Rq := %X\n", getValue( HMI_ICH_PreTm2_Hour_Rq ) );        filePutString( buffer, elcount(buffer), hFile);
    snprintf( buffer, elcount(buffer), "0.0000 HMI_ICH_PreTm2_Minute_Rq := %X\n", getValue( HMI_ICH_PreTm2_Minute_Rq ) );        filePutString( buffer, elcount(buffer), hFile);
    snprintf( buffer, elcount(buffer), "0.0000 HMI_ICH_PreTm3_Hour_Rq := %X\n", getValue( HMI_ICH_PreTm3_Hour_Rq ) );        filePutString( buffer, elcount(buffer), hFile);
    snprintf( buffer, elcount(buffer), "0.0000 HMI_ICH_PreTm3_Minute_Rq := %X\n", getValue( HMI_ICH_PreTm3_Minute_Rq ) );        filePutString( buffer, elcount(buffer), hFile);
    snprintf( buffer, elcount(buffer), "0.0000 HMI_ICH_PreTm_Rq := %X\n", getValue( HMI_ICH_PreTm_Rq ) );        filePutString( buffer, elcount(buffer), hFile);
}

on timer _tICH_Rq_HU_AR
{
    putValue( HMI__STMSG_ICH_Rq_HU_AR, 0 );
}

on EnvVar HMI__STMSG_ICH_Rq_HU_AR
{
    long tDelay;
    if( getValue( this ) == 2 )
    {
        tDelay = getValue( HMI__STMSGT_ICH_Rq_HU_AR );
        if( tDelay > 0 )    
            setTimer( _tICH_Rq_HU_AR, tDelay );
        else
            putValue( HMI__STMSG_ICH_Rq_HU_AR, 0 );
    }
}

on envVar HMI__STMSG_PO_ICH_Rq_HU_AR
{
    if( getValue( this ) )
        openPanel("ICH_Rq_HU_AR");
}

on EnvVar HMI_ICH_PreTm1_Hour_Rq
{
    _mICH_Rq_HU_AR.ICH_PreTm1_Hour_Rq.phys = getValue(this);
    _ICH_Rq_HU_AR_SpontanFlag = 1;
}

on EnvVar HMI_ICH_PreTm1_Minute_Rq
{
    _mICH_Rq_HU_AR.ICH_PreTm1_Minute_Rq.phys = getValue(this);
    _ICH_Rq_HU_AR_SpontanFlag = 1;
}

on EnvVar HMI_ICH_PreTm2_Hour_Rq
{
    _mICH_Rq_HU_AR.ICH_PreTm2_Hour_Rq.phys = getValue(this);
    _ICH_Rq_HU_AR_SpontanFlag = 1;
}

on EnvVar HMI_ICH_PreTm2_Minute_Rq
{
    _mICH_Rq_HU_AR.ICH_PreTm2_Minute_Rq.phys = getValue(this);
    _ICH_Rq_HU_AR_SpontanFlag = 1;
}

on EnvVar HMI_ICH_PreTm3_Hour_Rq
{
    _mICH_Rq_HU_AR.ICH_PreTm3_Hour_Rq.phys = getValue(this);
    _ICH_Rq_HU_AR_SpontanFlag = 1;
}

on EnvVar HMI_ICH_PreTm3_Minute_Rq
{
    _mICH_Rq_HU_AR.ICH_PreTm3_Minute_Rq.phys = getValue(this);
    _ICH_Rq_HU_AR_SpontanFlag = 1;
}

on EnvVar HMI_ICH_PreTm_Rq
{
    _mICH_Rq_HU_AR.ICH_PreTm_Rq.phys = getValue(this);
    _ICH_Rq_HU_AR_SpontanFlag = 1;
}

IL_AmbLgtCfg_Rq_AR_check_output()
{
    if( !getValue( HMI__STMSG_IL_AmbLgtCfg_Rq_AR ))
    {
        // Botschaft IL_AmbLgtCfg_Rq_AR ID: 844 --- Sendeart cyclicAndSpontanWithDelay --- 
        _IL_AmbLgtCfg_Rq_AR_Cnt--;
        if( _IL_AmbLgtCfg_Rq_AR_Cnt < 1 )
        {
            // Nachricht wg. abgelaufenem Zyklus ausgeben
            output( _mIL_AmbLgtCfg_Rq_AR );
            _IL_AmbLgtCfg_Rq_AR_Cnt = _MCMS_FL_Rq_AR_CycleCount; // Zyklus-Zähler zurücksetzen
             _IL_AmbLgtCfg_Rq_AR_SpontanFlag = 0; // Spontan-Flag zurücksetzen
        }
        else if( _IL_AmbLgtCfg_Rq_AR_SpontanFlag )
        {
            // Nachricht wg. spontaner Änderung ausgeben
            output( _mIL_AmbLgtCfg_Rq_AR );
             _IL_AmbLgtCfg_Rq_AR_SpontanFlag = 0; // Spontan-Flag zurücksetzen
        }
    }
}

IL_AmbLgtCfg_Rq_AR_init()
{   /* Botschaft IL_AmbLgtCfg_Rq_AR ID: 844 ---- Sendeart cyclicAndSpontanWithDelay --- 
BA_ "ApplMessage" BO_ 844 0;
BA_ "NmAsrMessage" BO_ 844 0;
BA_ "GenMsgMinAcceptLength" BO_ 844 8;
BA_ "GenMsgILSupport" BO_ 844 1;
BA_ "DiagState" BO_ 844 0;
BA_ "DiagRequest" BO_ 844 0;
BA_ "DiagResponse" BO_ 844 0;
BA_ "GenMsgStartValue" BO_ 844 "0";
BA_ "GenMsgStartDelayTime" BO_ 844 215;
BA_ "GenMsgDelayTime" BO_ 844 5;
BA_ "GenMsgNrOfRepetitions" BO_ 844 0;
BA_ "GenMsgCycleTime" BO_ 844 1000;
BA_ "GenMsgSendType" BO_ 844 5;
    */
    _IL_AmbLgtCfg_Rq_AR_Timebase =         c_tDBKomTimer_20ms;
    _IL_AmbLgtCfg_Rq_AR_CycleCount =     1000 / _IL_AmbLgtCfg_Rq_AR_Timebase;
    _IL_AmbLgtCfg_Rq_AR_StartDelay =      255 / _IL_AmbLgtCfg_Rq_AR_Timebase;
    _IL_AmbLgtCfg_Rq_AR_Cnt = 0;
    _IL_AmbLgtCfg_Rq_AR_SpontanFlag = 0;

    putValue( HMI__STMSGSD_IL_AmbLgtCfg_Rq_AR, _IL_AmbLgtCfg_Rq_AR_StartDelay * _IL_AmbLgtCfg_Rq_AR_Timebase );

    _IL_AmbLgtCfg_Rq_AR_Cnt = 0;
    _IL_AmbLgtCfg_Rq_AR_SpontanFlag = 0;
    _mIL_AmbLgtCfg_Rq_AR.AmbLgtCfg_01_Rq.phys = getValue( HMI_AmbLgtCfg_01_Rq );
    _mIL_AmbLgtCfg_Rq_AR.AmbLgtCfg_02_Rq.phys = getValue( HMI_AmbLgtCfg_02_Rq );
    _mIL_AmbLgtCfg_Rq_AR.AmbLgtCmd.phys = getValue( HMI_AmbLgtCmd );
    _mIL_AmbLgtCfg_Rq_AR.AmbLgtColor_Rq_V2.phys = getValue( HMI_AmbLgtColor_Rq_V2 );
    _mIL_AmbLgtCfg_Rq_AR.AmbLgtColProg_Rq.phys = getValue( HMI_AmbLgtColProg_Rq );
    _mIL_AmbLgtCfg_Rq_AR.AmbLgtCoupledToDesignVar_Rq.phys = getValue( HMI_AmbLgtCoupledToDesignVar_Rq );
	_mIL_AmbLgtCfg_Rq_AR.AmbLgtColorDesign_Rq_HU.phys = getValue( HMI_AmbLgtColorDesign_Rq_HU );
}

IL_AmbLgtCfg_Rq_AR_saveEnvVars( dword hFile )
{
    filePutString("\n// Knoten TGW: IL_AmbLgtCfg_Rq_AR\n", 27, hFile);
    snprintf( buffer, elcount(buffer), "0.0000 HMI__STMSG_IL_AmbLgtCfg_Rq_AR := %X\n", getValue( HMI__STMSG_IL_AmbLgtCfg_Rq_AR ));        filePutString( buffer, elcount(buffer), hFile);
    snprintf( buffer, elcount(buffer), "0.0000 HMI__STMSGT_IL_AmbLgtCfg_Rq_AR := %X\n", getValue( HMI__STMSGT_IL_AmbLgtCfg_Rq_AR ));        filePutString( buffer, elcount(buffer), hFile);
    snprintf( buffer, elcount(buffer), "0.0000 HMI_AmbLgtCfg_01_Rq := %X\n", getValue( HMI_AmbLgtCfg_01_Rq ) );        filePutString( buffer, elcount(buffer), hFile);
    snprintf( buffer, elcount(buffer), "0.0000 HMI_AmbLgtCfg_02_Rq := %X\n", getValue( HMI_AmbLgtCfg_02_Rq ) );        filePutString( buffer, elcount(buffer), hFile);
    snprintf( buffer, elcount(buffer), "0.0000 HMI_AmbLgtCmd := %X\n", getValue( HMI_AmbLgtCmd ) );        filePutString( buffer, elcount(buffer), hFile);
    snprintf( buffer, elcount(buffer), "0.0000 HMI_AmbLgtColor_Rq_V2 := %X\n", getValue( HMI_AmbLgtColor_Rq_V2 ) );        filePutString( buffer, elcount(buffer), hFile);
    snprintf( buffer, elcount(buffer), "0.0000 HMI_AmbLgtColProg_Rq := %X\n", getValue( HMI_AmbLgtColProg_Rq ) );        filePutString( buffer, elcount(buffer), hFile);
    snprintf( buffer, elcount(buffer), "0.0000 HMI_AmbLgtCoupledToDesignVar_Rq := %X\n", getValue( HMI_AmbLgtCoupledToDesignVar_Rq ) );        filePutString( buffer, elcount(buffer), hFile);
    snprintf( buffer, elcount(buffer), "0.0000 HMI_AmbLgtColorDesign_Rq_HU := %X\n", getValue( HMI_AmbLgtColorDesign_Rq_HU ) );        filePutString( buffer, elcount(buffer), hFile);
}

on timer _tIL_AmbLgtCfg_Rq_AR
{
    putValue( HMI__STMSG_IL_AmbLgtCfg_Rq_AR, 0 );
}

on EnvVar HMI__STMSG_IL_AmbLgtCfg_Rq_AR
{
    long tDelay;
    if( getValue( this ) == 2 )
    {
        tDelay = getValue( HMI__STMSGT_IL_AmbLgtCfg_Rq_AR );
        if( tDelay > 0 )    
            setTimer( _tIL_AmbLgtCfg_Rq_AR, tDelay );
        else
            putValue( HMI__STMSG_IL_AmbLgtCfg_Rq_AR, 0 );
    }
}

on envVar HMI__STMSG_PO_IL_AmbLgtCfg_Rq_AR
{
    if( getValue( this ) )
        openPanel("IL_AmbLgtCfg_Rq_AR");
}

on EnvVar HMI_AmbLgtCfg_01_Rq
{
    _mIL_AmbLgtCfg_Rq_AR.AmbLgtCfg_01_Rq.phys = getValue(this);
    _IL_AmbLgtCfg_Rq_AR_SpontanFlag = 1;
}

on EnvVar HMI_AmbLgtCfg_02_Rq
{
    _mIL_AmbLgtCfg_Rq_AR.AmbLgtCfg_02_Rq.phys = getValue(this);
    _IL_AmbLgtCfg_Rq_AR_SpontanFlag = 1;
}

on EnvVar HMI_AmbLgtCmd
{
    _mIL_AmbLgtCfg_Rq_AR.AmbLgtCmd.phys = getValue(this);
    _IL_AmbLgtCfg_Rq_AR_SpontanFlag = 1;
}

on EnvVar HMI_AmbLgtColor_Rq_V2
{
    _mIL_AmbLgtCfg_Rq_AR.AmbLgtColor_Rq_V2.phys = getValue(this);
    _IL_AmbLgtCfg_Rq_AR_SpontanFlag = 1;
}

on EnvVar HMI_AmbLgtColProg_Rq
{
    _mIL_AmbLgtCfg_Rq_AR.AmbLgtColProg_Rq.phys = getValue(this);
    _IL_AmbLgtCfg_Rq_AR_SpontanFlag = 1;
}

on EnvVar HMI_AmbLgtCoupledToDesignVar_Rq
{
    _mIL_AmbLgtCfg_Rq_AR.AmbLgtCoupledToDesignVar_Rq.phys = getValue(this);
    _IL_AmbLgtCfg_Rq_AR_SpontanFlag = 1;
}

on EnvVar HMI_AmbLgtColorDesign_Rq_HU
{
    _mIL_AmbLgtCfg_Rq_AR.AmbLgtColorDesign_Rq_HU.phys = getValue(this);
    _IL_AmbLgtCfg_Rq_AR_SpontanFlag = 1;
}

IL_AmbLgtCfg_Rq2_AR_check_output()
{
    if( !getValue( HMI__STMSG_IL_AmbLgtCfg_Rq2_AR ) )
    {
        // Botschaft IL_AmbLgtCfg_Rq_AR ID: 852 --- Sendeart 5 cyclicAndSpontanWithDelay --- 
        _IL_AmbLgtCfg_Rq2_AR_Cnt--;
        if( _IL_AmbLgtCfg_Rq2_AR_Cnt < 1 )
        {
            // Nachricht wg. abgelaufenem Zyklus ausgeben
            IL_AmbLgtCfg_Rq2_AR_output();
            _IL_AmbLgtCfg_Rq2_AR_Cnt = _IL_AmbLgtCfg_Rq2_AR_CycleCount; // Zyklus-Zähler zurücksetzen
            _IL_AmbLgtCfg_Rq2_AR_SpontanFlag = 0; // Spontan-Flag zurücksetzen
        }
        else if( _IL_AmbLgtCfg_Rq2_AR_SpontanFlag)
        {
            // Nachricht wg. spontaner Änderung ausgeben
            IL_AmbLgtCfg_Rq2_AR_output();
            _IL_AmbLgtCfg_Rq2_AR_SpontanFlag = 0; // Spontan-Flag zurücksetzen
        }
    }
}

IL_AmbLgtCfg_Rq2_AR_init()
{   /* Botschaft IL_AmbLgtCfg_Rq_AR ID: 852 --- Sendeart 5 cyclicAndSpontanWithDelay --- 
BA_ "ApplMessage" BO_ 852 0;
BA_ "NmAsrMessage" BO_ 852 0;
BA_ "GenMsgMinAcceptLength" BO_ 852 8;
BA_ "GenMsgILSupport" BO_ 852 1;
BA_ "DiagState" BO_ 852 0;
BA_ "DiagRequest" BO_ 852 0;
BA_ "DiagResponse" BO_ 852 0;
BA_ "GenMsgStartValue" BO_ 852 "0";
BA_ "GenMsgStartDelayTime" BO_ 852 160;
BA_ "GenMsgDelayTime" BO_ 852 5;
BA_ "GenMsgNrOfRepetition" BO_ 852 0;
BA_ "GenMsgCycleTime" BO_ 852 1000;
BA_ "GenMsgSendType" BO_ 852 5;
    */
    _IL_AmbLgtCfg_Rq2_AR_Timebase =      c_tDBKomTimer_20ms;
    _IL_AmbLgtCfg_Rq2_AR_CycleCount =   1000 / _IL_AmbLgtCfg_Rq2_AR_Timebase;
    _IL_AmbLgtCfg_Rq2_AR_StartDelay =    160 / _IL_AmbLgtCfg_Rq2_AR_Timebase;
    _IL_AmbLgtCfg_Rq2_AR_Cnt = _IL_AmbLgtCfg_Rq2_AR_StartDelay;
    _IL_AmbLgtCfg_Rq2_AR_SpontanFlag = 0;

    putValue( HMI__STMSGSD_IL_AmbLgtCfg_Rq2_AR, _IL_AmbLgtCfg_Rq2_AR_StartDelay * _IL_AmbLgtCfg_Rq2_AR_Timebase );

    _mIL_AmbLgtCfg_Rq2_AR.AmbBrt_Z01_Rq.phys = getValue( HMI_AmbBrt_Z01_Rq );
    _mIL_AmbLgtCfg_Rq2_AR.AmbBrt_Z02_Rq.phys = getValue( HMI_AmbBrt_Z02_Rq );
    _mIL_AmbLgtCfg_Rq2_AR.AmbBrt_Z03_Rq.phys = getValue( HMI_AmbBrt_Z03_Rq );
    _mIL_AmbLgtCfg_Rq2_AR.AmbBrt_Z04_Rq.phys = getValue( HMI_AmbBrt_Z04_Rq );
    _mIL_AmbLgtCfg_Rq2_AR.AmbBrt_Z05_Rq.phys = getValue( HMI_AmbBrt_Z05_Rq );
    _mIL_AmbLgtCfg_Rq2_AR.AmbBrt_Z06_Rq.phys = getValue( HMI_AmbBrt_Z06_Rq );
    _mIL_AmbLgtCfg_Rq2_AR.AmbBrt_Z07_Rq.phys = getValue( HMI_AmbBrt_Z07_Rq );
}

IL_AmbLgtCfg_Rq2_AR_output(void)
{
    output( _mIL_AmbLgtCfg_Rq2_AR );
}

IL_AmbLgtCfg_Rq2_AR_saveEnvVars( dword hFile )
{
    filePutString("\n// Knoten EIS: IL_AmbLgtCfg_Rq2_AR\n", 27, hFile );
    snprintf( buffer, elcount( buffer ), "0.0000 HMI__STMSG_IL_AmbLgtCfg_Rq2_AR := %X\n", getValue( HMI__STMSG_IL_AmbLgtCfg_Rq2_AR ) );        filePutString ( buffer, elcount( buffer ), hFile );
    snprintf( buffer, elcount( buffer ), "0.0000 HMI__STMSGT_IL_AmbLgtCfg_Rq2_AR := %X\n", getValue( HMI__STMSGT_IL_AmbLgtCfg_Rq2_AR ) );        filePutString ( buffer, elcount( buffer ), hFile );
    snprintf( buffer, elcount( buffer ), "0.0000 HMI_AmbBrt_Z01_Rq := %X\n", getValue( HMI_AmbBrt_Z01_Rq ) );        filePutString ( buffer, elcount( buffer ), hFile );
    snprintf( buffer, elcount( buffer ), "0.0000 HMI_AmbBrt_Z02_Rq := %X\n", getValue( HMI_AmbBrt_Z02_Rq ) );        filePutString ( buffer, elcount( buffer ), hFile );
    snprintf( buffer, elcount( buffer ), "0.0000 HMI_AmbBrt_Z03_Rq := %X\n", getValue( HMI_AmbBrt_Z03_Rq ) );        filePutString ( buffer, elcount( buffer ), hFile );
    snprintf( buffer, elcount( buffer ), "0.0000 HMI_AmbBrt_Z04_Rq := %X\n", getValue( HMI_AmbBrt_Z04_Rq ) );        filePutString ( buffer, elcount( buffer ), hFile );
    snprintf( buffer, elcount( buffer ), "0.0000 HMI_AmbBrt_Z05_Rq := %X\n", getValue( HMI_AmbBrt_Z05_Rq ) );        filePutString ( buffer, elcount( buffer ), hFile );
    snprintf( buffer, elcount( buffer ), "0.0000 HMI_AmbBrt_Z06_Rq := %X\n", getValue( HMI_AmbBrt_Z06_Rq ) );        filePutString ( buffer, elcount( buffer ), hFile );
    snprintf( buffer, elcount( buffer ), "0.0000 HMI_AmbBrt_Z07_Rq := %X\n", getValue( HMI_AmbBrt_Z07_Rq ) );        filePutString ( buffer, elcount( buffer ), hFile );
}

on timer _tIL_AmbLgtCfg_Rq2_AR
{
    putValue( HMI__STMSG_IL_AmbLgtCfg_Rq2_AR, 0 );
}

on EnvVar HMI__STMSG_IL_AmbLgtCfg_Rq2_AR
{
    long tDelay;
    if( getValue( this ) == 2 )
    {
        tDelay = getValue( HMI__STMSGT_IL_AmbLgtCfg_Rq2_AR );
        if( tDelay > 0)    
            setTimer( _tIL_AmbLgtCfg_Rq2_AR, tDelay );
        else
            putValue( HMI__STMSG_IL_AmbLgtCfg_Rq2_AR, 0 );
    }
}

on envVar HMI__STMSG_PO_IL_AmbLgtCfg_Rq2_AR
{
    if( getValue( this ) )
        openPanel("IL_AmbLgtCfg_Rq2_AR");
}

on EnvVar HMI_AmbBrt_Z01_Rq
{
    _mIL_AmbLgtCfg_Rq2_AR.AmbBrt_Z01_Rq.phys = getValue(this);
    _IL_AmbLgtCfg_Rq2_AR_SpontanFlag = 1;
}

on EnvVar HMI_AmbBrt_Z02_Rq
{
    _mIL_AmbLgtCfg_Rq2_AR.AmbBrt_Z02_Rq.phys = getValue(this);
    _IL_AmbLgtCfg_Rq2_AR_SpontanFlag = 1;
}

on EnvVar HMI_AmbBrt_Z03_Rq
{
    _mIL_AmbLgtCfg_Rq2_AR.AmbBrt_Z03_Rq.phys = getValue(this);
    _IL_AmbLgtCfg_Rq2_AR_SpontanFlag = 1;
}

on EnvVar HMI_AmbBrt_Z04_Rq
{
    _mIL_AmbLgtCfg_Rq2_AR.AmbBrt_Z04_Rq.phys = getValue(this);
    _IL_AmbLgtCfg_Rq2_AR_SpontanFlag = 1;
}

on EnvVar HMI_AmbBrt_Z05_Rq
{
    _mIL_AmbLgtCfg_Rq2_AR.AmbBrt_Z05_Rq.phys = getValue(this);
    _IL_AmbLgtCfg_Rq2_AR_SpontanFlag = 1;
}

on EnvVar HMI_AmbBrt_Z06_Rq
{
    _mIL_AmbLgtCfg_Rq2_AR.AmbBrt_Z06_Rq.phys = getValue(this);
    _IL_AmbLgtCfg_Rq2_AR_SpontanFlag = 1;
}

on EnvVar HMI_AmbBrt_Z07_Rq
{
    _mIL_AmbLgtCfg_Rq2_AR.AmbBrt_Z07_Rq.phys = getValue(this);
    _IL_AmbLgtCfg_Rq2_AR_SpontanFlag = 1;
}

MCMS_FL_Rq_AR_check_output()
{
    if( !getValue( HMI__STMSG_MCMS_FL_Rq_AR ))
    {
        // Botschaft MCMS_FL_Rq_AR ID: 765 --- Sendeart cyclicAndSpontanWithDelay --- 
        _MCMS_FL_Rq_AR_Cnt--;
        if( _MCMS_FL_Rq_AR_Cnt < 1 )
        {
            // Nachricht wg. abgelaufenem Zyklus ausgeben
            output( _mMCMS_FL_Rq_AR );
            _MCMS_FL_Rq_AR_Cnt = _MCMS_FL_Rq_AR_CycleCount; // Zyklus-Zähler zurücksetzen
             _MCMS_FL_Rq_AR_SpontanFlag = 0; // Spontan-Flag zurücksetzen
        }
        else if( _MCMS_FL_Rq_AR_SpontanFlag )
        {
            // Nachricht wg. spontaner Änderung ausgeben
            output( _mMCMS_FL_Rq_AR );
             _MCMS_FL_Rq_AR_SpontanFlag = 0; // Spontan-Flag zurücksetzen
        }
    }
}

MCMS_FL_Rq_AR_init()
{   /* Botschaft MCMS_FL_Rq_AR ID: 765 --- Sendeart cyclicAndSpontanWithDelay --- 
BA_ "ApplMessage" BO_ 765 0;
BA_ "NmAsrMessage" BO_ 765 0;
BA_ "GenMsgMinAcceptLength" BO_ 765 8;
BA_ "GenMsgILSupport" BO_ 765 1;
BA_ "DiagState" BO_ 765 0;
BA_ "DiagRequest" BO_ 765 0;
BA_ "DiagResponse" BO_ 765 0;
BA_ "GenMsgStartValue" BO_ 765 "0";
BA_ "GenMsgStartDelayTime" BO_ 765 255;
BA_ "GenMsgDelayTime" BO_ 765 5;
BA_ "GenMsgNrOfRepetitions" BO_ 765 0;
BA_ "GenMsgCycleTime" BO_ 765 1000;
BA_ "GenMsgSendType" BO_ 765 5;
    */
    _MCMS_FL_Rq_AR_Timebase =         c_tDBKomTimer_20ms;
    _MCMS_FL_Rq_AR_CycleCount =     1000 / _MCMS_FL_Rq_AR_Timebase;
    _MCMS_FL_Rq_AR_Cnt = 0;
    _MCMS_FL_Rq_AR_StartDelay =      255 / _MCMS_FL_Rq_AR_Timebase;
    _MCMS_FL_Rq_AR_SpontanFlag = 0;

    putValue( HMI__STMSGSD_MCMS_FL_Rq_AR, _MCMS_FL_Rq_AR_StartDelay * _MCMS_FL_Rq_AR_Timebase );

    _mMCMS_FL_Rq_AR.MCMS_AdjReset_FL_Rq.phys = getValue( HMI_MCMS_AdjReset_FL_Rq );
    _mMCMS_FL_Rq_AR.MCMS_DrvDynSeatMd_FL_Rq.phys = getValue( HMI_MCMS_DrvDynSeatMd_FL_Rq );
    _mMCMS_FL_Rq_AR.MCMS_HotStnInsty_FL_Rq.phys = getValue( HMI_MCMS_HotStnInsty_FL_Rq );
    _mMCMS_FL_Rq_AR.MCMS_LumPad_FL_Rq_V2.phys = getValue( HMI_MCMS_LumPad_FL_Rq_V2 );
    _mMCMS_FL_Rq_AR.MCMS_LumPosn_FL_Rq_V2.phys = getValue( HMI_MCMS_LumPosn_FL_Rq_V2 );
    _mMCMS_FL_Rq_AR.MCMS_Mass_FL_On_Rq.phys = getValue( HMI_MCMS_Mass_FL_On_Rq );
    _mMCMS_FL_Rq_AR.MCMS_MassAdj_FL_Rq_V3.phys = getValue( HMI_MCMS_MassAdj_FL_Rq_V3 );
    _mMCMS_FL_Rq_AR.MCMS_MassInsty_FL_Rq.phys = getValue( HMI_MCMS_MassInsty_FL_Rq );
    _mMCMS_FL_Rq_AR.MCMS_SdRstPad_FL_Rq_V2.phys = getValue( HMI_MCMS_SdRstPad_FL_Rq_V2 );
    _mMCMS_FL_Rq_AR.MCMS_SeatPad_FL_Rq_V2.phys = getValue( HMI_MCMS_SeatPad_FL_Rq_V2 );
    _mMCMS_FL_Rq_AR.MCMS_ShldrPad_FL_Rq_V2.phys = getValue( HMI_MCMS_ShldrPad_FL_Rq_V2 );
}

MCMS_FL_Rq_AR_saveEnvVars( dword hFile )
{
    filePutString("\n// Knoten TGW: MCMS_FL_Rq_AR\n", 27, hFile);
    snprintf( buffer, elcount(buffer), "0.0000 HMI__STMSG_MCMS_FL_Rq := %X\n", getValue( HMI__STMSG_MCMS_FL_Rq_AR ));        filePutString( buffer, elcount(buffer), hFile);
    snprintf( buffer, elcount(buffer), "0.0000 HMI__STMSGT_MCMS_FL_Rq := %X\n", getValue( HMI__STMSGT_MCMS_FL_Rq_AR ));        filePutString( buffer, elcount(buffer), hFile);
    snprintf( buffer, elcount(buffer), "0.0000 HMI_MCMS_AdjReset_FL_Rq := %X\n", getValue( HMI_MCMS_AdjReset_FL_Rq ) );        filePutString( buffer, elcount(buffer), hFile);
    snprintf( buffer, elcount(buffer), "0.0000 HMI_MCMS_DrvDynSeatMd_FL_Rq := %X\n", getValue( HMI_MCMS_DrvDynSeatMd_FL_Rq ) );        filePutString( buffer, elcount(buffer), hFile);
    snprintf( buffer, elcount(buffer), "0.0000 HMI_MCMS_HotStnInsty_FL_Rq := %X\n", getValue( HMI_MCMS_HotStnInsty_FL_Rq ) );        filePutString( buffer, elcount(buffer), hFile);
    snprintf( buffer, elcount(buffer), "0.0000 HMI_MCMS_LumPad_FL_Rq_V2 := %X\n", getValue( HMI_MCMS_LumPad_FL_Rq_V2 ) );        filePutString( buffer, elcount(buffer), hFile);
    snprintf( buffer, elcount(buffer), "0.0000 HMI_MCMS_LumPosn_FL_Rq_V2 := %X\n", getValue( HMI_MCMS_LumPosn_FL_Rq_V2 ) );        filePutString( buffer, elcount(buffer), hFile);
    snprintf( buffer, elcount(buffer), "0.0000 HMI_MCMS_Mass_FL_On_Rq := %X\n", getValue( HMI_MCMS_Mass_FL_On_Rq ) );        filePutString( buffer, elcount(buffer), hFile);
    snprintf( buffer, elcount(buffer), "0.0000 HMI_MCMS_MassAdj_FL_Rq_V3 := %X\n", getValue( HMI_MCMS_MassAdj_FL_Rq_V3 ) );        filePutString( buffer, elcount(buffer), hFile);
    snprintf( buffer, elcount(buffer), "0.0000 HMI_MCMS_MassInsty_FL_Rq := %X\n", getValue( HMI_MCMS_MassInsty_FL_Rq ) );        filePutString( buffer, elcount(buffer), hFile);
    snprintf( buffer, elcount(buffer), "0.0000 HMI_MCMS_SdRstPad_FL_Rq_V2 := %X\n", getValue( HMI_MCMS_SdRstPad_FL_Rq_V2 ) );        filePutString( buffer, elcount(buffer), hFile);
    snprintf( buffer, elcount(buffer), "0.0000 HMI_MCMS_SeatPad_FL_Rq_V2 := %X\n", getValue( HMI_MCMS_SeatPad_FL_Rq_V2 ) );        filePutString( buffer, elcount(buffer), hFile);
    snprintf( buffer, elcount(buffer), "0.0000 HMI_MCMS_ShldrPad_FL_Rq_V2 := %X\n", getValue( HMI_MCMS_ShldrPad_FL_Rq_V2 ) );        filePutString( buffer, elcount(buffer), hFile);
}

on timer _tMCMS_FL_Rq_AR
{
    putValue( HMI__STMSG_MCMS_FL_Rq_AR, 0 );
}

on EnvVar HMI__STMSG_MCMS_FL_Rq_AR
{
    long tDelay;
    if( getValue( this ) == 2 )
    {
        tDelay = getValue( HMI__STMSGT_MCMS_FL_Rq_AR );
        if( tDelay > 0 )    
            setTimer( _tMCMS_FL_Rq_AR, tDelay );
        else
            putValue( HMI__STMSG_MCMS_FL_Rq_AR, 0 );
    }
}

on envVar HMI__STMSG_PO_MCMS_FL_Rq_AR
{
    if( getValue( this ) )
        openPanel("MCMS_FL_Rq_AR");
}

on EnvVar HMI_MCMS_AdjReset_FL_Rq
{
    _mMCMS_FL_Rq_AR.MCMS_AdjReset_FL_Rq.phys = getValue(this);
    _MCMS_FL_Rq_AR_SpontanFlag = 1;
}

on EnvVar HMI_MCMS_DrvDynSeatMd_FL_Rq
{
    _mMCMS_FL_Rq_AR.MCMS_DrvDynSeatMd_FL_Rq.phys = getValue(this);
    _MCMS_FL_Rq_AR_SpontanFlag = 1;
}

on EnvVar HMI_MCMS_HotStnInsty_FL_Rq
{
    _mMCMS_FL_Rq_AR.MCMS_HotStnInsty_FL_Rq.phys = getValue(this);
    _MCMS_FL_Rq_AR_SpontanFlag = 1;
}

on EnvVar HMI_MCMS_LumPad_FL_Rq_V2
{
    _mMCMS_FL_Rq_AR.MCMS_LumPad_FL_Rq_V2.phys = getValue(this);
    _MCMS_FL_Rq_AR_SpontanFlag = 1;
}

on EnvVar HMI_MCMS_LumPosn_FL_Rq_V2
{
    _mMCMS_FL_Rq_AR.MCMS_LumPosn_FL_Rq_V2.phys = getValue(this);
    _MCMS_FL_Rq_AR_SpontanFlag = 1;
}

on EnvVar HMI_MCMS_Mass_FL_On_Rq
{
    _mMCMS_FL_Rq_AR.MCMS_Mass_FL_On_Rq.phys = getValue(this);
    _MCMS_FL_Rq_AR_SpontanFlag = 1;
}

on EnvVar HMI_MCMS_MassAdj_FL_Rq_V3
{
    _mMCMS_FL_Rq_AR.MCMS_MassAdj_FL_Rq_V3.phys = getValue(this);
    _MCMS_FL_Rq_AR_SpontanFlag = 1;
}

on EnvVar HMI_MCMS_MassInsty_FL_Rq
{
    _mMCMS_FL_Rq_AR.MCMS_MassInsty_FL_Rq.phys = getValue(this);
    _MCMS_FL_Rq_AR_SpontanFlag = 1;
}

on EnvVar HMI_MCMS_SdRstPad_FL_Rq_V2
{
    _mMCMS_FL_Rq_AR.MCMS_SdRstPad_FL_Rq_V2.phys = getValue(this);
    _MCMS_FL_Rq_AR_SpontanFlag = 1;
}

on EnvVar HMI_MCMS_SeatPad_FL_Rq_V2
{
    _mMCMS_FL_Rq_AR.MCMS_SeatPad_FL_Rq_V2.phys = getValue(this);
    _MCMS_FL_Rq_AR_SpontanFlag = 1;
}

on EnvVar HMI_MCMS_ShldrPad_FL_Rq_V2
{
    _mMCMS_FL_Rq_AR.MCMS_ShldrPad_FL_Rq_V2.phys = getValue(this);
    _MCMS_FL_Rq_AR_SpontanFlag = 1;
}

MCMS_FR_Rq_AR_check_output()
{
    if( !getValue( HMI__STMSG_MCMS_FR_Rq_AR ) )
    {
        // Botschaft MCMS_FR_Rq_AR ID: 767 --- Sendeart cyclicAndSpontanWithDelay --- 
        _MCMS_FR_Rq_AR_Cnt--;
        if(  _MCMS_FR_Rq_AR_Cnt < 1 )
        {
            // Nachricht wg. abgelaufenem Zyklus ausgeben
            output( _mMCMS_FR_Rq_AR );
            _MCMS_FR_Rq_AR_Cnt = _MCMS_FR_Rq_AR_CycleCount; // Zyklus-Zähler zurücksetzen
             _MCMS_FR_Rq_AR_SpontanFlag = 0; // Spontan-Flag zurücksetzen
        }
        else if(  _MCMS_FR_Rq_AR_SpontanFlag )
        {
            // Nachricht wg. spontaner Änderung ausgeben
            output( _mMCMS_FR_Rq_AR );
             _MCMS_FR_Rq_AR_SpontanFlag = 0; // Spontan-Flag zurücksetzen
        }
    }
}

MCMS_FR_Rq_AR_init()
{   /* Botschaft MCMS_FR_Rq_AR ID: 767 --- Sendeart cyclicAndSpontanWithDelay --- 
BA_ "ApplMessage" BO_ 767 0;
BA_ "NmAsrMessage" BO_ 767 0;
BA_ "GenMsgMinAcceptLength" BO_ 767 8;
BA_ "GenMsgILSupport" BO_ 767 1;
BA_ "DiagState" BO_ 767 0;
BA_ "DiagRequest" BO_ 767 0;
BA_ "DiagResponse" BO_ 767 0;
BA_ "GenMsgStartValue" BO_ 767 "0";
BA_ "GenMsgStartDelayTime" BO_ 767 135;
BA_ "GenMsgDelayTime" BO_ 767 5;
BA_ "GenMsgNrOfRepetitions" BO_ 767 0;
BA_ "GenMsgCycleTime" BO_ 767 1000;
BA_ "GenMsgSendType" BO_ 767 5;
    */
    _MCMS_FR_Rq_AR_Timebase =         c_tDBKomTimer_20ms;
    _MCMS_FR_Rq_AR_CycleCount =     1000 / _MCMS_FR_Rq_AR_Timebase;
    _MCMS_FR_Rq_AR_StartDelay =      135 / _MCMS_FR_Rq_AR_Timebase;
    _MCMS_FR_Rq_AR_Cnt = _MCMS_FR_Rq_AR_StartDelay;
    _MCMS_FR_Rq_AR_SpontanFlag = 0;

    putValue( HMI__STMSGSD_MCMS_FR_Rq_AR, _MCMS_FR_Rq_AR_StartDelay * _MCMS_FR_Rq_AR_Timebase );

    _mMCMS_FR_Rq_AR.MCMS_AdjReset_FR_Rq.phys = getValue( HMI_MCMS_AdjReset_FR_Rq );
    _mMCMS_FR_Rq_AR.MCMS_DrvDynSeatMd_FR_Rq.phys = getValue( HMI_MCMS_DrvDynSeatMd_FR_Rq );
    _mMCMS_FR_Rq_AR.MCMS_HotStnInsty_FR_Rq.phys = getValue( HMI_MCMS_HotStnInsty_FR_Rq );
    _mMCMS_FR_Rq_AR.MCMS_LumPad_FR_Rq_V2.phys = getValue( HMI_MCMS_LumPad_FR_Rq_V2 );
    _mMCMS_FR_Rq_AR.MCMS_LumPosn_FR_Rq_V2.phys = getValue( HMI_MCMS_LumPosn_FR_Rq_V2 );
    _mMCMS_FR_Rq_AR.MCMS_Mass_FR_On_Rq.phys = getValue( HMI_MCMS_Mass_FR_On_Rq );
    _mMCMS_FR_Rq_AR.MCMS_MassAdj_FR_Rq_V3.phys = getValue( HMI_MCMS_MassAdj_FR_Rq_V3 );
    _mMCMS_FR_Rq_AR.MCMS_MassInsty_FR_Rq.phys = getValue( HMI_MCMS_MassInsty_FR_Rq );
    _mMCMS_FR_Rq_AR.MCMS_SdRstPad_FR_Rq_V2.phys = getValue( HMI_MCMS_SdRstPad_FR_Rq_V2 );
    _mMCMS_FR_Rq_AR.MCMS_SeatPad_FR_Rq_V2.phys = getValue( HMI_MCMS_SeatPad_FR_Rq_V2 );
    _mMCMS_FR_Rq_AR.MCMS_ShldrPad_FR_Rq_V2.phys = getValue( HMI_MCMS_ShldrPad_FR_Rq_V2 );
}

MCMS_FR_Rq_AR_saveEnvVars( dword hFile )
{
    filePutString("\n// Knoten TGW: MCMS_FR_Rq_AR\n", 27, hFile);
    snprintf( buffer, elcount(buffer), "0.0000 HMI__STMSG_MCMS_FR_Rq := %X\n", getValue( HMI__STMSG_MCMS_FR_Rq_AR ));        filePutString( buffer, elcount(buffer), hFile);
    snprintf( buffer, elcount(buffer), "0.0000 HMI__STMSGT_MCMS_FR_Rq := %X\n", getValue( HMI__STMSGT_MCMS_FR_Rq_AR ));        filePutString( buffer, elcount(buffer), hFile);
    snprintf( buffer, elcount(buffer), "0.0000 HMI_MCMS_AdjReset_FR_Rq := %X\n", getValue( HMI_MCMS_AdjReset_FR_Rq ) );        filePutString( buffer, elcount(buffer), hFile);
    snprintf( buffer, elcount(buffer), "0.0000 HMI_MCMS_DrvDynSeatMd_FR_Rq := %X\n", getValue( HMI_MCMS_DrvDynSeatMd_FR_Rq ) );        filePutString( buffer, elcount(buffer), hFile);
    snprintf( buffer, elcount(buffer), "0.0000 HMI_MCMS_HotStnInsty_FR_Rq := %X\n", getValue( HMI_MCMS_HotStnInsty_FR_Rq ) );        filePutString( buffer, elcount(buffer), hFile);
    snprintf( buffer, elcount(buffer), "0.0000 HMI_MCMS_LumPad_FR_Rq_V2 := %X\n", getValue( HMI_MCMS_LumPad_FR_Rq_V2 ) );        filePutString( buffer, elcount(buffer), hFile);
    snprintf( buffer, elcount(buffer), "0.0000 HMI_MCMS_LumPosn_FR_Rq_V2 := %X\n", getValue( HMI_MCMS_LumPosn_FR_Rq_V2 ) );        filePutString( buffer, elcount(buffer), hFile);
    snprintf( buffer, elcount(buffer), "0.0000 HMI_MCMS_Mass_FR_On_Rq := %X\n", getValue( HMI_MCMS_Mass_FR_On_Rq ) );        filePutString( buffer, elcount(buffer), hFile);
    snprintf( buffer, elcount(buffer), "0.0000 HMI_MCMS_MassAdj_FR_Rq_V3 := %X\n", getValue( HMI_MCMS_MassAdj_FR_Rq_V3 ) );        filePutString( buffer, elcount(buffer), hFile);
    snprintf( buffer, elcount(buffer), "0.0000 HMI_MCMS_MassInsty_FR_Rq := %X\n", getValue( HMI_MCMS_MassInsty_FR_Rq ) );        filePutString( buffer, elcount(buffer), hFile);
    snprintf( buffer, elcount(buffer), "0.0000 HMI_MCMS_SdRstPad_FR_Rq_V2 := %X\n", getValue( HMI_MCMS_SdRstPad_FR_Rq_V2 ) );        filePutString( buffer, elcount(buffer), hFile);
    snprintf( buffer, elcount(buffer), "0.0000 HMI_MCMS_SeatPad_FR_Rq_V2 := %X\n", getValue( HMI_MCMS_SeatPad_FR_Rq_V2 ) );        filePutString( buffer, elcount(buffer), hFile);
    snprintf( buffer, elcount(buffer), "0.0000 HMI_MCMS_ShldrPad_FR_Rq_V2 := %X\n", getValue( HMI_MCMS_ShldrPad_FR_Rq_V2 ) );        filePutString( buffer, elcount(buffer), hFile);
}

on timer _tMCMS_FR_Rq_AR
{
    putValue( HMI__STMSG_MCMS_FR_Rq_AR, 0 );
}

on EnvVar HMI__STMSG_MCMS_FR_Rq_AR
{
    long tDelay;
    if( getValue( this ) == 2 )
    {
        tDelay = getValue( HMI__STMSGT_MCMS_FR_Rq_AR );
        if( tDelay > 0 )    
            setTimer( _tMCMS_FR_Rq_AR, tDelay );
        else
            putValue( HMI__STMSG_MCMS_FR_Rq_AR, 0 );
    }
}

on envVar HMI__STMSG_PO_MCMS_FR_Rq_AR
{
    if( getValue( this ) )
        openPanel("MCMS_FR_Rq_AR");
}

on EnvVar HMI_MCMS_AdjReset_FR_Rq
{
    _mMCMS_FR_Rq_AR.MCMS_AdjReset_FR_Rq.phys = getValue(this);
    _MCMS_FR_Rq_AR_SpontanFlag = 1;
}

on EnvVar HMI_MCMS_DrvDynSeatMd_FR_Rq
{
    _mMCMS_FR_Rq_AR.MCMS_DrvDynSeatMd_FR_Rq.phys = getValue(this);
    _MCMS_FR_Rq_AR_SpontanFlag = 1;
}

on EnvVar HMI_MCMS_HotStnInsty_FR_Rq
{
    _mMCMS_FR_Rq_AR.MCMS_HotStnInsty_FR_Rq.phys = getValue(this);
    _MCMS_FR_Rq_AR_SpontanFlag = 1;
}

on EnvVar HMI_MCMS_LumPad_FR_Rq_V2
{
    _mMCMS_FR_Rq_AR.MCMS_LumPad_FR_Rq_V2.phys = getValue(this);
    _MCMS_FR_Rq_AR_SpontanFlag = 1;
}

on EnvVar HMI_MCMS_LumPosn_FR_Rq_V2
{
    _mMCMS_FR_Rq_AR.MCMS_LumPosn_FR_Rq_V2.phys = getValue(this);
    _MCMS_FR_Rq_AR_SpontanFlag = 1;
}

on EnvVar HMI_MCMS_Mass_FR_On_Rq
{
    _mMCMS_FR_Rq_AR.MCMS_Mass_FR_On_Rq.phys = getValue(this);
    _MCMS_FR_Rq_AR_SpontanFlag = 1;
}

on EnvVar HMI_MCMS_MassAdj_FR_Rq_V3
{
    _mMCMS_FR_Rq_AR.MCMS_MassAdj_FR_Rq_V3.phys = getValue(this);
    _MCMS_FR_Rq_AR_SpontanFlag = 1;
}

on EnvVar HMI_MCMS_MassInsty_FR_Rq
{
    _mMCMS_FR_Rq_AR.MCMS_MassInsty_FR_Rq.phys = getValue(this);
    _MCMS_FR_Rq_AR_SpontanFlag = 1;
}

on EnvVar HMI_MCMS_SdRstPad_FR_Rq_V2
{
    _mMCMS_FR_Rq_AR.MCMS_SdRstPad_FR_Rq_V2.phys = getValue(this);
    _MCMS_FR_Rq_AR_SpontanFlag = 1;
}

on EnvVar HMI_MCMS_SeatPad_FR_Rq_V2
{
    _mMCMS_FR_Rq_AR.MCMS_SeatPad_FR_Rq_V2.phys = getValue(this);
    _MCMS_FR_Rq_AR_SpontanFlag = 1;
}

on EnvVar HMI_MCMS_ShldrPad_FR_Rq_V2
{
    _mMCMS_FR_Rq_AR.MCMS_ShldrPad_FR_Rq_V2.phys = getValue(this);
    _MCMS_FR_Rq_AR_SpontanFlag = 1;
}

MCMS_RL_Rq_AR_check_output()
{
    if(  !getValue( HMI__STMSG_MCMS_RL_Rq_AR ) )
    {
        // Botschaft MCMS_RL_Rq_AR ID: 769 --- Sendeart cyclicAndSpontanWithDelay --- 
        _MCMS_RL_Rq_AR_Cnt--;
        if(  _MCMS_RL_Rq_AR_Cnt < 1 )
        {
            // Nachricht wg. abgelaufenem Zyklus ausgeben
            output( _mMCMS_RL_Rq_AR );
            _MCMS_RL_Rq_AR_Cnt = _MCMS_RL_Rq_AR_CycleCount; // Zyklus-Zähler zurücksetzen
            _MCMS_RL_Rq_AR_SpontanFlag = 0; // Spontan-Flag zurücksetzen
        }
        else if(  _MCMS_RL_Rq_AR_SpontanFlag )
        {
            // Nachricht wg. spontaner Änderung ausgeben
            output( _mMCMS_RL_Rq_AR );
            _MCMS_RL_Rq_AR_SpontanFlag = 0; // Spontan-Flag zurücksetzen
        }
    }
}

MCMS_RL_Rq_AR_init()
{   /* Botschaft MCMS_RL_Rq_AR ID: 769 --- Sendeart cyclicAndSpontanWithDelay --- 
BA_ "ApplMessage" BO_ 769 0;
BA_ "NmAsrMessage" BO_ 769 0;
BA_ "GenMsgMinAcceptLength" BO_ 769 8;
BA_ "GenMsgILSupport" BO_ 769 1;
BA_ "DiagState" BO_ 769 0;
BA_ "DiagRequest" BO_ 769 0;
BA_ "DiagResponse" BO_ 769 0;
BA_ "GenMsgStartValue" BO_ 769 "0";
BA_ "GenMsgStartDelayTime" BO_ 769 165;
BA_ "GenMsgDelayTime" BO_ 769 5;
BA_ "GenMsgNrOfRepetitions" BO_ 769 0;
BA_ "GenMsgCycleTime" BO_ 769 1000;
BA_ "GenMsgSendType" BO_ 769 5;
    */
    _MCMS_RL_Rq_AR_Timebase =          c_tDBKomTimer_20ms;
    _MCMS_RL_Rq_AR_CycleCount =      1000 / _MCMS_RL_Rq_AR_Timebase;
    _MCMS_RL_Rq_AR_StartDelay =       165 / _MCMS_RL_Rq_AR_Timebase;
    _MCMS_RL_Rq_AR_Cnt = _MCMS_RL_Rq_AR_StartDelay;
    _MCMS_RL_Rq_AR_SpontanFlag = 0;

   putValue( HMI__STMSGSD_MCMS_RL_Rq_AR, _MCMS_RL_Rq_AR_StartDelay * _MCMS_RL_Rq_AR_Timebase );

    _mMCMS_RL_Rq_AR.MCMS_HotStnInsty_RL_Rq.phys = getValue( HMI_MCMS_HotStnInsty_RL_Rq );
 //   _mMCMS_RL_Rq_AR.MCMS_HotStnInsty_RR_Rq.phys = getValue( HMI_MCMS_HotStnInsty_RR_Rq );
}

MCMS_RL_Rq_AR_saveEnvVars( dword hFile)
{
    filePutString("\n// Knoten TGW: MCMS_RL_Rq_AR\n", 26, hFile);
    snprintf( buffer, elcount(buffer), "0.0000 HMI__STMSG_MCMS_RL_Rq_AR := %X\n", getValue( HMI__STMSG_MCMS_RL_Rq_AR ));        filePutString( buffer, elcount(buffer), hFile);
    snprintf( buffer, elcount(buffer), "0.0000 HMI__STMSGT_MCMS_RL_Rq_AR := %X\n", getValue( HMI__STMSGT_MCMS_RL_Rq_AR ));        filePutString( buffer, elcount(buffer), hFile);
    snprintf( buffer, elcount(buffer), "0.0000 HMI_MCMS_HotStnInsty_RL_Rq := %X\n", getValue( HMI_MCMS_HotStnInsty_RL_Rq ) );        filePutString( buffer, elcount(buffer), hFile);
    snprintf( buffer, elcount(buffer), "0.0000 HMI_MCMS_HotStnInsty_RR_Rq := %X\n", getValue( HMI_MCMS_HotStnInsty_RR_Rq ) );        filePutString( buffer, elcount(buffer), hFile);
}

on timer _tMCMS_RL_Rq_AR
{
    putValue( HMI__STMSG_MCMS_RL_Rq_AR, 0 );
}

on EnvVar HMI__STMSG_MCMS_RL_Rq_AR
{
    long tDelay;
    if( getValue( this ) == 2 )
    {
        tDelay = getValue( HMI__STMSGT_MCMS_RL_Rq_AR );
        if( tDelay > 0 )    
            setTimer( _tMCMS_RL_Rq_AR, tDelay );
        else
            putValue( HMI__STMSG_MCMS_RL_Rq_AR, 0 );
    }
}

on envVar HMI__STMSG_PO_MCMS_RL_Rq_AR
{
    if( getValue( this ) )
        openPanel("MCMS_RL_Rq_AR");
}

on EnvVar HMI_MCMS_AdjReset_RL_Rq
{
    _mMCMS_RL_Rq_AR.MCMS_AdjReset_RL_Rq.phys = getValue(this);
    _MCMS_RL_Rq_AR_SpontanFlag = 1;
}

on EnvVar HMI_MCMS_HotStnInsty_RL_Rq
{
    _mMCMS_RL_Rq_AR.MCMS_HotStnInsty_RL_Rq.phys = getValue(this);
    _MCMS_RL_Rq_AR_SpontanFlag = 1;
}

on EnvVar HMI_MCMS_LumPad_RL_Rq_V2
{
    _mMCMS_RL_Rq_AR.MCMS_LumPad_RL_Rq_V2.phys = getValue(this);
    _MCMS_RL_Rq_AR_SpontanFlag = 1;
}

on EnvVar HMI_MCMS_LumPosn_RL_Rq_V2
{
    _mMCMS_RL_Rq_AR.MCMS_LumPosn_RL_Rq_V2.phys = getValue(this);
    _MCMS_RL_Rq_AR_SpontanFlag = 1;
}

on EnvVar HMI_MCMS_Mass_RL_On_Rq
{
    _mMCMS_RL_Rq_AR.MCMS_Mass_RL_On_Rq.phys = getValue(this);
    _MCMS_RL_Rq_AR_SpontanFlag = 1;
}

on EnvVar HMI_MCMS_MassAdj_RL_Rq_V3
{
    _mMCMS_RL_Rq_AR.MCMS_MassAdj_RL_Rq_V3.phys = getValue(this);
    _MCMS_RL_Rq_AR_SpontanFlag = 1;
}

on EnvVar HMI_MCMS_MassInsty_RL_Rq
{
    _mMCMS_RL_Rq_AR.MCMS_MassInsty_RL_Rq.phys = getValue(this);
    _MCMS_RL_Rq_AR_SpontanFlag = 1;
}

on EnvVar HMI_MCMS_SdRstPad_RL_Rq_V2
{
    _mMCMS_RL_Rq_AR.MCMS_SdRstPad_RL_Rq_V2.phys = getValue(this);
    _MCMS_RL_Rq_AR_SpontanFlag = 1;
}

MCMS_RR_Rq_AR_check_output()
{
    if(  !getValue( HMI__STMSG_MCMS_RR_Rq_AR ) )
    {
        // Botschaft MCMS_RR_Rq_AR ID: 1097 --- Sendeart cyclicAndSpontanWithDelay --- 
        _MCMS_RR_Rq_AR_Cnt--;
        if(  _MCMS_RR_Rq_AR_Cnt < 1 )
        {
            // Nachricht wg. abgelaufenem Zyklus ausgeben
       //     output( _mMCMS_RR_Rq_AR );
            _MCMS_RR_Rq_AR_Cnt = _MCMS_RR_Rq_AR_CycleCount; // Zyklus-Zähler zurücksetzen
             _MCMS_RR_Rq_AR_SpontanFlag = 0; // Spontan-Flag zurücksetzen
        }
        else if(  _MCMS_RR_Rq_AR_SpontanFlag )
        {
            // Nachricht wg. spontaner Änderung ausgeben
     //       output( _mMCMS_RR_Rq_AR );
             _MCMS_RR_Rq_AR_SpontanFlag = 0; // Spontan-Flag zurücksetzen
        }
    }
}

MCMS_RR_Rq_AR_init()
{   /* Botschaft MCMS_RR_Rq_AR ID: 1097 --- Sendeart cyclicAndSpontanWithDelay --- 
BA_ "ApplMessage" BO_ 1097 0;
BA_ "NmAsrMessage" BO_ 1097 0;
BA_ "GenMsgMinAcceptLength" BO_ 1097 8;
BA_ "GenMsgILSupport" BO_ 1097 1;
BA_ "DiagState" BO_ 1097 0;
BA_ "DiagRequest" BO_ 1097 0;
BA_ "DiagResponse" BO_ 1097 0;
BA_ "GenMsgStartValue" BO_ 1097 "0";
BA_ "GenMsgStartDelayTime" BO_ 1097 275;
BA_ "GenMsgDelayTime" BO_ 1097 5;
BA_ "GenMsgNrOfRepetitions" BO_ 1097 0;
BA_ "GenMsgCycleTime" BO_ 1097 1000;
BA_ "GenMsgSendType" BO_ 1097 5;
    */
    _MCMS_RR_Rq_AR_Timebase =          c_tDBKomTimer_20ms;
    _MCMS_RR_Rq_AR_CycleCount =      1000 / _MCMS_RR_Rq_AR_Timebase;
    _MCMS_RR_Rq_AR_StartDelay =       275 / _MCMS_RR_Rq_AR_Timebase;
    _MCMS_RR_Rq_AR_Cnt = _MCMS_RR_Rq_AR_StartDelay;
    _MCMS_RR_Rq_AR_SpontanFlag = 0;

    putValue( HMI__STMSGSD_MCMS_RR_Rq_AR, _MCMS_RR_Rq_AR_StartDelay * _MCMS_RR_Rq_AR_Timebase );

    /*_mMCMS_RR_Rq_AR.MCMS_AdjReset_RL_Rq.phys = getValue( HMI_MCMS_AdjReset_RL_Rq );
    _mMCMS_RR_Rq_AR.MCMS_AdjReset_RR_Rq.phys = getValue( HMI_MCMS_AdjReset_RR_Rq );
    _mMCMS_RR_Rq_AR.MCMS_LumPad_RL_Rq_V2.phys = getValue( HMI_MCMS_LumPad_RL_Rq_V2 );
    _mMCMS_RR_Rq_AR.MCMS_LumPad_RR_Rq_V2.phys = getValue( HMI_MCMS_LumPad_RR_Rq_V2 );
    _mMCMS_RR_Rq_AR.MCMS_LumPosn_RL_Rq_V2.phys = getValue( HMI_MCMS_LumPosn_RL_Rq_V2 );
    _mMCMS_RR_Rq_AR.MCMS_LumPosn_RR_Rq_V2.phys = getValue( HMI_MCMS_LumPosn_RR_Rq_V2 );
    _mMCMS_RR_Rq_AR.MCMS_Mass_RL_On_Rq.phys = getValue( HMI_MCMS_Mass_RL_On_Rq );
    _mMCMS_RR_Rq_AR.MCMS_Mass_RR_On_Rq.phys = getValue( HMI_MCMS_Mass_RR_On_Rq );
    _mMCMS_RR_Rq_AR.MCMS_MassAdj_RL_Rq_V2.phys = getValue( HMI_MCMS_MassAdj_RL_Rq_V2 );
    _mMCMS_RR_Rq_AR.MCMS_MassAdj_RR_Rq_V2.phys = getValue( HMI_MCMS_MassAdj_RR_Rq_V2 );
    _mMCMS_RR_Rq_AR.MCMS_MassInsty_RL_Rq.phys = getValue( HMI_MCMS_MassInsty_RL_Rq );
    _mMCMS_RR_Rq_AR.MCMS_MassInsty_RR_Rq.phys = getValue( HMI_MCMS_MassInsty_RR_Rq );
    _mMCMS_RR_Rq_AR.MCMS_SdRstPad_RL_Rq_V2.phys = getValue( HMI_MCMS_SdRstPad_RL_Rq_V2 );
    _mMCMS_RR_Rq_AR.MCMS_SdRstPad_RR_Rq_V2.phys = getValue( HMI_MCMS_SdRstPad_RR_Rq_V2 );*/
}

MCMS_RR_Rq_AR_saveEnvVars( dword hFile)
{
    filePutString("\n// Knoten TGW: MCMS_RR_Rq_AR\n", 26, hFile);
    snprintf( buffer, elcount(buffer), "0.0000 HMI__STMSG_MCMS_RR_Rq := %X\n", getValue( HMI__STMSG_MCMS_RR_Rq_AR ));        filePutString( buffer, elcount(buffer), hFile);
    snprintf( buffer, elcount(buffer), "0.0000 HMI__STMSGT_MCMS_RR_Rq := %X\n", getValue( HMI__STMSGT_MCMS_RR_Rq_AR ));        filePutString( buffer, elcount(buffer), hFile);
    snprintf( buffer, elcount(buffer), "0.0000 HMI_MCMS_AdjReset_RL_Rq := %X\n", getValue( HMI_MCMS_AdjReset_RL_Rq ) );        filePutString( buffer, elcount(buffer), hFile);
    snprintf( buffer, elcount(buffer), "0.0000 HMI_MCMS_AdjReset_RR_Rq := %X\n", getValue( HMI_MCMS_AdjReset_RR_Rq ) );        filePutString( buffer, elcount(buffer), hFile);
    snprintf( buffer, elcount(buffer), "0.0000 HMI_MCMS_LumPad_RL_Rq_V2 := %X\n", getValue( HMI_MCMS_LumPad_RL_Rq_V2 ) );        filePutString( buffer, elcount(buffer), hFile);
    snprintf( buffer, elcount(buffer), "0.0000 HMI_MCMS_LumPad_RR_Rq_V2 := %X\n", getValue( HMI_MCMS_LumPad_RR_Rq_V2 ) );        filePutString( buffer, elcount(buffer), hFile);
    snprintf( buffer, elcount(buffer), "0.0000 HMI_MCMS_LumPosn_RL_Rq_V2 := %X\n", getValue( HMI_MCMS_LumPosn_RL_Rq_V2 ) );        filePutString( buffer, elcount(buffer), hFile);
    snprintf( buffer, elcount(buffer), "0.0000 HMI_MCMS_LumPosn_RR_Rq_V2 := %X\n", getValue( HMI_MCMS_LumPosn_RR_Rq_V2 ) );        filePutString( buffer, elcount(buffer), hFile);
    snprintf( buffer, elcount(buffer), "0.0000 HMI_MCMS_Mass_RL_On_Rq := %X\n", getValue( HMI_MCMS_Mass_RL_On_Rq ) );        filePutString( buffer, elcount(buffer), hFile);
    snprintf( buffer, elcount(buffer), "0.0000 HMI_MCMS_Mass_RR_On_Rq := %X\n", getValue( HMI_MCMS_Mass_RR_On_Rq ) );        filePutString( buffer, elcount(buffer), hFile);
    snprintf( buffer, elcount(buffer), "0.0000 HMI_MCMS_MassAdj_RL_Rq_V3 := %X\n", getValue( HMI_MCMS_MassAdj_RL_Rq_V3 ) );        filePutString( buffer, elcount(buffer), hFile);
    snprintf( buffer, elcount(buffer), "0.0000 HMI_MCMS_MassAdj_RR_Rq_V3 := %X\n", getValue( HMI_MCMS_MassAdj_RR_Rq_V3 ) );        filePutString( buffer, elcount(buffer), hFile);
    snprintf( buffer, elcount(buffer), "0.0000 HMI_MCMS_MassInsty_RL_Rq := %X\n", getValue( HMI_MCMS_MassInsty_RL_Rq ) );        filePutString( buffer, elcount(buffer), hFile);
    snprintf( buffer, elcount(buffer), "0.0000 HMI_MCMS_MassInsty_RR_Rq := %X\n", getValue( HMI_MCMS_MassInsty_RR_Rq ) );        filePutString( buffer, elcount(buffer), hFile);
    snprintf( buffer, elcount(buffer), "0.0000 HMI_MCMS_SdRstPad_RL_Rq_V2 := %X\n", getValue( HMI_MCMS_SdRstPad_RL_Rq_V2 ) );        filePutString( buffer, elcount(buffer), hFile);
    snprintf( buffer, elcount(buffer), "0.0000 HMI_MCMS_SdRstPad_RR_Rq_V2 := %X\n", getValue( HMI_MCMS_SdRstPad_RR_Rq_V2 ) );        filePutString( buffer, elcount(buffer), hFile);
}

on timer _tMCMS_RR_Rq_AR
{
    putValue( HMI__STMSG_MCMS_RR_Rq_AR, 0 );
}

on EnvVar HMI__STMSG_MCMS_RR_Rq_AR
{
    long tDelay;
    if( getValue( this ) == 2 )
    {
        tDelay = getValue( HMI__STMSGT_MCMS_RR_Rq_AR );
        if( tDelay > 0 )    
            setTimer( _tMCMS_RR_Rq_AR, tDelay );
        else
            putValue( HMI__STMSG_MCMS_RR_Rq_AR, 0 );
    }
}

on envVar HMI__STMSG_PO_MCMS_RR_Rq_AR
{
    if( getValue( this ) )
        openPanel("MCMS_RR_Rq_AR");
}

on EnvVar HMI_MCMS_AdjReset_RR_Rq
{
//    _mMCMS_RR_Rq_AR.MCMS_AdjReset_RR_Rq.phys = getValue(this);
    _MCMS_RR_Rq_AR_SpontanFlag = 1;
}

on EnvVar HMI_MCMS_HotStnInsty_RR_Rq
{
 //   _mMCMS_RR_Rq_AR.MCMS_HotStnInsty_RL_Rq.phys = getValue(this);
    _MCMS_RR_Rq_AR_SpontanFlag = 1;
}

on EnvVar HMI_MCMS_LumPad_RR_Rq_V2
{
 //   _mMCMS_RR_Rq_AR.MCMS_LumPad_RR_Rq_V2.phys = getValue(this);
    _MCMS_RR_Rq_AR_SpontanFlag = 1;
}

on EnvVar HMI_MCMS_LumPosn_RR_Rq_V2
{
 //   _mMCMS_RR_Rq_AR.MCMS_LumPosn_RR_Rq_V2.phys = getValue(this);
    _MCMS_RR_Rq_AR_SpontanFlag = 1;
}

on EnvVar HMI_MCMS_Mass_RR_On_Rq
{
  //  _mMCMS_RR_Rq_AR.MCMS_Mass_RR_On_Rq.phys = getValue(this);
    _MCMS_RR_Rq_AR_SpontanFlag = 1;
}

on EnvVar HMI_MCMS_MassAdj_RR_Rq_V3
{
    _mMCMS_RR_Rq_AR.MCMS_MassAdj_RR_Rq_V3.phys = getValue(this);
    _MCMS_RR_Rq_AR_SpontanFlag = 1;
}

on EnvVar HMI_MCMS_MassInsty_RR_Rq
{
  //  _mMCMS_RR_Rq_AR.MCMS_MassInsty_RR_Rq.phys = getValue(this);
    _MCMS_RR_Rq_AR_SpontanFlag = 1;
}

on EnvVar HMI_MCMS_SdRstPad_RR_Rq_V2
{
   // _mMCMS_RR_Rq_AR.MCMS_SdRstPad_RR_Rq_V2.phys = getValue(this);
    _MCMS_RR_Rq_AR_SpontanFlag = 1;
}

NAVI_CurrData_AR_check_output()
{
    if( !getValue( HMI__STMSG_NAVI_CurrData_AR ) )
    {
        // Botschaft NAVI_CurrData_AR ID: 826 --- Sendeart 5 cyclicAndSpontanWithDelay --- 
        if( _NAVI_CurrData_AR_DelayCnt > 0) _NAVI_CurrData_AR_DelayCnt--; // Mindestsendeabstand
        _NAVI_CurrData_AR_Cnt--;
        if( _NAVI_CurrData_AR_Cnt < 1 )
        {
            if( _NAVI_CurrData_AR_DelayCnt < 1 )
            {
                // Nachricht wg. abgelaufenem Zyklus ausgeben (Mindestsendeabstand eingehalten)
                NAVI_CurrData_AR_output();
                _NAVI_CurrData_AR_SpontanFlag = 0; // Spontan-Flag zurücksetzen
                _NAVI_CurrData_AR_DelayCnt = _NAVI_CurrData_AR_MinDelay;
            }
            else
            {
                // Spontanflag setzen damit nach Ablauf Mindestsendeabstand gesendet wird
                 _NAVI_CurrData_AR_SpontanFlag = 1;
            }
            _NAVI_CurrData_AR_Cnt = _NAVI_CurrData_AR_CycleCount; // Zyklus-Zähler zurücksetzen
        }
        else if( _NAVI_CurrData_AR_SpontanFlag)
        {
            if( _NAVI_CurrData_AR_DelayCnt < 1 )
            {
                // Nachricht wg. spontaner Änderung ausgeben (Mindestsendeabstand eingehalten)
                NAVI_CurrData_AR_output();
                _NAVI_CurrData_AR_SpontanFlag = 0; // Spontan-Flag zurücksetzen
                _NAVI_CurrData_AR_DelayCnt = _NAVI_CurrData_AR_MinDelay;
            }
        }
    }
}

NAVI_CurrData_AR_init()
{   /* Botschaft NAVI_CurrData_AR ID: 826 --- Sendeart 5 cyclicAndSpontanWithDelay --- 
BA_ "ApplMessage" BO_ 826 0;
BA_ "NmAsrMessage" BO_ 826 0;
BA_ "GenMsgMinAcceptLength" BO_ 826 8;
BA_ "GenMsgILSupport" BO_ 826 0;
BA_ "DiagState" BO_ 826 0;
BA_ "DiagRequest" BO_ 826 0;
BA_ "DiagResponse" BO_ 826 0;
BA_ "GenMsgStartValue" BO_ 826 "0";
BA_ "GenMsgStartDelayTime" BO_ 826 190;
BA_ "GenMsgDelayTime" BO_ 826 100;
BA_ "GenMsgNrOfRepetitions" BO_ 826 0;
BA_ "GenMsgCycleTime" BO_ 826 1000;
BA_ "GenMsgSendType" BO_ 826 5;
    */
    _NAVI_CurrData_AR_Timebase =           c_tDBKomTimer_20ms;
    _NAVI_CurrData_AR_CycleCount =      1000 / _NAVI_CurrData_AR_Timebase;
    _NAVI_CurrData_AR_StartDelay =       190 / _NAVI_CurrData_AR_Timebase;
    _NAVI_CurrData_AR_MinDelay =         100 / _NAVI_CurrData_AR_Timebase;
    _NAVI_CurrData_AR_Cnt = _NAVI_CurrData_AR_StartDelay;
    _NAVI_CurrData_AR_SpontanFlag = 0;
    _NAVI_CurrData_AR_DelayCnt = 0;

    putValue( HMI__STMSGSD_NAVI_CurrData_AR, _NAVI_CurrData_AR_StartDelay * _NAVI_CurrData_AR_Timebase );

    _mNAVI_CurrData_AR.NaviDistance_MdSel.phys = getValue( HMI_NaviDistance_MdSel );
    _mNAVI_CurrData_AR.NaviDistance_Destination.phys = getValue( HMI_NaviDistance_Destination );
    _mNAVI_CurrData_AR.NaviDistance_Waypoint_1.phys = getValue( HMI_NaviDistance_Waypoint_1 );
    _mNAVI_CurrData_AR.NaviDistance_Waypoint_2.phys = getValue( HMI_NaviDistance_Waypoint_2 );
    _mNAVI_CurrData_AR.NaviDistance_Waypoint_3.phys = getValue( HMI_NaviDistance_Waypoint_3 );
    _mNAVI_CurrData_AR.NaviDistance_Waypoint_4.phys = getValue( HMI_NaviDistance_Waypoint_4 );
    _mNAVI_CurrData_AR.NaviDistance_Waypoint_5.phys = getValue( HMI_NaviDistance_Waypoint_5 );
	_mNAVI_CurrData_AR.AccumPosElevation_Destination.phys = getValue( HMI_AccumPosElevation_Destination );
_mNAVI_CurrData_AR.AccumNegElevation_Destination.phys = getValue( HMI_AccumNegElevation_Destination );
_mNAVI_CurrData_AR.Navi_EstimatedDur_Destination.phys = getValue( HMI_Navi_EstimatedDur_Destination );
_mNAVI_CurrData_AR.EngyAvl_Gasoline_Destination.phys = getValue( HMI_EngyAvl_Gasoline_Destination );
_mNAVI_CurrData_AR.EngyAvl_Diesel_Destination.phys = getValue( HMI_EngyAvl_Diesel_Destination );
_mNAVI_CurrData_AR.EngyAvl_elPwr_Destination.phys = getValue( HMI_EngyAvl_elPwr_Destination );
_mNAVI_CurrData_AR.EngyAvl_H2_Destination.phys = getValue( HMI_EngyAvl_H2_Destination );
_mNAVI_CurrData_AR.EngyAvl_CNG_Destination.phys = getValue( HMI_EngyAvl_CNG_Destination );
_mNAVI_CurrData_AR.EngyAvl_LNG_Destination.phys = getValue( HMI_EngyAvl_LNG_Destination );
_mNAVI_CurrData_AR.EngyAvl_EngyTyp1_Destination.phys = getValue( HMI_EngyAvl_EngyTyp1_Destination );
_mNAVI_CurrData_AR.EngyAvl_EngyTyp2_Destination.phys = getValue( HMI_EngyAvl_EngyTyp2_Destination );
_mNAVI_CurrData_AR.AccumPosElevation_Waypoint_1.phys = getValue( HMI_AccumPosElevation_Waypoint_1 );
_mNAVI_CurrData_AR.AccumNegElevation_Waypoint_1.phys = getValue( HMI_AccumNegElevation_Waypoint_1 );
_mNAVI_CurrData_AR.Navi_EstimatedDur_Waypoint_1.phys = getValue( HMI_Navi_EstimatedDur_Waypoint_1 );
_mNAVI_CurrData_AR.EngyAvl_Gasoline_Waypoint_1.phys = getValue( HMI_EngyAvl_Gasoline_Waypoint_1 );
_mNAVI_CurrData_AR.EngyAvl_Diesel_Waypoint_1.phys = getValue( HMI_EngyAvl_Diesel_Waypoint_1 );
_mNAVI_CurrData_AR.EngyAvl_elPwr_Waypoint_1.phys = getValue( HMI_EngyAvl_elPwr_Waypoint_1 );
_mNAVI_CurrData_AR.EngyAvl_H2_Waypoint_1.phys = getValue( HMI_EngyAvl_H2_Waypoint_1 );
_mNAVI_CurrData_AR.EngyAvl_CNG_Waypoint_1.phys = getValue( HMI_EngyAvl_CNG_Waypoint_1 );
_mNAVI_CurrData_AR.EngyAvl_LNG_Waypoint_1.phys = getValue( HMI_EngyAvl_LNG_Waypoint_1 );
_mNAVI_CurrData_AR.EngyAvl_EngyTyp1_Waypoint_1.phys = getValue( HMI_EngyAvl_EngyTyp1_Waypoint_1 );
_mNAVI_CurrData_AR.EngyAvl_EngyTyp2_Waypoint_1.phys = getValue( HMI_EngyAvl_EngyTyp2_Waypoint_1 );
_mNAVI_CurrData_AR.AccumPosElevation_Waypoint_2.phys = getValue( HMI_AccumPosElevation_Waypoint_2 );
_mNAVI_CurrData_AR.AccumNegElevation_Waypoint_2.phys = getValue( HMI_AccumNegElevation_Waypoint_2 );
_mNAVI_CurrData_AR.Navi_EstimatedDur_Waypoint_2.phys = getValue( HMI_Navi_EstimatedDur_Waypoint_2 );
_mNAVI_CurrData_AR.EngyAvl_Gasoline_Waypoint_2.phys = getValue( HMI_EngyAvl_Gasoline_Waypoint_2 );
_mNAVI_CurrData_AR.EngyAvl_Diesel_Waypoint_2.phys = getValue( HMI_EngyAvl_Diesel_Waypoint_2 );
_mNAVI_CurrData_AR.EngyAvl_elPwr_Waypoint_2.phys = getValue( HMI_EngyAvl_elPwr_Waypoint_2 );
_mNAVI_CurrData_AR.EngyAvl_H2_Waypoint_2.phys = getValue( HMI_EngyAvl_H2_Waypoint_2 );
_mNAVI_CurrData_AR.EngyAvl_CNG_Waypoint_2.phys = getValue( HMI_EngyAvl_CNG_Waypoint_2 );
_mNAVI_CurrData_AR.EngyAvl_LNG_Waypoint_2.phys = getValue( HMI_EngyAvl_LNG_Waypoint_2 );
_mNAVI_CurrData_AR.EngyAvl_EngyTyp1_Waypoint_2.phys = getValue( HMI_EngyAvl_EngyTyp1_Waypoint_2 );
_mNAVI_CurrData_AR.EngyAvl_EngyTyp2_Waypoint_2.phys = getValue( HMI_EngyAvl_EngyTyp2_Waypoint_2 );
_mNAVI_CurrData_AR.AccumPosElevation_Waypoint_3.phys = getValue( HMI_AccumPosElevation_Waypoint_3 );
_mNAVI_CurrData_AR.AccumNegElevation_Waypoint_3.phys = getValue( HMI_AccumNegElevation_Waypoint_3 );
_mNAVI_CurrData_AR.Navi_EstimatedDur_Waypoint_3.phys = getValue( HMI_Navi_EstimatedDur_Waypoint_3 );
_mNAVI_CurrData_AR.EngyAvl_Gasoline_Waypoint_3.phys = getValue( HMI_EngyAvl_Gasoline_Waypoint_3 );
_mNAVI_CurrData_AR.EngyAvl_Diesel_Waypoint_3.phys = getValue( HMI_EngyAvl_Diesel_Waypoint_3 );
_mNAVI_CurrData_AR.EngyAvl_elPwr_Waypoint_3.phys = getValue( HMI_EngyAvl_elPwr_Waypoint_3 );
_mNAVI_CurrData_AR.EngyAvl_H2_Waypoint_3.phys = getValue( HMI_EngyAvl_H2_Waypoint_3 );
_mNAVI_CurrData_AR.EngyAvl_CNG_Waypoint_3.phys = getValue( HMI_EngyAvl_CNG_Waypoint_3 );
_mNAVI_CurrData_AR.EngyAvl_LNG_Waypoint_3.phys = getValue( HMI_EngyAvl_LNG_Waypoint_3 );
_mNAVI_CurrData_AR.EngyAvl_EngyTyp1_Waypoint_3.phys = getValue( HMI_EngyAvl_EngyTyp1_Waypoint_3 );
_mNAVI_CurrData_AR.EngyAvl_EngyTyp2_Waypoint_3.phys = getValue( HMI_EngyAvl_EngyTyp2_Waypoint_3 );
_mNAVI_CurrData_AR.AccumPosElevation_Waypoint_4.phys = getValue( HMI_AccumPosElevation_Waypoint_4 );
_mNAVI_CurrData_AR.AccumNegElevation_Waypoint_4.phys = getValue( HMI_AccumNegElevation_Waypoint_4 );
_mNAVI_CurrData_AR.Navi_EstimatedDur_Waypoint_4.phys = getValue( HMI_Navi_EstimatedDur_Waypoint_4 );
_mNAVI_CurrData_AR.EngyAvl_Gasoline_Waypoint_4.phys = getValue( HMI_EngyAvl_Gasoline_Waypoint_4 );
_mNAVI_CurrData_AR.EngyAvl_Diesel_Waypoint_4.phys = getValue( HMI_EngyAvl_Diesel_Waypoint_4 );
_mNAVI_CurrData_AR.EngyAvl_elPwr_Waypoint_4.phys = getValue( HMI_EngyAvl_elPwr_Waypoint_4 );
_mNAVI_CurrData_AR.EngyAvl_H2_Waypoint_4.phys = getValue( HMI_EngyAvl_H2_Waypoint_4 );
_mNAVI_CurrData_AR.EngyAvl_CNG_Waypoint_4.phys = getValue( HMI_EngyAvl_CNG_Waypoint_4 );
_mNAVI_CurrData_AR.EngyAvl_LNG_Waypoint_4.phys = getValue( HMI_EngyAvl_LNG_Waypoint_4 );
_mNAVI_CurrData_AR.EngyAvl_EngyTyp1_Waypoint_4.phys = getValue( HMI_EngyAvl_EngyTyp1_Waypoint_4 );
_mNAVI_CurrData_AR.EngyAvl_EngyTyp2_Waypoint_4.phys = getValue( HMI_EngyAvl_EngyTyp2_Waypoint_4 );
}

NAVI_CurrData_AR_output()
{
    byte selector = 0;

    selector = getValue( HMI_NaviDistance_MdSel );
    switch( selector )
    {
        case 0: _mNAVI_CurrData_AR.NaviDistance_Destination.phys = 0; break;
        case 1: _mNAVI_CurrData_AR.NaviDistance_Destination.phys = getValue( HMI_NaviDistance_Destination ); break;
        case 2: _mNAVI_CurrData_AR.NaviDistance_Waypoint_1.phys = getValue( HMI_NaviDistance_Waypoint_1 ); break;
        case 3: _mNAVI_CurrData_AR.NaviDistance_Waypoint_2.phys = getValue( HMI_NaviDistance_Waypoint_2 ); break;
        case 4: _mNAVI_CurrData_AR.NaviDistance_Waypoint_3.phys = getValue( HMI_NaviDistance_Waypoint_3 ); break;
        case 5: _mNAVI_CurrData_AR.NaviDistance_Waypoint_4.phys = getValue( HMI_NaviDistance_Waypoint_4 ); break;
	case 6: _mNAVI_CurrData_AR.NaviDistance_Waypoint_5.phys = getValue( HMI_NaviDistance_Waypoint_5 ); break;
        default: _mNAVI_CurrData_AR.NaviDistance_Destination.phys = 0; break;
    }
    output( _mNAVI_CurrData_AR );
}

NAVI_CurrData_AR_saveEnvVars( dword hFile )
{
    filePutString("\n// Knoten TGW: NAVI_CurrData_AR\n", 26, hFile);
    snprintf( buffer, elcount(buffer), "0.0000 HMI__STMSG_NAVI_CurrData_AR := %X\n", getValue( HMI__STMSG_NAVI_CurrData_AR ) );        filePutString( buffer, elcount(buffer), hFile);
    snprintf( buffer, elcount(buffer), "0.0000 HMI__STMSGT_NAVI_CurrData_AR := %X\n", getValue( HMI__STMSGT_NAVI_CurrData_AR ) );        filePutString( buffer, elcount(buffer), hFile);
    snprintf( buffer, elcount(buffer), "0.0000 HMI_NaviDistance_MdSel := %X\n", getValue( HMI_NaviDistance_MdSel ) );        filePutString( buffer, elcount(buffer), hFile);
    snprintf( buffer, elcount(buffer), "0.0000 HMI_NaviDistance_Destination := %X\n", getValue( HMI_NaviDistance_Destination ) );        filePutString( buffer, elcount(buffer), hFile);
    snprintf( buffer, elcount(buffer), "0.0000 HMI_NaviDistance_Waypoint_1 := %X\n", getValue( HMI_NaviDistance_Waypoint_1 ) );        filePutString( buffer, elcount(buffer), hFile);
    snprintf( buffer, elcount(buffer), "0.0000 HMI_NaviDistance_Waypoint_2 := %X\n", getValue( HMI_NaviDistance_Waypoint_2 ) );        filePutString( buffer, elcount(buffer), hFile);
    snprintf( buffer, elcount(buffer), "0.0000 HMI_NaviDistance_Waypoint_3 := %X\n", getValue( HMI_NaviDistance_Waypoint_3 ) );        filePutString( buffer, elcount(buffer), hFile);
    snprintf( buffer, elcount(buffer), "0.0000 HMI_NaviDistance_Waypoint_4 := %X\n", getValue( HMI_NaviDistance_Waypoint_4 ) );        filePutString( buffer, elcount(buffer), hFile);
    snprintf( buffer, elcount(buffer), "0.0000 HMI_NaviDistance_Waypoint_5 := %X\n", getValue( HMI_NaviDistance_Waypoint_5 ) );        filePutString( buffer, elcount(buffer), hFile);
	snprintf( buffer, elcount(buffer), "0.0000 HMI_AccumPosElevation_Destination := %X\n", getValue( HMI_AccumPosElevation_Destination  ) );        filePutString( buffer, elcount(buffer), hFile);
snprintf( buffer, elcount(buffer), "0.0000 HMI_AccumNegElevation_Destination := %X\n", getValue( HMI_AccumNegElevation_Destination  ) );        filePutString( buffer, elcount(buffer), hFile);
snprintf( buffer, elcount(buffer), "0.0000 HMI_Navi_EstimatedDur_Destination := %X\n", getValue( HMI_Navi_EstimatedDur_Destination  ) );        filePutString( buffer, elcount(buffer), hFile);
snprintf( buffer, elcount(buffer), "0.0000 HMI_EngyAvl_Gasoline_Destination := %X\n", getValue( HMI_EngyAvl_Gasoline_Destination  ) );        filePutString( buffer, elcount(buffer), hFile);
snprintf( buffer, elcount(buffer), "0.0000 HMI_EngyAvl_Diesel_Destination := %X\n", getValue( HMI_EngyAvl_Diesel_Destination  ) );        filePutString( buffer, elcount(buffer), hFile);
snprintf( buffer, elcount(buffer), "0.0000 HMI_EngyAvl_elPwr_Destination := %X\n", getValue( HMI_EngyAvl_elPwr_Destination  ) );        filePutString( buffer, elcount(buffer), hFile);
snprintf( buffer, elcount(buffer), "0.0000 HMI_EngyAvl_H2_Destination := %X\n", getValue( HMI_EngyAvl_H2_Destination  ) );        filePutString( buffer, elcount(buffer), hFile);
snprintf( buffer, elcount(buffer), "0.0000 HMI_EngyAvl_CNG_Destination := %X\n", getValue( HMI_EngyAvl_CNG_Destination  ) );        filePutString( buffer, elcount(buffer), hFile);
snprintf( buffer, elcount(buffer), "0.0000 HMI_EngyAvl_LNG_Destination := %X\n", getValue( HMI_EngyAvl_LNG_Destination  ) );        filePutString( buffer, elcount(buffer), hFile);
snprintf( buffer, elcount(buffer), "0.0000 HMI_EngyAvl_EngyTyp1_Destination := %X\n", getValue( HMI_EngyAvl_EngyTyp1_Destination  ) );        filePutString( buffer, elcount(buffer), hFile);
snprintf( buffer, elcount(buffer), "0.0000 HMI_EngyAvl_EngyTyp2_Destination := %X\n", getValue( HMI_EngyAvl_EngyTyp2_Destination  ) );        filePutString( buffer, elcount(buffer), hFile);
snprintf( buffer, elcount(buffer), "0.0000 HMI_AccumPosElevation_Waypoint_1 := %X\n", getValue( HMI_AccumPosElevation_Waypoint_1  ) );        filePutString( buffer, elcount(buffer), hFile);
snprintf( buffer, elcount(buffer), "0.0000 HMI_AccumNegElevation_Waypoint_1 := %X\n", getValue( HMI_AccumNegElevation_Waypoint_1  ) );        filePutString( buffer, elcount(buffer), hFile);
snprintf( buffer, elcount(buffer), "0.0000 HMI_Navi_EstimatedDur_Waypoint_1 := %X\n", getValue( HMI_Navi_EstimatedDur_Waypoint_1  ) );        filePutString( buffer, elcount(buffer), hFile);
snprintf( buffer, elcount(buffer), "0.0000 HMI_EngyAvl_Gasoline_Waypoint_1 := %X\n", getValue( HMI_EngyAvl_Gasoline_Waypoint_1  ) );        filePutString( buffer, elcount(buffer), hFile);
snprintf( buffer, elcount(buffer), "0.0000 HMI_EngyAvl_Diesel_Waypoint_1 := %X\n", getValue( HMI_EngyAvl_Diesel_Waypoint_1  ) );        filePutString( buffer, elcount(buffer), hFile);
snprintf( buffer, elcount(buffer), "0.0000 HMI_EngyAvl_elPwr_Waypoint_1 := %X\n", getValue( HMI_EngyAvl_elPwr_Waypoint_1  ) );        filePutString( buffer, elcount(buffer), hFile);
snprintf( buffer, elcount(buffer), "0.0000 HMI_EngyAvl_H2_Waypoint_1 := %X\n", getValue( HMI_EngyAvl_H2_Waypoint_1  ) );        filePutString( buffer, elcount(buffer), hFile);
snprintf( buffer, elcount(buffer), "0.0000 HMI_EngyAvl_CNG_Waypoint_1 := %X\n", getValue( HMI_EngyAvl_CNG_Waypoint_1  ) );        filePutString( buffer, elcount(buffer), hFile);
snprintf( buffer, elcount(buffer), "0.0000 HMI_EngyAvl_LNG_Waypoint_1 := %X\n", getValue( HMI_EngyAvl_LNG_Waypoint_1  ) );        filePutString( buffer, elcount(buffer), hFile);
snprintf( buffer, elcount(buffer), "0.0000 HMI_EngyAvl_EngyTyp1_Waypoint_1 := %X\n", getValue( HMI_EngyAvl_EngyTyp1_Waypoint_1  ) );        filePutString( buffer, elcount(buffer), hFile);
snprintf( buffer, elcount(buffer), "0.0000 HMI_EngyAvl_EngyTyp2_Waypoint_1 := %X\n", getValue( HMI_EngyAvl_EngyTyp2_Waypoint_1  ) );        filePutString( buffer, elcount(buffer), hFile);
snprintf( buffer, elcount(buffer), "0.0000 HMI_AccumPosElevation_Waypoint_2 := %X\n", getValue( HMI_AccumPosElevation_Waypoint_2  ) );        filePutString( buffer, elcount(buffer), hFile);
snprintf( buffer, elcount(buffer), "0.0000 HMI_AccumNegElevation_Waypoint_2 := %X\n", getValue( HMI_AccumNegElevation_Waypoint_2  ) );        filePutString( buffer, elcount(buffer), hFile);
snprintf( buffer, elcount(buffer), "0.0000 HMI_Navi_EstimatedDur_Waypoint_2 := %X\n", getValue( HMI_Navi_EstimatedDur_Waypoint_2  ) );        filePutString( buffer, elcount(buffer), hFile);
snprintf( buffer, elcount(buffer), "0.0000 HMI_EngyAvl_Gasoline_Waypoint_2 := %X\n", getValue( HMI_EngyAvl_Gasoline_Waypoint_2  ) );        filePutString( buffer, elcount(buffer), hFile);
snprintf( buffer, elcount(buffer), "0.0000 HMI_EngyAvl_Diesel_Waypoint_2 := %X\n", getValue( HMI_EngyAvl_Diesel_Waypoint_2  ) );        filePutString( buffer, elcount(buffer), hFile);
snprintf( buffer, elcount(buffer), "0.0000 HMI_EngyAvl_elPwr_Waypoint_2 := %X\n", getValue( HMI_EngyAvl_elPwr_Waypoint_2  ) );        filePutString( buffer, elcount(buffer), hFile);
snprintf( buffer, elcount(buffer), "0.0000 HMI_EngyAvl_H2_Waypoint_2 := %X\n", getValue( HMI_EngyAvl_H2_Waypoint_2  ) );        filePutString( buffer, elcount(buffer), hFile);
snprintf( buffer, elcount(buffer), "0.0000 HMI_EngyAvl_CNG_Waypoint_2 := %X\n", getValue( HMI_EngyAvl_CNG_Waypoint_2  ) );        filePutString( buffer, elcount(buffer), hFile);
snprintf( buffer, elcount(buffer), "0.0000 HMI_EngyAvl_LNG_Waypoint_2 := %X\n", getValue( HMI_EngyAvl_LNG_Waypoint_2  ) );        filePutString( buffer, elcount(buffer), hFile);
snprintf( buffer, elcount(buffer), "0.0000 HMI_EngyAvl_EngyTyp1_Waypoint_2 := %X\n", getValue( HMI_EngyAvl_EngyTyp1_Waypoint_2  ) );        filePutString( buffer, elcount(buffer), hFile);
snprintf( buffer, elcount(buffer), "0.0000 HMI_EngyAvl_EngyTyp2_Waypoint_2 := %X\n", getValue( HMI_EngyAvl_EngyTyp2_Waypoint_2  ) );        filePutString( buffer, elcount(buffer), hFile);
snprintf( buffer, elcount(buffer), "0.0000 HMI_AccumPosElevation_Waypoint_3 := %X\n", getValue( HMI_AccumPosElevation_Waypoint_3  ) );        filePutString( buffer, elcount(buffer), hFile);
snprintf( buffer, elcount(buffer), "0.0000 HMI_AccumNegElevation_Waypoint_3 := %X\n", getValue( HMI_AccumNegElevation_Waypoint_3  ) );        filePutString( buffer, elcount(buffer), hFile);
snprintf( buffer, elcount(buffer), "0.0000 HMI_Navi_EstimatedDur_Waypoint_3 := %X\n", getValue( HMI_Navi_EstimatedDur_Waypoint_3  ) );        filePutString( buffer, elcount(buffer), hFile);
snprintf( buffer, elcount(buffer), "0.0000 HMI_EngyAvl_Gasoline_Waypoint_3 := %X\n", getValue( HMI_EngyAvl_Gasoline_Waypoint_3  ) );        filePutString( buffer, elcount(buffer), hFile);
snprintf( buffer, elcount(buffer), "0.0000 HMI_EngyAvl_Diesel_Waypoint_3 := %X\n", getValue( HMI_EngyAvl_Diesel_Waypoint_3  ) );        filePutString( buffer, elcount(buffer), hFile);
snprintf( buffer, elcount(buffer), "0.0000 HMI_EngyAvl_elPwr_Waypoint_3 := %X\n", getValue( HMI_EngyAvl_elPwr_Waypoint_3  ) );        filePutString( buffer, elcount(buffer), hFile);
snprintf( buffer, elcount(buffer), "0.0000 HMI_EngyAvl_H2_Waypoint_3 := %X\n", getValue( HMI_EngyAvl_H2_Waypoint_3  ) );        filePutString( buffer, elcount(buffer), hFile);
snprintf( buffer, elcount(buffer), "0.0000 HMI_EngyAvl_CNG_Waypoint_3 := %X\n", getValue( HMI_EngyAvl_CNG_Waypoint_3  ) );        filePutString( buffer, elcount(buffer), hFile);
snprintf( buffer, elcount(buffer), "0.0000 HMI_EngyAvl_LNG_Waypoint_3 := %X\n", getValue( HMI_EngyAvl_LNG_Waypoint_3  ) );        filePutString( buffer, elcount(buffer), hFile);
snprintf( buffer, elcount(buffer), "0.0000 HMI_EngyAvl_EngyTyp1_Waypoint_3 := %X\n", getValue( HMI_EngyAvl_EngyTyp1_Waypoint_3  ) );        filePutString( buffer, elcount(buffer), hFile);
snprintf( buffer, elcount(buffer), "0.0000 HMI_EngyAvl_EngyTyp2_Waypoint_3 := %X\n", getValue( HMI_EngyAvl_EngyTyp2_Waypoint_3  ) );        filePutString( buffer, elcount(buffer), hFile);
snprintf( buffer, elcount(buffer), "0.0000 HMI_AccumPosElevation_Waypoint_4 := %X\n", getValue( HMI_AccumPosElevation_Waypoint_4  ) );        filePutString( buffer, elcount(buffer), hFile);
snprintf( buffer, elcount(buffer), "0.0000 HMI_AccumNegElevation_Waypoint_4 := %X\n", getValue( HMI_AccumNegElevation_Waypoint_4  ) );        filePutString( buffer, elcount(buffer), hFile);
snprintf( buffer, elcount(buffer), "0.0000 HMI_Navi_EstimatedDur_Waypoint_4 := %X\n", getValue( HMI_Navi_EstimatedDur_Waypoint_4  ) );        filePutString( buffer, elcount(buffer), hFile);
snprintf( buffer, elcount(buffer), "0.0000 HMI_EngyAvl_Gasoline_Waypoint_4 := %X\n", getValue( HMI_EngyAvl_Gasoline_Waypoint_4  ) );        filePutString( buffer, elcount(buffer), hFile);
snprintf( buffer, elcount(buffer), "0.0000 HMI_EngyAvl_Diesel_Waypoint_4 := %X\n", getValue( HMI_EngyAvl_Diesel_Waypoint_4  ) );        filePutString( buffer, elcount(buffer), hFile);
snprintf( buffer, elcount(buffer), "0.0000 HMI_EngyAvl_elPwr_Waypoint_4 := %X\n", getValue( HMI_EngyAvl_elPwr_Waypoint_4  ) );        filePutString( buffer, elcount(buffer), hFile);
snprintf( buffer, elcount(buffer), "0.0000 HMI_EngyAvl_H2_Waypoint_4 := %X\n", getValue( HMI_EngyAvl_H2_Waypoint_4  ) );        filePutString( buffer, elcount(buffer), hFile);
snprintf( buffer, elcount(buffer), "0.0000 HMI_EngyAvl_CNG_Waypoint_4 := %X\n", getValue( HMI_EngyAvl_CNG_Waypoint_4  ) );        filePutString( buffer, elcount(buffer), hFile);
snprintf( buffer, elcount(buffer), "0.0000 HMI_EngyAvl_LNG_Waypoint_4 := %X\n", getValue( HMI_EngyAvl_LNG_Waypoint_4  ) );        filePutString( buffer, elcount(buffer), hFile);
snprintf( buffer, elcount(buffer), "0.0000 HMI_EngyAvl_EngyTyp1_Waypoint_4 := %X\n", getValue( HMI_EngyAvl_EngyTyp1_Waypoint_4  ) );        filePutString( buffer, elcount(buffer), hFile);
snprintf( buffer, elcount(buffer), "0.0000 HMI_EngyAvl_EngyTyp2_Waypoint_4 := %X\n", getValue( HMI_EngyAvl_EngyTyp2_Waypoint_4  ) );        filePutString( buffer, elcount(buffer), hFile);
}

on timer _tNAVI_CurrData_AR
{
    putValue( HMI__STMSG_NAVI_CurrData_AR, 0 );
}

on EnvVar HMI__STMSG_NAVI_CurrData_AR
{
    long tDelay;
    if( getValue( this ) == 2 )
    {
        tDelay = getValue( HMI__STMSGT_NAVI_CurrData_AR );
        if( tDelay > 0 )    
            setTimer( _tNAVI_CurrData_AR, tDelay );
        else
            putValue( HMI__STMSG_NAVI_CurrData_AR, 0 );
    }
}

on envVar HMI__STMSG_PO_NAVI_CurrData_AR
{
    if( getValue( this ) )
        openPanel("NAVI_CurrData_AR");
}

on EnvVar HMI_NaviDistance_MdSel
{
    _mNAVI_CurrData_AR.NaviDistance_MdSel.phys = getValue(this);
    _NAVI_CurrData_AR_SpontanFlag = 1;
}

on EnvVar HMI_NaviDistance_Destination
{
    _mNAVI_CurrData_AR.NaviDistance_Destination.phys = getValue(this);
    _NAVI_CurrData_AR_SpontanFlag = 1;
}

on EnvVar HMI_NaviDistance_Waypoint_1
{
    _mNAVI_CurrData_AR.NaviDistance_Waypoint_1.phys = getValue(this);
    _NAVI_CurrData_AR_SpontanFlag = 1;
}

on EnvVar HMI_NaviDistance_Waypoint_2
{
    _mNAVI_CurrData_AR.NaviDistance_Waypoint_2.phys = getValue(this);
    _NAVI_CurrData_AR_SpontanFlag = 1;
}

on EnvVar HMI_NaviDistance_Waypoint_3
{
    _mNAVI_CurrData_AR.NaviDistance_Waypoint_3.phys = getValue(this);
    _NAVI_CurrData_AR_SpontanFlag = 1;
}

on EnvVar HMI_NaviDistance_Waypoint_4
{
    _mNAVI_CurrData_AR.NaviDistance_Waypoint_4.phys = getValue(this);
    _NAVI_CurrData_AR_SpontanFlag = 1;
}

on EnvVar HMI_NaviDistance_Waypoint_5
{
    _mNAVI_CurrData_AR.NaviDistance_Waypoint_5.phys = getValue(this);
    _NAVI_CurrData_AR_SpontanFlag = 1;
}

on EnvVar HMI_AccumPosElevation_Destination	
{			
	_mNAVI_CurrData_AR.AccumPosElevation_Destination.phys = getValue(this);
	_NAVI_CurrData_AR_SpontanFlag = 1;		
}			
			
on EnvVar HMI_AccumNegElevation_Destination	
{			
	_mNAVI_CurrData_AR.AccumNegElevation_Destination.phys = getValue(this);
	_NAVI_CurrData_AR_SpontanFlag = 1;		
}			
			
on EnvVar HMI_Navi_EstimatedDur_Destination	
{			
	_mNAVI_CurrData_AR.Navi_EstimatedDur_Destination.phys = getValue(this);
	_NAVI_CurrData_AR_SpontanFlag = 1;		
}			
			
on EnvVar HMI_EngyAvl_Gasoline_Destination	
{			
	_mNAVI_CurrData_AR.EngyAvl_Gasoline_Destination.phys = getValue(this);
	_NAVI_CurrData_AR_SpontanFlag = 1;		
}			
			
on EnvVar HMI_EngyAvl_Diesel_Destination	
{			
	_mNAVI_CurrData_AR.EngyAvl_Diesel_Destination.phys = getValue(this);
	_NAVI_CurrData_AR_SpontanFlag = 1;		
}			
			
on EnvVar HMI_EngyAvl_elPwr_Destination	
{			
	_mNAVI_CurrData_AR.EngyAvl_elPwr_Destination.phys = getValue(this);
	_NAVI_CurrData_AR_SpontanFlag = 1;		
}			
			
on EnvVar HMI_EngyAvl_H2_Destination	
{			
	_mNAVI_CurrData_AR.EngyAvl_H2_Destination.phys = getValue(this);
	_NAVI_CurrData_AR_SpontanFlag = 1;		
}			
			
on EnvVar HMI_EngyAvl_CNG_Destination	
{			
	_mNAVI_CurrData_AR.EngyAvl_CNG_Destination.phys = getValue(this);
	_NAVI_CurrData_AR_SpontanFlag = 1;		
}			
			
on EnvVar HMI_EngyAvl_LNG_Destination	
{			
	_mNAVI_CurrData_AR.EngyAvl_LNG_Destination.phys = getValue(this);
	_NAVI_CurrData_AR_SpontanFlag = 1;		
}			
			
on EnvVar HMI_EngyAvl_EngyTyp1_Destination	
{			
	_mNAVI_CurrData_AR.EngyAvl_EngyTyp1_Destination.phys = getValue(this);
	_NAVI_CurrData_AR_SpontanFlag = 1;		
}			
			
on EnvVar HMI_EngyAvl_EngyTyp2_Destination	
{			
	_mNAVI_CurrData_AR.EngyAvl_EngyTyp2_Destination.phys = getValue(this);
	_NAVI_CurrData_AR_SpontanFlag = 1;		
}			
			
on EnvVar HMI_AccumPosElevation_Waypoint_1	
{			
	_mNAVI_CurrData_AR.AccumPosElevation_Waypoint_1.phys = getValue(this);
	_NAVI_CurrData_AR_SpontanFlag = 1;		
}			
			
on EnvVar HMI_AccumNegElevation_Waypoint_1	
{			
	_mNAVI_CurrData_AR.AccumNegElevation_Waypoint_1.phys = getValue(this);
	_NAVI_CurrData_AR_SpontanFlag = 1;		
}			
			
on EnvVar HMI_EngyAvl_Gasoline_Waypoint_1	
{			
	_mNAVI_CurrData_AR.EngyAvl_Gasoline_Waypoint_1.phys = getValue(this);
	_NAVI_CurrData_AR_SpontanFlag = 1;		
}			
			
on EnvVar HMI_EngyAvl_Diesel_Waypoint_1	
{			
	_mNAVI_CurrData_AR.EngyAvl_Diesel_Waypoint_1.phys = getValue(this);
	_NAVI_CurrData_AR_SpontanFlag = 1;		
}			
			
on EnvVar HMI_EngyAvl_elPwr_Waypoint_1	
{			
	_mNAVI_CurrData_AR.EngyAvl_elPwr_Waypoint_1.phys = getValue(this);
	_NAVI_CurrData_AR_SpontanFlag = 1;		
}			
			
on EnvVar HMI_EngyAvl_H2_Waypoint_1	
{			
	_mNAVI_CurrData_AR.EngyAvl_H2_Waypoint_1.phys = getValue(this);
	_NAVI_CurrData_AR_SpontanFlag = 1;		
}			
			
on EnvVar HMI_EngyAvl_CNG_Waypoint_1	
{			
	_mNAVI_CurrData_AR.EngyAvl_CNG_Waypoint_1.phys = getValue(this);
	_NAVI_CurrData_AR_SpontanFlag = 1;		
}			
			
on EnvVar HMI_EngyAvl_LNG_Waypoint_1	
{			
	_mNAVI_CurrData_AR.EngyAvl_LNG_Waypoint_1.phys = getValue(this);
	_NAVI_CurrData_AR_SpontanFlag = 1;		
}			
			
on EnvVar HMI_EngyAvl_EngyTyp1_Waypoint_1	
{			
	_mNAVI_CurrData_AR.EngyAvl_EngyTyp1_Waypoint_1.phys = getValue(this);
	_NAVI_CurrData_AR_SpontanFlag = 1;		
}			
			
on EnvVar HMI_EngyAvl_EngyTyp2_Waypoint_1	
{			
	_mNAVI_CurrData_AR.EngyAvl_EngyTyp2_Waypoint_1.phys = getValue(this);
	_NAVI_CurrData_AR_SpontanFlag = 1;		
}			
			
on EnvVar HMI_AccumPosElevation_Waypoint_2	
{			
	_mNAVI_CurrData_AR.AccumPosElevation_Waypoint_2.phys = getValue(this);
	_NAVI_CurrData_AR_SpontanFlag = 1;		
}			
			
on EnvVar HMI_AccumNegElevation_Waypoint_2	
{			
	_mNAVI_CurrData_AR.AccumNegElevation_Waypoint_2.phys = getValue(this);
	_NAVI_CurrData_AR_SpontanFlag = 1;		
}			
			
on EnvVar HMI_Navi_EstimatedDur_Waypoint_2	
{			
	_mNAVI_CurrData_AR.Navi_EstimatedDur_Waypoint_2.phys = getValue(this);
	_NAVI_CurrData_AR_SpontanFlag = 1;		
}			
			
on EnvVar HMI_EngyAvl_Gasoline_Waypoint_2	
{			
	_mNAVI_CurrData_AR.EngyAvl_Gasoline_Waypoint_2.phys = getValue(this);
	_NAVI_CurrData_AR_SpontanFlag = 1;		
}			
			
on EnvVar HMI_EngyAvl_Diesel_Waypoint_2	
{			
	_mNAVI_CurrData_AR.EngyAvl_Diesel_Waypoint_2.phys = getValue(this);
	_NAVI_CurrData_AR_SpontanFlag = 1;		
}			
			
on EnvVar HMI_EngyAvl_elPwr_Waypoint_2	
{			
	_mNAVI_CurrData_AR.EngyAvl_elPwr_Waypoint_2.phys = getValue(this);
	_NAVI_CurrData_AR_SpontanFlag = 1;		
}			
			
on EnvVar HMI_EngyAvl_H2_Waypoint_2	
{			
	_mNAVI_CurrData_AR.EngyAvl_H2_Waypoint_2.phys = getValue(this);
	_NAVI_CurrData_AR_SpontanFlag = 1;		
}			
			
on EnvVar HMI_EngyAvl_CNG_Waypoint_2	
{			
	_mNAVI_CurrData_AR.EngyAvl_CNG_Waypoint_2.phys = getValue(this);
	_NAVI_CurrData_AR_SpontanFlag = 1;		
}			
			
on EnvVar HMI_EngyAvl_LNG_Waypoint_2	
{			
	_mNAVI_CurrData_AR.EngyAvl_LNG_Waypoint_2.phys = getValue(this);
	_NAVI_CurrData_AR_SpontanFlag = 1;		
}			
			
on EnvVar HMI_EngyAvl_EngyTyp1_Waypoint_2	
{			
	_mNAVI_CurrData_AR.EngyAvl_EngyTyp1_Waypoint_2.phys = getValue(this);
	_NAVI_CurrData_AR_SpontanFlag = 1;		
}			
			
on EnvVar HMI_EngyAvl_EngyTyp2_Waypoint_2	
{			
	_mNAVI_CurrData_AR.EngyAvl_EngyTyp2_Waypoint_2.phys = getValue(this);
	_NAVI_CurrData_AR_SpontanFlag = 1;		
}			
			
on EnvVar HMI_AccumPosElevation_Waypoint_3	
{			
	_mNAVI_CurrData_AR.AccumPosElevation_Waypoint_3.phys = getValue(this);
	_NAVI_CurrData_AR_SpontanFlag = 1;		
}			
			
on EnvVar HMI_AccumNegElevation_Waypoint_3	
{			
	_mNAVI_CurrData_AR.AccumNegElevation_Waypoint_3.phys = getValue(this);
	_NAVI_CurrData_AR_SpontanFlag = 1;		
}			
			
on EnvVar HMI_Navi_EstimatedDur_Waypoint_3	
{			
	_mNAVI_CurrData_AR.Navi_EstimatedDur_Waypoint_3.phys = getValue(this);
	_NAVI_CurrData_AR_SpontanFlag = 1;		
}			
			
on EnvVar HMI_EngyAvl_Gasoline_Waypoint_3	
{			
	_mNAVI_CurrData_AR.EngyAvl_Gasoline_Waypoint_3.phys = getValue(this);
	_NAVI_CurrData_AR_SpontanFlag = 1;		
}			
			
on EnvVar HMI_EngyAvl_Diesel_Waypoint_3	
{			
	_mNAVI_CurrData_AR.EngyAvl_Diesel_Waypoint_3.phys = getValue(this);
	_NAVI_CurrData_AR_SpontanFlag = 1;		
}			
			
on EnvVar HMI_EngyAvl_elPwr_Waypoint_3	
{			
	_mNAVI_CurrData_AR.EngyAvl_elPwr_Waypoint_3.phys = getValue(this);
	_NAVI_CurrData_AR_SpontanFlag = 1;		
}			
			
on EnvVar HMI_EngyAvl_H2_Waypoint_3	
{			
	_mNAVI_CurrData_AR.EngyAvl_H2_Waypoint_3.phys = getValue(this);
	_NAVI_CurrData_AR_SpontanFlag = 1;		
}			
			
on EnvVar HMI_EngyAvl_CNG_Waypoint_3	
{			
	_mNAVI_CurrData_AR.EngyAvl_CNG_Waypoint_3.phys = getValue(this);
	_NAVI_CurrData_AR_SpontanFlag = 1;		
}			
			
on EnvVar HMI_EngyAvl_LNG_Waypoint_3	
{			
	_mNAVI_CurrData_AR.EngyAvl_LNG_Waypoint_3.phys = getValue(this);
	_NAVI_CurrData_AR_SpontanFlag = 1;		
}			
			
on EnvVar HMI_EngyAvl_EngyTyp1_Waypoint_3	
{			
	_mNAVI_CurrData_AR.EngyAvl_EngyTyp1_Waypoint_3.phys = getValue(this);
	_NAVI_CurrData_AR_SpontanFlag = 1;		
}			
			
on EnvVar HMI_EngyAvl_EngyTyp2_Waypoint_3	
{			
	_mNAVI_CurrData_AR.EngyAvl_EngyTyp2_Waypoint_3.phys = getValue(this);
	_NAVI_CurrData_AR_SpontanFlag = 1;		
}			
			
on EnvVar HMI_AccumPosElevation_Waypoint_4	
{			
	_mNAVI_CurrData_AR.AccumPosElevation_Waypoint_4.phys = getValue(this);
	_NAVI_CurrData_AR_SpontanFlag = 1;		
}			
			
on EnvVar HMI_AccumNegElevation_Waypoint_4	
{			
	_mNAVI_CurrData_AR.AccumNegElevation_Waypoint_4.phys = getValue(this);
	_NAVI_CurrData_AR_SpontanFlag = 1;		
}			
			
on EnvVar HMI_Navi_EstimatedDur_Waypoint_4	
{			
	_mNAVI_CurrData_AR.Navi_EstimatedDur_Waypoint_4.phys = getValue(this);
	_NAVI_CurrData_AR_SpontanFlag = 1;		
}			
			
on EnvVar HMI_EngyAvl_Gasoline_Waypoint_4	
{			
	_mNAVI_CurrData_AR.EngyAvl_Gasoline_Waypoint_4.phys = getValue(this);
	_NAVI_CurrData_AR_SpontanFlag = 1;		
}			
			
on EnvVar HMI_EngyAvl_Diesel_Waypoint_4	
{			
	_mNAVI_CurrData_AR.EngyAvl_Diesel_Waypoint_4.phys = getValue(this);
	_NAVI_CurrData_AR_SpontanFlag = 1;		
}			
			
on EnvVar HMI_EngyAvl_elPwr_Waypoint_4	
{			
	_mNAVI_CurrData_AR.EngyAvl_elPwr_Waypoint_4.phys = getValue(this);
	_NAVI_CurrData_AR_SpontanFlag = 1;		
}			
			
on EnvVar HMI_EngyAvl_H2_Waypoint_4	
{			
	_mNAVI_CurrData_AR.EngyAvl_H2_Waypoint_4.phys = getValue(this);
	_NAVI_CurrData_AR_SpontanFlag = 1;		
}			
			
on EnvVar HMI_EngyAvl_CNG_Waypoint_4	
{			
	_mNAVI_CurrData_AR.EngyAvl_CNG_Waypoint_4.phys = getValue(this);
	_NAVI_CurrData_AR_SpontanFlag = 1;		
}			
			
on EnvVar HMI_EngyAvl_LNG_Waypoint_4	
{			
	_mNAVI_CurrData_AR.EngyAvl_LNG_Waypoint_4.phys = getValue(this);
	_NAVI_CurrData_AR_SpontanFlag = 1;		
}			
			
on EnvVar HMI_EngyAvl_EngyTyp1_Waypoint_4	
{			
	_mNAVI_CurrData_AR.EngyAvl_EngyTyp1_Waypoint_4.phys = getValue(this);
	_NAVI_CurrData_AR_SpontanFlag = 1;		
}			
			
on EnvVar HMI_EngyAvl_EngyTyp2_Waypoint_4	
{			
	_mNAVI_CurrData_AR.EngyAvl_EngyTyp2_Waypoint_4.phys = getValue(this);
	_NAVI_CurrData_AR_SpontanFlag = 1;		
}			

NAVI_Dest_AR_check_output()
{
    if( !getValue( HMI__STMSG_NAVI_Dest_AR ) )
    {
        // Botschaft NAVI_Dest_AR ID: 1192 --- Sendeart 0 cyclicX --- 
        _NAVI_Dest_AR_Cnt--;
        if( _NAVI_Dest_AR_Cnt < 1 )
        {
            NAVI_Dest_AR_output(); // Nachricht wg. abgelaufenem Zyklus ausgeben
            _NAVI_Dest_AR_Cnt = _NAVI_Dest_AR_CycleCount; // Zyklus-Zähler zurücksetzen
        }
    }
}

NAVI_Dest_AR_init()
{   /* Botschaft NAVI_Dest_AR ID: 1192 --- Sendeart 0 cyclicX --- 
BA_ "ApplMessage" BO_ 1192 0;
BA_ "NmAsrMessage" BO_ 1192 0;
BA_ "GenMsgMinAcceptLength" BO_ 1192 8;
BA_ "GenMsgILSupport" BO_ 1192 0;
BA_ "DiagState" BO_ 1192 0;
BA_ "DiagRequest" BO_ 1192 0;
BA_ "DiagResponse" BO_ 1192 0;
BA_ "GenMsgStartValue" BO_ 1192 "0";
BA_ "GenMsgStartDelayTime" BO_ 1192 215;
BA_ "GenMsgCycleTime" BO_ 1192 1000;
BA_ "GenMsgSendType" BO_ 1192 0;
    */
    _NAVI_Dest_AR_Timebase =        c_tDBKomTimer_20ms;
    _NAVI_Dest_AR_CycleCount =   1000 / _NAVI_Dest_AR_Timebase;
    _NAVI_Dest_AR_StartDelay =    215 / _NAVI_Dest_AR_Timebase;
    _NAVI_Dest_AR_Cnt = _NAVI_Dest_AR_StartDelay;

    putValue( HMI__STMSGSD_NAVI_Dest_AR, _NAVI_Dest_AR_StartDelay * _NAVI_Dest_AR_Timebase );

    _mNAVI_Dest_AR.NaviDest_MdSel.phys = getValue( HMI_NaviDest_MdSel );
    _mNAVI_Dest_AR.NaviDest_Lat_1.phys = getValue( HMI_NaviDest_Lat_1 );
    _mNAVI_Dest_AR.NaviDest_Long_1.phys = getValue( HMI_NaviDest_Long_1 );
    _mNAVI_Dest_AR.NaviDest_Lat_2.phys = getValue( HMI_NaviDest_Lat_2 );
    _mNAVI_Dest_AR.NaviDest_Long_2.phys = getValue( HMI_NaviDest_Long_2 );
    _mNAVI_Dest_AR.NaviDest_Lat_3.phys = getValue( HMI_NaviDest_Lat_3 );
    _mNAVI_Dest_AR.NaviDest_Long_3.phys = getValue( HMI_NaviDest_Long_3 );
    _mNAVI_Dest_AR.NaviDest_Lat_4.phys = getValue( HMI_NaviDest_Lat_4 );
    _mNAVI_Dest_AR.NaviDest_Long_4.phys = getValue( HMI_NaviDest_Long_4 );
    _mNAVI_Dest_AR.NaviDest_Lat_5.phys = getValue( HMI_NaviDest_Lat_5 );
    _mNAVI_Dest_AR.NaviDest_Long_5.phys = getValue( HMI_NaviDest_Long_5 );
    _mNAVI_Dest_AR.NaviDest_Lat_6.phys = getValue( HMI_NaviDest_Lat_6 );
    _mNAVI_Dest_AR.NaviDest_Long_6.phys = getValue( HMI_NaviDest_Long_6 );
}

NAVI_Dest_AR_output()
{
/*    select( getValue( HMI_NaviDest_MdSel ) )
    {
    case 1: 
    }
    BO_ 1192 NAVI_Dest_AR : 8 TGW
 SG_ NaviDest_MdSel
 SG_ NaviDest_Lat_1
 SG_ NaviDest_Long_1
 SG_ NaviDest_Lat_2
 SG_ NaviDest_Long_2
 SG_ NaviDest_Lat_3
 SG_ NaviDest_Long_3
 SG_ NaviDest_Lat_4
 SG_ NaviDest_Long_4
 SG_ NaviDest_Lat_5
 SG_ NaviDest_Long_5
 SG_ NaviDest_Lat_6
 SG_ NaviDest_Long_6


*/
    output ( _mNAVI_Dest_AR );
}

NAVI_Dest_AR_saveEnvVars( dword hFile )
{
    filePutString("\n// Knoten TGW: NAVI_Dest_AR\n", 26, hFile);
    snprintf( buffer, elcount(buffer), "0.0000 HMI__STMSG_NAVI_Dest_AR := %X\n", getValue( HMI__STMSG_NAVI_Dest_AR ) );        filePutString( buffer, elcount(buffer), hFile);
    snprintf( buffer, elcount(buffer), "0.0000 HMI__STMSGT_NAVI_Dest_AR := %X\n", getValue( HMI__STMSGT_NAVI_Dest_AR ) );        filePutString( buffer, elcount(buffer), hFile);
    snprintf( buffer, elcount(buffer), "0.0000 HMI_NaviDest_MdSel := %X\n", getValue( HMI_NaviDest_MdSel ) );        filePutString( buffer, elcount(buffer), hFile);
    snprintf( buffer, elcount(buffer), "0.0000 HMI_NaviDest_Lat_1 := %X\n", getValue( HMI_NaviDest_Lat_1 ) );        filePutString( buffer, elcount(buffer), hFile);
    snprintf( buffer, elcount(buffer), "0.0000 HMI_NaviDest_Long_1 := %X\n", getValue( HMI_NaviDest_Long_1 ) );        filePutString( buffer, elcount(buffer), hFile);
    snprintf( buffer, elcount(buffer), "0.0000 HMI_NaviDest_Lat_2 := %X\n", getValue( HMI_NaviDest_Lat_2 ) );        filePutString( buffer, elcount(buffer), hFile);
    snprintf( buffer, elcount(buffer), "0.0000 HMI_NaviDest_Long_2 := %X\n", getValue( HMI_NaviDest_Long_2 ) );        filePutString( buffer, elcount(buffer), hFile);
    snprintf( buffer, elcount(buffer), "0.0000 HMI_NaviDest_Lat_3 := %X\n", getValue( HMI_NaviDest_Lat_3 ) );        filePutString( buffer, elcount(buffer), hFile);
    snprintf( buffer, elcount(buffer), "0.0000 HMI_NaviDest_Long_3 := %X\n", getValue( HMI_NaviDest_Long_3 ) );        filePutString( buffer, elcount(buffer), hFile);
    snprintf( buffer, elcount(buffer), "0.0000 HMI_NaviDest_Lat_4 := %X\n", getValue( HMI_NaviDest_Lat_4 ) );        filePutString( buffer, elcount(buffer), hFile);
    snprintf( buffer, elcount(buffer), "0.0000 HMI_NaviDest_Long_4 := %X\n", getValue( HMI_NaviDest_Long_4 ) );        filePutString( buffer, elcount(buffer), hFile);
    snprintf( buffer, elcount(buffer), "0.0000 HMI_NaviDest_Lat_5 := %X\n", getValue( HMI_NaviDest_Lat_5 ) );        filePutString( buffer, elcount(buffer), hFile);
    snprintf( buffer, elcount(buffer), "0.0000 HMI_NaviDest_Long_5 := %X\n", getValue( HMI_NaviDest_Long_5 ) );        filePutString( buffer, elcount(buffer), hFile);
    snprintf( buffer, elcount(buffer), "0.0000 HMI_NaviDest_Lat_6 := %X\n", getValue( HMI_NaviDest_Lat_6 ) );        filePutString( buffer, elcount(buffer), hFile);
    snprintf( buffer, elcount(buffer), "0.0000 HMI_NaviDest_Long_6 := %X\n", getValue( HMI_NaviDest_Long_6 ) );        filePutString( buffer, elcount(buffer), hFile);
}

on timer _tNAVI_Dest_AR
{
    putValue( HMI__STMSG_NAVI_Dest_AR, 0 );
}

on EnvVar HMI__STMSG_NAVI_Dest_AR
{
    long tDelay;
    if( getValue( this ) == 2 )
    {
        tDelay = getValue( HMI__STMSGT_NAVI_Dest_AR );
        if( tDelay > 0 )    
            setTimer( _tNAVI_Dest_AR, tDelay );
        else
            putValue( HMI__STMSG_NAVI_Dest_AR, 0 );
    }
}

on envVar HMI__STMSG_PO_NAVI_Dest_AR
{
    if( getValue( this ) )
        openPanel("NAVI_Dest_AR");
}

on EnvVar HMI_NaviDest_MdSel
{
    _mNAVI_Dest_AR.NaviDest_MdSel.phys = getValue(this);
}

on EnvVar HMI_NaviDest_Lat_1
{
    _mNAVI_Dest_AR.NaviDest_Lat_1.phys = getValue(this);
}

on EnvVar HMI_NaviDest_Long_1
{
    _mNAVI_Dest_AR.NaviDest_Long_1.phys = getValue(this);
}

on EnvVar HMI_NaviDest_Lat_2
{
    _mNAVI_Dest_AR.NaviDest_Lat_2.phys = getValue(this);
}

on EnvVar HMI_NaviDest_Long_2
{
    _mNAVI_Dest_AR.NaviDest_Long_2.phys = getValue(this);
}

on EnvVar HMI_NaviDest_Lat_3
{
    _mNAVI_Dest_AR.NaviDest_Lat_3.phys = getValue(this);
}

on EnvVar HMI_NaviDest_Long_3
{
    _mNAVI_Dest_AR.NaviDest_Long_3.phys = getValue(this);
}

on EnvVar HMI_NaviDest_Lat_4
{
    _mNAVI_Dest_AR.NaviDest_Lat_4.phys = getValue(this);
}

on EnvVar HMI_NaviDest_Long_4
{
    _mNAVI_Dest_AR.NaviDest_Long_4.phys = getValue(this);
}

on EnvVar HMI_NaviDest_Lat_5
{
    _mNAVI_Dest_AR.NaviDest_Lat_5.phys = getValue(this);
}

on EnvVar HMI_NaviDest_Long_5
{
    _mNAVI_Dest_AR.NaviDest_Long_5.phys = getValue(this);
}

on EnvVar HMI_NaviDest_Lat_6
{
    _mNAVI_Dest_AR.NaviDest_Lat_6.phys = getValue(this);
}

on EnvVar HMI_NaviDest_Long_6
{
    _mNAVI_Dest_AR.NaviDest_Long_6.phys = getValue(this);
}

NAVI_Pos1_AR_check_output()
{
    if( !getValue( HMI__STMSG_NAVI_Pos1_AR))
    {
        // Botschaft NAVI_Pos1_AR ID: 1003 --- Sendeart 0 cyclicX --- 
        _NAVI_Pos1_AR_Cnt--;
        if( _NAVI_Pos1_AR_Cnt < 1 )
        {
            // Nachricht wg. abgelaufenem Zyklus ausgeben
            output( _mNAVI_Pos1_AR );
            // Zyklus-Zähler zurücksetzen
            _NAVI_Pos1_AR_Cnt = _NAVI_Pos1_AR_CycleCount;
        }
    }
}

NAVI_Pos1_AR_init()
{   /* Botschaft NAVI_Pos1_AR ID: 1003 --- Sendeart 0 cyclicX --- 
BA_ "ApplMessage" BO_ 1003 0;
BA_ "NmAsrMessage" BO_ 1003 0;
BA_ "GenMsgMinAcceptLength" BO_ 1003 8;
BA_ "GenMsgILSupport" BO_ 1003 1;
BA_ "DiagState" BO_ 1003 0;
BA_ "DiagRequest" BO_ 1003 0;
BA_ "DiagResponse" BO_ 1003 0;
BA_ "GenMsgStartValue" BO_ 1003 "0";
BA_ "GenMsgStartDelayTime" BO_ 1003 270;
BA_ "GenMsgCycleTime" BO_ 1003 1000;
BA_ "GenMsgSendType" BO_ 1003 0;
    */
    _NAVI_Pos1_AR_Timebase =          c_tDBKomTimer_20ms;
    _NAVI_Pos1_AR_CycleCount =      1000 / _NAVI_Pos1_AR_Timebase;
    _NAVI_Pos1_AR_StartDelay =       270 / _NAVI_Pos1_AR_Timebase;
    _NAVI_Pos1_AR_Cnt = _NAVI_Pos1_AR_StartDelay;
    
    putValue( HMI__STMSGSD_NAVI_Pos1_AR, _NAVI_Pos1_AR_StartDelay * _NAVI_Pos1_AR_Timebase );

    _mNAVI_Pos1_AR.GPS_Lat.phys = getValue( HMI_GPS_Lat );
    _mNAVI_Pos1_AR.GPS_Long.phys = getValue( HMI_GPS_Long );
}

NAVI_Pos1_AR_saveEnvVars( dword hFile )
{
    filePutString("\n// Knoten TGW: NAVI_Pos1_AR\n", 26, hFile);
    snprintf( buffer, elcount(buffer), "0.0000 HMI__STMSG_NAVI_Pos1_AR := %X\n", getValue( HMI__STMSG_NAVI_Pos1_AR ) );        filePutString( buffer, elcount(buffer), hFile);
    snprintf( buffer, elcount(buffer), "0.0000 HMI__STMSGT_NAVI_Pos1_AR := %X\n", getValue( HMI__STMSGT_NAVI_Pos1_AR ) );        filePutString( buffer, elcount(buffer), hFile);
    snprintf( buffer, elcount(buffer), "0.0000 HMI_GPS_Lat := %X\n", getValue( HMI_GPS_Lat ) );        filePutString( buffer, elcount(buffer), hFile);
    snprintf( buffer, elcount(buffer), "0.0000 HMI_GPS_Long := %X\n", getValue( HMI_GPS_Long ) );        filePutString( buffer, elcount(buffer), hFile);
}

on timer _tNAVI_Pos1_AR
{
    putValue( HMI__STMSG_NAVI_Pos1_AR, 0 );
}

on EnvVar HMI__STMSG_NAVI_Pos1_AR
{
    long tDelay;
    if( getValue( this ) == 2 )
    {
        tDelay = getValue( HMI__STMSGT_NAVI_Pos1_AR );
        if( tDelay > 0 )    
            setTimer( _tNAVI_Pos1_AR, tDelay );
        else
            putValue( HMI__STMSG_NAVI_Pos1_AR, 0 );
    }
}

on envVar HMI__STMSG_PO_NAVI_Pos1_AR
{
    if( getValue( this ) )
        openPanel("NAVI_Pos1_AR");
}

on EnvVar HMI_GPS_Lat
{
    _mNAVI_Pos1_AR.GPS_Lat.phys = getValue(this);
}

on EnvVar HMI_GPS_Long
{
    _mNAVI_Pos1_AR.GPS_Long.phys = getValue(this);
}

NAVI_Pos2_AR_check_output()
{
    if( !getValue( HMI__STMSG_NAVI_Pos2_AR))
    {
        // Botschaft NAVI_Pos2_AR ID: 1005 --- Sendeart 0 cyclicX --- 
        _NAVI_Pos2_AR_Cnt--;
        if( _NAVI_Pos2_AR_Cnt < 1 )
        {
            // Nachricht wg. abgelaufenem Zyklus ausgeben
            output( _mNAVI_Pos2_AR );
            // Zyklus-Zähler zurücksetzen
            _NAVI_Pos2_AR_Cnt = _NAVI_Pos2_AR_CycleCount;
        }
    }
}

NAVI_Pos2_AR_init()
{   /* Botschaft NAVI_Pos2_AR ID: 1005 --- Sendeart 0 cyclicX --- 
BA_ "ApplMessage" BO_ 1005 0;
BA_ "NmAsrMessage" BO_ 1005 0;
BA_ "GenMsgMinAcceptLength" BO_ 1005 8;
BA_ "GenMsgILSupport" BO_ 1005 1;
BA_ "DiagState" BO_ 1005 0;
BA_ "DiagRequest" BO_ 1005 0;
BA_ "DiagResponse" BO_ 1005 0;
BA_ "GenMsgStartValue" BO_ 1005 "0";
BA_ "GenMsgStartDelayTime" BO_ 1005 30;
BA_ "GenMsgCycleTime" BO_ 1005 1000;
BA_ "GenMsgSendType" BO_ 1005 0;
    */
    _NAVI_Pos2_AR_Timebase =          c_tDBKomTimer_20ms;
    _NAVI_Pos2_AR_CycleCount =      1000 / _NAVI_Pos2_AR_Timebase;
    _NAVI_Pos2_AR_StartDelay =        30 / _NAVI_Pos2_AR_Timebase;
    _NAVI_Pos2_AR_Cnt = _NAVI_Pos2_AR_StartDelay;

    putValue( HMI__STMSGSD_NAVI_Pos2_AR, _NAVI_Pos2_AR_StartDelay * _NAVI_Pos2_AR_Timebase );

    _mNAVI_Pos2_AR.GPS_Alt.phys = getValue( HMI_GPS_Alt );
    _mNAVI_Pos2_AR.GPS_Ellip.phys = getValue( HMI_GPS_Ellip );
    _mNAVI_Pos2_AR.GPS_Head.phys = getValue( HMI_GPS_Head );
    _mNAVI_Pos2_AR.GPS_Vel.phys = getValue( HMI_GPS_Vel );
}

NAVI_Pos2_AR_saveEnvVars( dword hFile )
{
    filePutString("\n// Knoten TGW: NAVI_Pos2_AR\n", 26, hFile);
    snprintf( buffer, elcount(buffer), "0.0000 HMI__STMSG_NAVI_Pos2_AR := %X\n", getValue( HMI__STMSG_NAVI_Pos2_AR ));        filePutString( buffer, elcount(buffer), hFile);
    snprintf( buffer, elcount(buffer), "0.0000 HMI__STMSGT_NAVI_Pos2_AR := %X\n", getValue( HMI__STMSGT_NAVI_Pos2_AR ));        filePutString( buffer, elcount(buffer), hFile);
    snprintf( buffer, elcount(buffer), "0.0000 HMI_GPS_Alt := %X\n", getValue( HMI_GPS_Alt ) );        filePutString( buffer, elcount(buffer), hFile);
    snprintf( buffer, elcount(buffer), "0.0000 HMI_GPS_Ellip := %X\n", getValue( HMI_GPS_Ellip ) );        filePutString( buffer, elcount(buffer), hFile);
    snprintf( buffer, elcount(buffer), "0.0000 HMI_GPS_Head := %f\n", getValue( HMI_GPS_Head ) );        filePutString( buffer, elcount(buffer), hFile);
    snprintf( buffer, elcount(buffer), "0.0000 HMI_GPS_Vel := %X\n", getValue( HMI_GPS_Vel ) );        filePutString( buffer, elcount(buffer), hFile);
}

on timer _tNAVI_Pos2_AR
{
    putValue( HMI__STMSG_NAVI_Pos2_AR, 0 );
}

on EnvVar HMI__STMSG_NAVI_Pos2_AR
{
    long tDelay;
    if( getValue( this ) == 2 )
    {
        tDelay = getValue( HMI__STMSGT_NAVI_Pos2_AR );
        if( tDelay > 0 )    
            setTimer( _tNAVI_Pos2_AR, tDelay );
        else
            putValue( HMI__STMSG_NAVI_Pos2_AR, 0 );
    }
}

on envVar HMI__STMSG_PO_NAVI_Pos2_AR
{
    if( getValue( this ) )
        openPanel("NAVI_Pos2_AR");
}

on EnvVar HMI_GPS_Alt
{
    _mNAVI_Pos2_AR.GPS_Alt.phys = getValue(this);
}

on EnvVar HMI_GPS_Ellip
{
    _mNAVI_Pos2_AR.GPS_Ellip.phys = getValue(this);
}

on EnvVar HMI_GPS_Head
{
    _mNAVI_Pos2_AR.GPS_Head.phys = getValue(this);
}

on EnvVar HMI_GPS_Vel
{
    _mNAVI_Pos2_AR.GPS_Vel.phys = getValue(this);
}

NAVI_Pos3_AR_check_output()
{
    if( !getValue( HMI__STMSG_NAVI_Pos3_AR ))
    {
        // Botschaft NAVI_Pos3_AR ID: 1007 --- Sendeart 0 cyclicX --- 
        _NAVI_Pos3_AR_Cnt--;
        if( _NAVI_Pos3_AR_Cnt < 1 )
        {
            // Nachricht wg. abgelaufenem Zyklus ausgeben
            output( _mNAVI_Pos3_AR );
            // Zyklus-Zähler zurücksetzen
            _NAVI_Pos3_AR_Cnt = _NAVI_Pos3_AR_CycleCount;
        }
    }
}

NAVI_Pos3_AR_init()
{   /* Botschaft NAVI_Pos3_AR ID: 1007 --- Sendeart 0 cyclicX --- 
BA_ "ApplMessage" BO_ 1007 0;
BA_ "NmAsrMessage" BO_ 1007 0;
BA_ "GenMsgMinAcceptLength" BO_ 1007 8;
BA_ "GenMsgILSupport" BO_ 1007 1;
BA_ "DiagState" BO_ 1007 0;
BA_ "DiagRequest" BO_ 1007 0;
BA_ "DiagResponse" BO_ 1007 0;
BA_ "GenMsgStartValue" BO_ 1007 "0";
BA_ "GenMsgStartDelayTime" BO_ 1007 90;
BA_ "GenMsgCycleTime" BO_ 1007 1000;
BA_ "GenMsgSendType" BO_ 1007 0;
    */
    _NAVI_Pos3_AR_Timebase =          c_tDBKomTimer_20ms;
    _NAVI_Pos3_AR_CycleCount =      1000 / _NAVI_Pos3_AR_Timebase;
    _NAVI_Pos3_AR_StartDelay =        90 / _NAVI_Pos3_AR_Timebase;
    _NAVI_Pos3_AR_Cnt = _NAVI_Pos3_AR_StartDelay;

    putValue( HMI__STMSGSD_NAVI_Pos3_AR, _NAVI_Pos3_AR_StartDelay * _NAVI_Pos3_AR_Timebase );

    _mNAVI_Pos3_AR.GPS_Date_Day.phys = getValue( HMI_GPS_Date_Day );
    _mNAVI_Pos3_AR.GPS_Date_Month.phys = getValue( HMI_GPS_Date_Month );
    _mNAVI_Pos3_AR.GPS_Date_Year.phys = getValue( HMI_GPS_Date_Year );
    _mNAVI_Pos3_AR.GPS_UTC_Hour.phys = getValue( HMI_GPS_UTC_Hour );
    _mNAVI_Pos3_AR.GPS_UTC_Minute.phys = getValue( HMI_GPS_UTC_Minute );
    _mNAVI_Pos3_AR.GPS_UTC_Second.phys = getValue( HMI_GPS_UTC_Second );
}

NAVI_Pos3_AR_saveEnvVars( dword hFile )
{
    filePutString("\n// Knoten TGW: NAVI_Pos3_AR\n", 26, hFile);
    snprintf( buffer, elcount(buffer), "0.0000 HMI__STMSG_NAVI_Pos3_AR := %X\n", getValue( HMI__STMSG_NAVI_Pos3_AR ));        filePutString( buffer, elcount(buffer), hFile);
    snprintf( buffer, elcount(buffer), "0.0000 HMI__STMSGT_NAVI_Pos3_AR := %X\n", getValue( HMI__STMSGT_NAVI_Pos3_AR ));        filePutString( buffer, elcount(buffer), hFile);
    snprintf( buffer, elcount(buffer), "0.0000 HMI_GPS_Date_Day := %X\n", getValue( HMI_GPS_Date_Day));        filePutString( buffer, elcount(buffer), hFile);
    snprintf( buffer, elcount(buffer), "0.0000 HMI_GPS_Date_Month := %X\n", getValue( HMI_GPS_Date_Month));        filePutString( buffer, elcount(buffer), hFile);
    snprintf( buffer, elcount(buffer), "0.0000 HMI_GPS_Date_Year := %X\n", getValue( HMI_GPS_Date_Year));        filePutString( buffer, elcount(buffer), hFile);
    snprintf( buffer, elcount(buffer), "0.0000 HMI_GPS_UTC_Hour := %X\n", getValue( HMI_GPS_UTC_Hour));        filePutString( buffer, elcount(buffer), hFile);
    snprintf( buffer, elcount(buffer), "0.0000 HMI_GPS_UTC_Minute := %X\n", getValue( HMI_GPS_UTC_Minute));        filePutString( buffer, elcount(buffer), hFile);
    snprintf( buffer, elcount(buffer), "0.0000 HMI_GPS_UTC_Second := %f\n", getValue( HMI_GPS_UTC_Second));        filePutString( buffer, elcount(buffer), hFile);
}

on timer _tNAVI_Pos3_AR
{
    putValue( HMI__STMSG_NAVI_Pos3_AR, 0 );
}

on EnvVar HMI__STMSG_NAVI_Pos3_AR
{
    long tDelay;
    if( getValue( this ) == 2 )
    {
        tDelay = getValue( HMI__STMSGT_NAVI_Pos3_AR );
        if( tDelay > 0 )    
            setTimer( _tNAVI_Pos3_AR, tDelay );
        else
            putValue( HMI__STMSG_NAVI_Pos3_AR, 0 );
    }
}

on envVar HMI__STMSG_PO_NAVI_Pos3_AR
{
    if( getValue( this ) )
        openPanel("NAVI_Pos3_AR");
}

on EnvVar HMI_GPS_Date_Day
{
    _mNAVI_Pos3_AR.GPS_Date_Day.phys = getValue(this);
}

on EnvVar HMI_GPS_Date_Month
{
    _mNAVI_Pos3_AR.GPS_Date_Month.phys = getValue(this);
}

on EnvVar HMI_GPS_Date_Year
{
    _mNAVI_Pos3_AR.GPS_Date_Year.phys = getValue(this);
}

on EnvVar HMI_GPS_UTC_Hour
{
    _mNAVI_Pos3_AR.GPS_UTC_Hour.phys = getValue(this);
}

on EnvVar HMI_GPS_UTC_Minute
{
    _mNAVI_Pos3_AR.GPS_UTC_Minute.phys = getValue(this);
}

on EnvVar HMI_GPS_UTC_Second
{
    _mNAVI_Pos3_AR.GPS_UTC_Second.phys = getValue(this);
}

NAVI_Pos4_AR_check_output()
{
    if( !getValue( HMI__STMSG_NAVI_Pos4_AR ))
    {
        // Botschaft NAVI_Pos4_AR ID: 1009 --- Sendeart 0 cyclicX --- 
        _NAVI_Pos4_AR_Cnt--;
        if( _NAVI_Pos4_AR_Cnt < 1 )
        {
            // Nachricht wg. abgelaufenem Zyklus ausgeben
            output( _mNAVI_Pos4_AR );
            // Zyklus-Zähler zurücksetzen
            _NAVI_Pos4_AR_Cnt = _NAVI_Pos4_AR_CycleCount;
        }
    }
}

NAVI_Pos4_AR_init()
{   /* Botschaft NAVI_Pos4_AR ID: 1009 --- Sendeart 0 cyclicX --- 
BA_ "ApplMessage" BO_ 1009 0;
BA_ "NmAsrMessage" BO_ 1009 0;
BA_ "GenMsgMinAcceptLength" BO_ 1009 8;
BA_ "GenMsgILSupport" BO_ 1009 1;
BA_ "DiagState" BO_ 1009 0;
BA_ "DiagRequest" BO_ 1009 0;
BA_ "DiagResponse" BO_ 1009 0;
BA_ "GenMsgStartValue" BO_ 1009 "0";
BA_ "GenMsgStartDelayTime" BO_ 1009 180;
BA_ "GenMsgCycleTime" BO_ 1009 1000;
BA_ "GenMsgSendType" BO_ 1009 0;
    */
    _NAVI_Pos4_AR_Timebase =          c_tDBKomTimer_20ms;
    _NAVI_Pos4_AR_CycleCount =      1000 / _NAVI_Pos4_AR_Timebase;
    _NAVI_Pos4_AR_StartDelay =       180 / _NAVI_Pos4_AR_Timebase;
    _NAVI_Pos4_AR_Cnt = _NAVI_Pos4_AR_StartDelay;

    putValue( HMI__STMSGSD_NAVI_Pos4_AR, _NAVI_Pos4_AR_StartDelay * _NAVI_Pos4_AR_Timebase );

    _mNAVI_Pos4_AR.DR_MM_Lat.phys = getValue( HMI_DR_MM_Lat );
    _mNAVI_Pos4_AR.DR_MM_Long.phys = getValue( HMI_DR_MM_Long );
}

NAVI_Pos4_AR_saveEnvVars( dword hFile )
{
    filePutString("\n// Knoten TGW: NAVI_Pos4_AR\n", 26, hFile);
    snprintf( buffer, elcount(buffer), "0.0000 HMI__STMSG_NAVI_Pos4_AR := %X\n", getValue( HMI__STMSG_NAVI_Pos4_AR ));    filePutString( buffer, elcount(buffer), hFile);
    snprintf( buffer, elcount(buffer), "0.0000 HMI__STMSGT_NAVI_Pos4_AR := %X\n", getValue( HMI__STMSGT_NAVI_Pos4_AR ));    filePutString( buffer, elcount(buffer), hFile);
    snprintf( buffer, elcount(buffer), "0.0000 HMI_DR_MM_Lat := %X\n", getValue( HMI_DR_MM_Lat ) );    filePutString( buffer, elcount(buffer), hFile);
    snprintf( buffer, elcount(buffer), "0.0000 HMI_DR_MM_Long := %X\n", getValue( HMI_DR_MM_Long ) );    filePutString( buffer, elcount(buffer), hFile);
}

on timer _tNAVI_Pos4_AR
{
    putValue( HMI__STMSG_NAVI_Pos4_AR, 0 );
}

on EnvVar HMI__STMSG_NAVI_Pos4_AR
{
    long tDelay;
    if( getValue( this ) == 2 )
    {
        tDelay = getValue( HMI__STMSGT_NAVI_Pos4_AR );
        if( tDelay > 0 )    
            setTimer( _tNAVI_Pos4_AR, tDelay );
        else
            putValue( HMI__STMSG_NAVI_Pos4_AR, 0 );
    }
}

on envVar HMI__STMSG_PO_NAVI_Pos4_AR
{
    if( getValue( this ) )
        openPanel("NAVI_Pos4_AR");
}

on EnvVar HMI_DR_MM_Lat
{
    _mNAVI_Pos4_AR.DR_MM_Lat.phys = getValue(this);
}

on EnvVar HMI_DR_MM_Long
{
    _mNAVI_Pos4_AR.DR_MM_Long.phys = getValue(this);
}

NAVI_Pos5_AR_check_output()
{
    if( !getValue( HMI__STMSG_NAVI_Pos5_AR))
    {
        // Botschaft NAVI_Pos5_AR ID: 1011 --- Sendeart 0 cyclicX --- 
        _NAVI_Pos5_AR_Cnt--;
        if( _NAVI_Pos5_AR_Cnt < 1 )
        {
            // Nachricht wg. abgelaufenem Zyklus ausgeben
            output( _mNAVI_Pos5_AR );
            // Zyklus-Zähler zurücksetzen
            _NAVI_Pos5_AR_Cnt = _NAVI_Pos5_AR_CycleCount;
        }
    }
}

NAVI_Pos5_AR_init()
{   /* Botschaft NAVI_Pos5_AR ID: 1011 --- Sendeart 0 cyclicX --- 
BA_ "ApplMessage" BO_ 1011 0;
BA_ "NmAsrMessage" BO_ 1011 0;
BA_ "GenMsgMinAcceptLength" BO_ 1011 8;
BA_ "GenMsgILSupport" BO_ 1011 1;
BA_ "DiagState" BO_ 1011 0;
BA_ "DiagRequest" BO_ 1011 0;
BA_ "DiagResponse" BO_ 1011 0;
BA_ "GenMsgStartValue" BO_ 1011 "0";
BA_ "GenMsgStartDelayTime" BO_ 1011 120;
BA_ "GenMsgCycleTime" BO_ 1011 1000;
BA_ "GenMsgSendType" BO_ 1011 0;
    */
    _NAVI_Pos5_AR_Timebase =          c_tDBKomTimer_20ms;
    _NAVI_Pos5_AR_CycleCount =      1000 / _NAVI_Pos5_AR_Timebase;
    _NAVI_Pos5_AR_StartDelay =       120 / _NAVI_Pos5_AR_Timebase;
    _NAVI_Pos5_AR_Cnt = _NAVI_Pos5_AR_StartDelay;

    putValue( HMI__STMSGSD_NAVI_Pos5_AR, _NAVI_Pos5_AR_StartDelay * _NAVI_Pos5_AR_Timebase );

    _mNAVI_Pos5_AR.GPS_Fix.phys = getValue( HMI_GPS_Fix );
    _mNAVI_Pos5_AR.GPS_Hdop.phys = getValue( HMI_GPS_Hdop );
    _mNAVI_Pos5_AR.GPS_Pdop.phys = getValue( HMI_GPS_Pdop );
    _mNAVI_Pos5_AR.GPS_Trck_Sat.phys = getValue( HMI_GPS_Trck_Sat );
    _mNAVI_Pos5_AR.GPS_Vdop.phys = getValue( HMI_GPS_Vdop );
    _mNAVI_Pos5_AR.GPS_Vsbl_Sat.phys = getValue( HMI_GPS_Vsbl_Sat );
	_mNAVI_Pos5_AR.WhlCircumDyn_F_HU.phys = getValue( HMI_WhlCircumDyn_F_HU );
}

NAVI_Pos5_AR_saveEnvVars( dword hFile )
{
    filePutString("\n// Knoten TGW: \n", 26, hFile);
    snprintf( buffer, elcount(buffer), "0.0000 HMI__STMSG_NAVI_Pos5_AR := %X\n", getValue( HMI__STMSG_NAVI_Pos5_AR ));        filePutString( buffer, elcount(buffer), hFile);
    snprintf( buffer, elcount(buffer), "0.0000 HMI__STMSGT_NAVI_Pos5_AR := %X\n", getValue( HMI__STMSGT_NAVI_Pos5_AR ));        filePutString( buffer, elcount(buffer), hFile);
    snprintf( buffer, elcount(buffer), "0.0000 HMI_GPS_Fix := %X\n", getValue( HMI_GPS_Fix ) );        filePutString( buffer, elcount(buffer), hFile);
    snprintf( buffer, elcount(buffer), "0.0000 HMI_GPS_Hdop := %X\n", getValue( HMI_GPS_Hdop ) );        filePutString( buffer, elcount(buffer), hFile);
    snprintf( buffer, elcount(buffer), "0.0000 HMI_GPS_Pdop := %X\n", getValue( HMI_GPS_Pdop ) );        filePutString( buffer, elcount(buffer), hFile);
    snprintf( buffer, elcount(buffer), "0.0000 HMI_GPS_Trck_Sat := %X\n", getValue( HMI_GPS_Trck_Sat ) );        filePutString( buffer, elcount(buffer), hFile);
    snprintf( buffer, elcount(buffer), "0.0000 HMI_GPS_Vdop := %X\n", getValue( HMI_GPS_Vdop ) );        filePutString( buffer, elcount(buffer), hFile);
    snprintf( buffer, elcount(buffer), "0.0000 HMI_GPS_Vsbl_Sat := %X\n", getValue( HMI_GPS_Vsbl_Sat ) );        filePutString( buffer, elcount(buffer), hFile);
	snprintf( buffer, elcount(buffer), "0.0000 HMI_WhlCircumDyn_F_HU := %X\n", getValue( HMI_WhlCircumDyn_F_HU ) );        filePutString( buffer, elcount(buffer), hFile);
}

on timer _tNAVI_Pos5_AR
{
    putValue( HMI__STMSG_NAVI_Pos5_AR, 0 );
}

on EnvVar HMI__STMSG_NAVI_Pos5_AR
{
    long tDelay;
    if( getValue( this ) == 2 )
    {
        tDelay = getValue( HMI__STMSGT_NAVI_Pos5_AR );
        if( tDelay > 0 )    
            setTimer( _tNAVI_Pos5_AR, tDelay );
        else
            putValue( HMI__STMSG_NAVI_Pos5_AR, 0 );
    }
}

on envVar HMI__STMSG_PO_NAVI_Pos5_AR
{
    if( getValue( this ) )
        openPanel("NAVI_Pos5_AR");
}

on EnvVar HMI_GPS_Fix
{
    _mNAVI_Pos5_AR.GPS_Fix.phys = getValue(this);
}

on EnvVar HMI_GPS_Hdop
{
    _mNAVI_Pos5_AR.GPS_Hdop.phys = getValue(this);
}

on EnvVar HMI_GPS_Pdop
{
    _mNAVI_Pos5_AR.GPS_Pdop.phys = getValue(this);
}

on EnvVar HMI_GPS_Trck_Sat
{
    _mNAVI_Pos5_AR.GPS_Trck_Sat.phys = getValue(this);
}

on EnvVar HMI_WhlCircumDyn_F_HU
{
    _mNAVI_Pos5_AR.WhlCircumDyn_F_HU.phys = getValue(this);
}

on EnvVar HMI_GPS_Vdop
{
    _mNAVI_Pos5_AR.GPS_Vdop.phys = getValue(this);
}

on EnvVar HMI_GPS_Vsbl_Sat
{
    _mNAVI_Pos5_AR.GPS_Vsbl_Sat.phys = getValue(this);
}

//Pers_Rq_AR_check_output()
//{
//    if( !getValue( HMI__STMSG_Pers_Rq_AR ) )
//    {
//        // Botschaft Pers_Rq_AR ID: 1080 --- Sendeart 5 cyclicAndSpontanWithDelay --- 
//        if( _Pers_Rq_AR_DelayCnt > 0 ) _Pers_Rq_AR_DelayCnt--; // Mindestsendeabstand
//        _Pers_Rq_AR_Cnt--;
//        if( _Pers_Rq_AR_Cnt < 1 )
//        {
//            if( _Pers_Rq_AR_DelayCnt < 1 )
//            {
//                // Nachricht wg. abgelaufenem Zyklus ausgeben (Mindestsendeabstand eingehalten)
//                Pers_Rq_AR_output();
//                _Pers_Rq_AR_SpontanFlag = 0; // Spontan-Flag zurücksetzen
//                _Pers_Rq_AR_DelayCnt = _Pers_Rq_AR_MinDelay;
//            }
//            else
//            {
//                // Spontanflag setzen damit nach Ablauf Mindestsendeabstand gesendet wird
//                 _Pers_Rq_AR_SpontanFlag = 1;
//            }
//            _Pers_Rq_AR_Cnt = _Pers_Rq_AR_CycleCount; // Zyklus-Zähler zurücksetzen
//        }
//        else if( _Pers_Rq_AR_SpontanFlag)
//        {
//            if( _Pers_Rq_AR_DelayCnt < 1 )
//            {
//                // Nachricht wg. spontaner Änderung ausgeben (Mindestsendeabstand eingehalten)
//                Pers_Rq_AR_output();
//                _Pers_Rq_AR_SpontanFlag = 0; // Spontan-Flag zurücksetzen
//                _Pers_Rq_AR_DelayCnt = _Pers_Rq_AR_MinDelay;
//            }
//        }
//    }
//}
///*@@end*/
//
///*@@caplFunc:Pers_Rq_AR_init():*/
//Pers_Rq_AR_init()
//{   /* Botschaft Pers_Rq_AR ID: 1080 --- Sendeart 5 cyclicAndSpontanWithDelay --- 
//BA_ "ApplMessage" BO_ 1153 0;
//BA_ "NmAsrMessage" BO_ 1153 0;
//BA_ "GenMsgMinAcceptLength" BO_ 1153 8;
//BA_ "GenMsgILSupport" BO_ 1153 1;
//BA_ "DiagState" BO_ 1153 0;
//BA_ "DiagRequest" BO_ 1153 0;
//BA_ "DiagResponse" BO_ 1153 0;
//BA_ "GenMsgStartValue" BO_ 1153 "0";
//BA_ "GenMsgStartDelayTime" BO_ 1153 235;
//BA_ "GenMsgDelayTime" BO_ 1153 60;
//BA_ "GenMsgNrOfRepetitions" BO_ 1153 0;
//BA_ "GenMsgCycleTime" BO_ 1153 1000;
//BA_ "GenMsgSendType" BO_ 1153 5;
//    */
//    _Pers_Rq_AR_Timebase =      c_tDBKomTimer_20ms;
//    _Pers_Rq_AR_CycleCount =   1000 / _Pers_Rq_AR_Timebase;
//    _Pers_Rq_AR_StartDelay =    235 / _Pers_Rq_AR_Timebase;
//    _Pers_Rq_AR_MinDelay =       60 / _Pers_Rq_AR_Timebase;
//    _Pers_Rq_AR_Cnt = _Pers_Rq_AR_StartDelay;
//    _Pers_Rq_AR_SpontanFlag = 0;
//    _Pers_Rq_AR_DelayCnt = 0;
//
//    putValue( HMI__STMSGSD_Pers_Rq_AR, _Pers_Rq_AR_StartDelay * _Pers_Rq_AR_Timebase );
//
//    _mPers_Rq_AR.Pers_ActvSlotId_Rq.phys = getValue( HMI_Pers_ActvSlotId_Rq );
//    _mPers_Rq_AR.Pers_MBConnectUserId.phys = getValue( HMI_Pers_MBConnectUserId );
//    _mPers_Rq_AR.Pers_RemUserDataCmd_Stat .phys = getValue( HMI_Pers_RemUserDataCmd_Stat  );
//    _mPers_Rq_AR.Pers_UserAuthLev.phys = getValue( HMI_Pers_UserAuthLev );
//    _mPers_Rq_AR.Pers_UserProfActv_Rq.phys = getValue( HMI_Pers_UserProfActv_Rq );
//    _mPers_Rq_AR.Pers_UserProfListUpd_Actv.phys = getValue( HMI_Pers_UserProfListUpd_Actv );
//    _mPers_Rq_AR.Pers_UserProfSel_Rq.phys = getValue( HMI_Pers_UserProfSel_Rq );
//}
///*@@end*/
//
///*@@caplFunc:Pers_Rq_AR_output():*/
//Pers_Rq_AR_output(void)
//{
//    output( _mPers_Rq_AR );
//}
///*@@end*/
//
///*@@caplFunc:Pers_Rq_AR_saveEnvVars(dword):*/
//Pers_Rq_AR_saveEnvVars( dword hFile )
//{
//    filePutString("\n// Knoten EIS: Pers_Rq_AR\n", 27, hFile );
//    snprintf( buffer, elcount( buffer ), "0.0000 HMI__STMSG_Pers_Rq_AR := %X\n", getValue( HMI__STMSG_Pers_Rq_AR ) );        filePutString ( buffer, elcount( buffer ), hFile );
//    snprintf( buffer, elcount( buffer ), "0.0000 HMI__STMSGT_Pers_Rq_AR := %X\n", getValue( HMI__STMSGT_Pers_Rq_AR ) );        filePutString ( buffer, elcount( buffer ), hFile );
//    snprintf( buffer, elcount( buffer ), "0.0000 HMI_Pers_ActvSlotId_Rq := %X\n", getValue( HMI_Pers_ActvSlotId_Rq ) );        filePutString ( buffer, elcount( buffer ), hFile );
//    snprintf( buffer, elcount( buffer ), "0.0000 HMI_Pers_MBConnectUserId := %X\n", getValue( HMI_Pers_MBConnectUserId ) );        filePutString ( buffer, elcount( buffer ), hFile );
//    snprintf( buffer, elcount( buffer ), "0.0000 HMI_Pers_RemUserDataCmd_Stat  := %X\n", getValue( HMI_Pers_RemUserDataCmd_Stat  ) );        filePutString ( buffer, elcount( buffer ), hFile );
//    snprintf( buffer, elcount( buffer ), "0.0000 HMI_Pers_UserAuthLev := %X\n", getValue( HMI_Pers_UserAuthLev ) );        filePutString ( buffer, elcount( buffer ), hFile );
//    snprintf( buffer, elcount( buffer ), "0.0000 HMI_Pers_UserProfActv_Rq := %X\n", getValue( HMI_Pers_UserProfActv_Rq ) );        filePutString ( buffer, elcount( buffer ), hFile );
//    snprintf( buffer, elcount( buffer ), "0.0000 HMI_Pers_UserProfListUpd_Actv := %X\n", getValue( HMI_Pers_UserProfListUpd_Actv ) );        filePutString ( buffer, elcount( buffer ), hFile );
//    snprintf( buffer, elcount( buffer ), "0.0000 HMI_Pers_UserProfSel_Rq := %X\n", getValue( HMI_Pers_UserProfSel_Rq ) );        filePutString ( buffer, elcount( buffer ), hFile );
//}
///*@@end*/
//
///*@@timer:_tPers_Rq_AR:*/
//on timer _tPers_Rq_AR
//{
//    putValue( HMI__STMSG_Pers_Rq_AR, 0 );
//}
///*@@end*/
//
///*@@envVar:HMI__STMSG_Pers_Rq_AR:*/
//on EnvVar HMI__STMSG_Pers_Rq_AR
//{
//    long tDelay;
//    if( getValue( this ) == 2 )
//    {
//        tDelay = getValue( HMI__STMSGT_Pers_Rq_AR );
//        if( tDelay > 0)    
//            setTimer( _tPers_Rq_AR, tDelay );
//        else
//            putValue( HMI__STMSG_Pers_Rq_AR, 0 );
//    }
//}
///*@@end*/
//
///*@@envVar:HMI__STMSG_PO_Pers_Rq_AR:*/
//on envVar HMI__STMSG_PO_Pers_Rq_AR
//{
//    if( getValue( this ) )
//        openPanel("Pers_Rq_AR");
//}
///*@@end*/
//
///*@@envVar:HMI_Pers_ActvSlotId_Rq:*/
//on EnvVar HMI_Pers_ActvSlotId_Rq
//{
//    _mPers_Rq_AR.Pers_ActvSlotId_Rq.phys = getValue(this);
//    _Pers_Rq_AR_SpontanFlag = 1;
//}
///*@@end*/
//
///*@@envVar:HMI_Pers_MBConnectUserId:*/
//on EnvVar HMI_Pers_MBConnectUserId
//{
//    _mPers_Rq_AR.Pers_MBConnectUserId.phys = getValue(this);
//    _Pers_Rq_AR_SpontanFlag = 1;
//}
///*@@end*/
//
///*@@envVar:HMI_Pers_RemUserDataCmd_Stat:*/
//on EnvVar HMI_Pers_RemUserDataCmd_Stat
//{
//    _mPers_Rq_AR.Pers_RemUserDataCmd_Stat.phys = getValue(this);
//    _Pers_Rq_AR_SpontanFlag = 1;
//}
///*@@end*/
//
///*@@envVar:HMI_Pers_UserAuthLev:*/
//on EnvVar HMI_Pers_UserAuthLev
//{
//    _mPers_Rq_AR.Pers_UserAuthLev.phys = getValue(this);
//    _Pers_Rq_AR_SpontanFlag = 1;
//}
///*@@end*/
//
///*@@envVar:HMI_Pers_UserProfActv_Rq:*/
//on EnvVar HMI_Pers_UserProfActv_Rq
//{
//    _mPers_Rq_AR.Pers_UserProfActv_Rq.phys = getValue(this);
//    _Pers_Rq_AR_SpontanFlag = 1;
//}
///*@@end*/
//
///*@@envVar:HMI_Pers_UserProfListUpd_Actv:*/
//on EnvVar HMI_Pers_UserProfListUpd_Actv
//{
//    _mPers_Rq_AR.Pers_UserProfListUpd_Actv.phys = getValue(this);
//    _Pers_Rq_AR_SpontanFlag = 1;
//}
///*@@end*/
//
///*@@envVar:HMI_Pers_UserProfSel_Rq:*/
//on EnvVar HMI_Pers_UserProfSel_Rq
//{
//    _mPers_Rq_AR.Pers_UserProfSel_Rq.phys = getValue(this);
//    _Pers_Rq_AR_SpontanFlag = 1;
//}
///*@@end*/

Pers_Stat_AR_check_output()
{
    if( !getValue( HMI__STMSG_Pers_Stat_AR ) )
    {
        // Botschaft Pers_Stat_AR ID: 1082 --- Sendeart 5 cyclicAndSpontanWithDelay --- 
        if( _Pers_Stat_AR_DelayCnt > 0 ) _Pers_Stat_AR_DelayCnt--; // Mindestsendeabstand
        _Pers_Stat_AR_Cnt--;
        if( _Pers_Stat_AR_Cnt < 1 )
        {
            if( _Pers_Stat_AR_DelayCnt < 1 )
            {
                // Nachricht wg. abgelaufenem Zyklus ausgeben (Mindestsendeabstand eingehalten)
                Pers_Stat_AR_output();
                _Pers_Stat_AR_SpontanFlag = 0; // Spontan-Flag zurücksetzen
                _Pers_Stat_AR_DelayCnt = _PNHV_WeekDepTmTbl_Rq_HU_AR_MinDelay;
            }
            else
            {
                // Spontanflag setzen damit nach Ablauf Mindestsendeabstand gesendet wird
                 _Pers_Stat_AR_SpontanFlag = 1;
            }
            _Pers_Stat_AR_Cnt = _Pers_Stat_AR_CycleCount; // Zyklus-Zähler zurücksetzen
        }
        else if( _Pers_Stat_AR_SpontanFlag)
        {
            if( _Pers_Stat_AR_DelayCnt < 1 )
            {
                // Nachricht wg. spontaner Änderung ausgeben (Mindestsendeabstand eingehalten)
                Pers_Stat_AR_output();
                _Pers_Stat_AR_SpontanFlag = 0; // Spontan-Flag zurücksetzen
                _Pers_Stat_AR_DelayCnt = _Pers_Stat_AR_MinDelay;
            }
        }
    }
}

Pers_Stat_AR_init()
{   /* Botschaft Pers_Stat_AR ID: 1082 --- Sendeart 5 cyclicAndSpontanWithDelay --- 
BA_ "ApplMessage" BO_ 1082 0;
BA_ "NmAsrMessage" BO_ 1082 0;
BA_ "GenMsgMinAcceptLength" BO_ 1082 8;
BA_ "GenMsgILSupport" BO_ 1082 1;
BA_ "DiagState" BO_ 1082 0;
BA_ "DiagRequest" BO_ 1082 0;
BA_ "DiagResponse" BO_ 1082 0;
BA_ "GenMsgStartValue" BO_ 1082 "0";
BA_ "GenMsgStartDelayTime" BO_ 1082 150;
BA_ "GenMsgDelayTime" BO_ 1082 100;
BA_ "GenMsgNrOfRepetition" BO_ 1082 0;
BA_ "GenMsgCycleTime" BO_ 1082 500;
BA_ "GenMsgSendType" BO_ 1082 5;
    */
    _Pers_Stat_AR_Timebase =      c_tDBKomTimer_20ms;
    _Pers_Stat_AR_CycleCount =   	500 / _Pers_Stat_AR_Timebase;
    _Pers_Stat_AR_StartDelay =    	150 / _Pers_Stat_AR_Timebase;
    _Pers_Stat_AR_MinDelay =       	100 / _Pers_Stat_AR_Timebase;
    _Pers_Stat_AR_Cnt = _Pers_Stat_AR_StartDelay;
    _Pers_Stat_AR_SpontanFlag = 0;
    _Pers_Stat_AR_DelayCnt = 0;

    putValue( HMI__STMSGSD_Pers_Stat_AR, _Pers_Stat_AR_StartDelay * _Pers_Stat_AR_Timebase );

    _mPers_Stat_AR.Pers_ActvSlotId_Stat.phys = getValue( HMI_Pers_ActvSlotId_Stat );
    _mPers_Stat_AR.Pers_AutoSeatPosn_Enbl.phys = getValue( HMI_Pers_AutoSeatPosn_Enbl );
    _mPers_Stat_AR.Pers_InstSlotIdList.phys = getValue( HMI_Pers_InstSlotIdList );
    _mPers_Stat_AR.Pers_MBConnectUserId_high.phys = getValue( HMI_Pers_MBConnectUserId_high );
    _mPers_Stat_AR.Pers_MBConnectUserId_low.phys = getValue( HMI_Pers_MBConnectUserId_low );
    _mPers_Stat_AR.Pers_RemUserDataCmd_Stat.phys = getValue( HMI_Pers_RemUserDataCmd_Stat );
    _mPers_Stat_AR.Pers_UserAuthLev.phys = getValue( HMI_Pers_UserAuthLev );
	_mPers_Stat_AR.Pers_UserProfListUpd_Actv.phys = getValue( HMI_Pers_UserProfListUpd_Actv );
	_mPers_Stat_AR.Pers_UserProfSel_Stat.phys = getValue( HMI_Pers_UserProfSel_Stat );
 // _mPNHV_WeekDepTmTbl_Rq_HU_AR.HU_IntelRecup_Rq.phys = getValue( HMI_HU_IntelRecup_Rq );
  _mPNHV_WeekDepTmTbl_Rq_HU_AR.HU_ChrgProgSel_Rq.phys = getValue( HMI_HU_ChrgProgSel_Rq );
}

Pers_Stat_AR_output(void)
{
    output( _mPers_Stat_AR );
}

Pers_Stat_AR_saveEnvVars( dword hFile )
{
    filePutString("\n// Knoten EIS: Pers_Stat_AR\n", 27, hFile );
    snprintf( buffer, elcount( buffer ), "0.0000 HMI__STMSG_Pers_Stat_AR := %X\n", getValue( HMI__STMSG_Pers_Stat_AR ) );        filePutString ( buffer, elcount( buffer ), hFile );
    snprintf( buffer, elcount( buffer ), "0.0000 HMI__STMSGT_Pers_Stat_AR := %X\n", getValue( HMI__STMSGT_Pers_Stat_AR ) );        filePutString ( buffer, elcount( buffer ), hFile );
    snprintf( buffer, elcount( buffer ), "0.0000 HMI_Pers_ActvSlotId_Stat := %X\n", getValue( HMI_Pers_ActvSlotId_Stat ) );        filePutString ( buffer, elcount( buffer ), hFile );
    snprintf( buffer, elcount( buffer ), "0.0000 HMI_Pers_AutoSeatPosn_Enbl := %X\n", getValue( HMI_Pers_AutoSeatPosn_Enbl ) );        filePutString ( buffer, elcount( buffer ), hFile );
    snprintf( buffer, elcount( buffer ), "0.0000 HMI_Pers_InstSlotIdList := %X\n", getValue( HMI_Pers_InstSlotIdList ) );        filePutString ( buffer, elcount( buffer ), hFile );
    snprintf( buffer, elcount( buffer ), "0.0000 HMI_Pers_MBConnectUserId_high := %X\n", getValue( HMI_Pers_MBConnectUserId_high ) );        filePutString ( buffer, elcount( buffer ), hFile );
    snprintf( buffer, elcount( buffer ), "0.0000 HMI_Pers_MBConnectUserId_low := %X\n", getValue( HMI_Pers_MBConnectUserId_low ) );        filePutString ( buffer, elcount( buffer ), hFile );
    snprintf( buffer, elcount( buffer ), "0.0000 HMI_Pers_RemUserDataCmd_Stat := %X\n", getValue( HMI_Pers_RemUserDataCmd_Stat ) );        filePutString ( buffer, elcount( buffer ), hFile );
    snprintf( buffer, elcount( buffer ), "0.0000 HMI_Pers_UserAuthLev := %X\n", getValue( HMI_Pers_UserAuthLev ) );        filePutString ( buffer, elcount( buffer ), hFile );
	snprintf( buffer, elcount( buffer ), "0.0000 HMI_Pers_UserProfListUpd_Actv := %X\n", getValue( HMI_Pers_UserProfListUpd_Actv ) );        filePutString ( buffer, elcount( buffer ), hFile );
	snprintf( buffer, elcount( buffer ), "0.0000 HMI_Pers_UserProfSel_Stat := %X\n", getValue( HMI_Pers_UserProfSel_Stat ) );        filePutString ( buffer, elcount( buffer ), hFile );
    snprintf( buffer, elcount(buffer), "0.0000 HMI_HU_IntelRecup_Rq := %X\n", getValue( HMI_HU_IntelRecup_Rq ) );        filePutString( buffer, elcount(buffer), hFile);
	snprintf( buffer, elcount(buffer), "0.0000 HMI_HU_ChrgProgSel_Rq := %X\n", getValue( HMI_HU_ChrgProgSel_Rq ) );        filePutString( buffer, elcount(buffer), hFile);
}

on timer _tPers_Stat_AR
{
    putValue( HMI__STMSG_Pers_Stat_AR, 0 );
}

on EnvVar HMI__STMSG_Pers_Stat_AR
{
    long tDelay;
    if( getValue( this ) == 2 )
    {
        tDelay = getValue( HMI__STMSGT_Pers_Stat_AR );
        if( tDelay > 0)    
            setTimer( _tPers_Stat_AR, tDelay );
        else
            putValue( HMI__STMSG_Pers_Stat_AR, 0 );
    }
}

on envVar HMI__STMSG_PO_Pers_Stat_AR
{
    if( getValue( this ) )
        openPanel("Pers_Stat_AR");
}

on EnvVar HMI_Pers_ActvSlotId_Stat
{
    _mPers_Stat_AR.Pers_ActvSlotId_Stat.phys = getValue(this);
    _Pers_Stat_AR_SpontanFlag = 1;
}

on EnvVar HMI_Pers_AutoSeatPosn_Enbl
{
    _mPers_Stat_AR.Pers_AutoSeatPosn_Enbl.phys = getValue(this);
    _Pers_Stat_AR_SpontanFlag = 1;
}

on EnvVar HMI_Pers_InstSlotIdList
{
    _mPers_Stat_AR.Pers_InstSlotIdList.phys = getValue(this);
    _Pers_Stat_AR_SpontanFlag = 1;
}

on EnvVar HMI_Pers_MBConnectUserId_high
{
    _mPers_Stat_AR.Pers_MBConnectUserId_high.phys = getValue(this);
    _Pers_Stat_AR_SpontanFlag = 1;
}

on EnvVar HMI_Pers_MBConnectUserId_low
{
    _mPers_Stat_AR.Pers_MBConnectUserId_low.phys = getValue(this);
    _Pers_Stat_AR_SpontanFlag = 1;
}

on EnvVar HMI_Pers_RemUserDataCmd_Stat
{
    _mPers_Stat_AR.Pers_RemUserDataCmd_Stat.phys = getValue(this);
    _Pers_Stat_AR_SpontanFlag = 1;
}

on EnvVar HMI_Pers_UserAuthLev
{
    _mPers_Stat_AR.Pers_UserAuthLev.phys = getValue(this);
    _Pers_Stat_AR_SpontanFlag = 1;
}

on EnvVar HMI_Pers_UserProfListUpd_Actv
{
    _mPers_Stat_AR.Pers_UserProfListUpd_Actv.phys = getValue(this);
    _Pers_Stat_AR_SpontanFlag = 1;
}

on EnvVar HMI_Pers_UserProfSel_Stat
{
    _mPers_Stat_AR.Pers_UserProfSel_Stat.phys = getValue(this);
    _Pers_Stat_AR_SpontanFlag = 1;
}

PnHt_Rq_HU_AR_check_output()
{
    if(  !getValue( HMI__STMSG_PnHt_Rq_HU_AR ) )
    {
        // Botschaft PnHt_Rq_HU_AR ID: 997 --- Sendeart 5 cyclicAndSpontanWithDelay --- 
        _PnHt_Rq_HU_AR_Cnt--;
        if(  _PnHt_Rq_HU_AR_Cnt < 1 )
        {
            // Nachricht wg. abgelaufenem Zyklus ausgeben
            output( _mPnHt_Rq_HU_AR );
            _PnHt_Rq_HU_AR_Cnt = _PnHt_Rq_HU_AR_CycleCount; // Zyklus-Zähler zurücksetzen
             _PnHt_Rq_HU_AR_SpontanFlag = 0; // Spontan-Flag zurücksetzen
        }
        else if( _PnHt_Rq_HU_AR_SpontanFlag)
        {
            // Nachricht wg. spontaner Änderung ausgeben
            output( _mPnHt_Rq_HU_AR );
             _PnHt_Rq_HU_AR_SpontanFlag = 0; // Spontan-Flag zurücksetzen
        }
    }
}

PnHt_Rq_HU_AR_init()
{   /* Botschaft PnHt_Rq_HU_AR ID: 997 --- Sendeart 5 cyclicAndSpontanWithDelay --- 
BA_ "ApplMessage" BO_ 997 0;
BA_ "NmAsrMessage" BO_ 997 0;
BA_ "GenMsgMinAcceptLength" BO_ 997 8;
BA_ "GenMsgILSupport" BO_ 997 1;
BA_ "DiagState" BO_ 997 0;
BA_ "DiagRequest" BO_ 997 0;
BA_ "DiagResponse" BO_ 997 0;
BA_ "GenMsgStartValue" BO_ 997 "0";
BA_ "GenMsgStartDelayTime" BO_ 997 20;
BA_ "GenMsgDelayTime" BO_ 997 5;
BA_ "GenMsgNrOfRepetitions" BO_ 997 0;
BA_ "GenMsgCycleTime" BO_ 997 1000;
BA_ "GenMsgSendType" BO_ 997 5;
    */
    _PnHt_Rq_HU_AR_Timebase =         c_tDBKomTimer_20ms;
    _PnHt_Rq_HU_AR_CycleCount =     1000 / _PnHt_Rq_HU_AR_Timebase;
    _PnHt_Rq_HU_AR_StartDelay =      120 / _PnHt_Rq_HU_AR_Timebase;
    _PnHt_Rq_HU_AR_Cnt = _PnHt_Rq_HU_AR_StartDelay;
    _PnHt_Rq_HU_AR_SpontanFlag = 0;

    putValue( HMI__STMSGSD_PnHt_Rq_HU_AR, _PnHt_Rq_HU_AR_StartDelay * _PnHt_Rq_HU_AR_Timebase );

    _mPnHt_Rq_HU_AR.PnHt_CenCnsl_Ft_Rq.phys = getValue( HMI_PnHt_CenCnsl_Ft_Rq );
    _mPnHt_Rq_HU_AR.PnHt_CenCnsl_R_Rq.phys = getValue( HMI_PnHt_CenCnsl_R_Rq );
    _mPnHt_Rq_HU_AR.PnHt_Door_FL_Rq.phys = getValue( HMI_PnHt_Door_FL_Rq );
    _mPnHt_Rq_HU_AR.PnHt_Door_FR_Rq.phys = getValue( HMI_PnHt_Door_FR_Rq );
    _mPnHt_Rq_HU_AR.PnHt_Door_RL_Rq.phys = getValue( HMI_PnHt_Door_RL_Rq );
    _mPnHt_Rq_HU_AR.PnHt_Door_RR_Rq.phys = getValue( HMI_PnHt_Door_RR_Rq );
}

PnHt_Rq_HU_AR_saveEnvVars( dword hFile )
{
    filePutString("\n// Knoten TGW: PnHt_Rq_HU_AR\n", 27, hFile);
    snprintf( buffer, elcount(buffer), "0.0000 HMI__STMSG_PnHt_Rq_HU := %X\n", getValue( HMI__STMSG_PnHt_Rq_HU_AR ) );        filePutString( buffer, elcount(buffer), hFile);
    snprintf( buffer, elcount(buffer), "0.0000 HMI__STMSGT_PnHt_Rq_HU := %X\n", getValue( HMI__STMSGT_PnHt_Rq_HU_AR ) );        filePutString( buffer, elcount(buffer), hFile);
    snprintf( buffer, elcount(buffer), "0.0000 HMI_PnHt_CenCnsl_Ft_Rq := %X\n", getValue( HMI_PnHt_CenCnsl_Ft_Rq ) );        filePutString( buffer, elcount(buffer), hFile);
    snprintf( buffer, elcount(buffer), "0.0000 HMI_PnHt_CenCnsl_R_Rq := %X\n", getValue( HMI_PnHt_CenCnsl_R_Rq ) );        filePutString( buffer, elcount(buffer), hFile);
    snprintf( buffer, elcount(buffer), "0.0000 HMI_PnHt_Door_FL_Rq := %X\n", getValue( HMI_PnHt_Door_FL_Rq ) );        filePutString( buffer, elcount(buffer), hFile);
    snprintf( buffer, elcount(buffer), "0.0000 HMI_PnHt_Door_FR_Rq := %X\n", getValue( HMI_PnHt_Door_FR_Rq ) );        filePutString( buffer, elcount(buffer), hFile);
    snprintf( buffer, elcount(buffer), "0.0000 HMI_PnHt_Door_RL_Rq := %X\n", getValue( HMI_PnHt_Door_RL_Rq ) );        filePutString( buffer, elcount(buffer), hFile);
    snprintf( buffer, elcount(buffer), "0.0000 HMI_PnHt_Door_RR_Rq := %X\n", getValue( HMI_PnHt_Door_RR_Rq ) );        filePutString( buffer, elcount(buffer), hFile);
}

on timer _tPnHt_Rq_HU_AR
{
    putValue( HMI__STMSG_PnHt_Rq_HU_AR, 0 );
}

on EnvVar HMI__STMSG_PnHt_Rq_HU_AR
{
    long tDelay;
    if( getValue( this ) == 2 )
    {
        tDelay = getValue( HMI__STMSGT_PnHt_Rq_HU_AR );
        if( tDelay > 0 )    
            setTimer( _tPnHt_Rq_HU_AR, tDelay );
        else
            putValue( HMI__STMSG_PnHt_Rq_HU_AR, 0 );
    }
}

on envVar HMI__STMSG_PO_PnHt_Rq_HU_AR
{
    if( getValue( this ) )
        openPanel("PnHt_Rq_HU_AR");
}

on EnvVar HMI_PnHt_CenCnsl_Ft_Rq
{
    _mPnHt_Rq_HU_AR.PnHt_CenCnsl_Ft_Rq.phys = getValue(this);
    _PnHt_Rq_HU_AR_SpontanFlag = 1;
}

on EnvVar HMI_PnHt_CenCnsl_R_Rq
{
    _mPnHt_Rq_HU_AR.PnHt_CenCnsl_R_Rq.phys = getValue(this);
    _PnHt_Rq_HU_AR_SpontanFlag = 1;
}

on EnvVar HMI_PnHt_Door_FL_Rq
{
    _mPnHt_Rq_HU_AR.PnHt_Door_FL_Rq.phys = getValue(this);
    _PnHt_Rq_HU_AR_SpontanFlag = 1;
}

on EnvVar HMI_PnHt_Door_FR_Rq
{
    _mPnHt_Rq_HU_AR.PnHt_Door_FR_Rq.phys = getValue(this);
    _PnHt_Rq_HU_AR_SpontanFlag = 1;
}

on EnvVar HMI_PnHt_Door_RL_Rq
{
    _mPnHt_Rq_HU_AR.PnHt_Door_RL_Rq.phys = getValue(this);
    _PnHt_Rq_HU_AR_SpontanFlag = 1;
}

on EnvVar HMI_PnHt_Door_RR_Rq
{
    _mPnHt_Rq_HU_AR.PnHt_Door_RR_Rq.phys = getValue(this);
    _PnHt_Rq_HU_AR_SpontanFlag = 1;
}

PNHV_WeekDepTmTbl_Rq_HU_AR_check_output()
{
    if( !getValue( HMI__STMSG_PNHV_WeekDepTmTbl_Rq_HU_AR ) )
    {
        // Botschaft PNHV_WeekDepTmTbl_Rq_HU_AR ID: 1153 --- Sendeart 5 cyclicAndSpontanWithDelay --- 
        if( _PNHV_WeekDepTmTbl_Rq_HU_AR_DelayCnt > 0) _PNHV_WeekDepTmTbl_Rq_HU_AR_DelayCnt--; // Mindestsendeabstand
        _PNHV_WeekDepTmTbl_Rq_HU_AR_Cnt--;
        if( _PNHV_WeekDepTmTbl_Rq_HU_AR_Cnt < 1 )
        {
            if( _PNHV_WeekDepTmTbl_Rq_HU_AR_DelayCnt < 1 )
            {
                // Nachricht wg. abgelaufenem Zyklus ausgeben (Mindestsendeabstand eingehalten)
                PNHV_WeekDepTmTbl_Rq_HU_AR_output();
                _PNHV_WeekDepTmTbl_Rq_HU_AR_SpontanFlag = 0; // Spontan-Flag zurücksetzen
                _PNHV_WeekDepTmTbl_Rq_HU_AR_DelayCnt = _PNHV_WeekDepTmTbl_Rq_HU_AR_MinDelay;
            }
            else
            {
                // Spontanflag setzen damit nach Ablauf Mindestsendeabstand gesendet wird
                 _PNHV_WeekDepTmTbl_Rq_HU_AR_SpontanFlag = 1;
            }
            _PNHV_WeekDepTmTbl_Rq_HU_AR_Cnt = _PNHV_WeekDepTmTbl_Rq_HU_AR_CycleCount; // Zyklus-Zähler zurücksetzen
        }
        else if( _PNHV_WeekDepTmTbl_Rq_HU_AR_SpontanFlag)
        {
            if( _PNHV_WeekDepTmTbl_Rq_HU_AR_DelayCnt < 1 )
            {
                // Nachricht wg. spontaner Änderung ausgeben (Mindestsendeabstand eingehalten)
                PNHV_WeekDepTmTbl_Rq_HU_AR_output();
                _PNHV_WeekDepTmTbl_Rq_HU_AR_SpontanFlag = 0; // Spontan-Flag zurücksetzen
                _PNHV_WeekDepTmTbl_Rq_HU_AR_DelayCnt = _PNHV_WeekDepTmTbl_Rq_HU_AR_MinDelay;
            }
        }
    }
}

PNHV_WeekDepTmTbl_Rq_HU_AR_init()
{   /* Botschaft PNHV_WeekDepTmTbl_Rq_HU_AR ID: 1153 --- Sendeart 5 cyclicAndSpontanWithDelay --- 
BA_ "ApplMessage" BO_ 1153 0;
BA_ "NmAsrMessage" BO_ 1153 0;
BA_ "GenMsgMinAcceptLength" BO_ 1153 8;
BA_ "GenMsgILSupport" BO_ 1153 1;
BA_ "DiagState" BO_ 1153 0;
BA_ "DiagRequest" BO_ 1153 0;
BA_ "DiagResponse" BO_ 1153 0;
BA_ "GenMsgStartValue" BO_ 1153 "0";
BA_ "GenMsgStartDelayTime" BO_ 1153 235;
BA_ "GenMsgDelayTime" BO_ 1153 60;
BA_ "GenMsgNrOfRepetitions" BO_ 1153 0;
BA_ "GenMsgCycleTime" BO_ 1153 1000;
BA_ "GenMsgSendType" BO_ 1153 5;
    */
    _PNHV_WeekDepTmTbl_Rq_HU_AR_Timebase =      c_tDBKomTimer_20ms;
    _PNHV_WeekDepTmTbl_Rq_HU_AR_CycleCount =   1000 / _PNHV_WeekDepTmTbl_Rq_HU_AR_Timebase;
    _PNHV_WeekDepTmTbl_Rq_HU_AR_StartDelay =    235 / _PNHV_WeekDepTmTbl_Rq_HU_AR_Timebase;
    _PNHV_WeekDepTmTbl_Rq_HU_AR_MinDelay =       60 / _PNHV_WeekDepTmTbl_Rq_HU_AR_Timebase;
    _PNHV_WeekDepTmTbl_Rq_HU_AR_Cnt = _PNHV_WeekDepTmTbl_Rq_HU_AR_StartDelay;
    _PNHV_WeekDepTmTbl_Rq_HU_AR_SpontanFlag = 0;
    _PNHV_WeekDepTmTbl_Rq_HU_AR_DelayCnt = 0;

    putValue( HMI__STMSGSD_PNHV_WeekDepTmTbl_Rq_HU_AR, _PNHV_WeekDepTmTbl_Rq_HU_AR_StartDelay * _PNHV_WeekDepTmTbl_Rq_HU_AR_Timebase );

    _mPNHV_WeekDepTmTbl_Rq_HU_AR.EMM_MaxSOC_Rq_HU.phys = getValue( HMI_EMM_MaxSOC_Rq_HU );
    _mPNHV_WeekDepTmTbl_Rq_HU_AR.EMM_WPT_ManSet_Rq_HU.phys = getValue( HMI_EMM_WPT_ManSet_Rq_HU );
    _mPNHV_WeekDepTmTbl_Rq_HU_AR.HU_DepTm_Actv.phys = getValue( HMI_HU_DepTm_Actv );
    _mPNHV_WeekDepTmTbl_Rq_HU_AR.HU_DepTmManSet_Hour_Rq.phys = getValue( HMI_HU_DepTmManSet_Hour_Rq );
    _mPNHV_WeekDepTmTbl_Rq_HU_AR.HU_DepTmManSet_Minute_Rq.phys = getValue( HMI_HU_DepTmManSet_Minute_Rq );
    _mPNHV_WeekDepTmTbl_Rq_HU_AR.HU_WeekDepTmTbl_Edit_Actv.phys = getValue( HMI_HU_WeekDepTmTbl_Edit_Actv );
    _mPNHV_WeekDepTmTbl_Rq_HU_AR.PNHV_WeekDepTmTbl_DelAll_Rq.phys = getValue( HMI_PNHV_WeekDepTmTbl_DelAll_Rq );
    _mPNHV_WeekDepTmTbl_Rq_HU_AR.PNHV_WeekDepTmTbl_DelTm_Rq_HU.phys = getValue( HMI_PNHV_WeekDepTmTbl_DelTm_Rq_HU );
    _mPNHV_WeekDepTmTbl_Rq_HU_AR.PNHV_WeekDepTmTbl_SetTm_Rq_HU.phys = getValue( HMI_PNHV_WeekDepTmTbl_SetTm_Rq_HU );
    _mPNHV_WeekDepTmTbl_Rq_HU_AR.PNHV_WeekDepTmTbl_Updt_Rq_HU.phys = getValue( HMI_PNHV_WeekDepTmTbl_Updt_Rq_HU );
    _mPNHV_WeekDepTmTbl_Rq_HU_AR.HU_ChrgProgSel_Rq.phys = getValue( HMI_HU_ChrgProgSel_Rq );
}

PNHV_WeekDepTmTbl_Rq_HU_AR_output(void)
{
    output( _mPNHV_WeekDepTmTbl_Rq_HU_AR );
}

PNHV_WeekDepTmTbl_Rq_HU_AR_saveEnvVars( dword hFile )
{
    filePutString("\n// Knoten EIS: PNHV_WeekDepTmTbl_Rq_HU_AR\n", 27, hFile );
    snprintf( buffer, elcount( buffer ), "0.0000 HMI__STMSG_PNHV_WeekDepTmTbl_Rq_HU_AR := %X\n", getValue( HMI__STMSG_PNHV_WeekDepTmTbl_Rq_HU_AR ) );        filePutString ( buffer, elcount( buffer ), hFile );
    snprintf( buffer, elcount( buffer ), "0.0000 HMI__STMSGT_PNHV_WeekDepTmTbl_Rq_HU_AR := %X\n", getValue( HMI__STMSGT_PNHV_WeekDepTmTbl_Rq_HU_AR ) );        filePutString ( buffer, elcount( buffer ), hFile );
    snprintf( buffer, elcount( buffer ), "0.0000 HMI_EMM_MaxSOC_Rq_HU := %X\n", getValue( HMI_EMM_MaxSOC_Rq_HU ) );        filePutString ( buffer, elcount( buffer ), hFile );
    snprintf( buffer, elcount( buffer ), "0.0000 HMI_EMM_WPT_ManSet_Rq_HU := %X\n", getValue( HMI_EMM_WPT_ManSet_Rq_HU ) );        filePutString ( buffer, elcount( buffer ), hFile );
    snprintf( buffer, elcount( buffer ), "0.0000 HMI_HU_DepTm_Actv := %X\n", getValue( HMI_HU_DepTm_Actv ) );        filePutString ( buffer, elcount( buffer ), hFile );
    snprintf( buffer, elcount( buffer ), "0.0000 HMI_HU_DepTmManSet_Hour_Rq := %X\n", getValue( HMI_HU_DepTmManSet_Hour_Rq ) );        filePutString ( buffer, elcount( buffer ), hFile );
    snprintf( buffer, elcount( buffer ), "0.0000 HMI_HU_DepTmManSet_Minute_Rq := %X\n", getValue( HMI_HU_DepTmManSet_Minute_Rq ) );        filePutString ( buffer, elcount( buffer ), hFile );
    snprintf( buffer, elcount( buffer ), "0.0000 HMI_HU_WeekDepTmTbl_Edit_Actv := %X\n", getValue( HMI_HU_WeekDepTmTbl_Edit_Actv ) );        filePutString ( buffer, elcount( buffer ), hFile );
    snprintf( buffer, elcount( buffer ), "0.0000 HMI_PNHV_WeekDepTmTbl_DelAll_Rq := %X\n", getValue( HMI_PNHV_WeekDepTmTbl_DelAll_Rq ) );        filePutString ( buffer, elcount( buffer ), hFile );
    snprintf( buffer, elcount( buffer ), "0.0000 HMI_PNHV_WeekDepTmTbl_DelTm_Rq_HU := %X\n", getValue( HMI_PNHV_WeekDepTmTbl_DelTm_Rq_HU ) );        filePutString ( buffer, elcount( buffer ), hFile );
    snprintf( buffer, elcount( buffer ), "0.0000 HMI_PNHV_WeekDepTmTbl_SetTm_Rq_HU := %X\n", getValue( HMI_PNHV_WeekDepTmTbl_SetTm_Rq_HU ) );        filePutString ( buffer, elcount( buffer ), hFile );
    snprintf( buffer, elcount( buffer ), "0.0000 HMI_PNHV_WeekDepTmTbl_Updt_Rq_HU := %X\n", getValue( HMI_PNHV_WeekDepTmTbl_Updt_Rq_HU ) );        filePutString ( buffer, elcount( buffer ), hFile );
    snprintf( buffer, elcount( buffer ), "0.0000 HMI_HU_ChrgProgSel_Rq := %X\n", getValue( HMI_HU_ChrgProgSel_Rq ) );        filePutString ( buffer, elcount( buffer ), hFile );
}

on timer _tPNHV_WeekDepTmTbl_Rq_HU_AR
{
    putValue( HMI__STMSG_PNHV_WeekDepTmTbl_Rq_HU_AR, 0 );
}

on EnvVar HMI__STMSG_PNHV_WeekDepTmTbl_Rq_HU_AR
{
    long tDelay;
    if( getValue( this ) == 2 )
    {
        tDelay = getValue( HMI__STMSGT_PNHV_WeekDepTmTbl_Rq_HU_AR );
        if( tDelay > 0)    
            setTimer( _tPNHV_WeekDepTmTbl_Rq_HU_AR, tDelay );
        else
            putValue( HMI__STMSG_PNHV_WeekDepTmTbl_Rq_HU_AR, 0 );
    }
}

on envVar HMI__STMSG_PO_PNHV_WeekDepTmTbl_Rq_HU_AR
{
    if( getValue( this ) )
        openPanel("PNHV_WeekDepTmTbl_Rq_HU_AR");
}

on EnvVar HMI_EMM_MaxSOC_Rq_HU
{
    _mPNHV_WeekDepTmTbl_Rq_HU_AR.EMM_MaxSOC_Rq_HU.phys = getValue(this);
    _PNHV_WeekDepTmTbl_Rq_HU_AR_SpontanFlag = 1;
}

on EnvVar HMI_EMM_WPT_ManSet_Rq_HU
{
    _mPNHV_WeekDepTmTbl_Rq_HU_AR.EMM_WPT_ManSet_Rq_HU.phys = getValue(this);
    _PNHV_WeekDepTmTbl_Rq_HU_AR_SpontanFlag = 1;
}

on EnvVar HMI_HU_DepTm_Actv
{
    _mPNHV_WeekDepTmTbl_Rq_HU_AR.HU_DepTm_Actv.phys = getValue(this);
    _PNHV_WeekDepTmTbl_Rq_HU_AR_SpontanFlag = 1;
}

on EnvVar HMI_HU_DepTmManSet_Hour_Rq
{
    _mPNHV_WeekDepTmTbl_Rq_HU_AR.HU_DepTmManSet_Hour_Rq.phys = getValue(this);
    _PNHV_WeekDepTmTbl_Rq_HU_AR_SpontanFlag = 1;
}

on EnvVar HMI_HU_DepTmManSet_Minute_Rq
{
    _mPNHV_WeekDepTmTbl_Rq_HU_AR.HU_DepTmManSet_Minute_Rq.phys = getValue(this);
    _PNHV_WeekDepTmTbl_Rq_HU_AR_SpontanFlag = 1;
}

on EnvVar HMI_HU_WeekDepTmTbl_Edit_Actv
{
    _mPNHV_WeekDepTmTbl_Rq_HU_AR.HU_WeekDepTmTbl_Edit_Actv.phys = getValue(this);
    _PNHV_WeekDepTmTbl_Rq_HU_AR_SpontanFlag = 1;
}

on EnvVar HMI_PNHV_WeekDepTmTbl_DelAll_Rq
{
    _mPNHV_WeekDepTmTbl_Rq_HU_AR.PNHV_WeekDepTmTbl_DelAll_Rq.phys = getValue(this);
    _PNHV_WeekDepTmTbl_Rq_HU_AR_SpontanFlag = 1;
}

on EnvVar HMI_PNHV_WeekDepTmTbl_DelTm_Rq_HU
{
    _mPNHV_WeekDepTmTbl_Rq_HU_AR.PNHV_WeekDepTmTbl_DelTm_Rq_HU.phys = getValue(this);
    _PNHV_WeekDepTmTbl_Rq_HU_AR_SpontanFlag = 1;
}

on EnvVar HMI_PNHV_WeekDepTmTbl_SetTm_Rq_HU
{
    _mPNHV_WeekDepTmTbl_Rq_HU_AR.PNHV_WeekDepTmTbl_SetTm_Rq_HU.phys = getValue(this);
    _PNHV_WeekDepTmTbl_Rq_HU_AR_SpontanFlag = 1;
}

on EnvVar HMI_PNHV_WeekDepTmTbl_Updt_Rq_HU
{
    _mPNHV_WeekDepTmTbl_Rq_HU_AR.PNHV_WeekDepTmTbl_Updt_Rq_HU.phys = getValue(this);
    _PNHV_WeekDepTmTbl_Rq_HU_AR_SpontanFlag = 1;
}

//on EnvVar HMI_HU_IntelRecup_Rq
//{
//    _mPNHV_WeekDepTmTbl_Rq_HU_AR.HU_IntelRecup_Rq.phys = getValue(this);
//    _PNHV_WeekDepTmTbl_Rq_HU_AR_SpontanFlag = 1;
//}

on EnvVar HMI_HU_ChrgProgSel_Rq
{
    _mPNHV_WeekDepTmTbl_Rq_HU_AR.HU_ChrgProgSel_Rq.phys = getValue(this);
    _PNHV_WeekDepTmTbl_Rq_HU_AR_SpontanFlag = 1;
}


RemDev_Touchscreen_check_output()
{
    if( !getValue( HMI__STMSG_RemDev_Touchscreen ) )
    {
    //  message   RemDev_Touchscreen ID: 626 --- Sendeart 1 spontanX --- 
        if( _RemDev_Touchscreen_SpontanFlag)
        {
            RemDev_Touchscreen_output(); // Nachricht wg. spontaner Änderung ausgeben
            _RemDev_Touchscreen_SpontanFlag = 0; // Spontan-Flag zurücksetzen
        }
    }
}

RemDev_Touchscreen_init()
{   /* Botschaft RemDev_Touchscreen ID: 626 --- Sendeart 1 spontanX --- 
BA_ "ApplMessage" BO_ 626 0;
BA_ "NmAsrMessage" BO_ 626 0;
BA_ "GenMsgMinAcceptLength" BO_ 626 8;
BA_ "GenMsgILSupport" BO_ 626 1;
BA_ "DiagState" BO_ 626 0;
BA_ "DiagRequest" BO_ 626 0;
BA_ "DiagResponse" BO_ 626 0;
BA_ "GenMsgStartValue" BO_ 626 "0";
BA_ "GenMsgDelayTime" BO_ 626 100;
BA_ "GenMsgNrOfRepetition" BO_ 626 0;
BA_ "GenMsgSendType" BO_ 626 1;
    */
    _RemDev_Touchscreen_Timebase =      c_tDBKomTimer_20ms;
    _RemDev_Touchscreen_SpontanFlag = 0;

    _mRemDev_Touchscreen.RemDev_TouchEv_FctrAngl.phys = getValue( HMI_RemDev_TouchEv_FctrAngl );
    _mRemDev_Touchscreen.RemDev_TouchEv_Gest_Speed.phys = getValue( HMI_RemDev_TouchEv_Gest_Speed );
    _mRemDev_Touchscreen.RemDev_TouchEv_Gest_Stat.phys = getValue( HMI_RemDev_TouchEv_Gest_Stat );
    _mRemDev_Touchscreen.RemDev_TouchEv_PosX.phys = getValue( HMI_RemDev_TouchEv_PosX );
    _mRemDev_Touchscreen.RemDev_TouchEv_PosY.phys = getValue( HMI_RemDev_TouchEv_PosY );
    _mRemDev_Touchscreen.RemDev_TouchEv_ProxSens_Stat.phys = getValue( HMI_RemDev_TouchEv_ProxSens_Stat );
    _mRemDev_Touchscreen.RemDev_TouchEv_Type.phys = getValue( HMI_RemDev_TouchEv_Type );
    
}

RemDev_Touchscreen_output(void)
{
    output( _mRemDev_Touchscreen );
}

RemDev_Touchscreen_saveEnvVars( dword hFile )
{
    filePutString("\n// Knoten EIS: RemDev_Touchscreen\n", 24, hFile );
    snprintf( buffer, elcount( buffer ), "0.0000 HMI__STMSG_RemDev_Touchscreen := %X\n", getValue( HMI__STMSG_RemDev_Touchscreen ) );        filePutString( buffer, elcount( buffer ), hFile );
    snprintf( buffer, elcount( buffer ), "0.0000 HMI__STMSGT_RemDev_Touchscreen := %X\n", getValue( HMI__STMSGT_RemDev_Touchscreen ) );        filePutString( buffer, elcount( buffer ), hFile );
    snprintf( buffer, elcount( buffer ), "0.0000 HMI_RemDev_TouchEv_FctrAngl := %X\n", getValue( HMI_RemDev_TouchEv_FctrAngl ) );        filePutString( buffer, elcount( buffer ), hFile );
    snprintf( buffer, elcount( buffer ), "0.0000 HMI_RemDev_TouchEv_Gest_Speed := %X\n", getValue( HMI_RemDev_TouchEv_Gest_Speed ) );        filePutString( buffer, elcount( buffer ), hFile );
    snprintf( buffer, elcount( buffer ), "0.0000 HMI_RemDev_TouchEv_Gest_Stat := %X\n", getValue( HMI_RemDev_TouchEv_Gest_Stat ) );        filePutString( buffer, elcount( buffer ), hFile );
    snprintf( buffer, elcount( buffer ), "0.0000 HMI_RemDev_TouchEv_PosX := %X\n", getValue( HMI_RemDev_TouchEv_PosX ) );        filePutString( buffer, elcount( buffer ), hFile );
    snprintf( buffer, elcount( buffer ), "0.0000 HMI_RemDev_TouchEv_PosY := %X\n", getValue( HMI_RemDev_TouchEv_PosY ) );        filePutString( buffer, elcount( buffer ), hFile );
    snprintf( buffer, elcount( buffer ), "0.0000 HMI_RemDev_TouchEv_ProxSens_Stat := %X\n", getValue( HMI_RemDev_TouchEv_ProxSens_Stat ) );        filePutString( buffer, elcount( buffer ), hFile );
    snprintf( buffer, elcount( buffer ), "0.0000 HMI_RemDev_TouchEv_Type := %X\n", getValue( HMI_RemDev_TouchEv_Type ) );        filePutString( buffer, elcount( buffer ), hFile );
}

on timer _tRemDev_Touchscreen
{
    putValue( HMI__STMSG_RemDev_Touchscreen, 0 );
}

on EnvVar HMI__STMSG_RemDev_Touchscreen
{
    long tDelay;
    if( getValue( this ) == 2 )
    {
        tDelay = getValue( HMI__STMSGT_RemDev_Touchscreen );
        if( tDelay > 0)    
            setTimer( _tRemDev_Touchscreen, tDelay );
        else
            putValue( HMI__STMSG_RemDev_Touchscreen, 0 );
    }
}

on envVar HMI__STMSG_PO_RemDev_Touchscreen
{
    if( getValue( this ) )
        openPanel("RemDev_Touchscreen");
}

on EnvVar HMI_RemDev_TouchEv_FctrAngl
{
    _mRemDev_Touchscreen.RemDev_TouchEv_FctrAngl.phys = getValue(this);
    _RemDev_Touchscreen_SpontanFlag = 1;
}

on EnvVar HMI_RemDev_TouchEv_Gest_Speed
{
    _mRemDev_Touchscreen.RemDev_TouchEv_Gest_Speed.phys = getValue(this);
    _RemDev_Touchscreen_SpontanFlag = 1;
}

on EnvVar HMI_RemDev_TouchEv_Gest_Stat
{
    _mRemDev_Touchscreen.RemDev_TouchEv_Gest_Stat.phys = getValue(this);
    _RemDev_Touchscreen_SpontanFlag = 1;
}

on EnvVar HMI_RemDev_TouchEv_PosX
{
    _mRemDev_Touchscreen.RemDev_TouchEv_PosX.phys = getValue(this);
    _RemDev_Touchscreen_SpontanFlag = 1;
}

on EnvVar HMI_RemDev_TouchEv_PosY
{
    _mRemDev_Touchscreen.RemDev_TouchEv_PosY.phys = getValue(this);
    _RemDev_Touchscreen_SpontanFlag = 1;
}

on EnvVar HMI_RemDev_TouchEv_ProxSens_Stat
{
    _mRemDev_Touchscreen.RemDev_TouchEv_ProxSens_Stat.phys = getValue(this);
    _RemDev_Touchscreen_SpontanFlag = 1;
}

on EnvVar HMI_RemDev_TouchEv_Type
{
    _mRemDev_Touchscreen.RemDev_TouchEv_Type.phys = getValue(this);
    _RemDev_Touchscreen_SpontanFlag = 1;
}

ROE_CTRL_C_check_output()
{
    if( !getValue( HMI__STMSG_ROE_CTRL_C ))
    {
        // Botschaft ROE_CTRL_C ID: 2012 --- Sendeart 9 cyclicWithRepeatOnDemand --- 
        if( _ROE_CTRL_C_Cnt > 0 )
        {
            _ROE_CTRL_C_Cnt--;
            if( _ROE_CTRL_C_Cnt < 1 )
            {
                // Nachricht wg. abgelaufenem Zyklus ausgeben
                output( _mROE_CTRL_C );
                _ROE_CTRL_C_MsgRepetitions--;
                if( _ROE_CTRL_C_MsgRepetitions > 0 ) _ROE_CTRL_C_Cnt = _ROE_CTRL_C_CycleCount;
            }
        }
    }
}

ROE_CTRL_C_init()
{   /* Botschaft ROE_CTRL_C ID: 2012 --- Sendeart 9 cyclicWithRepeatOnDemand ---  
BA_ "ApplMessage" BO_ 2012 0;
BA_ "NmAsrMessage" BO_ 2012 0;
BA_ "GenMsgMinAcceptLength" BO_ 2012 8;
BA_ "GenMsgILSupport" BO_ 2012 1;
BA_ "DiagState" BO_ 2012 0;
BA_ "DiagRequest" BO_ 2012 0;
BA_ "DiagResponse" BO_ 2012 0;
BA_ "GenMsgStartValue" BO_ 2012 "0";
BA_ "GenMsgDelayTime" BO_ 2012 5;
BA_ "GenMsgNrOfRepetitions" BO_ 2012 0;
BA_ "GenMsgCycleTime" BO_ 2012 200;
BA_ "GenMsgSendType" BO_ 2012 9;
    */
    _ROE_CTRL_C_Timebase = 20;
    _ROE_CTRL_C_Cnt = 0;
    _ROE_CTRL_C_MsgRepetitions = 0;
    _mROE_CTRL_C.ROE_Header_CTRL_C.phys = getValue(HMI_ROE_Header_CTRL_C );
    _mROE_CTRL_C.ROE_DTC_Stat_CTRL_C.phys = getValue(HMI_ROE_DTC_Stat_CTRL_C );
    _mROE_CTRL_C.ROE_DTC_CTRL_C.phys = getValue(HMI_ROE_DTC_CTRL_C );
}

ROE_CTRL_C_saveEnvVars( dword hFile )
{
    filePutString("\n// Knoten TGW: ROE_CTRL_C\n", 30, hFile);
    snprintf( buffer, elcount(buffer), "0.0000 HMI__STMSG_ROE_CTRL_C := %X\n", getValue( HMI__STMSG_ROE_CTRL_C ));        filePutString( buffer, elcount(buffer), hFile);
    snprintf( buffer, elcount(buffer), "0.0000 HMI__STMSGT_ROE_CTRL_C := %X\n", getValue( HMI__STMSGT_ROE_CTRL_C ));        filePutString( buffer, elcount(buffer), hFile);
    snprintf( buffer, elcount(buffer), "0.0000 HMI_ROE_DTC_CTRL_C := %X\n", getValue( HMI_ROE_DTC_CTRL_C ) );        filePutString( buffer, elcount(buffer), hFile);
    snprintf( buffer, elcount(buffer), "0.0000 HMI_ROE_DTC_Stat_CTRL_C := %X\n", getValue( HMI_ROE_DTC_Stat_CTRL_C ) );        filePutString( buffer, elcount(buffer), hFile);
    snprintf( buffer, elcount(buffer), "0.0000 HMI_ROE_Header_CTRL_C := %X\n", getValue( HMI_ROE_Header_CTRL_C ) );        filePutString( buffer, elcount(buffer), hFile);
}

ROE_CTRL_C_restart(int nNumRepetitions)
{
    if( nNumRepetitions > _ROE_CTRL_C_MsgRepetitions )
    {
        if( _ROE_CTRL_C_MsgRepetitions < 1 )
            _ROE_CTRL_C_Cnt = 1;
        _ROE_CTRL_C_MsgRepetitions = nNumRepetitions;
    }
}

on envVar HMI__STMSG_PO_ROE_CTRL_C
{
    if( getValue( this ) )
        openPanel("ROE_CTRL_C");
}

on EnvVar HMI_ROE_DTC_CTRL_C
{
    _mROE_CTRL_C.ROE_DTC_CTRL_C.phys = getValue(this);
    ROE_CTRL_C_restart( 1 );
}

on EnvVar HMI_ROE_DTC_Stat_CTRL_C
{
    _mROE_CTRL_C.ROE_DTC_Stat_CTRL_C.phys = getValue(this);
    ROE_CTRL_C_restart( 1 );
}

on EnvVar HMI_ROE_Header_CTRL_C
{
    _mROE_CTRL_C.ROE_Header_CTRL_C.phys = getValue(this);
    ROE_CTRL_C_restart( 1 );
}

ROE_DISP_C_check_output()
{
    if( !getValue( HMI__STMSG_ROE_DISP_C ))
    {
        // Botschaft ROE_DISP_C ID: 2013 --- Sendeart 9 cyclicWithRepeatOnDemand --- 
        if( _ROE_DISP_C_Cnt > 0 )
        {
            _ROE_DISP_C_Cnt--;
            if( _ROE_DISP_C_Cnt < 1 )
            {
                // Nachricht wg. abgelaufenem Zyklus ausgeben
                output( _mROE_DISP_C );
                _ROE_DISP_C_MsgRepetitions--;
                if( _ROE_DISP_C_MsgRepetitions > 0 ) _ROE_DISP_C_Cnt = _ROE_DISP_C_CycleCount;
            }
        }
    }
}

ROE_DISP_C_init()
{   /* Botschaft ROE_DISP_C ID: 2013 --- Sendeart 9 cyclicWithRepeatOnDemand ---  
BA_ "ApplMessage" BO_ 2013 0;
BA_ "NmAsrMessage" BO_ 2013 0;
BA_ "GenMsgMinAcceptLength" BO_ 2013 8;
BA_ "GenMsgILSupport" BO_ 2013 1;
BA_ "DiagState" BO_ 2013 0;
BA_ "DiagRequest" BO_ 2013 0;
BA_ "DiagResponse" BO_ 2013 0;
BA_ "GenMsgStartValue" BO_ 2013 "0";
BA_ "GenMsgDelayTime" BO_ 2013 5;
BA_ "GenMsgNrOfRepetitions" BO_ 2013 0;
BA_ "GenMsgCycleTime" BO_ 2013 200;
BA_ "GenMsgSendType" BO_ 2013 9;
    */
    _ROE_DISP_C_Timebase = 20;
    _ROE_DISP_C_Cnt = 0;
    _ROE_DISP_C_MsgRepetitions = 0;
    _mROE_DISP_C.ROE_Header_DISP_C.phys = getValue(HMI_ROE_Header_DISP_C );
    _mROE_DISP_C.ROE_DTC_Stat_DISP_C.phys = getValue(HMI_ROE_DTC_Stat_DISP_C );
    _mROE_DISP_C.ROE_DTC_DISP_C.phys = getValue(HMI_ROE_DTC_DISP_C );
}

ROE_DISP_C_saveEnvVars( dword hFile )
{
    filePutString("\n// Knoten TGW: ROE_DISP_C\n", 30, hFile);
    snprintf( buffer, elcount(buffer), "0.0000 HMI__STMSG_ROE_DISP_C := %X\n", getValue( HMI__STMSG_ROE_DISP_C ));        filePutString( buffer, elcount(buffer), hFile);
    snprintf( buffer, elcount(buffer), "0.0000 HMI__STMSGT_ROE_DISP_C := %X\n", getValue( HMI__STMSGT_ROE_DISP_C ));        filePutString( buffer, elcount(buffer), hFile);
    snprintf( buffer, elcount(buffer), "0.0000 HMI_ROE_DTC_DISP_C := %X\n", getValue( HMI_ROE_DTC_DISP_C ) );        filePutString( buffer, elcount(buffer), hFile);
    snprintf( buffer, elcount(buffer), "0.0000 HMI_ROE_DTC_Stat_DISP_C := %X\n", getValue( HMI_ROE_DTC_Stat_DISP_C ) );        filePutString( buffer, elcount(buffer), hFile);
    snprintf( buffer, elcount(buffer), "0.0000 HMI_ROE_Header_DISP_C := %X\n", getValue( HMI_ROE_Header_DISP_C ) );        filePutString( buffer, elcount(buffer), hFile);
}

ROE_DISP_RL_check_output()
{
    if( !getValue( HMI__STMSG_ROE_DISP_RL ))
    {
        // Botschaft ROE_DISP_RL ID: 2011 --- Sendeart 9 cyclicWithRepeatOnDemand --- 
        if( _ROE_DISP_RL_Cnt > 0 )
        {
            _ROE_DISP_RL_Cnt--;
            if( _ROE_DISP_RL_Cnt < 1 )
            {
                // Nachricht wg. abgelaufenem Zyklus ausgeben
                output( _mROE_DISP_RL );
                _ROE_DISP_RL_MsgRepetitions--;
                if( _ROE_DISP_RL_MsgRepetitions > 0 ) _ROE_DISP_RL_Cnt = _ROE_DISP_RL_CycleCount;
            }
        }
    }
}

ROE_DISP_RL_init()
{   /* Botschaft ROE_DISP_RL ID: 2011 --- Sendeart 9 cyclicWithRepeatOnDemand ---  
BA_ "ApplMessage" BO_ 2011 0;
BA_ "NmAsrMessage" BO_ 2011 0;
BA_ "GenMsgMinAcceptLength" BO_ 2011 8;
BA_ "GenMsgILSupport" BO_ 2011 1;
BA_ "DiagState" BO_ 2011 0;
BA_ "DiagRequest" BO_ 2011 0;
BA_ "DiagResponse" BO_ 2011 0;
BA_ "GenMsgStartValue" BO_ 2011 "0";
BA_ "GenMsgDelayTime" BO_ 2011 5;
BA_ "GenMsgNrOfRepetitions" BO_ 2011 0;
BA_ "GenMsgCycleTime" BO_ 2011 200;
BA_ "GenMsgSendType" BO_ 2011 9;
    */
    _ROE_DISP_RL_Timebase = 20;
    _ROE_DISP_RL_Cnt = 0;
    _ROE_DISP_RL_MsgRepetitions = 0;
    _mROE_DISP_RL.ROE_Header_DISP_RL.phys = getValue(HMI_ROE_Header_DISP_RL );
    _mROE_DISP_RL.ROE_DTC_Stat_DISP_RL.phys = getValue(HMI_ROE_DTC_Stat_DISP_RL );
    _mROE_DISP_RL.ROE_DTC_DISP_RL.phys = getValue(HMI_ROE_DTC_DISP_RL );
}

ROE_DISP_RL_saveEnvVars( dword hFile )
{
    filePutString("\n// Knoten TGW: ROE_DISP_RL\n", 30, hFile);
    snprintf( buffer, elcount(buffer), "0.0000 HMI__STMSG_ROE_DISP_RL := %X\n", getValue( HMI__STMSG_ROE_DISP_RL ));        filePutString( buffer, elcount(buffer), hFile);
    snprintf( buffer, elcount(buffer), "0.0000 HMI__STMSGT_ROE_DISP_RL := %X\n", getValue( HMI__STMSGT_ROE_DISP_RL ));        filePutString( buffer, elcount(buffer), hFile);
    snprintf( buffer, elcount(buffer), "0.0000 HMI_ROE_DTC_DISP_RL := %X\n", getValue( HMI_ROE_DTC_DISP_RL ) );        filePutString( buffer, elcount(buffer), hFile);
    snprintf( buffer, elcount(buffer), "0.0000 HMI_ROE_DTC_Stat_DISP_RL := %X\n", getValue( HMI_ROE_DTC_Stat_DISP_RL ) );        filePutString( buffer, elcount(buffer), hFile);
    snprintf( buffer, elcount(buffer), "0.0000 HMI_ROE_Header_DISP_RL := %X\n", getValue( HMI_ROE_Header_DISP_RL ) );        filePutString( buffer, elcount(buffer), hFile);
}

ROE_DISP_RR_check_output()
{
    if( !getValue( HMI__STMSG_ROE_DISP_RR ))
    {
        // Botschaft ROE_DISP_RR ID: 2010 --- Sendeart 9 cyclicWithRepeatOnDemand --- 
        if( _ROE_DISP_RR_Cnt > 0 )
        {
            _ROE_DISP_RR_Cnt--;
            if( _ROE_DISP_RR_Cnt < 1 )
            {
                // Nachricht wg. abgelaufenem Zyklus ausgeben
                output( _mROE_DISP_RR );
                _ROE_DISP_RR_MsgRepetitions--;
                if( _ROE_DISP_RR_MsgRepetitions > 0 ) _ROE_DISP_RR_Cnt = _ROE_DISP_RR_CycleCount;
            }
        }
    }
}

ROE_DISP_RR_init()
{   /* Botschaft ROE_DISP_RR ID: 2010 --- Sendeart 9 cyclicWithRepeatOnDemand ---  
BA_ "ApplMessage" BO_ 2010 0;
BA_ "NmAsrMessage" BO_ 2010 0;
BA_ "GenMsgMinAcceptLength" BO_ 2010 8;
BA_ "GenMsgILSupport" BO_ 2010 1;
BA_ "DiagState" BO_ 2010 0;
BA_ "DiagRequest" BO_ 2010 0;
BA_ "DiagResponse" BO_ 2010 0;
BA_ "GenMsgStartValue" BO_ 2010 "0";
BA_ "GenMsgDelayTime" BO_ 2010 5;
BA_ "GenMsgNrOfRepetitions" BO_ 2010 0;
BA_ "GenMsgCycleTime" BO_ 2010 200;
BA_ "GenMsgSendType" BO_ 2010 9;
    */
    _ROE_DISP_RR_Timebase = 20;
    _ROE_DISP_RR_Cnt = 0;
    _ROE_DISP_RR_MsgRepetitions = 0;
    _mROE_DISP_RR.ROE_Header_DISP_RR.phys = getValue(HMI_ROE_Header_DISP_RR );
    _mROE_DISP_RR.ROE_DTC_Stat_DISP_RR.phys = getValue(HMI_ROE_DTC_Stat_DISP_RR );
    _mROE_DISP_RR.ROE_DTC_DISP_RR.phys = getValue(HMI_ROE_DTC_DISP_RR );
}

ROE_DISP_RR_saveEnvVars( dword hFile )
{
    filePutString("\n// Knoten TGW: ROE_DISP_RR\n", 30, hFile);
    snprintf( buffer, elcount(buffer), "0.0000 HMI__STMSG_ROE_DISP_RR := %X\n", getValue( HMI__STMSG_ROE_DISP_RR ));        filePutString( buffer, elcount(buffer), hFile);
    snprintf( buffer, elcount(buffer), "0.0000 HMI__STMSGT_ROE_DISP_RR := %X\n", getValue( HMI__STMSGT_ROE_DISP_RR ));        filePutString( buffer, elcount(buffer), hFile);
    snprintf( buffer, elcount(buffer), "0.0000 HMI_ROE_DTC_DISP_RR := %X\n", getValue( HMI_ROE_DTC_DISP_RR ) );        filePutString( buffer, elcount(buffer), hFile);
    snprintf( buffer, elcount(buffer), "0.0000 HMI_ROE_DTC_Stat_DISP_RR := %X\n", getValue( HMI_ROE_DTC_Stat_DISP_RR ) );        filePutString( buffer, elcount(buffer), hFile);
    snprintf( buffer, elcount(buffer), "0.0000 HMI_ROE_Header_DISP_RR := %X\n", getValue( HMI_ROE_Header_DISP_RR ) );        filePutString( buffer, elcount(buffer), hFile);
}

ROE_FONDUNIT_init()
{   /* Botschaft ROE_FONDUNIT ID: 2007 --- Sendeart 9 cyclicWithRepeatOnDemand ---  
BA_ "ApplMessage" BO_ 2007 0;
BA_ "NmAsrMessage" BO_ 2007 0;
BA_ "GenMsgMinAcceptLength" BO_ 2007 8;
BA_ "GenMsgILSupport" BO_ 2007 1;
BA_ "DiagState" BO_ 2007 0;
BA_ "DiagRequest" BO_ 2007 0;
BA_ "DiagResponse" BO_ 2007 0;
BA_ "GenMsgStartValue" BO_ 2007 "0";
BA_ "GenMsgDelayTime" BO_ 2007 5;
BA_ "GenMsgNrOfRepetitions" BO_ 2007 0;
BA_ "GenMsgCycleTime" BO_ 2007 200;
BA_ "GenMsgSendType" BO_ 2007 9;
    */
    _ROE_FONDUNIT_Timebase = 20;
    _ROE_FONDUNIT_Cnt = 0;
    _ROE_FONDUNIT_MsgRepetitions = 0;
    _mROE_FONDUNIT.ROE_Header_FONDUNIT.phys = getValue(HMI_ROE_Header_FONDUNIT );
    _mROE_FONDUNIT.ROE_DTC_Stat_FONDUNIT.phys = getValue(HMI_ROE_DTC_Stat_FONDUNIT );
    _mROE_FONDUNIT.ROE_DTC_FONDUNIT.phys = getValue(HMI_ROE_DTC_FONDUNIT );
}

/*

BO_ 2012 ROE_CTRL_C : 8 TGW
ROE_DTC_CTRL_C : 32|24@1+ (1,0) [0|16777215] "" EIS
ROE_DTC_Stat_CTRL_C : 56|8@1+ (1,0) [0|255] "" EIS
ROE_Header_CTRL_C : 0|32@1+ (1,0) [0|4294967295] "" EIS

BO_ 2013 ROE_DISP_C : 8 TGW
ROE_DTC_DISP_C : 32|24@1+ (1,0) [0|16777215] "" EIS
ROE_DTC_Stat_DISP_C : 56|8@1+ (1,0) [0|255] "" EIS
ROE_Header_DISP_C : 0|32@1+ (1,0) [0|4294967295] "" EIS

BO_ 2011 ROE_DISP_RL : 8 TGW
ROE_DTC_DISP_RL : 32|24@1+ (1,0) [0|16777215] "" EIS
ROE_DTC_Stat_DISP_RL : 56|8@1+ (1,0) [0|255] "" EIS
ROE_Header_DISP_RL : 0|32@1+ (1,0) [0|4294967295] "" EIS

BO_ 2010 ROE_DISP_RR : 8 TGW
ROE_DTC_DISP_RR : 32|24@1+ (1,0) [0|16777215] "" EIS
ROE_DTC_Stat_DISP_RR : 56|8@1+ (1,0) [0|255] "" EIS
ROE_Header_DISP_RR : 0|32@1+ (1,0) [0|4294967295] "" EIS

BO_ 2007 ROE_FONDUNIT : 8 TGW
ROE_DTC_FONDUNIT : 32|24@1+ (1,0) [0|16777215] "" EIS
ROE_DTC_Stat_FONDUNIT : 56|8@1+ (1,0) [0|255] "" EIS
ROE_Header_FONDUNIT : 0|32@1+ (1,0) [0|4294967295] "" EIS
*/

ROE_SOUND_check_output()
{
    if( !getValue( HMI__STMSG_ROE_SOUND))
    {
        // Botschaft ROE_SOUND ID: 2007 --- Sendeart cyclicWithRepeatOnDemand --- 
        if( _ROE_SOUND_Cnt > 0 )
        {
            _ROE_SOUND_Cnt--;
            if( _ROE_SOUND_Cnt < 1 )
            {
                // Nachricht wg. abgelaufenem Zyklus ausgeben
                output( _mROE_SOUND);
                _ROE_SOUND_MsgRepetitions--;
                if( _ROE_SOUND_MsgRepetitions > 0 ) _ROE_SOUND_Cnt = _ROE_SOUND_CycleCount;
            }
        }
    }
}

ROE_SOUND_init()
{   /* Botschaft ROE_SOUND ID: 2008 --- Sendeart 9 cyclicWithRepeatOnDemand ---  
BA_ "ApplMessage" BO_ 2008 0;
BA_ "NmAsrMessage" BO_ 2008 0;
BA_ "GenMsgMinAcceptLength" BO_ 2008 8;
BA_ "GenMsgILSupport" BO_ 2008 1;
BA_ "DiagState" BO_ 2008 0;
BA_ "DiagRequest" BO_ 2008 0;
BA_ "DiagResponse" BO_ 2008 0;
BA_ "GenMsgStartValue" BO_ 2008 "0";
BA_ "GenMsgDelayTime" BO_ 2008 5;
BA_ "GenMsgNrOfRepetitions" BO_ 2008 0;
BA_ "GenMsgCycleTime" BO_ 2008 200;
BA_ "GenMsgSendType" BO_ 2008 9;
    */
    _ROE_SOUND_Timebase = 20;
    _ROE_SOUND_Cnt = 0;
    _ROE_SOUND_MsgRepetitions = 0;
    
    _mROE_SOUND.ROE_Header_SOUND.phys = getValue(HMI_ROE_Header_SOUND );
    _mROE_SOUND.ROE_DTC_Stat_SOUND.phys = getValue(HMI_ROE_DTC_Stat_SOUND );
    _mROE_SOUND.ROE_DTC_SOUND.phys = getValue(HMI_ROE_DTC_SOUND );
}

ROE_TGW_check_output()
{
    if( !getValue( HMI__STMSG_ROE_TGW))
    {
        // Botschaft ROE_TGW ID: 2014 --- Sendeart 9 cyclicWithRepeatOnDemand --- 
        if( _ROE_TGW_Cnt > 0 )
        {
            _ROE_TGW_Cnt--;
            if( _ROE_TGW_Cnt < 1 )
            {
                // Nachricht wg. abgelaufenem Zyklus ausgeben
                output( _mROE_TGW);
                _ROE_TGW_MsgRepetitions--;
                if( _ROE_TGW_MsgRepetitions > 0 ) _ROE_TGW_Cnt = _ROE_TGW_CycleCount;
            }
        }
    }
}

ROE_TGW_init()
{
    /* Botschaft ROE_TGW ID: 2014 --- Sendeart cyclicWithRepeatOnDemand --- 
BA_ "ApplMessage" BO_ 2014 0;
BA_ "NmAsrMessage" BO_ 2014 0;
BA_ "GenMsgMinAcceptLength" BO_ 2014 8;
BA_ "GenMsgILSupport" BO_ 2014 1;
BA_ "DiagState" BO_ 2014 0;
BA_ "DiagRequest" BO_ 2014 0;
BA_ "DiagResponse" BO_ 2014 0;
BA_ "GenMsgStartValue" BO_ 2014 "0";
BA_ "GenMsgDelayTime" BO_ 2014 5;
BA_ "GenMsgNrOfRepetitions" BO_ 2014 0;
BA_ "GenMsgCycleTime" BO_ 2014 200;
BA_ "GenMsgSendType" BO_ 2014 9;
    */
    _ROE_TGW_Timebase =           c_tDBKomTimer_20ms;
    _ROE_TGW_CycleCount =        200 / _ROE_TGW_Timebase;
    _ROE_TGW_StartDelay =          0 / _ROE_TGW_Timebase;
    _ROE_TGW_Cnt = 0;
    _ROE_TGW_MsgRepetitions = 0;

    putValue( HMI__STMSGSD_ROE_TGW, _ROE_TGW_StartDelay * _ROE_TGW_Timebase );

    _mROE_TGW.ROE_Header_TGW.phys = getValue(HMI_ROE_Header_TGW);
    _mROE_TGW.ROE_DTC_Stat_TGW.phys = getValue(HMI_ROE_DTC_Stat_TGW);
    _mROE_TGW.ROE_DTC_TGW.phys = getValue(HMI_ROE_DTC_TGW);
}

ROE_TGW_restart(int nNumRepetitions)
{
    if( nNumRepetitions > _ROE_TGW_MsgRepetitions )
    {
        if( _ROE_TGW_MsgRepetitions < 1 )
            _ROE_TGW_Cnt = 1;
        _ROE_TGW_MsgRepetitions = nNumRepetitions;
    }
}

on envVar HMI__STMSG_PO_ROE_TGW
{
    if( getValue( this ) )
        openPanel("ROE_TGW");
}

on EnvVar HMI_ROE_Header_TGW
{
    _mROE_TGW.ROE_Header_TGW.phys = getValue(this);
    ROE_TGW_restart( 1 );
}

on EnvVar HMI_ROE_DTC_Stat_TGW
{
    _mROE_TGW.ROE_DTC_Stat_TGW.phys = getValue(this);
    ROE_TGW_restart( 1 );
}

on EnvVar HMI_ROE_DTC_TGW
{
    _mROE_TGW.ROE_DTC_TGW.phys = getValue(this);
    ROE_TGW_restart( 1 );
}

ROE_TPAD_init()
{   /* Botschaft ROE_TPAD ID: 1981 --- Sendeart 9 cyclicWithRepeatOnDemand ---  
BA_ "ApplMessage" BO_ 1981 0;
BA_ "NmAsrMessage" BO_ 1981 0;
BA_ "GenMsgMinAcceptLength" BO_ 1981 8;
BA_ "GenMsgILSupport" BO_ 1981 1;
BA_ "DiagState" BO_ 1981 0;
BA_ "DiagRequest" BO_ 1981 0;
BA_ "DiagResponse" BO_ 1981 0;
BA_ "GenMsgStartValue" BO_ 1981 "0";
BA_ "GenMsgDelayTime" BO_ 1981 5;
BA_ "GenMsgNrOfRepetitions" BO_ 1981 0;
BA_ "GenMsgCycleTime" BO_ 1981 200;
BA_ "GenMsgSendType" BO_ 1981 9;
    */
    _ROE_TPAD_Timebase =           c_tDBKomTimer_20ms;
    _ROE_TPAD_CycleCount =      65535 / _ROE_TPAD_Timebase;
    _ROE_TPAD_Cnt = 0;
    _ROE_TPAD_StartDelay =          0 / _ROE_TPAD_Timebase;
    _ROE_TPAD_MsgRepetitions = 0;

    putValue( HMI__STMSGSD_ROE_TPAD, _ROE_TPAD_StartDelay * _ROE_TPAD_Timebase );

    _mROE_TPAD.ROE_DTC_TPAD.phys = getValue( HMI_ROE_DTC_TPAD );
    _mROE_TPAD.ROE_DTC_Stat_TPAD.phys = getValue( HMI_ROE_DTC_Stat_TPAD );
    _mROE_TPAD.ROE_Header_TPAD.phys = getValue( HMI_ROE_Header_TPAD );
}

ROE_TUNER_DAB_init()
{   /* Botschaft ROE_TUNER_DAB ID: 2005 --- Sendeart 9 cyclicWithRepeatOnDemand ---  
BA_ "ApplMessage" BO_ 2005 0;
BA_ "NmAsrMessage" BO_ 2005 0;
BA_ "GenMsgMinAcceptLength" BO_ 2005 8;
BA_ "GenMsgILSupport" BO_ 2005 1;
BA_ "DiagState" BO_ 2005 0;
BA_ "DiagRequest" BO_ 2005 0;
BA_ "DiagResponse" BO_ 2005 0;
BA_ "GenMsgStartValue" BO_ 2005 "0";
BA_ "GenMsgDelayTime" BO_ 2005 5;
BA_ "GenMsgNrOfRepetitions" BO_ 2005 0;
BA_ "GenMsgCycleTime" BO_ 2005 200;
BA_ "GenMsgSendType" BO_ 2005 9;
    */
    _ROE_TUNER_DAB_Timebase =           c_tDBKomTimer_20ms;
    _ROE_TUNER_DAB_CycleCount =      65535 / _ROE_TUNER_DAB_Timebase;
    _ROE_TUNER_DAB_StartDelay =          0 / _ROE_TUNER_DAB_Timebase;
    _ROE_TUNER_DAB_Cnt = 0;
    _ROE_TUNER_DAB_MsgRepetitions = 0;

    putValue( HMI__STMSGSD_ROE_TUNER_DAB, _ROE_TUNER_DAB_StartDelay * _ROE_TUNER_DAB_Timebase );

    _mROE_TUNER_DAB.ROE_DTC_TUNER_DAB.phys = getValue( HMI_ROE_DTC_TUNER_DAB );
    _mROE_TUNER_DAB.ROE_DTC_Stat_TUNER_DAB.phys = getValue( HMI_ROE_DTC_Stat_TUNER_DAB );
    _mROE_TUNER_DAB.ROE_Header_TUNER_DAB.phys = getValue( HMI_ROE_Header_TUNER_DAB );
}

ROE_TUNER_TV_SDARS_init()
{   /* Botschaft ROE_TUNER_TV_SDARS ID: 2009 --- Sendeart 9 cyclicWithRepeatOnDemand ---  
BA_ "ApplMessage" BO_ 2009 0;
BA_ "NmAsrMessage" BO_ 2009 0;
BA_ "GenMsgMinAcceptLength" BO_ 2009 8;
BA_ "GenMsgILSupport" BO_ 2009 1;
BA_ "DiagState" BO_ 2009 0;
BA_ "DiagRequest" BO_ 2009 0;
BA_ "DiagResponse" BO_ 2009 0;
BA_ "GenMsgStartValue" BO_ 2009 "0";
BA_ "GenMsgDelayTime" BO_ 2009 5;
BA_ "GenMsgNrOfRepetitions" BO_ 2009 0;
BA_ "GenMsgCycleTime" BO_ 2009 200;
BA_ "GenMsgSendType" BO_ 2009 9;
    */
    _ROE_TUNER_TV_SDARS_Timebase =           c_tDBKomTimer_20ms;
    _ROE_TUNER_TV_SDARS_CycleCount =      65535 / _ROE_TUNER_TV_SDARS_Timebase;
    _ROE_TUNER_TV_SDARS_StartDelay =          0 / _ROE_TUNER_TV_SDARS_Timebase;
    _ROE_TUNER_TV_SDARS_Cnt = 0;
    _ROE_TUNER_TV_SDARS_MsgRepetitions = 0;

    putValue( HMI__STMSGSD_ROE_TUNER_TV_SDARS, _ROE_TUNER_TV_SDARS_StartDelay * _ROE_TUNER_TV_SDARS_Timebase );

    _mROE_TUNER_TV_SDARS.ROE_DTC_TUNER_TV_SDARS.phys = getValue( HMI_ROE_DTC_TUNER_TV_SDARS );
    _mROE_TUNER_TV_SDARS.ROE_DTC_Stat_TUNER_TV_SDARS.phys = getValue( HMI_ROE_DTC_Stat_TUNER_TV_SDARS );
    _mROE_TUNER_TV_SDARS.ROE_Header_TUNER_TV_SDARS.phys = getValue( HMI_ROE_Header_TUNER_TV_SDARS );
}

ROE_WMI_init()
{
    /* Botschaft ROE_WMI ID: 2565816064 --- Sendeart cyclicWithRepeatOnDemand --- 
BA_ "ApplMessage" BO_ 2565816064 0;
BA_ "NmAsrMessage" BO_ 2565816064 0;
BA_ "GenMsgMinAcceptLength" BO_ 2565816064 8;
BA_ "GenMsgILSupport" BO_ 2565816064 1;
BA_ "DiagState" BO_ 2565816064 0;
BA_ "DiagRequest" BO_ 2565816064 0;
BA_ "DiagResponse" BO_ 2565816064 0;
BA_ "GenMsgStartValue" BO_ 2565816064 "0";
BA_ "GenMsgDelayTime" BO_ 2565816064 5;
BA_ "GenMsgNrOfRepetitions" BO_ 2565816064 0;
BA_ "GenMsgCycleTime" BO_ 2565816064 200;
BA_ "GenMsgSendType" BO_ 2565816064 9;
    */
    _ROE_WMI_Timebase =           c_tDBKomTimer_20ms;
    _ROE_WMI_CycleCount =      65535 / _ROE_WMI_Timebase;
    _ROE_WMI_StartDelay =          0 / _ROE_WMI_Timebase;
    _ROE_WMI_Cnt = 0;
    _ROE_WMI_MsgRepetitions = 0;

    putValue( HMI__STMSGSD_ROE_WMI, _ROE_WMI_StartDelay * _ROE_WMI_Timebase );

    _mROE_WMI.ROE_DTC_WMI.phys = getValue( HMI_ROE_DTC_WMI );
    _mROE_WMI.ROE_DTC_Stat_WMI.phys = getValue( HMI_ROE_DTC_Stat_WMI );
    _mROE_WMI.ROE_Header_WMI.phys = getValue( HMI_ROE_Header_WMI );
}

/*
BO_ 2014 ROE_TGW : 8 TGW
ROE_DTC_Stat_TGW : 56|8@1+ (1,0) [0|255] "" EIS
ROE_DTC_TGW : 32|24@1+ (1,0) [0|16777215] "" EIS
ROE_Header_TGW : 0|32@1+ (1,0) [0|4294967295] "" EIS

BO_ 1981 ROE_TPAD : 8 TGW
ROE_DTC_Stat_TPAD : 56|8@1+ (1,0) [0|255] "" EIS
ROE_DTC_TPAD : 32|24@1+ (1,0) [0|16777215] "" EIS
ROE_Header_TPAD : 0|32@1+ (1,0) [0|4294967295] "" EIS

BO_ 2005 ROE_TUNER_DAB : 8 TGW
ROE_DTC_Stat_TUNER_DAB : 56|8@1+ (1,0) [0|255] "" EIS
ROE_DTC_TUNER_DAB : 32|24@1+ (1,0) [0|16777215] "" EIS
ROE_Header_TUNER_DAB : 0|32@1+ (1,0) [0|4294967295] "" EIS

BO_ 2009 ROE_TUNER_TV_SDARS : 8 TGW
ROE_DTC_Stat_TUNER_TV_SDARS : 56|8@1+ (1,0) [0|255] "" EIS
ROE_DTC_TUNER_TV_SDARS : 32|24@1+ (1,0) [0|16777215] "" EIS
ROE_Header_TUNER_TV_SDARS : 0|32@1+ (1,0) [0|4294967295] "" EIS

*/

SeatCM_D_Rq_HU_AR_check_output()
{
    if( !getValue( HMI__STMSG_SeatCM_D_Rq_HU_AR ) )
    {
    //  message   SeatCM_D_Rq_HU_AR ID: 1138 --- Sendeart 5 cyclicAndSpontanWithDelay --- 
        if( _SeatCM_D_Rq_HU_AR_DelayCnt > 0) _SeatCM_D_Rq_HU_AR_DelayCnt--; // Mindestsendeabstand
        _SeatCM_D_Rq_HU_AR_Cnt--;
        if( _SeatCM_D_Rq_HU_AR_Cnt < 1 )
        {
            if( _SeatCM_D_Rq_HU_AR_DelayCnt < 1 )
            {
                SeatCM_D_Rq_HU_AR_output();  // Nachricht wg. abgelaufenem Zyklus ausgeben (Mindestsendeabstand eingehalten)
                 _SeatCM_D_Rq_HU_AR_SpontanFlag = 0; // Spontan-Flag zurücksetzen
                _SeatCM_D_Rq_HU_AR_DelayCnt = _SeatCM_D_Rq_HU_AR_MinDelay;
            }
            else
            {
                // Spontanflag setzen damit nach Ablauf Mindestsendeabstand gesendet wird
                 _SeatCM_D_Rq_HU_AR_SpontanFlag = 1;
            }
            _SeatCM_D_Rq_HU_AR_Cnt = _SeatCM_D_Rq_HU_AR_CycleCount; // Zyklus-Zähler zurücksetzen
        }
        else if( _SeatCM_D_Rq_HU_AR_SpontanFlag )
        {
            if( _SeatCM_D_Rq_HU_AR_DelayCnt < 1 )
            {
                SeatCM_D_Rq_HU_AR_output(); // Nachricht wg. spontaner Änderung ausgeben (Mindestsendeabstand eingehalten)
                _SeatCM_D_Rq_HU_AR_SpontanFlag = 0; // Spontan-Flag zurücksetzen
                _SeatCM_D_Rq_HU_AR_DelayCnt = _SeatCM_D_Rq_HU_AR_MinDelay;
            }
        }
    }
}

SeatCM_D_Rq_HU_AR_init()
{   /* Botschaft SeatCM_D_Rq_HU_AR ID: 1138 --- Sendeart 5 cyclicAndSpontanWithDelay --- 
BA_ "ApplMessage" BO_ 1138 0;
BA_ "NmAsrMessage" BO_ 1138 0;
BA_ "GenMsgMinAcceptLength" BO_ 1138 4;
BA_ "GenMsgILSupport" BO_ 1138 1;
BA_ "DiagState" BO_ 1138 0;
BA_ "DiagRequest" BO_ 1138 0;
BA_ "DiagResponse" BO_ 1138 0;
BA_ "GenMsgStartValue" BO_ 1138 "0";
BA_ "GenMsgStartDelayTime" BO_ 1138 205;
BA_ "GenMsgDelayTime" BO_ 1138 100;
BA_ "GenMsgNrOfRepetition" BO_ 1138 0;
BA_ "GenMsgCycleTime" BO_ 1138 500;
BA_ "GenMsgSendType" BO_ 1138 5;
    */
    _SeatCM_D_Rq_HU_AR_Timebase =          c_tDBKomTimer_20ms;
    _SeatCM_D_Rq_HU_AR_CycleCount =       500 / _SeatCM_D_Rq_HU_AR_Timebase;
    _SeatCM_D_Rq_HU_AR_StartDelay =       205 / _SeatCM_D_Rq_HU_AR_Timebase;
    _SeatCM_D_Rq_HU_AR_MinDelay =         100 / _SeatCM_D_Rq_HU_AR_Timebase;
    _SeatCM_D_Rq_HU_AR_Cnt = _SeatCM_D_Rq_HU_AR_StartDelay;
    _SeatCM_D_Rq_HU_AR_SpontanFlag = 0;
    _SeatCM_D_Rq_HU_AR_DelayCnt = 0;

    putValue( HMI__STMSGSD_SeatCM_D_Rq_HU_AR, _SeatCM_D_Rq_HU_AR_StartDelay * _SeatCM_D_Rq_HU_AR_Timebase );

    _mSeatCM_D_Rq_HU_AR.SEAT_D_CM_Adj_Rq.phys =     getValue( HMI_SEAT_D_CM_Adj_Rq );
    _mSeatCM_D_Rq_HU_AR.SEAT_D_CM_LD_Rq.phys =  	getValue( HMI_SEAT_D_CM_LD_Rq );
    _mSeatCM_D_Rq_HU_AR.SEAT_D_CM_OnOff_Rq.phys =   getValue( HMI_SEAT_D_CM_OnOff_Rq );
    _mSeatCM_D_Rq_HU_AR.SEAT_D_CM_Time_Rq.phys =    getValue( HMI_SEAT_D_CM_Time_Rq );	
    _mSeatCM_D_Rq_HU_AR.WprWash_R_RQ_HU.phys =    getValue( HMI_WprWash_R_RQ_HU );	
    _mSeatCM_D_Rq_HU_AR.SEAT_D_CM_PosnSv_Rq.phys =    getValue( HMI_SEAT_D_CM_PosnSv_Rq );
}

SeatCM_D_Rq_HU_AR_output(void)
{
    output( _mSeatCM_D_Rq_HU_AR );
}

SeatCM_D_Rq_HU_AR_saveEnvVars( dword hFile )
{
    filePutString("\n// Knoten EIS: SeatCM_D_Rq_HU_AR\n", 25, hFile );
    snprintf( buffer, elcount( buffer ), "0.0000 HMI__STMSG_SeatCM_D_Rq_HU_AR := %X\n", getValue( HMI__STMSG_SeatCM_D_Rq_HU_AR ) );        filePutString ( buffer, elcount( buffer ), hFile );
    snprintf( buffer, elcount( buffer ), "0.0000 HMI__STMSGT_SeatCM_D_Rq_HU_AR := %X\n", getValue( HMI__STMSGT_SeatCM_D_Rq_HU_AR ) );        filePutString ( buffer, elcount( buffer ), hFile );
    snprintf( buffer, elcount( buffer ), "0.0000 HMI_SEAT_D_CM_Adj_Rq := %X\n", getValue( HMI_SEAT_D_CM_Adj_Rq ) );        filePutString ( buffer, elcount( buffer ), hFile );
    snprintf( buffer, elcount( buffer ), "0.0000 HMI_SEAT_D_CM_LD_Rq := %X\n", getValue( HMI_SEAT_D_CM_LD_Rq ) );        filePutString ( buffer, elcount( buffer ), hFile );
    snprintf( buffer, elcount( buffer ), "0.0000 HMI_SEAT_D_CM_OnOff_Rq := %X\n", getValue( HMI_SEAT_D_CM_OnOff_Rq ) );        filePutString ( buffer, elcount( buffer ), hFile );
    snprintf( buffer, elcount( buffer ), "0.0000 HMI_SEAT_D_CM_Time_Rq := %X\n", getValue( HMI_SEAT_D_CM_Time_Rq ) );        filePutString ( buffer, elcount( buffer ), hFile );
    snprintf( buffer, elcount( buffer ), "0.0000 HMI_WprWash_R_RQ_HU := %X\n", getValue( HMI_WprWash_R_RQ_HU ) );        filePutString ( buffer, elcount( buffer ), hFile );
    snprintf( buffer, elcount( buffer ), "0.0000 HMI_SEAT_D_CM_PosnSv_Rq := %X\n", getValue( HMI_SEAT_D_CM_PosnSv_Rq ) );        filePutString ( buffer, elcount( buffer ), hFile );
}

on timer _tSeatCM_D_Rq_HU_AR
{
    putValue( HMI__STMSG_SeatCM_D_Rq_HU_AR, 0 );
}

on EnvVar HMI__STMSG_SeatCM_D_Rq_HU_AR
{
    long tDelay;
    if( getValue( this ) == 2 )
    {
        tDelay = getValue( HMI__STMSGT_SeatCM_D_Rq_HU_AR );
        if( tDelay > 0)    
            setTimer( _tSeatCM_D_Rq_HU_AR, tDelay );
        else
            putValue( HMI__STMSG_SeatCM_D_Rq_HU_AR, 0 );
    }
}

on envVar HMI__STMSG_PO_SeatCM_D_Rq_HU_AR
{
    if( getValue( this ) )
        openPanel("SeatCM_D_Rq_HU_AR");
}

on EnvVar HMI_SEAT_D_CM_Adj_Rq
{
    _mSeatCM_D_Rq_HU_AR.SEAT_D_CM_Adj_Rq.phys = getValue(this);
    _SeatCM_D_Rq_HU_AR_SpontanFlag = 1;
}

on EnvVar HMI_SEAT_D_CM_LD_Rq
{
    _mSeatCM_D_Rq_HU_AR.SEAT_D_CM_LD_Rq.phys = getValue(this);
    _SeatCM_D_Rq_HU_AR_SpontanFlag = 1;
}

on EnvVar HMI_SEAT_D_CM_OnOff_Rq
{
    _mSeatCM_D_Rq_HU_AR.SEAT_D_CM_OnOff_Rq.phys = getValue(this);
    _SeatCM_D_Rq_HU_AR_SpontanFlag = 1;
}

on EnvVar HMI_SEAT_D_CM_Time_Rq
{
    _mSeatCM_D_Rq_HU_AR.SEAT_D_CM_Time_Rq.phys = getValue(this);
    _SeatCM_D_Rq_HU_AR_SpontanFlag = 1;
}

on EnvVar HMI_WprWash_R_RQ_HU
{
    _mSeatCM_D_Rq_HU_AR.WprWash_R_RQ_HU.phys = getValue(this);
    _SeatCM_D_Rq_HU_AR_SpontanFlag = 1;
}

on EnvVar HMI_SEAT_D_CM_PosnSv_Rq
{
    _mSeatCM_D_Rq_HU_AR.SEAT_D_CM_PosnSv_Rq.phys = getValue(this);
    _SeatCM_D_Rq_HU_AR_SpontanFlag = 1;
}

SeatCM_P_Rq_HU_AR_check_output()
{
    if( !getValue( HMI__STMSG_SeatCM_P_Rq_HU_AR ) )
    {
    //  message   SeatCM_P_Rq_HU_AR ID: 1142 --- Sendeart 5 cyclicAndSpontanWithDelay --- 
        if( _SeatCM_P_Rq_HU_AR_DelayCnt > 0) _SeatCM_P_Rq_HU_AR_DelayCnt--; // Mindestsendeabstand
        _SeatCM_P_Rq_HU_AR_Cnt--;
        if( _SeatCM_P_Rq_HU_AR_Cnt < 1 )
        {
            if( _SeatCM_P_Rq_HU_AR_DelayCnt < 1 )
            {
                SeatCM_P_Rq_HU_AR_output();  // Nachricht wg. abgelaufenem Zyklus ausgeben (Mindestsendeabstand eingehalten)
                 _SeatCM_P_Rq_HU_AR_SpontanFlag = 0; // Spontan-Flag zurücksetzen
                _SeatCM_P_Rq_HU_AR_DelayCnt = _SeatCM_P_Rq_HU_AR_MinDelay;
            }
            else
            {
                // Spontanflag setzen damit nach Ablauf Mindestsendeabstand gesendet wird
                 _SeatCM_P_Rq_HU_AR_SpontanFlag = 1;
            }
            _SeatCM_P_Rq_HU_AR_Cnt = _SeatCM_P_Rq_HU_AR_CycleCount; // Zyklus-Zähler zurücksetzen
        }
        else if( _SeatCM_P_Rq_HU_AR_SpontanFlag )
        {
            if( _SeatCM_P_Rq_HU_AR_DelayCnt < 1 )
            {
                SeatCM_P_Rq_HU_AR_output(); // Nachricht wg. spontaner Änderung ausgeben (Mindestsendeabstand eingehalten)
                _SeatCM_P_Rq_HU_AR_SpontanFlag = 0; // Spontan-Flag zurücksetzen
                _SeatCM_P_Rq_HU_AR_DelayCnt = _SeatCM_P_Rq_HU_AR_MinDelay;
            }
        }
    }
}

SeatCM_P_Rq_HU_AR_init()
{   /* Botschaft SeatCM_P_Rq_HU_AR ID: 1142 --- Sendeart 5 cyclicAndSpontanWithDelay --- 
BA_ "ApplMessage" BO_ 1142 0;
BA_ "NmAsrMessage" BO_ 1142 0;
BA_ "GenMsgMinAcceptLength" BO_ 1142 4;
BA_ "GenMsgILSupport" BO_ 1142 1;
BA_ "DiagState" BO_ 1142 0;
BA_ "DiagRequest" BO_ 1142 0;
BA_ "DiagResponse" BO_ 1142 0;
BA_ "GenMsgStartValue" BO_ 1142 "0";
BA_ "GenMsgStartDelayTime" BO_ 1142 220;
BA_ "GenMsgDelayTime" BO_ 1142 100;
BA_ "GenMsgNrOfRepetition" BO_ 1142 0;
BA_ "GenMsgCycleTime" BO_ 1142 500;
BA_ "GenMsgSendType" BO_ 1142 5;
    */
    _SeatCM_P_Rq_HU_AR_Timebase =          c_tDBKomTimer_20ms;
    _SeatCM_P_Rq_HU_AR_CycleCount =       500 / _SeatCM_P_Rq_HU_AR_Timebase;
    _SeatCM_P_Rq_HU_AR_StartDelay =       220 / _SeatCM_P_Rq_HU_AR_Timebase;
    _SeatCM_P_Rq_HU_AR_MinDelay =         100 / _SeatCM_P_Rq_HU_AR_Timebase;
    _SeatCM_P_Rq_HU_AR_Cnt = _SeatCM_P_Rq_HU_AR_StartDelay;
    _SeatCM_P_Rq_HU_AR_SpontanFlag = 0;
    _SeatCM_P_Rq_HU_AR_DelayCnt = 0;

    putValue( HMI__STMSGSD_SeatCM_P_Rq_HU_AR, _SeatCM_P_Rq_HU_AR_StartDelay * _SeatCM_P_Rq_HU_AR_Timebase );

    _mSeatCM_P_Rq_HU_AR.SEAT_P_CM_Adj_Rq.phys     =     getValue( HMI_SEAT_P_CM_Adj_Rq  );
    _mSeatCM_P_Rq_HU_AR.SEAT_P_CM_LD_Rq.phys      =  	  getValue( HMI_SEAT_P_CM_LD_Rq );
    _mSeatCM_P_Rq_HU_AR.SEAT_P_CM_OnOff_Rq.phys   =     getValue( HMI_SEAT_P_CM_OnOff_Rq );
    _mSeatCM_P_Rq_HU_AR.SEAT_P_CM_Time_Rq.phys    =     getValue( HMI_SEAT_P_CM_Time_Rq );	
    _mSeatCM_P_Rq_HU_AR.SEAT_P_CM_PosnSv_Rq.phys  =     getValue( HMI_SEAT_P_CM_PosnSv_Rq );
}

SeatCM_P_Rq_HU_AR_output(void)
{
    output( _mSeatCM_P_Rq_HU_AR );
}

SeatCM_P_Rq_HU_AR_saveEnvVars( dword hFile )
{
    filePutString("\n// Knoten EIS: SeatCM_P_Rq_HU_AR\n", 25, hFile );
    snprintf( buffer, elcount( buffer ), "0.0000 HMI__STMSG_SeatCM_P_Rq_HU_AR := %X\n", getValue( HMI__STMSG_SeatCM_P_Rq_HU_AR ) );        filePutString ( buffer, elcount( buffer ), hFile );
    snprintf( buffer, elcount( buffer ), "0.0000 HMI__STMSGT_SeatCM_P_Rq_HU_AR := %X\n", getValue( HMI__STMSGT_SeatCM_P_Rq_HU_AR ) );        filePutString ( buffer, elcount( buffer ), hFile );
    snprintf( buffer, elcount( buffer ), "0.0000 HMI_SEAT_P_CM_Adj_Rq := %X\n", getValue( HMI_SEAT_P_CM_Adj_Rq ) );        filePutString ( buffer, elcount( buffer ), hFile );
    snprintf( buffer, elcount( buffer ), "0.0000 HMI_SEAT_P_CM_LD_Rq := %X\n", getValue( HMI_SEAT_P_CM_LD_Rq ) );        filePutString ( buffer, elcount( buffer ), hFile );
    snprintf( buffer, elcount( buffer ), "0.0000 HMI_SEAT_P_CM_OnOff_Rq := %X\n", getValue( HMI_SEAT_P_CM_OnOff_Rq ) );        filePutString ( buffer, elcount( buffer ), hFile );
    snprintf( buffer, elcount( buffer ), "0.0000 HMI_SEAT_P_CM_Time_Rq := %X\n", getValue( HMI_SEAT_P_CM_Time_Rq ) );        filePutString ( buffer, elcount( buffer ), hFile );
    snprintf( buffer, elcount( buffer ), "0.0000 HMI_SEAT_P_CM_PosnSv_Rq := %X\n", getValue( HMI_SEAT_P_CM_PosnSv_Rq ) );        filePutString ( buffer, elcount( buffer ), hFile );
}

on timer _tSeatCM_P_Rq_HU_AR
{
    putValue( HMI__STMSG_SeatCM_P_Rq_HU_AR, 0 );
}

on EnvVar HMI__STMSG_SeatCM_P_Rq_HU_AR
{
    long tDelay;
    if( getValue( this ) == 2 )
    {
        tDelay = getValue( HMI__STMSGT_SeatCM_P_Rq_HU_AR );
        if( tDelay > 0)    
            setTimer( _tSeatCM_P_Rq_HU_AR, tDelay );
        else
            putValue( HMI__STMSG_SeatCM_P_Rq_HU_AR, 0 );
    }
}

on envVar HMI__STMSG_PO_SeatCM_P_Rq_HU_AR
{
    if( getValue( this ) )
        openPanel("SeatCM_P_Rq_HU_AR");
}

on EnvVar HMI_SEAT_P_CM_Adj_Rq
{
    _mSeatCM_P_Rq_HU_AR.SEAT_P_CM_Adj_Rq.phys = getValue(this);
    _SeatCM_P_Rq_HU_AR_SpontanFlag = 1;
}

on EnvVar HMI_SEAT_P_CM_LD_Rq
{
    _mSeatCM_P_Rq_HU_AR.SEAT_P_CM_LD_Rq.phys = getValue(this);
    _SeatCM_P_Rq_HU_AR_SpontanFlag = 1;
}

on EnvVar HMI_SEAT_P_CM_OnOff_Rq
{
    _mSeatCM_P_Rq_HU_AR.SEAT_P_CM_OnOff_Rq.phys = getValue(this);
    _SeatCM_P_Rq_HU_AR_SpontanFlag = 1;
}

on EnvVar HMI_SEAT_P_CM_Time_Rq
{
    _mSeatCM_P_Rq_HU_AR.SEAT_P_CM_Time_Rq.phys = getValue(this);
    _SeatCM_P_Rq_HU_AR_SpontanFlag = 1;
}

on EnvVar HMI_SEAT_P_CM_PosnSv_Rq
{
    _mSeatCM_P_Rq_HU_AR.SEAT_P_CM_PosnSv_Rq.phys = getValue(this);
    _SeatCM_P_Rq_HU_AR_SpontanFlag = 1;
}

SVS_Rq_HU_AR_check_output()
{
    if(  !getValue( HMI__STMSG_SVS_Rq_HU_AR ) )
    {
        // Botschaft SVS_Rq_HU_AR ID: 1029 --- Sendeart 5 cyclicAndSpontanWithDelay --- 
        _SVS_Rq_HU_AR_Cnt--;
        if(  _SVS_Rq_HU_AR_Cnt < 1 )
        {
            // Nachricht wg. abgelaufenem Zyklus ausgeben
            output( _mSVS_Rq_HU_AR );
            _SVS_Rq_HU_AR_Cnt = _SVS_Rq_HU_AR_CycleCount; // Zyklus-Zähler zurücksetzen
             _SVS_Rq_HU_AR_SpontanFlag = 0; // Spontan-Flag zurücksetzen
        }
        else if(  _SVS_Rq_HU_AR_SpontanFlag )
        {
            // Nachricht wg. spontaner Änderung ausgeben
            output( _mSVS_Rq_HU_AR );
             _SVS_Rq_HU_AR_SpontanFlag = 0; // Spontan-Flag zurücksetzen
        }
    }
}

SVS_Rq_HU_AR_init()
{   /* Botschaft SVS_Rq_HU_AR ID: 1029 --- Sendeart 5 cyclicAndSpontanWithDelay --- 
BA_ "ApplMessage" BO_ 1029 0;
BA_ "NmAsrMessage" BO_ 1029 0;
BA_ "GenMsgMinAcceptLength" BO_ 1029 8;
BA_ "GenMsgILSupport" BO_ 1029 1;
BA_ "DiagState" BO_ 1029 0;
BA_ "DiagRequest" BO_ 1029 0;
BA_ "DiagResponse" BO_ 1029 0;
BA_ "GenMsgStartValue" BO_ 1029 "0";
BA_ "GenMsgStartDelayTime" BO_ 1029 210;
BA_ "GenMsgDelayTime" BO_ 1029 20;
BA_ "GenMsgNrOfRepetitions" BO_ 1029 0;
BA_ "GenMsgCycleTime" BO_ 1029 1000;
BA_ "GenMsgSendType" BO_ 1029 5;
    */
    _SVS_Rq_HU_AR_Timebase =          c_tDBKomTimer_20ms;
    _SVS_Rq_HU_AR_CycleCount =       1000 / _SVS_Rq_HU_AR_Timebase;
    _SVS_Rq_HU_AR_StartDelay =        210 / _SVS_Rq_HU_AR_Timebase;
    _SVS_Rq_HU_AR_Cnt = _SVS_Rq_HU_AR_StartDelay;
    _SVS_Rq_HU_AR_SpontanFlag = 0;

    putValue( HMI__STMSGSD_SVS_Rq_HU_AR, _SVS_Rq_HU_AR_StartDelay * _SVS_Rq_HU_AR_Timebase );

    _mSVS_Rq_HU_AR.PARK_Hitch_KinkAngl_Rq.phys = getValue( HMI_PARK_Hitch_KinkAngl_Rq );
    _mSVS_Rq_HU_AR.LDP_Add_Md_Rq_HU_V2.phys = getValue( HMI_LDP_Add_Md_Rq_HU_V2 );
    _mSVS_Rq_HU_AR.LDP_Md_Rq_HU_V2.phys = getValue( HMI_LDP_Md_Rq_HU_V2 );
    _mSVS_Rq_HU_AR.LDP_Sens_Md_Rq_HU_V2.phys = getValue( HMI_LDP_Sens_Md_Rq_HU_V2 );
    _mSVS_Rq_HU_AR.PARK_RemLocalList_Rq.phys = getValue( HMI_PARK_RemLocalList_Rq );
    _mSVS_Rq_HU_AR.PARK_RemLocalPosn_Rq.phys = getValue( HMI_PARK_RemLocalPosn_Rq );
    _mSVS_Rq_HU_AR.PARK_SysMd_Rq_HU.phys = getValue( HMI_PARK_SysMd_Rq_HU );
    _mSVS_Rq_HU_AR.SVS_BrtLvl.phys = getValue( HMI_SVS_BrtLvl );
    _mSVS_Rq_HU_AR.SVS_Disp_Actv.phys = getValue( HMI_SVS_Disp_Actv );
    _mSVS_Rq_HU_AR.SVS_RevGrActvMd_Rq.phys = getValue( HMI_SVS_RevGrActvMd_Rq );
    _mSVS_Rq_HU_AR.SVS_ServMd_Rq.phys = getValue( HMI_SVS_ServMd_Rq );
    _mSVS_Rq_HU_AR.SVS_ShortRngObjDtct_Actv.phys = getValue( HMI_SVS_ShortRngObjDtct_Actv );
    _mSVS_Rq_HU_AR.SVS_PkActvMd_Rq.phys = getValue( HMI_SVS_PkActvMd_Rq );
}

SVS_Rq_HU_AR_saveEnvVars( dword hFile )
{
    filePutString("\n// Knoten TGW: SVS_Rq_HU_AR\n", 26, hFile);
    snprintf( buffer, elcount(buffer), "0.0000 HMI__STMSG_SVS_Rq_HU_AR := %X\n", getValue( HMI__STMSG_SVS_Rq_HU_AR ));        filePutString( buffer, elcount(buffer), hFile);
    snprintf( buffer, elcount(buffer), "0.0000 HMI__STMSGT_SVS_Rq_HU_AR := %X\n", getValue( HMI__STMSGT_SVS_Rq_HU_AR ));        filePutString( buffer, elcount(buffer), hFile);
    snprintf( buffer, elcount(buffer), "0.0000 HMI_PARK_Hitch_KinkAngl_Rq := %X\n", getValue( HMI_PARK_Hitch_KinkAngl_Rq ) );        filePutString( buffer, elcount(buffer), hFile);
    snprintf( buffer, elcount(buffer), "0.0000 HMI_LDP_Add_Md_Rq_HU_V2 := %X\n", getValue( HMI_LDP_Add_Md_Rq_HU_V2 ) );        filePutString( buffer, elcount(buffer), hFile);
    snprintf( buffer, elcount(buffer), "0.0000 HMI_LDP_Md_Rq_HU_V2 := %X\n", getValue( HMI_LDP_Md_Rq_HU_V2 ) );        filePutString( buffer, elcount(buffer), hFile);
    snprintf( buffer, elcount(buffer), "0.0000 HMI_LDP_Sens_Md_Rq_HU_V2 := %X\n", getValue( HMI_LDP_Sens_Md_Rq_HU_V2 ) );        filePutString( buffer, elcount(buffer), hFile);
    snprintf( buffer, elcount(buffer), "0.0000 HMI_PARK_RemLocalList_Rq := %X\n", getValue( HMI_PARK_RemLocalList_Rq ) );        filePutString( buffer, elcount(buffer), hFile);
    snprintf( buffer, elcount(buffer), "0.0000 HMI_PARK_RemLocalPosn_Rq := %X\n", getValue( HMI_PARK_RemLocalPosn_Rq ) );        filePutString( buffer, elcount(buffer), hFile);
    snprintf( buffer, elcount(buffer), "0.0000 HMI_PARK_SysMd_Rq_HU := %X\n", getValue( HMI_PARK_SysMd_Rq_HU ) );        filePutString( buffer, elcount(buffer), hFile);
    snprintf( buffer, elcount(buffer), "0.0000 HMI_SVS_BrtLvl := %X\n", getValue( HMI_SVS_BrtLvl ) );        filePutString( buffer, elcount(buffer), hFile);
    snprintf( buffer, elcount(buffer), "0.0000 HMI_SVS_Disp_Actv := %X\n", getValue( HMI_SVS_Disp_Actv ) );        filePutString( buffer, elcount(buffer), hFile);
    snprintf( buffer, elcount(buffer), "0.0000 HMI_SVS_PkActvMd_Rq := %X\n", getValue( HMI_SVS_PkActvMd_Rq ) );        filePutString( buffer, elcount(buffer), hFile);
    snprintf( buffer, elcount(buffer), "0.0000 HMI_SVS_RevGrActvMd_Rq := %X\n", getValue( HMI_SVS_RevGrActvMd_Rq ) );        filePutString( buffer, elcount(buffer), hFile);
    snprintf( buffer, elcount(buffer), "0.0000 HMI_SVS_ServMd_Rq := %X\n", getValue( HMI_SVS_ServMd_Rq ) );        filePutString( buffer, elcount(buffer), hFile);
    snprintf( buffer, elcount(buffer), "0.0000 HMI_SVS_ShortRngObjDtct_Actv := %X\n", getValue( HMI_SVS_ShortRngObjDtct_Actv ) );        filePutString( buffer, elcount(buffer), hFile);
}

on timer _tSVS_Rq_HU_AR
{
    putValue( HMI__STMSG_SVS_Rq_HU_AR, 0 );
}

on EnvVar HMI__STMSG_SVS_Rq_HU_AR
{
    long tDelay;
    if( getValue( this ) == 2 )
    {
        tDelay = getValue( HMI__STMSGT_SVS_Rq_HU_AR );
        if( tDelay > 0 )    
            setTimer( _tSVS_Rq_HU_AR, tDelay );
        else
            putValue( HMI__STMSG_SVS_Rq_HU_AR, 0 );
    }
}

on envVar HMI__STMSG_PO_SVS_Rq_HU_AR
{
    if( getValue( this ) )
        openPanel("SVS_Rq_HU_AR");
}

on EnvVar HMI_PARK_Hitch_KinkAngl_Rq
{
    _mSVS_Rq_HU_AR.PARK_Hitch_KinkAngl_Rq.phys = getValue(this);
    _SVS_Rq_HU_AR_SpontanFlag = 1;
}

on EnvVar HMI_LDP_Sens_Md_Rq_HU_V2
{
    _mSVS_Rq_HU_AR.LDP_Sens_Md_Rq_HU_V2.phys = getValue(this);
    _SVS_Rq_HU_AR_SpontanFlag = 1;
}

on EnvVar HMI_LDP_Md_Rq_HU_V2
{
    _mSVS_Rq_HU_AR.LDP_Md_Rq_HU_V2.phys = getValue(this);
    _SVS_Rq_HU_AR_SpontanFlag = 1;
}

on EnvVar HMI_LDP_Add_Md_Rq_HU_V2
{
    _mSVS_Rq_HU_AR.LDP_Add_Md_Rq_HU_V2.phys = getValue(this);
    _SVS_Rq_HU_AR_SpontanFlag = 1;
}

on EnvVar HMI_PARK_RemLocalList_Rq
{
    _mSVS_Rq_HU_AR.PARK_RemLocalList_Rq.phys = getValue(this);
    _SVS_Rq_HU_AR_SpontanFlag = 1;
}

on EnvVar HMI_PARK_RemLocalPosn_Rq
{
    _mSVS_Rq_HU_AR.PARK_RemLocalPosn_Rq.phys = getValue(this);
    _SVS_Rq_HU_AR_SpontanFlag = 1;
}

on EnvVar HMI_PARK_SysMd_Rq_HU
{
    _mSVS_Rq_HU_AR.PARK_SysMd_Rq_HU.phys = getValue(this);
    _SVS_Rq_HU_AR_SpontanFlag = 1;
}

on EnvVar HMI_SVS_BrtLvl
{
    _mSVS_Rq_HU_AR.SVS_BrtLvl.phys = getValue(this);
    _SVS_Rq_HU_AR_SpontanFlag = 1;
}

on EnvVar HMI_SVS_Disp_Actv
{
    _mSVS_Rq_HU_AR.SVS_Disp_Actv.phys = getValue(this);
    _SVS_Rq_HU_AR_SpontanFlag = 1;
}

on EnvVar HMI_SVS_PkActvMd_Rq
{
    _mSVS_Rq_HU_AR.SVS_PkActvMd_Rq.phys = getValue(this);
    _SVS_Rq_HU_AR_SpontanFlag = 1;
}

on EnvVar HMI_SVS_RevGrActvMd_Rq
{
    _mSVS_Rq_HU_AR.SVS_RevGrActvMd_Rq.phys = getValue(this);
    _SVS_Rq_HU_AR_SpontanFlag = 1;
}

on EnvVar HMI_SVS_ServMd_Rq
{
    _mSVS_Rq_HU_AR.SVS_ServMd_Rq.phys = getValue(this);
    _SVS_Rq_HU_AR_SpontanFlag = 1;
}

on EnvVar HMI_SVS_ShortRngObjDtct_Actv
{
    _mSVS_Rq_HU_AR.SVS_ShortRngObjDtct_Actv.phys = getValue(this);
    _SVS_Rq_HU_AR_SpontanFlag = 1;
}

TGW_COM_Call_Disp_Rq_AR_check_output()
{
    if( !getValue( HMI__STMSG_TGW_COM_Call_Disp_Rq_AR ))
    {
        // Botschaft TGW_COM_Call_Disp_Rq_AR ID: 710 --- Sendeart 5 cyclicAndSpontanWithDelay --- 
        if( _TGW_COM_Call_Disp_Rq_AR_DelayCnt > 0) _TGW_COM_Call_Disp_Rq_AR_DelayCnt--; // Mindestsendeabstand
        _TGW_COM_Call_Disp_Rq_AR_Cnt--;
        if( _TGW_COM_Call_Disp_Rq_AR_Cnt < 1 )
        {
            if( _TGW_COM_Call_Disp_Rq_AR_DelayCnt < 1 )
            {
                // Nachricht wg. abgelaufenem Zyklus ausgeben (Mindestsendeabstand eingehalten)
                TGW_COM_Call_Disp_Rq_AR_output();
                _TGW_COM_Call_Disp_Rq_AR_SpontanFlag = 0; // Spontan-Flag zurücksetzen
                _TGW_COM_Call_Disp_Rq_AR_DelayCnt = _TGW_COM_Call_Disp_Rq_AR_MinDelay;
            }
            else
            {
                // Spontanflag setzen damit nach Ablauf Mindestsendeabstand gesendet wird
                 _TGW_COM_Call_Disp_Rq_AR_SpontanFlag = 1;
            }
            _TGW_COM_Call_Disp_Rq_AR_Cnt = _TGW_COM_Call_Disp_Rq_AR_CycleCount; // Zyklus-Zähler zurücksetzen
        }
        else if( _TGW_COM_Call_Disp_Rq_AR_SpontanFlag)
        {
            if( _TGW_COM_Call_Disp_Rq_AR_DelayCnt < 1 )
            {
                // Nachricht wg. spontaner Änderung ausgeben (Mindestsendeabstand eingehalten)
                TGW_COM_Call_Disp_Rq_AR_output();
                _TGW_COM_Call_Disp_Rq_AR_SpontanFlag = 0; // Spontan-Flag zurücksetzen
                _TGW_COM_Call_Disp_Rq_AR_DelayCnt = _TGW_COM_Call_Disp_Rq_AR_MinDelay;
            }
        }
    }
}

TGW_COM_Call_Disp_Rq_AR_init()
{   /* Botschaft TGW_COM_Call_Disp_Rq_AR ID: 710 --- Sendeart 5 cyclicAndSpontanWithDelay --- 
BA_ "ApplMessage" BO_ 710 0;
BA_ "NmAsrMessage" BO_ 710 0;
BA_ "GenMsgMinAcceptLength" BO_ 710 8;
BA_ "GenMsgILSupport" BO_ 710 1;
BA_ "DiagState" BO_ 710 0;
BA_ "DiagRequest" BO_ 710 0;
BA_ "DiagResponse" BO_ 710 0;
BA_ "GenMsgStartValue" BO_ 710 "0";
BA_ "GenMsgStartDelayTime" BO_ 710 265;
BA_ "GenMsgDelayTime" BO_ 710 50;
BA_ "GenMsgNrOfRepetitions" BO_ 710 0;
BA_ "GenMsgCycleTime" BO_ 710 1000;
BA_ "GenMsgSendType" BO_ 710 5;
    */
    _TGW_COM_Call_Disp_Rq_AR_Timebase =           c_tDBKomTimer_20ms;
    _TGW_COM_Call_Disp_Rq_AR_CycleCount =      1000 / _TGW_COM_Call_Disp_Rq_AR_Timebase;
    _TGW_COM_Call_Disp_Rq_AR_StartDelay =       265 / _TGW_COM_Call_Disp_Rq_AR_Timebase;
    _TGW_COM_Call_Disp_Rq_AR_MinDelay =          50 / _TGW_COM_Call_Disp_Rq_AR_Timebase;
    _TGW_COM_Call_Disp_Rq_AR_Cnt = 0;
    _TGW_COM_Call_Disp_Rq_AR_SpontanFlag = 0;
    _TGW_COM_Call_Disp_Rq_AR_DelayCnt = 0;

    putValue( HMI__STMSGSD_TGW_COM_Call_Disp_Rq_AR, _TGW_COM_Call_Disp_Rq_AR_StartDelay * _TGW_COM_Call_Disp_Rq_AR_Timebase );

    _mTGW_COM_Call_Disp_Rq_AR.MBCall_Call_Rq.phys = getValue( HMI_MBCall_Call_Rq );
    _mTGW_COM_Call_Disp_Rq_AR.MBCall_End_Call_Rq.phys = getValue( HMI_MBCall_End_Call_Rq );
    _mTGW_COM_Call_Disp_Rq_AR.MBCall_Popup_Cnfrm.phys = getValue( HMI_MBCall_Popup_Cnfrm );
    _mTGW_COM_Call_Disp_Rq_AR.MBCall_TrckMd_Rq.phys = getValue( HMI_MBCall_TrckMd_Rq );
    _mTGW_COM_Call_Disp_Rq_AR.OfflineMd_Rq.phys = getValue( HMI_OfflineMd_Rq );
    _mTGW_COM_Call_Disp_Rq_AR.UserDataReset_Stat.phys = getValue( HMI_UserDataReset_Stat );
    _mTGW_COM_Call_Disp_Rq_AR.MBCall_ReturnCall_Stat.phys = getValue( HMI_MBCall_ReturnCall_Stat );
}

TGW_COM_Call_Disp_Rq_AR_output()
{
    output( _mTGW_COM_Call_Disp_Rq_AR );
}

TGW_COM_Call_Disp_Rq_AR_saveEnvVars( dword hFile )
{
    filePutString("\n// Knoten TGW: TGW_COM_Call_Disp_Rq_AR\n", 26, hFile);
    snprintf( buffer, elcount(buffer), "0.0000 HMI__STMSG_TGW_COM_Call_Disp_Rq_AR := %X\n", getValue( HMI__STMSG_TGW_COM_Call_Disp_Rq_AR ));        filePutString( buffer, elcount(buffer), hFile);
    snprintf( buffer, elcount(buffer), "0.0000 HMI__STMSGT_TGW_COM_Call_Disp_Rq_AR := %X\n", getValue( HMI__STMSGT_TGW_COM_Call_Disp_Rq_AR ));        filePutString( buffer, elcount(buffer), hFile);
    snprintf( buffer, elcount(buffer), "0.0000 HMI_MBCall_Call_Rq := %X\n", getValue( HMI_MBCall_Call_Rq ) );        filePutString( buffer, elcount(buffer), hFile);
    snprintf( buffer, elcount(buffer), "0.0000 HMI_MBCall_End_Call_Rq := %X\n", getValue( HMI_MBCall_End_Call_Rq ) );        filePutString( buffer, elcount(buffer), hFile);
    snprintf( buffer, elcount(buffer), "0.0000 HMI_MBCall_Popup_Cnfrm := %X\n", getValue( HMI_MBCall_Popup_Cnfrm ) );        filePutString( buffer, elcount(buffer), hFile);
    snprintf( buffer, elcount(buffer), "0.0000 HMI_MBCall_TrckMd_Rq := %X\n", getValue( HMI_MBCall_TrckMd_Rq ) );        filePutString( buffer, elcount(buffer), hFile);
    snprintf( buffer, elcount(buffer), "0.0000 HMI_OfflineMd_Rq := %X\n", getValue( HMI_OfflineMd_Rq ) );        filePutString( buffer, elcount(buffer), hFile);
    snprintf( buffer, elcount(buffer), "0.0000 HMI_UserDataReset_Stat := %X\n", getValue( HMI_UserDataReset_Stat ) );        filePutString( buffer, elcount(buffer), hFile);
    snprintf( buffer, elcount(buffer), "0.0000 HMI_MBCall_ReturnCall_Stat := %X\n", getValue( HMI_MBCall_ReturnCall_Stat ) );        filePutString( buffer, elcount(buffer), hFile);
}

on timer _tTGW_COM_Call_Disp_Rq_AR
{
    putValue( HMI__STMSG_TGW_COM_Call_Disp_Rq_AR, 0 );
}

on EnvVar HMI__STMSG_TGW_COM_Call_Disp_Rq_AR
{
    long tDelay;
    if( getValue( this ) == 2 )
    {
        tDelay = getValue( HMI__STMSGT_TGW_COM_Call_Disp_Rq_AR );
        if( tDelay > 0)    
            setTimer( _tTGW_COM_Call_Disp_Rq_AR, tDelay );
        else
            putValue( HMI__STMSG_TGW_COM_Call_Disp_Rq_AR, 0 );
    }
}

on envVar HMI__STMSG_PO_TGW_COM_Call_Disp_Rq_AR
{
    if( getValue( this ) )
        openPanel("TGW_COM_Call_Disp_Rq_AR");
}

on EnvVar HMI_MBCall_Call_Rq
{
    _mTGW_COM_Call_Disp_Rq_AR.MBCall_Call_Rq.phys = getValue(this);
    _TGW_COM_Call_Disp_Rq_AR_SpontanFlag = 1;
}

on EnvVar HMI_MBCall_End_Call_Rq
{
    _mTGW_COM_Call_Disp_Rq_AR.MBCall_End_Call_Rq.phys = getValue(this);
    _TGW_COM_Call_Disp_Rq_AR_SpontanFlag = 1;
}

on EnvVar HMI_MBCall_Popup_Cnfrm
{
    _mTGW_COM_Call_Disp_Rq_AR.MBCall_Popup_Cnfrm.phys = getValue(this);
    _TGW_COM_Call_Disp_Rq_AR_SpontanFlag = 1;
}

on EnvVar HMI_MBCall_TrckMd_Rq
{
    _mTGW_COM_Call_Disp_Rq_AR.MBCall_TrckMd_Rq.phys = getValue(this);
    _TGW_COM_Call_Disp_Rq_AR_SpontanFlag = 1;
}

on EnvVar HMI_OfflineMd_Rq
{
    _mTGW_COM_Call_Disp_Rq_AR.OfflineMd_Rq.phys = getValue(this);
    _TGW_COM_Call_Disp_Rq_AR_SpontanFlag = 1;
}

on EnvVar HMI_UserDataReset_Stat
{
    _mTGW_COM_Call_Disp_Rq_AR.UserDataReset_Stat.phys = getValue(this);
    _TGW_COM_Call_Disp_Rq_AR_SpontanFlag = 1;
}

on EnvVar HMI_MBCall_ReturnCall_Stat
{
    _mTGW_COM_Call_Disp_Rq_AR.MBCall_ReturnCall_Stat.phys = getValue(this);
    _TGW_COM_Call_Disp_Rq_AR_SpontanFlag = 1;
}

TGW_DateTm_Stat_AR_check_output()
{
    if(  !getValue( HMI__STMSG_TGW_DateTm_Stat_AR ) )
    {
        // Botschaft TGW_DateTm_Stat_AR ID: 1243 --- Sendeart 5 cyclicAndSpontanWithDelay --- 
        _TGW_DateTm_Stat_AR_Cnt--;
        if(  _TGW_DateTm_Stat_AR_Cnt < 1 )
        {
            // Nachricht wg. abgelaufenem Zyklus ausgeben
            output( _mTGW_DateTm_Stat_AR );
            _TGW_DateTm_Stat_AR_Cnt = _TGW_DateTm_Stat_AR_CycleCount; // Zyklus-Zähler zurücksetzen
             _TGW_DateTm_Stat_AR_SpontanFlag = 0; // Spontan-Flag zurücksetzen
        }
        else if(  _TGW_DateTm_Stat_AR_SpontanFlag )
        {
            // Nachricht wg. spontaner Änderung ausgeben
            output( _mTGW_DateTm_Stat_AR );
             _TGW_DateTm_Stat_AR_SpontanFlag = 0; // Spontan-Flag zurücksetzen
        }
    }
}

TGW_DateTm_Stat_AR_init()
{   /* Botschaft TGW_DateTm_Stat_AR ID: 1243 --- Sendeart 5 cyclicAndSpontanWithDelay --- 
BA_ "ApplMessage" BO_ 1243 0;
BA_ "NmAsrMessage" BO_ 1243 0;
BA_ "GenMsgMinAcceptLength" BO_ 1243 8;
BA_ "GenMsgILSupport" BO_ 1243 1;
BA_ "DiagState" BO_ 1243 0;
BA_ "DiagRequest" BO_ 1243 0;
BA_ "DiagResponse" BO_ 1243 0;
BA_ "GenMsgStartValue" BO_ 1243 "0";
BA_ "GenMsgStartDelayTime" BO_ 1243 245;
BA_ "GenMsgDelayTime" BO_ 1243 200;
BA_ "GenMsgNrOfRepetitions" BO_ 1243 0;
BA_ "GenMsgCycleTime" BO_ 1243 5000;
BA_ "GenMsgSendType" BO_ 1243 5;
    */
    _TGW_DateTm_Stat_AR_Timebase =        c_tDBKomTimer_20ms;
    _TGW_DateTm_Stat_AR_CycleCount =    5000 / _TGW_DateTm_Stat_AR_Timebase;
    _TGW_DateTm_Stat_AR_StartDelay =     245 / _TGW_DateTm_Stat_AR_Timebase;
    _TGW_DateTm_Stat_AR_MinDelay =       200 / _TGW_DateTm_Stat_AR_Timebase;
    _TGW_DateTm_Stat_AR_Cnt = _TGW_DateTm_Stat_AR_StartDelay;
    _TGW_DateTm_Stat_AR_SpontanFlag = 0;
    _TGW_DateTm_Stat_AR_DelayCnt = 0;

    putValue( HMI__STMSGSD_TGW_DateTm_Stat_AR, _TGW_DateTm_Stat_AR_StartDelay * _TGW_DateTm_Stat_AR_Timebase );

    _mTGW_DateTm_Stat_AR.DateTm_DST_CntDn.phys = getValue( HMI_DateTm_DST_CntDn );
    _mTGW_DateTm_Stat_AR.DateTm_DST_HourOffset.phys = getValue( HMI_DateTm_DST_HourOffset );
}

TGW_DateTm_Stat_AR_saveEnvVars( dword hFile )
{
    filePutString("\n// Knoten TGW: TGW_DateTm_Stat_AR\n", 31, hFile);
    snprintf( buffer, elcount(buffer), "0.0000 HMI__STMSG_TGW_DateTm_Stat_AR := %X\n", getValue( HMI__STMSG_TGW_DateTm_Stat_AR ) );        filePutString( buffer, elcount(buffer), hFile);
    snprintf( buffer, elcount(buffer), "0.0000 HMI__STMSGT_TGW_DateTm_Stat_AR := %X\n", getValue( HMI__STMSGT_TGW_DateTm_Stat_AR ) );        filePutString( buffer, elcount(buffer), hFile);
    snprintf( buffer, elcount(buffer), "0.0000 HMI_DateTm_DST_CntDn := %X\n", getValue( HMI_DateTm_DST_CntDn ) );        filePutString( buffer, elcount(buffer), hFile);
    snprintf( buffer, elcount(buffer), "0.0000 HMI_DateTm_DST_HourOffset := %X\n", getValue( HMI_DateTm_DST_HourOffset ) );        filePutString( buffer, elcount(buffer), hFile);
}

on timer _tTGW_DateTm_Stat_AR
{
    putValue( HMI__STMSG_TGW_DateTm_Stat_AR, 0 );
}

on EnvVar HMI__STMSG_TGW_DateTm_Stat_AR
{
    long tDelay;
    if( getValue( this ) == 2 )
    {
        tDelay = getValue( HMI__STMSGT_TGW_DateTm_Stat_AR );
        if( tDelay > 0 )    
            setTimer( _tTGW_DateTm_Stat_AR, tDelay );
        else
            putValue( HMI__STMSG_TGW_DateTm_Stat_AR, 0 );
    }
}

on envVar HMI__STMSG_PO_TGW_DateTm_Stat_AR
{
    if( getValue( this ) )
        openPanel("TGW_DateTm_Stat_AR");
}

on EnvVar HMI_DateTm_DST_CntDn
{
   _mTGW_DateTm_Stat_AR.DateTm_DST_CntDn.phys = getValue(this);
   _TGW_DateTm_Stat_AR_SpontanFlag = 1;
}

on EnvVar HMI_DateTm_DST_HourOffset
{
    _mTGW_DateTm_Stat_AR.DateTm_DST_HourOffset.phys = getValue(this);
    _TGW_DateTm_Stat_AR_SpontanFlag = 1;
}

TGW_DriveAssistSys_AR_check_output()
{
    if(  !getValue( HMI__STMSG_TGW_DriveAssistSys_AR ) )
    {
        // Botschaft TGW_DriveAssistSys_AR ID: 1013 --- Sendeart 5 cyclicAndSpontanWithDelay --- 
        _TGW_DriveAssistSys_AR_Cnt--;
        if(  _TGW_DriveAssistSys_AR_Cnt < 1 )
        {
            // Nachricht wg. abgelaufenem Zyklus ausgeben
            output( _mTGW_DriveAssistSys_AR );
            _TGW_DriveAssistSys_AR_Cnt = _TGW_DriveAssistSys_AR_CycleCount; // Zyklus-Zähler zurücksetzen
             _TGW_DriveAssistSys_AR_SpontanFlag = 0; // Spontan-Flag zurücksetzen
        }
        else if(  _TGW_DriveAssistSys_AR_SpontanFlag )
        {
            // Nachricht wg. spontaner Änderung ausgeben
            output( _mTGW_DriveAssistSys_AR );
             _TGW_DriveAssistSys_AR_SpontanFlag = 0; // Spontan-Flag zurücksetzen
        }
    }
}

TGW_DriveAssistSys_AR_init()
{   /* Botschaft TGW_DriveAssistSys_AR ID: 1013 --- Sendeart 5 cyclicAndSpontanWithDelay --- 
BA_ "ApplMessage" BO_ 1013 0;
BA_ "NmAsrMessage" BO_ 1013 0;
BA_ "GenMsgMinAcceptLength" BO_ 1013 8;
BA_ "GenMsgILSupport" BO_ 1013 1;
BA_ "DiagState" BO_ 1013 0;
BA_ "DiagRequest" BO_ 1013 0;
BA_ "DiagResponse" BO_ 1013 0;
BA_ "GenMsgStartValue" BO_ 1013 "0";
BA_ "GenMsgStartDelayTime" BO_ 1013 285;
BA_ "GenMsgDelayTime" BO_ 1013 5;
BA_ "GenMsgNrOfRepetitions" BO_ 1013 0;
BA_ "GenMsgCycleTime" BO_ 1013 1000;
BA_ "GenMsgSendType" BO_ 1013 5;
    */
    _TGW_DriveAssistSys_AR_Timebase =       c_tDBKomTimer_20ms;
    _TGW_DriveAssistSys_AR_CycleCount =   1000 / _TGW_DriveAssistSys_AR_Timebase;
    _TGW_DriveAssistSys_AR_StartDelay =    285 / _TGW_DriveAssistSys_AR_Timebase;
    _TGW_DriveAssistSys_AR_Cnt = _TGW_DriveAssistSys_AR_StartDelay;
    _TGW_DriveAssistSys_AR_SpontanFlag = 0;

    putValue( HMI__STMSGSD_TGW_DriveAssistSys_AR, _TGW_DriveAssistSys_AR_StartDelay * _TGW_DriveAssistSys_AR_Timebase );

    _mTGW_DriveAssistSys_AR.DRVM_UserMd_Rq_V3.phys = getValue( HMI_DRVM_UserMd_Rq_V3 );
    _mTGW_DriveAssistSys_AR.NAVI_Curr_SpecZ_ID.phys = getValue( HMI_NAVI_Curr_SpecZ_ID );
    _mTGW_DriveAssistSys_AR.NAVI_Curr_SpecZ_Type.phys = getValue( HMI_NAVI_Curr_SpecZ_Type );
    _mTGW_DriveAssistSys_AR.RVC_Disp_Act_TGW.phys = getValue( HMI_RVC_Disp_Act_TGW );
    _mTGW_DriveAssistSys_AR.RVC_Rev_Enbl.phys = getValue( HMI_RVC_Rev_Enbl );
}

TGW_DriveAssistSys_AR_saveEnvVars( dword hFile )
{
    filePutString("\n// Knoten TGW: TGW_DriveAssistSys_AR\n", 31, hFile);
    snprintf( buffer, elcount(buffer), "0.0000 HMI__STMSG_TGW_DriveAssistSys_AR := %X\n", getValue( HMI__STMSG_TGW_DriveAssistSys_AR ) );        filePutString( buffer, elcount(buffer), hFile);
    snprintf( buffer, elcount(buffer), "0.0000 HMI__STMSGT_TGW_DriveAssistSys_AR := %X\n", getValue( HMI__STMSGT_TGW_DriveAssistSys_AR ) );        filePutString( buffer, elcount(buffer), hFile);
    snprintf( buffer, elcount(buffer), "0.0000 HMI_DRVM_UserMd_Rq_V3 := %X\n", getValue( HMI_DRVM_UserMd_Rq_V3 ) );        filePutString( buffer, elcount(buffer), hFile);
    snprintf( buffer, elcount(buffer), "0.0000 HMI_NAVI_Curr_SpecZ_ID := %X\n", getValue( HMI_NAVI_Curr_SpecZ_ID ) );        filePutString( buffer, elcount(buffer), hFile);
    snprintf( buffer, elcount(buffer), "0.0000 HMI_NAVI_Curr_SpecZ_Type := %X\n", getValue( HMI_NAVI_Curr_SpecZ_Type ) );        filePutString( buffer, elcount(buffer), hFile);
    snprintf( buffer, elcount(buffer), "0.0000 HMI_RVC_Disp_Act_TGW := %X\n", getValue( HMI_RVC_Disp_Act_TGW ) );        filePutString( buffer, elcount(buffer), hFile);
    snprintf( buffer, elcount(buffer), "0.0000 HMI_RVC_Rev_Enbl := %X\n", getValue( HMI_RVC_Rev_Enbl ) );        filePutString( buffer, elcount(buffer), hFile);
}

on timer _tTGW_DriveAssistSys_AR
{
    putValue( HMI__STMSG_TGW_DriveAssistSys_AR, 0 );
}

on EnvVar HMI__STMSG_TGW_DriveAssistSys_AR
{
    long tDelay;
    if( getValue( this ) == 2 )
    {
        tDelay = getValue( HMI__STMSGT_TGW_DriveAssistSys_AR );
        if( tDelay > 0 )    
            setTimer( _tTGW_DriveAssistSys_AR, tDelay );
        else
            putValue( HMI__STMSG_TGW_DriveAssistSys_AR, 0 );
    }
}

on envVar HMI__STMSG_PO_TGW_DriveAssistSys_AR
{
    if( getValue( this ) )
        openPanel("TGW_DriveAssistSys_AR");
}

on EnvVar HMI_DRVM_UserMd_Rq_V3
{
   _mTGW_DriveAssistSys_AR.DRVM_UserMd_Rq_V3.phys = getValue(this);
   _TGW_DriveAssistSys_AR_SpontanFlag = 1;
}

on EnvVar HMI_NAVI_Curr_SpecZ_ID
{
   _mTGW_DriveAssistSys_AR.NAVI_Curr_SpecZ_ID.phys = getValue(this);
   _TGW_DriveAssistSys_AR_SpontanFlag = 1;
}

on EnvVar HMI_NAVI_Curr_SpecZ_Type
{
   _mTGW_DriveAssistSys_AR.NAVI_Curr_SpecZ_Type.phys = getValue(this);
   _TGW_DriveAssistSys_AR_SpontanFlag = 1;
}

on EnvVar HMI_RVC_Disp_Act_TGW
{
    _mTGW_DriveAssistSys_AR.RVC_Disp_Act_TGW.phys = getValue(this);
    _TGW_DriveAssistSys_AR_SpontanFlag = 1;
}

on EnvVar HMI_RVC_Rev_Enbl
{
   _mTGW_DriveAssistSys_AR.RVC_Rev_Enbl.phys = getValue(this);
   _TGW_DriveAssistSys_AR_SpontanFlag = 1;
}

//TP_TGW_COM_Adapt_check_output()
//{
//    if( !getValue( HMI__STMSG_TP_TGW_COM_Adapt ))
//    {
//        // Botschaft TP_TGW_COM_Adapt ID: 702 --- Sendeart 1 spontanX --- 
//        if( _TP_TGW_COM_Adapt_SpontanFlag)
//        {
//            TP_TGW_COM_Adapt_output(); // Nachricht wg. spontaner Änderung ausgeben
//           _TP_TGW_COM_Adapt_SpontanFlag = 0; // Spontan-Flag zurücksetzen
//        }
//    }
//}
//
//TP_TGW_COM_Adapt_getValue(void)
//{
//    _mTP_TGW_COM_Adapt.byte( 0 ) = getValue( HMI_TP_COM_TGW_Adapt_0 );
//    _mTP_TGW_COM_Adapt.byte( 1 ) = getValue( HMI_TP_COM_TGW_Adapt_1 );
//    _mTP_TGW_COM_Adapt.byte( 2 ) = getValue( HMI_TP_COM_TGW_Adapt_2 );
//    _mTP_TGW_COM_Adapt.byte( 3 ) = getValue( HMI_TP_COM_TGW_Adapt_3 );
//    _mTP_TGW_COM_Adapt.byte( 4 ) = getValue( HMI_TP_COM_TGW_Adapt_4 );
//    _mTP_TGW_COM_Adapt.byte( 5 ) = getValue( HMI_TP_COM_TGW_Adapt_5 );
//    _mTP_TGW_COM_Adapt.byte( 6 ) = getValue( HMI_TP_COM_TGW_Adapt_6 );
//    _mTP_TGW_COM_Adapt.byte( 7 ) = getValue( HMI_TP_COM_TGW_Adapt_7 );
//}
//
//TP_TGW_COM_Adapt_init()
//{
//    /* Botschaft TP_TGW_COM_Adapt ID: 702 ---- Sendeart 1 spontanX --- 
//BA_ "ApplMessage" BO_ 702 0;
//BA_ "NmAsrMessage" BO_ 702 0;
//BA_ "GenMsgMinAcceptLength" BO_ 702 8;
//BA_ "GenMsgILSupport" BO_ 702 0;
//BA_ "DiagState" BO_ 702 0;
//BA_ "DiagRequest" BO_ 702 0;
//BA_ "DiagResponse" BO_ 702 0;
//BA_ "GenMsgStartValue" BO_ 702 "0";
//    */
//    _TP_TGW_COM_Adapt_Timebase =         c_tDBKomTimer_5ms ;
//    _TP_TGW_COM_Adapt_SpontanFlag = 0;
//
//    TP_TGW_COM_Adapt_getValue();
//}
//
//TP_TGW_COM_Adapt_output()
//{
//    output( _mTP_TGW_COM_Adapt );
//}
//
//TP_TGW_COM_Adapt_saveEnvVars( dword hFile )
//{
//    filePutString("\n// Knoten TGW: TP_TGW_COM_Adapt\n", 23, hFile);
//    snprintf( buffer, elcount(buffer), "0.0000 HMI__STMSG_TP_TGW_COM_Adapt := %X\n", getValue( HMI__STMSG_TP_TGW_COM_Adapt ));     filePutString( buffer, elcount(buffer), hFile);
//    snprintf( buffer, elcount(buffer), "0.0000 HMI__STMSGT_TP_TGW_COM_Adapt := %X\n", getValue( HMI__STMSGT_TP_TGW_COM_Adapt ));   filePutString( buffer, elcount(buffer), hFile);
//    snprintf( buffer, elcount(buffer), "0.0000 HMI_TP_TGW_COM_Adapt_0 := %X\n", getValue( HMI_TP_TGW_COM_Adapt_0 ) );    filePutString( buffer, elcount(buffer), hFile);
//    snprintf( buffer, elcount(buffer), "0.0000 HMI_TP_TGW_COM_Adapt_1 := %X\n", getValue( HMI_TP_TGW_COM_Adapt_1 ) );    filePutString( buffer, elcount(buffer), hFile);
//    snprintf( buffer, elcount(buffer), "0.0000 HMI_TP_TGW_COM_Adapt_2 := %X\n", getValue( HMI_TP_TGW_COM_Adapt_2 ) );    filePutString( buffer, elcount(buffer), hFile);
//    snprintf( buffer, elcount(buffer), "0.0000 HMI_TP_TGW_COM_Adapt_3 := %X\n", getValue( HMI_TP_TGW_COM_Adapt_3 ) );    filePutString( buffer, elcount(buffer), hFile);
//    snprintf( buffer, elcount(buffer), "0.0000 HMI_TP_TGW_COM_Adapt_4 := %X\n", getValue( HMI_TP_TGW_COM_Adapt_4 ) );    filePutString( buffer, elcount(buffer), hFile);
//    snprintf( buffer, elcount(buffer), "0.0000 HMI_TP_TGW_COM_Adapt_5 := %X\n", getValue( HMI_TP_TGW_COM_Adapt_5 ) );    filePutString( buffer, elcount(buffer), hFile);
//    snprintf( buffer, elcount(buffer), "0.0000 HMI_TP_TGW_COM_Adapt_6 := %X\n", getValue( HMI_TP_TGW_COM_Adapt_6 ) );    filePutString( buffer, elcount(buffer), hFile);
//    snprintf( buffer, elcount(buffer), "0.0000 HMI_TP_TGW_COM_Adapt_7 := %X\n", getValue( HMI_TP_TGW_COM_Adapt_7 ) );    filePutString( buffer, elcount(buffer), hFile);
//}
//
//on timer _tTP_TGW_COM_Adapt
//{
//    putValue( HMI__STMSG_TP_TGW_COM_Adapt, 0 );
//}
//
//on EnvVar HMI__STMSG_TP_TGW_COM_Adapt
//{
//    long tDelay;
//    if( getValue( this ) == 2 )
//    {
//        tDelay = getValue( HMI__STMSGT_TP_TGW_COM_Adapt );
//        if( tDelay > 0 )    
//            setTimer( _tTP_TGW_COM_Adapt, tDelay );
//        else
//            putValue( HMI__STMSG_TP_TGW_COM_Adapt, 0 );
//    }
//}
//
//on EnvVar HMI_TP_TGW_COM_Adapt_Send
//{
//    TP_TGW_COM_Adapt_getValue();
//    _TP_TGW_COM_Adapt_SpontanFlag = 1;
//}
//
//on envVar HMI__STMSG_PO_TP_TGW_COM_Adapt
//{
//    if( getValue( this ) )
//        openPanel("TP_TGW_COM_Adapt");
//}

TP_TGW_IC_Aud_check_output()
{
    if( !getValue( HMI__STMSG_TP_TGW_IC_Aud ) )
    {
        // Botschaft TP_TGW_IC_Aud ID: 731 --- Sendeart 1 spontanX --- 
        if( _TP_TGW_IC_Aud_SpontanFlag)
        {
            TP_TGW_IC_Aud_output(); // Nachricht wg. spontaner Änderung ausgeben
            _TP_TGW_IC_Aud_SpontanFlag = 0; // Spontan-Flag zurücksetzen
        }
    }
}

void TP_TGW_IC_Aud_getValue(void)
{
    _mTP_TGW_IC_Aud.byte( 0 ) = getValue( HMI_TP_TGW_IC_Aud_0 );
    _mTP_TGW_IC_Aud.byte( 1 ) = getValue( HMI_TP_TGW_IC_Aud_1 );
    _mTP_TGW_IC_Aud.byte( 2 ) = getValue( HMI_TP_TGW_IC_Aud_2 );
    _mTP_TGW_IC_Aud.byte( 3 ) = getValue( HMI_TP_TGW_IC_Aud_3 );
    _mTP_TGW_IC_Aud.byte( 4 ) = getValue( HMI_TP_TGW_IC_Aud_4 );
    _mTP_TGW_IC_Aud.byte( 5 ) = getValue( HMI_TP_TGW_IC_Aud_5 );
    _mTP_TGW_IC_Aud.byte( 6 ) = getValue( HMI_TP_TGW_IC_Aud_6 );
    _mTP_TGW_IC_Aud.byte( 7 ) = getValue( HMI_TP_TGW_IC_Aud_7 );
}

TP_TGW_IC_Aud_init()
{   /* Botschaft TP_TGW_IC_Aud ID: 731 --- Sendeart 1 spontanX --- 
BA_ "ApplMessage" BO_ 731 0;
BA_ "NmAsrMessage" BO_ 731 0;
BA_ "GenMsgMinAcceptLength" BO_ 731 8;
BA_ "GenMsgILSupport" BO_ 731 0;
BA_ "DiagState" BO_ 731 0;
BA_ "DiagRequest" BO_ 731 0;
BA_ "DiagResponse" BO_ 731 0;
BA_ "GenMsgStartValue" BO_ 731 "255";
    */
    _TP_TGW_IC_Aud_Timebase =         c_tDBKomTimer_5ms ;
    _TP_TGW_IC_Aud_SpontanFlag = 0;

    TP_TGW_IC_Aud_getValue();
}

TP_TGW_IC_Aud_output()
{
    output( _mTP_TGW_IC_Aud );
}

TP_TGW_IC_Aud_saveEnvVars( dword hFile )
{
    filePutString("\n// Knoten TGW: TP_TGW_IC_Aud\n", 23, hFile);
    snprintf( buffer, elcount(buffer), "0.0000 HMI__STMSG_TP_TGW_IC_Aud := %X\n", getValue( HMI__STMSG_TP_TGW_IC_Aud ));     filePutString( buffer, elcount(buffer), hFile);
    snprintf( buffer, elcount(buffer), "0.0000 HMI__STMSGT_TP_TGW_IC_Aud := %X\n", getValue( HMI__STMSGT_TP_TGW_IC_Aud ));   filePutString( buffer, elcount(buffer), hFile);
    snprintf( buffer, elcount(buffer), "0.0000 HMI_TP_TGW_IC_Aud_0 := %X\n", getValue( HMI_TP_TGW_IC_Aud_0 ) );    filePutString( buffer, elcount(buffer), hFile);
    snprintf( buffer, elcount(buffer), "0.0000 HMI_TP_TGW_IC_Aud_1 := %X\n", getValue( HMI_TP_TGW_IC_Aud_1 ) );    filePutString( buffer, elcount(buffer), hFile);
    snprintf( buffer, elcount(buffer), "0.0000 HMI_TP_TGW_IC_Aud_2 := %X\n", getValue( HMI_TP_TGW_IC_Aud_2 ) );    filePutString( buffer, elcount(buffer), hFile);
    snprintf( buffer, elcount(buffer), "0.0000 HMI_TP_TGW_IC_Aud_3 := %X\n", getValue( HMI_TP_TGW_IC_Aud_3 ) );    filePutString( buffer, elcount(buffer), hFile);
    snprintf( buffer, elcount(buffer), "0.0000 HMI_TP_TGW_IC_Aud_4 := %X\n", getValue( HMI_TP_TGW_IC_Aud_4 ) );    filePutString( buffer, elcount(buffer), hFile);
    snprintf( buffer, elcount(buffer), "0.0000 HMI_TP_TGW_IC_Aud_5 := %X\n", getValue( HMI_TP_TGW_IC_Aud_5 ) );    filePutString( buffer, elcount(buffer), hFile);
    snprintf( buffer, elcount(buffer), "0.0000 HMI_TP_TGW_IC_Aud_6 := %X\n", getValue( HMI_TP_TGW_IC_Aud_6 ) );    filePutString( buffer, elcount(buffer), hFile);
    snprintf( buffer, elcount(buffer), "0.0000 HMI_TP_TGW_IC_Aud_7 := %X\n", getValue( HMI_TP_TGW_IC_Aud_7 ) );    filePutString( buffer, elcount(buffer), hFile);
}

on timer _tTP_TGW_IC_Aud
{
    putValue( HMI__STMSG_TP_TGW_IC_Aud, 0 );
}

on EnvVar HMI__STMSG_TP_TGW_IC_Aud
{
    long tDelay;
    if( getValue( this ) == 2 )
    {
        tDelay = getValue( HMI__STMSGT_TP_TGW_IC_Aud );
        if( tDelay > 0 )    
            setTimer( _tTP_TGW_IC_Aud, tDelay );
        else
            putValue( HMI__STMSG_TP_TGW_IC_Aud, 0 );
    }
}

on EnvVar HMI_TP_TGW_IC_Aud_Send
{
    TP_TGW_IC_Aud_getValue();
    _TP_TGW_IC_Aud_SpontanFlag = 1;
}

on envVar HMI__STMSG_PO_TP_TGW_IC_Aud
{
    if( getValue( this ) )
        openPanel("TP_TGW_IC_Aud");
}

TP_TGW_IC_HUD_check_output()
{
    if( !getValue( HMI__STMSG_TP_TGW_IC_HUD ))
    {
        // Botschaft TP_TGW_IC_HUD ID: 672 --- Sendeart 1 spontanX --- 
        if( _TP_TGW_IC_Aud_SpontanFlag)
        {
            TP_TGW_IC_HUD_output(); // Nachricht wg. spontaner Änderung ausgeben
            _TP_TGW_IC_HUD_SpontanFlag = 0; // Spontan-Flag zurücksetzen
        }
    }
}

void TP_TGW_IC_HUD_getValue(void)
{
    _mTP_TGW_IC_HUD.byte( 0 ) = getValue( HMI_TP_TGW_IC_HUD_0 );
    _mTP_TGW_IC_HUD.byte( 1 ) = getValue( HMI_TP_TGW_IC_HUD_1 );
    _mTP_TGW_IC_HUD.byte( 2 ) = getValue( HMI_TP_TGW_IC_HUD_2 );
    _mTP_TGW_IC_HUD.byte( 3 ) = getValue( HMI_TP_TGW_IC_HUD_3 );
    _mTP_TGW_IC_HUD.byte( 4 ) = getValue( HMI_TP_TGW_IC_HUD_4 );
    _mTP_TGW_IC_HUD.byte( 5 ) = getValue( HMI_TP_TGW_IC_HUD_5 );
    _mTP_TGW_IC_HUD.byte( 6 ) = getValue( HMI_TP_TGW_IC_HUD_6 );
    _mTP_TGW_IC_HUD.byte( 7 ) = getValue( HMI_TP_TGW_IC_HUD_7 );
}

TP_TGW_IC_HUD_init()
{
    /* Botschaft TP_TGW_IC_HUD ID: 672 ---- Sendeart 1 spontanX --- 
BA_ "ApplMessage" BO_ 672 0;
BA_ "NmAsrMessage" BO_ 672 0;
BA_ "GenMsgMinAcceptLength" BO_ 672 8;
BA_ "GenMsgILSupport" BO_ 672 0;
BA_ "DiagState" BO_ 672 0;
BA_ "DiagRequest" BO_ 672 0;
BA_ "DiagResponse" BO_ 672 0;
BA_ "GenMsgStartValue" BO_ 672 "255";
    */
    _TP_TGW_IC_HUD_Timebase =         c_tDBKomTimer_5ms ;
    _TP_TGW_IC_HUD_SpontanFlag = 0;

    TP_TGW_IC_HUD_getValue();
}

TP_TGW_IC_HUD_output()
{
    output( _mTP_TGW_IC_HUD );
}

TP_MPM_TGW_saveEnvVars( dword hFile )
{
    filePutString("\n// Knoten EIS: TP_TGW_IC_HUD\n", 32, hFile );
    snprintf( buffer, elcount( buffer ), "0.0000 HMI__STMSG_TP_TGW_IC_HUD := %X\n", getValue( HMI__STMSG_TP_TGW_IC_HUD ) );        filePutString( buffer, elcount( buffer ), hFile );
    snprintf( buffer, elcount( buffer ), "0.0000 HMI__STMSGT_TP_TGW_IC_HUD := %X\n", getValue( HMI__STMSGT_TP_TGW_IC_HUD ) );        filePutString( buffer, elcount( buffer ), hFile );
    snprintf( buffer, elcount( buffer ), "0.0000 HMI_TP_TGW_IC_HUD_0 := %X\n", getValue( HMI_TP_TGW_IC_HUD_0 ) );        filePutString( buffer, elcount( buffer ), hFile );
    snprintf( buffer, elcount( buffer ), "0.0000 HMI_TP_TGW_IC_HUD_1 := %X\n", getValue( HMI_TP_TGW_IC_HUD_1 ) );        filePutString( buffer, elcount( buffer ), hFile );
    snprintf( buffer, elcount( buffer ), "0.0000 HMI_TP_TGW_IC_HUD_2 := %X\n", getValue( HMI_TP_TGW_IC_HUD_2 ) );        filePutString( buffer, elcount( buffer ), hFile );
    snprintf( buffer, elcount( buffer ), "0.0000 HMI_TP_TGW_IC_HUD_3 := %X\n", getValue( HMI_TP_TGW_IC_HUD_3 ) );        filePutString( buffer, elcount( buffer ), hFile );
    snprintf( buffer, elcount( buffer ), "0.0000 HMI_TP_TGW_IC_HUD_4 := %X\n", getValue( HMI_TP_TGW_IC_HUD_4 ) );        filePutString( buffer, elcount( buffer ), hFile );
    snprintf( buffer, elcount( buffer ), "0.0000 HMI_TP_TGW_IC_HUD_5 := %X\n", getValue( HMI_TP_TGW_IC_HUD_5 ) );        filePutString( buffer, elcount( buffer ), hFile );
    snprintf( buffer, elcount( buffer ), "0.0000 HMI_TP_TGW_IC_HUD_6 := %X\n", getValue( HMI_TP_TGW_IC_HUD_6 ) );        filePutString( buffer, elcount( buffer ), hFile );
    snprintf( buffer, elcount( buffer ), "0.0000 HMI_TP_TGW_IC_HUD_7 := %X\n", getValue( HMI_TP_TGW_IC_HUD_7 ) );        filePutString( buffer, elcount( buffer ), hFile );
}

on timer _tTP_TGW_IC_HUD
{
    putValue( HMI__STMSG_TP_TGW_IC_HUD, 0 );
}

on EnvVar HMI__STMSG_TP_TGW_IC_HUD
{
    long tDelay;
    if( getValue( this ) == 2 )
    {
        tDelay = getValue( HMI__STMSGT_TP_TGW_IC_HUD );
        if( tDelay > 0 )    
            setTimer( _tTP_TGW_IC_HUD, tDelay );
        else
            putValue( HMI__STMSG_TP_TGW_IC_HUD, 0 );
    }
}

on EnvVar HMI_TP_TGW_IC_HUD_Send
{
    TP_TGW_IC_HUD_getValue();
    _TP_TGW_IC_HUD_SpontanFlag = 1;
}

on envVar HMI__STMSG_PO_TP_TGW_IC_HUD
{
    if( getValue( this ) )
        openPanel("TP_TGW_IC_HUD");
}

TP_TGW_IC_Pers_check_output()
{

//BO_ 1277 TP_TGW_IC_Pers : 8 TGW
 //SG_ TP_TGW_IC_Pers : 0|64@1+ (1,0) [0|0] "" IC


}

TP_TGW_IC_Nav_check_output()
{
    if( !getValue( HMI__STMSG_TP_TGW_IC_Nav ) )
    {
        // Botschaft TP_TGW_IC_Nav ID: 703 --- Sendeart 1 spontanX --- 
        if( _TP_TGW_IC_Nav_SpontanFlag)
        {
            TP_TGW_IC_Nav_output(); // Nachricht wg. spontaner Änderung ausgeben
            _TP_TGW_IC_Nav_SpontanFlag = 0; // Spontan-Flag zurücksetzen
        }
    }
}

void TP_TGW_IC_Nav_getValue(void)
{
    _mTP_TGW_IC_Nav.byte(0 ) = getValue( HMI_TP_TGW_IC_Nav_0 );
    _mTP_TGW_IC_Nav.byte(1 ) = getValue( HMI_TP_TGW_IC_Nav_1 );
    _mTP_TGW_IC_Nav.byte(2) = getValue( HMI_TP_TGW_IC_Nav_2);
    _mTP_TGW_IC_Nav.byte(3) = getValue( HMI_TP_TGW_IC_Nav_3);
    _mTP_TGW_IC_Nav.byte(4) = getValue( HMI_TP_TGW_IC_Nav_4);
    _mTP_TGW_IC_Nav.byte(5) = getValue( HMI_TP_TGW_IC_Nav_5);
    _mTP_TGW_IC_Nav.byte(6) = getValue( HMI_TP_TGW_IC_Nav_6);
    _mTP_TGW_IC_Nav.byte(7) = getValue( HMI_TP_TGW_IC_Nav_7);
}

TP_TGW_IC_Nav_init()
{
   /* Botschaft TP_TGW_IC_Nav ID: 703 --- Sendeart 0 cyclicX --- 
BA_ "ApplMessage" BO_ 703 0;
BA_ "NmAsrMessage" BO_ 703 0;
BA_ "GenMsgMinAcceptLength" BO_ 703 8;
BA_ "GenMsgILSupport" BO_ 703 0;
BA_ "DiagState" BO_ 703 0;
BA_ "DiagRequest" BO_ 703 0;
BA_ "DiagResponse" BO_ 703 0;
BA_ "GenMsgStartValue" BO_ 703 "255";
    */
    _TP_TGW_IC_Nav_Timebase =         c_tDBKomTimer_5ms ;
    _TP_TGW_IC_Nav_SpontanFlag = 0;

    TP_TGW_IC_Nav_getValue();
}

TP_TGW_IC_Nav_output()
{
    output( _mTP_TGW_IC_Nav );
}

TP_TGW_IC_Nav_saveEnvVars( dword hFile )
{
    filePutString("\n// Knoten TGW: TP_TGW_IC_Nav\n", 23, hFile);
    snprintf( buffer, elcount(buffer), "0.0000 HMI__STMSG_TP_TGW_IC_Nav := %X\n", getValue( HMI__STMSG_TP_TGW_IC_Nav ));     filePutString( buffer, elcount(buffer), hFile);
    snprintf( buffer, elcount(buffer), "0.0000 HMI__STMSGT_TP_TGW_IC_Nav := %X\n", getValue( HMI__STMSGT_TP_TGW_IC_Nav ));   filePutString( buffer, elcount(buffer), hFile);
    snprintf( buffer, elcount(buffer), "0.0000 HMI_TP_TGW_IC_Nav_0 := %X\n", getValue( HMI_TP_TGW_IC_Nav_0 ) );    filePutString( buffer, elcount(buffer), hFile);
    snprintf( buffer, elcount(buffer), "0.0000 HMI_TP_TGW_IC_Nav_1 := %X\n", getValue( HMI_TP_TGW_IC_Nav_1 ) );    filePutString( buffer, elcount(buffer), hFile);
    snprintf( buffer, elcount(buffer), "0.0000 HMI_TP_TGW_IC_Nav_2 := %X\n", getValue( HMI_TP_TGW_IC_Nav_2 ) );    filePutString( buffer, elcount(buffer), hFile);
    snprintf( buffer, elcount(buffer), "0.0000 HMI_TP_TGW_IC_Nav_3 := %X\n", getValue( HMI_TP_TGW_IC_Nav_3 ) );    filePutString( buffer, elcount(buffer), hFile);
    snprintf( buffer, elcount(buffer), "0.0000 HMI_TP_TGW_IC_Nav_4 := %X\n", getValue( HMI_TP_TGW_IC_Nav_4 ) );    filePutString( buffer, elcount(buffer), hFile);
    snprintf( buffer, elcount(buffer), "0.0000 HMI_TP_TGW_IC_Nav_5 := %X\n", getValue( HMI_TP_TGW_IC_Nav_5 ) );    filePutString( buffer, elcount(buffer), hFile);
    snprintf( buffer, elcount(buffer), "0.0000 HMI_TP_TGW_IC_Nav_6 := %X\n", getValue( HMI_TP_TGW_IC_Nav_6 ) );    filePutString( buffer, elcount(buffer), hFile);
    snprintf( buffer, elcount(buffer), "0.0000 HMI_TP_TGW_IC_Nav_7 := %X\n", getValue( HMI_TP_TGW_IC_Nav_7 ) );    filePutString( buffer, elcount(buffer), hFile);
}

on timer _tTP_TGW_IC_Nav
{
    putValue( HMI__STMSG_TP_TGW_IC_Nav, 0 );
}

on EnvVar HMI__STMSG_TP_TGW_IC_Nav
{
    long tDelay;
    if( getValue( this ) == 2 )
    {
        tDelay = getValue( HMI__STMSGT_TP_TGW_IC_Nav );
        if( tDelay > 0 )    
            setTimer( _tTP_TGW_IC_Nav, tDelay );
        else
            putValue( HMI__STMSG_TP_TGW_IC_Nav, 0 );
    }
}

on EnvVar HMI_TP_TGW_IC_Nav_Send
{
    TP_TGW_IC_Nav_getValue();
    _TP_TGW_IC_Nav_SpontanFlag = 1;
}

on envVar HMI__STMSG_PO_TP_TGW_IC_Nav
{
    if( getValue( this ) )
        openPanel("TP_TGW_IC_Nav");
}

TP_TGW_IC_SCA_check_output()
{
    if( !getValue( HMI__STMSG_TP_TGW_IC_SCA ))
    {
        // Botschaft TP_TGW_IC_SCA ID: 751 --- Sendeart 1 spontanX --- 
        if( _TP_TGW_IC_SCA_SpontanFlag)
        {
            TP_TGW_IC_SCA_output(); // Nachricht wg. spontaner Änderung ausgeben
            _TP_TGW_IC_SCA_SpontanFlag = 0; // Spontan-Flag zurücksetzen
        }
    }
}

void TP_TGW_IC_SCA_getValue(void)
{
    _mTP_TGW_IC_SCA.byte( 0 ) = getValue( HMI_TP_TGW_IC_SCA_0 );
    _mTP_TGW_IC_SCA.byte( 1 ) = getValue( HMI_TP_TGW_IC_SCA_1 );
    _mTP_TGW_IC_SCA.byte( 2 ) = getValue( HMI_TP_TGW_IC_SCA_2 );
    _mTP_TGW_IC_SCA.byte( 3 ) = getValue( HMI_TP_TGW_IC_SCA_3 );
    _mTP_TGW_IC_SCA.byte( 4 ) = getValue( HMI_TP_TGW_IC_SCA_4 );
    _mTP_TGW_IC_SCA.byte( 5 ) = getValue( HMI_TP_TGW_IC_SCA_5 );
    _mTP_TGW_IC_SCA.byte( 6 ) = getValue( HMI_TP_TGW_IC_SCA_6 );
    _mTP_TGW_IC_SCA.byte( 7 ) = getValue( HMI_TP_TGW_IC_SCA_7 );
}

TP_TGW_IC_SCA_init()
{
    /* Botschaft TP_TGW_IC_SCA ID: 751 ---- Sendeart 0 cyclicX --- 
BA_ "ApplMessage" BO_ 751 0;
BA_ "NmAsrMessage" BO_ 751 0;
BA_ "GenMsgMinAcceptLength" BO_ 751 8;
BA_ "GenMsgILSupport" BO_ 751 0;
BA_ "DiagState" BO_ 751 0;
BA_ "DiagRequest" BO_ 751 0;
BA_ "DiagResponse" BO_ 751 0;
BA_ "GenMsgStartValue" BO_ 751 "255";
    */
    _TP_TGW_IC_SCA_Timebase =         c_tDBKomTimer_5ms ;
    _TP_TGW_IC_SCA_SpontanFlag = 0;

    TP_TGW_IC_SCA_getValue();
}

TP_TGW_IC_SCA_output()
{
    output( _mTP_TGW_IC_SCA );
}

TP_TELEAID_TGW_saveEnvVars( dword hFile )
{
    filePutString("\n// Knoten EIS: TP_TGW_IC_SCA\n", 32, hFile );
    snprintf( buffer, elcount( buffer ), "0.0000 HMI__STMSG_TP_TGW_IC_SCA := %X\n", getValue( HMI__STMSG_TP_TGW_IC_SCA ) );    filePutString( buffer, elcount( buffer ), hFile );
    snprintf( buffer, elcount( buffer ), "0.0000 HMI__STMSGT_TP_TGW_IC_SCA := %X\n", getValue( HMI__STMSGT_TP_TGW_IC_SCA ) );    filePutString( buffer, elcount( buffer ), hFile );
    snprintf( buffer, elcount( buffer ), "0.0000 HMI_TP_TGW_IC_SCA_0 := %X\n", getValue( HMI_TP_TGW_IC_SCA_0 ) );    filePutString( buffer, elcount( buffer ), hFile );
    snprintf( buffer, elcount( buffer ), "0.0000 HMI_TP_TGW_IC_SCA_1 := %X\n", getValue( HMI_TP_TGW_IC_SCA_1 ) );    filePutString( buffer, elcount( buffer ), hFile );
    snprintf( buffer, elcount( buffer ), "0.0000 HMI_TP_TGW_IC_SCA_2 := %X\n", getValue( HMI_TP_TGW_IC_SCA_2 ) );    filePutString( buffer, elcount( buffer ), hFile );
    snprintf( buffer, elcount( buffer ), "0.0000 HMI_TP_TGW_IC_SCA_3 := %X\n", getValue( HMI_TP_TGW_IC_SCA_3 ) );    filePutString( buffer, elcount( buffer ), hFile );
    snprintf( buffer, elcount( buffer ), "0.0000 HMI_TP_TGW_IC_SCA_4 := %X\n", getValue( HMI_TP_TGW_IC_SCA_4 ) );    filePutString( buffer, elcount( buffer ), hFile );
    snprintf( buffer, elcount( buffer ), "0.0000 HMI_TP_TGW_IC_SCA_5 := %X\n", getValue( HMI_TP_TGW_IC_SCA_5 ) );    filePutString( buffer, elcount( buffer ), hFile );
    snprintf( buffer, elcount( buffer ), "0.0000 HMI_TP_TGW_IC_SCA_6 := %X\n", getValue( HMI_TP_TGW_IC_SCA_6 ) );    filePutString( buffer, elcount( buffer ), hFile );
    snprintf( buffer, elcount( buffer ), "0.0000 HMI_TP_TGW_IC_SCA_7 := %X\n", getValue( HMI_TP_TGW_IC_SCA_7 ) );    filePutString( buffer, elcount( buffer ), hFile );
}

on timer _tTP_TGW_IC_SCA
{
    putValue( HMI__STMSG_TP_TGW_IC_SCA, 0 );
}

on EnvVar HMI__STMSG_TP_TGW_IC_SCA
{
    long tDelay;
    if( getValue( this ) == 2 )
    {
        tDelay = getValue( HMI__STMSGT_TP_TGW_IC_SCA );
        if( tDelay > 0 )    
            setTimer( _tTP_TGW_IC_SCA, tDelay );
        else
            putValue( HMI__STMSG_TP_TGW_IC_SCA, 0 );
    }
}

on EnvVar HMI_TP_TGW_IC_SCA_Send
{
    TP_TGW_IC_SCA_getValue();
    _TP_TGW_IC_SCA_SpontanFlag = 1;
}

on envVar HMI__STMSG_PO_TP_TGW_IC_SCA
{
    if( getValue( this ) )
        openPanel("TP_TGW_IC_SCA");
}

TP_TGW_IC_Tel_check_output()
{
    if( !getValue( HMI__STMSG_TP_TGW_IC_Tel))
    {
        // Botschaft TP_TGW_IC_Tel ID: 707 --- Sendeart 1 spontanX --- 
        if( _TP_TGW_IC_Tel_SpontanFlag)
        {
            // Nachricht wg. spontaner Änderung ausgeben
            TP_TGW_IC_Tel_output();
            // Spontan-Flag zurücksetzen
            _TP_TGW_IC_Tel_SpontanFlag = 0;
        }
    }
}

void TP_TGW_IC_Tel_getValue(void)
{
    _mTP_TGW_IC_Tel.byte(0 ) = getValue( HMI_TP_TGW_IC_Tel_0 );
    _mTP_TGW_IC_Tel.byte(1 ) = getValue( HMI_TP_TGW_IC_Tel_1 );
    _mTP_TGW_IC_Tel.byte(2) = getValue( HMI_TP_TGW_IC_Tel_2);
    _mTP_TGW_IC_Tel.byte(3) = getValue( HMI_TP_TGW_IC_Tel_3);
    _mTP_TGW_IC_Tel.byte(4) = getValue( HMI_TP_TGW_IC_Tel_4);
    _mTP_TGW_IC_Tel.byte(5) = getValue( HMI_TP_TGW_IC_Tel_5);
    _mTP_TGW_IC_Tel.byte(6) = getValue( HMI_TP_TGW_IC_Tel_6);
    _mTP_TGW_IC_Tel.byte(7) = getValue( HMI_TP_TGW_IC_Tel_7);
}

TP_TGW_IC_Tel_init()
{   /* Botschaft TP_TGW_IC_Tel ID: 707 --- Sendeart 0 cyclicX --- 
BA_ "ApplMessage" BO_ 707 0;
BA_ "NmAsrMessage" BO_ 707 0;
BA_ "GenMsgMinAcceptLength" BO_ 707 8;
BA_ "GenMsgILSupport" BO_ 707 0;
BA_ "DiagState" BO_ 707 0;
BA_ "DiagRequest" BO_ 707 0;
BA_ "DiagResponse" BO_ 707 0;
BA_ "GenMsgStartValue" BO_ 707 "255";
    */
    _TP_TGW_IC_Tel_Timebase =         c_tDBKomTimer_5ms ;
    _TP_TGW_IC_Tel_SpontanFlag = 0;

    TP_TGW_IC_Tel_getValue();
}

TP_TGW_IC_Tel_output()
{
    output( _mTP_TGW_IC_Tel );
}

TP_TGW_IC_Tel_saveEnvVars( dword hFile )
{
    filePutString("\n// Knoten TGW: TP_TGW_IC_Tel\n", 23, hFile);
    snprintf( buffer, elcount(buffer), "0.0000 HMI__STMSG_TP_TGW_IC_Tel := %X\n", getValue( HMI__STMSG_TP_TGW_IC_Tel ));     filePutString( buffer, elcount(buffer), hFile);
    snprintf( buffer, elcount(buffer), "0.0000 HMI__STMSGT_TP_TGW_IC_Tel := %X\n", getValue( HMI__STMSGT_TP_TGW_IC_Tel ));   filePutString( buffer, elcount(buffer), hFile);
    snprintf( buffer, elcount(buffer), "0.0000 HMI_TP_TGW_IC_Tel_0 := %X\n", getValue( HMI_TP_TGW_IC_Tel_0 ) );    filePutString( buffer, elcount(buffer), hFile);
    snprintf( buffer, elcount(buffer), "0.0000 HMI_TP_TGW_IC_Tel_1 := %X\n", getValue( HMI_TP_TGW_IC_Tel_1 ) );    filePutString( buffer, elcount(buffer), hFile);
    snprintf( buffer, elcount(buffer), "0.0000 HMI_TP_TGW_IC_Tel_2 := %X\n", getValue( HMI_TP_TGW_IC_Tel_2 ) );    filePutString( buffer, elcount(buffer), hFile);
    snprintf( buffer, elcount(buffer), "0.0000 HMI_TP_TGW_IC_Tel_3 := %X\n", getValue( HMI_TP_TGW_IC_Tel_3 ) );    filePutString( buffer, elcount(buffer), hFile);
    snprintf( buffer, elcount(buffer), "0.0000 HMI_TP_TGW_IC_Tel_4 := %X\n", getValue( HMI_TP_TGW_IC_Tel_4 ) );    filePutString( buffer, elcount(buffer), hFile);
    snprintf( buffer, elcount(buffer), "0.0000 HMI_TP_TGW_IC_Tel_5 := %X\n", getValue( HMI_TP_TGW_IC_Tel_5 ) );    filePutString( buffer, elcount(buffer), hFile);
    snprintf( buffer, elcount(buffer), "0.0000 HMI_TP_TGW_IC_Tel_6 := %X\n", getValue( HMI_TP_TGW_IC_Tel_6 ) );    filePutString( buffer, elcount(buffer), hFile);
    snprintf( buffer, elcount(buffer), "0.0000 HMI_TP_TGW_IC_Tel_7 := %X\n", getValue( HMI_TP_TGW_IC_Tel_7 ) );    filePutString( buffer, elcount(buffer), hFile);
}

on timer _tTP_TGW_IC_Tel
{
    putValue( HMI__STMSG_TP_TGW_IC_Tel, 0 );
}

on EnvVar HMI__STMSG_TP_TGW_IC_Tel
{
    long tDelay;
    if( getValue( this ) == 2 )
    {
        tDelay = getValue( HMI__STMSGT_TP_TGW_IC_Tel );
        if( tDelay > 0 )    
            setTimer( _tTP_TGW_IC_Tel, tDelay );
        else
            putValue( HMI__STMSG_TP_TGW_IC_Tel, 0 );
    }
}

on EnvVar HMI_TP_TGW_IC_Tel_Send
{
    TP_TGW_IC_Tel_getValue();
    _TP_TGW_IC_Tel_SpontanFlag = 1;
}

on envVar HMI__STMSG_PO_TP_TGW_IC_Tel
{
    if( getValue( this ) )
        openPanel("TP_TGW_IC_Tel");
}

TP_TGW_MPM_Nav_check_output()
{
    if( !getValue( HMI__STMSG_TP_TGW_MPM_Nav))
    {
        // Botschaft TP_TGW_MPM_Nav ID: 747 --- Sendeart 1 spontanX --- 
        if( _TP_TGW_MPM_Nav_SpontanFlag)
        {
            // Nachricht wg. spontaner Änderung ausgeben
            TP_TGW_MPM_Nav_output();
            // Spontan-Flag zurücksetzen
            _TP_TGW_MPM_Nav_SpontanFlag = 0;
        }
    }
}

void TP_TGW_MPM_Nav_getValue(void)
{
    _mTP_TGW_MPM_Nav.byte( 0 ) = getValue( HMI_TP_TGW_MPM_Nav_0 );
    _mTP_TGW_MPM_Nav.byte( 1 ) = getValue( HMI_TP_TGW_MPM_Nav_1 );
    _mTP_TGW_MPM_Nav.byte( 2 ) = getValue( HMI_TP_TGW_MPM_Nav_2 );
    _mTP_TGW_MPM_Nav.byte( 3 ) = getValue( HMI_TP_TGW_MPM_Nav_3 );
    _mTP_TGW_MPM_Nav.byte( 4 ) = getValue( HMI_TP_TGW_MPM_Nav_4 );
    _mTP_TGW_MPM_Nav.byte( 5 ) = getValue( HMI_TP_TGW_MPM_Nav_5 );
    _mTP_TGW_MPM_Nav.byte( 6 ) = getValue( HMI_TP_TGW_MPM_Nav_6 );
    _mTP_TGW_MPM_Nav.byte( 7 ) = getValue( HMI_TP_TGW_MPM_Nav_7 );
}

TP_TGW_MPM_Nav_init()
{   /* Botschaft TP_TGW_MPM_Nav ID: 747 --- Sendeart cyclicX --- 
BA_ "ApplMessage" BO_ 747 0;
BA_ "NmAsrMessage" BO_ 747 0;
BA_ "GenMsgMinAcceptLength" BO_ 747 8;
BA_ "GenMsgILSupport" BO_ 747 0;
BA_ "DiagState" BO_ 747 0;
BA_ "DiagRequest" BO_ 747 0;
BA_ "DiagResponse" BO_ 747 0;
BA_ "GenMsgStartValue" BO_ 747 "255";
    */
    _TP_TGW_MPM_Nav_Timebase =         c_tDBKomTimer_5ms ;
    _TP_TGW_MPM_Nav_SpontanFlag = 0;

    TP_TGW_MPM_Nav_getValue();
}

TP_TGW_MPM_Nav_output()
{
    output( _mTP_TGW_MPM_Nav );
}

TP_TGW_MPM_Nav_saveEnvVars( dword hFile )
{
    filePutString("\n// Knoten TGW: TP_TGW_MPM_Nav\n", 31, hFile);
    snprintf( buffer, elcount(buffer), "0.0000 HMI__STMSG_TP_TGW_MPM_Nav := %X\n", getValue( HMI__STMSG_TP_TGW_MPM_Nav ) );        filePutString( buffer, elcount(buffer), hFile);
    snprintf( buffer, elcount(buffer), "0.0000 HMI__STMSGT_TP_TGW_MPM_Nav := %X\n", getValue( HMI__STMSGT_TP_TGW_MPM_Nav ) );        filePutString( buffer, elcount(buffer), hFile);
    snprintf( buffer, elcount(buffer), "0.0000 TP_TGW_MPM_Nav_0 := %X\n", getValue( HMI_TP_TGW_MPM_Nav_0 ) );        filePutString( buffer, elcount(buffer), hFile);
    snprintf( buffer, elcount(buffer), "0.0000 TP_TGW_MPM_Nav_1 := %X\n", getValue( HMI_TP_TGW_MPM_Nav_1 ) );        filePutString( buffer, elcount(buffer), hFile);
    snprintf( buffer, elcount(buffer), "0.0000 TP_TGW_MPM_Nav_2 := %X\n", getValue( HMI_TP_TGW_MPM_Nav_2 ) );        filePutString( buffer, elcount(buffer), hFile);
    snprintf( buffer, elcount(buffer), "0.0000 TP_TGW_MPM_Nav_3 := %X\n", getValue( HMI_TP_TGW_MPM_Nav_3 ) );        filePutString( buffer, elcount(buffer), hFile);
    snprintf( buffer, elcount(buffer), "0.0000 TP_TGW_MPM_Nav_4 := %X\n", getValue( HMI_TP_TGW_MPM_Nav_4 ) );        filePutString( buffer, elcount(buffer), hFile);
    snprintf( buffer, elcount(buffer), "0.0000 TP_TGW_MPM_Nav_5 := %X\n", getValue( HMI_TP_TGW_MPM_Nav_5 ) );        filePutString( buffer, elcount(buffer), hFile);
    snprintf( buffer, elcount(buffer), "0.0000 TP_TGW_MPM_Nav_6 := %X\n", getValue( HMI_TP_TGW_MPM_Nav_6 ) );        filePutString( buffer, elcount(buffer), hFile);
    snprintf( buffer, elcount(buffer), "0.0000 TP_TGW_MPM_Nav_7 := %X\n", getValue( HMI_TP_TGW_MPM_Nav_7 ) );        filePutString( buffer, elcount(buffer), hFile);
}

on timer _tTP_TGW_MPM_Nav
{
    putValue( HMI__STMSG_TP_TGW_MPM_Nav, 0 );
}

on EnvVar HMI__STMSG_TP_TGW_MPM_Nav
{
    long tDelay;
    if( getValue( this ) == 2 )
    {
        tDelay = getValue( HMI__STMSGT_TP_TGW_MPM_Nav );
        if( tDelay > 0 )    
            setTimer( _tTP_TGW_MPM_Nav, tDelay );
        else
            putValue( HMI__STMSG_TP_TGW_MPM_Nav, 0 );
    }
}

on EnvVar HMI_TP_TGW_MPM_Nav_Send
{
    TP_TGW_MPM_Nav_getValue();
    _TP_TGW_MPM_Nav_SpontanFlag = 1;
}

on envVar HMI__STMSG_PO_TP_TGW_MPM_Nav
{
    if( getValue( this ) )
        openPanel("TP_TGW_MPM_Nav");
}

TP_TGW_PARK_check_output()
{
    if( !getValue( HMI__STMSG_TP_TGW_PARK ))
    {
        // Botschaft TP_TGW_PARK ID: 664 --- Sendeart 1 spontanX --- 
        if( _TP_TGW_PARK_SpontanFlag)
        {
            // Nachricht wg. spontaner Änderung ausgeben
            TP_TGW_PARK_output();
            // Spontan-Flag zurücksetzen
            _TP_TGW_PARK_SpontanFlag = 0;
        }
    }
}

TP_TGW_PARK_init()
{   /* Botschaft TP_TGW_PARK ID: 664 --- Sendeart 0 cyclicX --- 

BA_ "ApplMessage" BO_ 664 0;
BA_ "NmAsrMessage" BO_ 664 0;
BA_ "GenMsgMinAcceptLength" BO_ 664 8;
BA_ "GenMsgILSupport" BO_ 664 0;
BA_ "DiagState" BO_ 664 0;
BA_ "DiagRequest" BO_ 664 0;
BA_ "DiagResponse" BO_ 664 0;
BA_ "GenMsgStartValue" BO_ 664 "0";
    */
    _TP_TGW_PARK_Timebase =         c_tDBKomTimer_5ms ;
    _TP_TGW_PARK_SpontanFlag = 0;

    TP_TGW_PARK_getValue();
}

TP_TGW_PARK_output()
{
    output( _mTP_TGW_PARK );
}

void TP_TGW_PARK_getValue(void)
{
    _mTP_TGW_PARK.byte( 0 ) = getValue( HMI_TP_TGW_PARK_0 );
    _mTP_TGW_PARK.byte( 1 ) = getValue( HMI_TP_TGW_PARK_1 );
    _mTP_TGW_PARK.byte( 2 ) = getValue( HMI_TP_TGW_PARK_2 );
    _mTP_TGW_PARK.byte( 3 ) = getValue( HMI_TP_TGW_PARK_3 );
    _mTP_TGW_PARK.byte( 4 ) = getValue( HMI_TP_TGW_PARK_4 );
    _mTP_TGW_PARK.byte( 5 ) = getValue( HMI_TP_TGW_PARK_5 );
    _mTP_TGW_PARK.byte( 6 ) = getValue( HMI_TP_TGW_PARK_6 );
    _mTP_TGW_PARK.byte( 7 ) = getValue( HMI_TP_TGW_PARK_7 );
}

on timer _tTP_TGW_PARK
{
    putValue( HMI__STMSG_TP_TGW_PARK, 0 );
}

on EnvVar HMI__STMSG_TP_TGW_PARK
{
    long tDelay;
    if( getValue( this ) == 2 )
    {
        tDelay = getValue( HMI__STMSGT_TP_TGW_PARK );
        if( tDelay > 0 )    
            setTimer( _tTP_TGW_PARK, tDelay );
        else
            putValue( HMI__STMSG_TP_TGW_PARK, 0 );
    }
}

on EnvVar HMI_TP_TGW_PARK_Send
{
    TP_TGW_PARK_getValue();
    _TP_TGW_PARK_SpontanFlag = 1;
}

on envVar HMI__STMSG_PO_TP_TGW_PARK
{
    if( getValue( this ) )
        openPanel("TP_TGW_PARK");
}

TP_TGW_TELEAID_check_output()
{
    if( !getValue( HMI__STMSG_TP_TGW_TELEAID ))
    {
        // Botschaft TP_TGW_TELEAID ID: 737 --- Sendeart 1 spontanX --- 
        if( _TP_TGW_TELEAID_SpontanFlag)
        {
            // Nachricht wg. spontaner Änderung ausgeben
            TP_TGW_TELEAID_output();
            // Spontan-Flag zurücksetzen
            _TP_TGW_TELEAID_SpontanFlag = 0;
        }
    }
}

void TP_TGW_TELEAID_getValue(void)
{
    _mTP_TGW_TELEAID.byte( 0 ) = getValue( HMI_TP_TGW_TELEAID_0 );
    _mTP_TGW_TELEAID.byte( 1 ) = getValue( HMI_TP_TGW_TELEAID_1 );
    _mTP_TGW_TELEAID.byte( 2 ) = getValue( HMI_TP_TGW_TELEAID_2 );
    _mTP_TGW_TELEAID.byte( 3 ) = getValue( HMI_TP_TGW_TELEAID_3 );
    _mTP_TGW_TELEAID.byte( 4 ) = getValue( HMI_TP_TGW_TELEAID_4 );
    _mTP_TGW_TELEAID.byte( 5 ) = getValue( HMI_TP_TGW_TELEAID_5 );
    _mTP_TGW_TELEAID.byte( 6 ) = getValue( HMI_TP_TGW_TELEAID_6 );
    _mTP_TGW_TELEAID.byte( 7 ) = getValue( HMI_TP_TGW_TELEAID_7 );
}

TP_TGW_TELEAID_init()
{   /* Botschaft TP_TGW_TELEAID ID: 737 --- Sendeart cyclicX --- 
BA_ "ApplMessage" BO_ 737 0;
BA_ "NmAsrMessage" BO_ 737 0;
BA_ "GenMsgMinAcceptLength" BO_ 737 8;
BA_ "GenMsgILSupport" BO_ 737 0;
BA_ "DiagState" BO_ 737 0;
BA_ "DiagRequest" BO_ 737 0;
BA_ "DiagResponse" BO_ 737 0;
BA_ "GenMsgStartValue" BO_ 737 "0";
    */
    _TP_TGW_TELEAID_Timebase =         c_tDBKomTimer_5ms ;
    _TP_TGW_TELEAID_SpontanFlag = 0;

    TP_TGW_TELEAID_getValue();
}

TP_TGW_TELEAID_output()
{
    output( _mTP_TGW_TELEAID );
}

TP_TGW_TELEAID_saveEnvVars( dword hFile )
{
    filePutString("\n// Knoten TGW: TP_TGW_TELEAID\n", 31, hFile);
    snprintf( buffer, elcount(buffer), "0.0000 HMI__STMSG_TP_TGW_TELEAID := %X\n", getValue( HMI__STMSG_TP_TGW_TELEAID ) );        filePutString( buffer, elcount(buffer), hFile);
    snprintf( buffer, elcount(buffer), "0.0000 HMI__STMSGT_TP_TGW_TELEAID := %X\n", getValue( HMI__STMSGT_TP_TGW_TELEAID ) );        filePutString( buffer, elcount(buffer), hFile);
    snprintf( buffer, elcount(buffer), "0.0000 TP_TGW_TELEAID_0 := %X\n", getValue( HMI_TP_TGW_TELEAID_0 ) );        filePutString( buffer, elcount(buffer), hFile);
    snprintf( buffer, elcount(buffer), "0.0000 TP_TGW_TELEAID_1 := %X\n", getValue( HMI_TP_TGW_TELEAID_1 ) );        filePutString( buffer, elcount(buffer), hFile);
    snprintf( buffer, elcount(buffer), "0.0000 TP_TGW_TELEAID_2 := %X\n", getValue( HMI_TP_TGW_TELEAID_2 ) );        filePutString( buffer, elcount(buffer), hFile);
    snprintf( buffer, elcount(buffer), "0.0000 TP_TGW_TELEAID_3 := %X\n", getValue( HMI_TP_TGW_TELEAID_3 ) );        filePutString( buffer, elcount(buffer), hFile);
    snprintf( buffer, elcount(buffer), "0.0000 TP_TGW_TELEAID_4 := %X\n", getValue( HMI_TP_TGW_TELEAID_4 ) );        filePutString( buffer, elcount(buffer), hFile);
    snprintf( buffer, elcount(buffer), "0.0000 TP_TGW_TELEAID_5 := %X\n", getValue( HMI_TP_TGW_TELEAID_5 ) );        filePutString( buffer, elcount(buffer), hFile);
    snprintf( buffer, elcount(buffer), "0.0000 TP_TGW_TELEAID_6 := %X\n", getValue( HMI_TP_TGW_TELEAID_6 ) );        filePutString( buffer, elcount(buffer), hFile);
    snprintf( buffer, elcount(buffer), "0.0000 TP_TGW_TELEAID_7 := %X\n", getValue( HMI_TP_TGW_TELEAID_7 ) );        filePutString( buffer, elcount(buffer), hFile);
}

on timer _tTP_TGW_TELEAID
{
    putValue( HMI__STMSG_TP_TGW_TELEAID, 0 );
}

on EnvVar HMI__STMSG_TP_TGW_TELEAID
{
    long tDelay;
    if( getValue( this ) == 2 )
    {
        tDelay = getValue( HMI__STMSGT_TP_TGW_TELEAID );
        if( tDelay > 0 )    
            setTimer( _tTP_TGW_TELEAID, tDelay );
        else
            putValue( HMI__STMSG_TP_TGW_TELEAID, 0 );
    }
}

on EnvVar HMI_TP_TGW_TELEAID_Send
{
    TP_TGW_TELEAID_getValue();
    _TP_TGW_TELEAID_SpontanFlag = 1;
}

on envVar HMI__STMSG_PO_TP_TGW_TELEAID
{
    if( getValue( this ) )
        openPanel("TP_TGW_TELEAID");
}

TP_TGW_WPT_check_output()
{
    if( !getValue( HMI__STMSG_TP_TGW_WPT ))
    {
        // Botschaft TP_TGW_WPT ID: 649 --- Sendeart 1 spontanX --- 
        if( _TP_TGW_WPT_SpontanFlag)
        {
            TP_TGW_WPT_output(); // Nachricht wg. spontaner Änderung ausgeben
            _TP_TGW_WPT_SpontanFlag = 0; // Spontan-Flag zurücksetzen
        }
    }
}

void TP_TGW_WPT_getValue(void)
{
    _mTP_TGW_WPT.byte( 0 ) = getValue( HMI_TP_TGW_WPT_0 );
    _mTP_TGW_WPT.byte( 1 ) = getValue( HMI_TP_TGW_WPT_1 );
    _mTP_TGW_WPT.byte( 2 ) = getValue( HMI_TP_TGW_WPT_2 );
    _mTP_TGW_WPT.byte( 3 ) = getValue( HMI_TP_TGW_WPT_3 );
    _mTP_TGW_WPT.byte( 4 ) = getValue( HMI_TP_TGW_WPT_4 );
    _mTP_TGW_WPT.byte( 5 ) = getValue( HMI_TP_TGW_WPT_5 );
    _mTP_TGW_WPT.byte( 6 ) = getValue( HMI_TP_TGW_WPT_6 );
    _mTP_TGW_WPT.byte( 7 ) = getValue( HMI_TP_TGW_WPT_7 );
}

TP_TGW_WPT_init()
{   /* Botschaft TP_TGW_WPT ID: 649 --- Sendeart cyclicX --- 
BA_ "ApplMessage" BO_ 649 0;
BA_ "NmAsrMessage" BO_ 649 0;
BA_ "GenMsgMinAcceptLength" BO_ 649 8;
BA_ "GenMsgILSupport" BO_ 649 0;
BA_ "DiagState" BO_ 649 0;
BA_ "DiagRequest" BO_ 649 0;
BA_ "DiagResponse" BO_ 649 0;
BA_ "GenMsgStartValue" BO_ 649 "0";
    */
    _TP_TGW_WPT_Timebase =         c_tDBKomTimer_5ms ;
    _TP_TGW_WPT_SpontanFlag = 0;

    TP_TGW_WPT_getValue();
}

TP_TGW_WPT_output()
{
    output( _mTP_TGW_WPT );
}

TP_TGW_WPT_saveEnvVars( dword hFile )
{
    filePutString("\n// Knoten TGW: TP_TGW_WPT\n", 31, hFile);
    snprintf( buffer, elcount(buffer), "0.0000 HMI__STMSG_TP_TGW_WPT := %X\n", getValue( HMI__STMSG_TP_TGW_WPT ) );        filePutString( buffer, elcount(buffer), hFile);
    snprintf( buffer, elcount(buffer), "0.0000 HMI__STMSGT_TP_TGW_WPT := %X\n", getValue( HMI__STMSGT_TP_TGW_WPT ) );        filePutString( buffer, elcount(buffer), hFile);
    snprintf( buffer, elcount(buffer), "0.0000 TP_TGW_WPT_0 := %X\n", getValue( HMI_TP_TGW_WPT_0 ) );        filePutString( buffer, elcount(buffer), hFile);
    snprintf( buffer, elcount(buffer), "0.0000 TP_TGW_WPT_1 := %X\n", getValue( HMI_TP_TGW_WPT_1 ) );        filePutString( buffer, elcount(buffer), hFile);
    snprintf( buffer, elcount(buffer), "0.0000 TP_TGW_WPT_2 := %X\n", getValue( HMI_TP_TGW_WPT_2 ) );        filePutString( buffer, elcount(buffer), hFile);
    snprintf( buffer, elcount(buffer), "0.0000 TP_TGW_WPT_3 := %X\n", getValue( HMI_TP_TGW_WPT_3 ) );        filePutString( buffer, elcount(buffer), hFile);
    snprintf( buffer, elcount(buffer), "0.0000 TP_TGW_WPT_4 := %X\n", getValue( HMI_TP_TGW_WPT_4 ) );        filePutString( buffer, elcount(buffer), hFile);
    snprintf( buffer, elcount(buffer), "0.0000 TP_TGW_WPT_5 := %X\n", getValue( HMI_TP_TGW_WPT_5 ) );        filePutString( buffer, elcount(buffer), hFile);
    snprintf( buffer, elcount(buffer), "0.0000 TP_TGW_WPT_6 := %X\n", getValue( HMI_TP_TGW_WPT_6 ) );        filePutString( buffer, elcount(buffer), hFile);
    snprintf( buffer, elcount(buffer), "0.0000 TP_TGW_WPT_7 := %X\n", getValue( HMI_TP_TGW_WPT_7 ) );        filePutString( buffer, elcount(buffer), hFile);
}

on timer _tTP_TGW_WPT
{
    putValue( HMI__STMSG_TP_TGW_WPT, 0 );
}

on EnvVar HMI__STMSG_TP_TGW_WPT
{
    long tDelay;
    if( getValue( this ) == 2 )
    {
        tDelay = getValue( HMI__STMSGT_TP_TGW_WPT );
        if( tDelay > 0 )    
            setTimer( _tTP_TGW_WPT, tDelay );
        else
            putValue( HMI__STMSG_TP_TGW_WPT, 0 );
    }
}

on EnvVar HMI_TP_TGW_WPT_Send
{
    TP_TGW_WPT_getValue();
    _TP_TGW_WPT_SpontanFlag = 1;
}

on envVar HMI__STMSG_PO_TP_TGW_WPT
{
    if( getValue( this ) )
        openPanel("TP_TGW_WPT");
}

TrafficInfo_AR_check_output()
{
    if(  !getValue( HMI__STMSG_TrafficInfo_AR ) )
    {
        // Botschaft TrafficInfo_AR ID: 1145 --- Sendeart 0 cyclicX --- 
        _TrafficInfo_AR_Cnt--;
        if(  _TrafficInfo_AR_Cnt < 1 )
        {
            // Nachricht wg. abgelaufenem Zyklus ausgeben
            output( _mTrafficInfo_AR );
            // Zyklus-Zähler zurücksetzen
            _TrafficInfo_AR_Cnt = _TrafficInfo_AR_CycleCount;
        }
    }
}

TrafficInfo_AR_init()
{   /* Botschaft TrafficInfo_AR ID: 1145 --- Sendeart 0 cyclicX --- 
BA_ "ApplMessage" BO_ 1145 0;
BA_ "NmAsrMessage" BO_ 1145 0;
BA_ "GenMsgMinAcceptLength" BO_ 1145 8;
BA_ "GenMsgILSupport" BO_ 1145 1;
BA_ "DiagState" BO_ 1145 0;
BA_ "DiagRequest" BO_ 1145 0;
BA_ "DiagResponse" BO_ 1145 0;
BA_ "GenMsgStartValue" BO_ 1145 "0";
BA_ "GenMsgStartDelayTime" BO_ 1145 295;
BA_ "GenMsgCycleTime" BO_ 1145 1000;
BA_ "GenMsgSendType" BO_ 1145 0;
    */
    _TrafficInfo_AR_Timebase =               c_tDBKomTimer_20ms;
    _TrafficInfo_AR_CycleCount =           1000 / _TrafficInfo_AR_Timebase;
    _TrafficInfo_AR_StartDelay =            295 / _TrafficInfo_AR_Timebase;
    _TrafficInfo_AR_Cnt = _TrafficInfo_AR_StartDelay;

    putValue( HMI__STMSGSD_TrafficInfo_AR, _TrafficInfo_AR_StartDelay * _TrafficInfo_AR_Timebase );

    _mTrafficInfo_AR.TrafficInfo_Distance_Stat1.phys = getValue( HMI_TrafficInfo_Distance_Stat1 );
    _mTrafficInfo_AR.TrafficInfo_Distance_Stat2.phys = getValue( HMI_TrafficInfo_Distance_Stat2 );
    _mTrafficInfo_AR.TrafficInfo_Distance_Stat3.phys = getValue( HMI_TrafficInfo_Distance_Stat3 );
    _mTrafficInfo_AR.TrafficInfo_Distance_Stat4.phys = getValue( HMI_TrafficInfo_Distance_Stat4 );
    _mTrafficInfo_AR.TrafficInfo_Distance_Stat5.phys = getValue( HMI_TrafficInfo_Distance_Stat5 );
    _mTrafficInfo_AR.TrafficInfo_Stat1.phys = getValue( HMI_TrafficInfo_Stat1 );
    _mTrafficInfo_AR.TrafficInfo_Stat2.phys = getValue( HMI_TrafficInfo_Stat2 );
    _mTrafficInfo_AR.TrafficInfo_Stat3.phys = getValue( HMI_TrafficInfo_Stat3 );
    _mTrafficInfo_AR.TrafficInfo_Stat4.phys = getValue( HMI_TrafficInfo_Stat4 );
    _mTrafficInfo_AR.TrafficInfo_Stat5.phys = getValue( HMI_TrafficInfo_Stat5 );
    _mTrafficInfo_AR.TrafficInfo_StatPosCurr.phys = getValue( HMI_TrafficInfo_StatPosCurr );
}

TrafficInfo_AR_saveEnvVars( dword hFile )
{
    filePutString("\n// Knoten TGW: TrafficInfo_AR\n", 31, hFile);
    snprintf( buffer, elcount(buffer), "0.0000 HMI__STMSG_TrafficInfo_AR := %X\n", getValue( HMI__STMSG_TrafficInfo_AR ) );        filePutString( buffer, elcount(buffer), hFile);
    snprintf( buffer, elcount(buffer), "0.0000 HMI__STMSGT_TrafficInfo_AR := %X\n", getValue( HMI__STMSGT_TrafficInfo_AR ) );        filePutString( buffer, elcount(buffer), hFile);
    snprintf( buffer, elcount(buffer), "0.0000 HMI_TrafficInfo_Distance_Stat1 := %X\n", getValue( HMI_TrafficInfo_Distance_Stat1 ) );        filePutString( buffer, elcount(buffer), hFile);
    snprintf( buffer, elcount(buffer), "0.0000 HMI_TrafficInfo_Distance_Stat2 := %X\n", getValue( HMI_TrafficInfo_Distance_Stat2 ) );        filePutString( buffer, elcount(buffer), hFile);
    snprintf( buffer, elcount(buffer), "0.0000 HMI_TrafficInfo_Distance_Stat3 := %X\n", getValue( HMI_TrafficInfo_Distance_Stat3 ) );        filePutString( buffer, elcount(buffer), hFile);
    snprintf( buffer, elcount(buffer), "0.0000 HMI_TrafficInfo_Distance_Stat4 := %X\n", getValue( HMI_TrafficInfo_Distance_Stat4 ) );        filePutString( buffer, elcount(buffer), hFile);
    snprintf( buffer, elcount(buffer), "0.0000 HMI_TrafficInfo_Distance_Stat5 := %X\n", getValue( HMI_TrafficInfo_Distance_Stat5 ) );        filePutString( buffer, elcount(buffer), hFile);
    snprintf( buffer, elcount(buffer), "0.0000 HMI_TrafficInfo_Stat1 := %X\n", getValue( HMI_TrafficInfo_Stat1 ) );        filePutString( buffer, elcount(buffer), hFile);
    snprintf( buffer, elcount(buffer), "0.0000 HMI_TrafficInfo_Stat2 := %X\n", getValue( HMI_TrafficInfo_Stat2 ) );        filePutString( buffer, elcount(buffer), hFile);
    snprintf( buffer, elcount(buffer), "0.0000 HMI_TrafficInfo_Stat3 := %X\n", getValue( HMI_TrafficInfo_Stat3 ) );        filePutString( buffer, elcount(buffer), hFile);
    snprintf( buffer, elcount(buffer), "0.0000 HMI_TrafficInfo_Stat4 := %X\n", getValue( HMI_TrafficInfo_Stat4 ) );        filePutString( buffer, elcount(buffer), hFile);
    snprintf( buffer, elcount(buffer), "0.0000 HMI_TrafficInfo_Stat5 := %X\n", getValue( HMI_TrafficInfo_Stat5 ) );        filePutString( buffer, elcount(buffer), hFile);
    snprintf( buffer, elcount(buffer), "0.0000 HMI_TrafficInfo_StatPosCurr := %X\n", getValue( HMI_TrafficInfo_StatPosCurr ) );        filePutString( buffer, elcount(buffer), hFile);
}

on timer _tTrafficInfo_AR
{
    putValue( HMI__STMSG_TrafficInfo_AR, 0 );
}

on EnvVar HMI__STMSG_TrafficInfo_AR
{
    long tDelay;
    if( getValue( this ) == 2 )
    {
        tDelay = getValue( HMI__STMSGT_TrafficInfo_AR );
        if( tDelay > 0 )    
            setTimer( _tTrafficInfo_AR, tDelay );
        else
            putValue( HMI__STMSG_TrafficInfo_AR, 0 );
    }
}

on envVar HMI__STMSG_PO_TrafficInfo_AR
{
    if( getValue( this ) )
        openPanel("TrafficInfo_AR");
}

on EnvVar HMI_TrafficInfo_Distance_Stat1
{
   _mTrafficInfo_AR.TrafficInfo_Distance_Stat1.phys = getValue(this);
}

on EnvVar HMI_TrafficInfo_Distance_Stat2
{
   _mTrafficInfo_AR.TrafficInfo_Distance_Stat2.phys = getValue(this);
}

on EnvVar HMI_TrafficInfo_Distance_Stat3
{
   _mTrafficInfo_AR.TrafficInfo_Distance_Stat3.phys = getValue(this);
}

on EnvVar HMI_TrafficInfo_Distance_Stat4
{
   _mTrafficInfo_AR.TrafficInfo_Distance_Stat4.phys = getValue(this);
}

on EnvVar HMI_TrafficInfo_Distance_Stat5
{
   _mTrafficInfo_AR.TrafficInfo_Distance_Stat5.phys = getValue(this);
}

on EnvVar HMI_TrafficInfo_Stat1
{
   _mTrafficInfo_AR.TrafficInfo_Stat1.phys = getValue(this);
}

on EnvVar HMI_TrafficInfo_Stat2
{
   _mTrafficInfo_AR.TrafficInfo_Stat2.phys = getValue(this);
}

on EnvVar HMI_TrafficInfo_Stat3
{
   _mTrafficInfo_AR.TrafficInfo_Stat3.phys = getValue(this);
}

on EnvVar HMI_TrafficInfo_Stat4
{
   _mTrafficInfo_AR.TrafficInfo_Stat4.phys = getValue(this);
}

on EnvVar HMI_TrafficInfo_Stat5
{
   _mTrafficInfo_AR.TrafficInfo_Stat5.phys = getValue(this);
}

on EnvVar HMI_TrafficInfo_StatPosCurr
{
   _mTrafficInfo_AR.TrafficInfo_StatPosCurr.phys = getValue(this);
}

	TrafficInfo_AR2_check_output()
{
    if(  !getValue( HMI__STMSG_TrafficInfo_AR2 ) )
    {
        // Botschaft TrafficInfo_AR2 ID: 2395996160 --- Sendeart 0 cyclicX --- 
        _TrafficInfo_AR2_Cnt--;
        if(  _TrafficInfo_AR2_Cnt < 1 )
        {
            // Nachricht wg. abgelaufenem Zyklus ausgeben
            output( _mTrafficInfo_AR2 );
            // Zyklus-Zähler zurücksetzen
            _TrafficInfo_AR2_Cnt = _TrafficInfo_AR2_CycleCount;
        }
    }
}

TrafficInfo_AR2_init()
{   /* Botschaft TrafficInfo_AR2 ID: 2395996160 --- Sendeart 0 cyclicX --- 
BA_ "ApplMessage" BO_ 2395996160 0;
BA_ "NmAsrMessage" BO_ 2395996160 0;
BA_ "GenMsgMinAcceptLength" BO_ 2395996160 8;
BA_ "GenMsgILSupport" BO_ 2395996160 1;
BA_ "DiagState" BO_ 2395996160 0;
BA_ "DiagRequest" BO_ 2395996160 0;
BA_ "DiagResponse" BO_ 2395996160 0;
BA_ "GenMsgStartValue" BO_ 2395996160 "0";
BA_ "GenMsgStartDelayTime" BO_ 2395996160 295;
BA_ "GenMsgCycleTime" BO_ 2395996160 1000;
BA_ "GenMsgSendType" BO_ 2395996160 0;
    */
    _TrafficInfo_AR2_Timebase =               c_tDBKomTimer_20ms;
    _TrafficInfo_AR2_CycleCount =           1000 / _TrafficInfo_AR2_Timebase;
    _TrafficInfo_AR2_StartDelay =            295 / _TrafficInfo_AR2_Timebase;
    _TrafficInfo_AR2_Cnt = _TrafficInfo_AR2_StartDelay;

    putValue( HMI__STMSGSD_TrafficInfo_AR2, _TrafficInfo_AR2_StartDelay * _TrafficInfo_AR2_Timebase );

    _mTrafficInfo_AR2.TrafficInfo_Distance_Stat01_V2.phys = getValue( HMI_TrafficInfo_Distance_Stat01_V2 );
    _mTrafficInfo_AR2.TrafficInfo_Distance_Stat02_V2.phys = getValue( HMI_TrafficInfo_Distance_Stat02_V2 );
    _mTrafficInfo_AR2.TrafficInfo_Distance_Stat03_V2.phys = getValue( HMI_TrafficInfo_Distance_Stat03_V2 );
    _mTrafficInfo_AR2.TrafficInfo_Distance_Stat04_V2.phys = getValue( HMI_TrafficInfo_Distance_Stat04_V2 );
    _mTrafficInfo_AR2.TrafficInfo_Distance_Stat05_V2.phys = getValue( HMI_TrafficInfo_Distance_Stat05_V2 );
    _mTrafficInfo_AR2.TrafficInfo_Distance_Stat06_V2.phys = getValue( HMI_TrafficInfo_Distance_Stat06_V2 );
    _mTrafficInfo_AR2.TrafficInfo_Distance_Stat07_V2.phys = getValue( HMI_TrafficInfo_Distance_Stat07_V2 );
    _mTrafficInfo_AR2.TrafficInfo_Distance_Stat08_V2.phys = getValue( HMI_TrafficInfo_Distance_Stat08_V2 );
    _mTrafficInfo_AR2.TrafficInfo_Distance_Stat09_V2.phys = getValue( HMI_TrafficInfo_Distance_Stat09_V2 );
    _mTrafficInfo_AR2.TrafficInfo_Distance_Stat10_V2.phys = getValue( HMI_TrafficInfo_Distance_Stat10_V2 );
	_mTrafficInfo_AR2.TrafficInfo_Distance_Stat11_V2.phys = getValue( HMI_TrafficInfo_Distance_Stat11_V2 );
    _mTrafficInfo_AR2.TrafficInfo_Distance_Stat12_V2.phys = getValue( HMI_TrafficInfo_Distance_Stat12_V2 );
    _mTrafficInfo_AR2.TrafficInfo_Distance_Stat13_V2.phys = getValue( HMI_TrafficInfo_Distance_Stat13_V2 );
    _mTrafficInfo_AR2.TrafficInfo_Distance_Stat14_V2.phys = getValue( HMI_TrafficInfo_Distance_Stat14_V2 );
    _mTrafficInfo_AR2.TrafficInfo_Distance_Stat15_V2.phys = getValue( HMI_TrafficInfo_Distance_Stat15_V2 );
    _mTrafficInfo_AR2.TrafficInfo_Distance_Stat16_V2.phys = getValue( HMI_TrafficInfo_Distance_Stat16_V2 );
    _mTrafficInfo_AR2.TrafficInfo_Distance_Stat17_V2.phys = getValue( HMI_TrafficInfo_Distance_Stat17_V2 );
    _mTrafficInfo_AR2.TrafficInfo_Distance_Stat18_V2.phys = getValue( HMI_TrafficInfo_Distance_Stat18_V2 );
    _mTrafficInfo_AR2.TrafficInfo_Distance_Stat19_V2.phys = getValue( HMI_TrafficInfo_Distance_Stat19_V2 );
    _mTrafficInfo_AR2.TrafficInfo_Distance_Stat20_V2.phys = getValue( HMI_TrafficInfo_Distance_Stat20_V2 ); _mTrafficInfo_AR2.TrafficInfo_Distance_Stat21_V2.phys = getValue( HMI_TrafficInfo_Distance_Stat21_V2 );
    _mTrafficInfo_AR2.TrafficInfo_Distance_Stat22_V2.phys = getValue( HMI_TrafficInfo_Distance_Stat22_V2 );
    _mTrafficInfo_AR2.TrafficInfo_Distance_Stat23_V2.phys = getValue( HMI_TrafficInfo_Distance_Stat23_V2 );
    _mTrafficInfo_AR2.TrafficInfo_Distance_Stat24_V2.phys = getValue( HMI_TrafficInfo_Distance_Stat24_V2 );
    _mTrafficInfo_AR2.TrafficInfo_Distance_Stat25_V2.phys = getValue( HMI_TrafficInfo_Distance_Stat25_V2 );
    _mTrafficInfo_AR2.TrafficInfo_Distance_Stat26_V2.phys = getValue( HMI_TrafficInfo_Distance_Stat26_V2 );
    _mTrafficInfo_AR2.TrafficInfo_Distance_Stat27_V2.phys = getValue( HMI_TrafficInfo_Distance_Stat27_V2 );
    _mTrafficInfo_AR2.TrafficInfo_Distance_Stat28_V2.phys = getValue( HMI_TrafficInfo_Distance_Stat28_V2 );
    _mTrafficInfo_AR2.TrafficInfo_Distance_Stat29_V2.phys = getValue( HMI_TrafficInfo_Distance_Stat29_V2 );
    _mTrafficInfo_AR2.TrafficInfo_Distance_Stat30_V2.phys = getValue( HMI_TrafficInfo_Distance_Stat30_V2); _mTrafficInfo_AR2.TrafficInfo_Distance_Stat31_V2.phys = getValue( HMI_TrafficInfo_Distance_Stat31_V2 );
    _mTrafficInfo_AR2.TrafficInfo_Distance_Stat32_V2.phys = getValue( HMI_TrafficInfo_Distance_Stat32_V2 );
    _mTrafficInfo_AR2.TrafficInfo_Distance_Stat33_V2.phys = getValue( HMI_TrafficInfo_Distance_Stat33_V2 );
    _mTrafficInfo_AR2.TrafficInfo_Distance_Stat34_V2.phys = getValue( HMI_TrafficInfo_Distance_Stat34_V2 );
    _mTrafficInfo_AR2.TrafficInfo_Distance_Stat35_V2.phys = getValue( HMI_TrafficInfo_Distance_Stat35_V2 );
    _mTrafficInfo_AR2.TrafficInfo_Distance_Stat36_V2.phys = getValue( HMI_TrafficInfo_Distance_Stat36_V2 );
    _mTrafficInfo_AR2.TrafficInfo_Distance_Stat37_V2.phys = getValue( HMI_TrafficInfo_Distance_Stat37_V2 );
    _mTrafficInfo_AR2.TrafficInfo_Distance_Stat38_V2.phys = getValue( HMI_TrafficInfo_Distance_Stat38_V2 );
    _mTrafficInfo_AR2.TrafficInfo_Distance_Stat39_V2.phys = getValue( HMI_TrafficInfo_Distance_Stat39_V2 );
    _mTrafficInfo_AR2.TrafficInfo_Distance_Stat40_V2.phys = getValue( HMI_TrafficInfo_Distance_Stat40_V2 ); _mTrafficInfo_AR2.TrafficInfo_Distance_Stat41_V2.phys = getValue( HMI_TrafficInfo_Distance_Stat41_V2 );
    _mTrafficInfo_AR2.TrafficInfo_Distance_Stat42_V2.phys = getValue( HMI_TrafficInfo_Distance_Stat42_V2 );
    _mTrafficInfo_AR2.TrafficInfo_Distance_Stat43_V2.phys = getValue( HMI_TrafficInfo_Distance_Stat43_V2 );
    _mTrafficInfo_AR2.TrafficInfo_Distance_Stat44_V2.phys = getValue( HMI_TrafficInfo_Distance_Stat44_V2 );
    _mTrafficInfo_AR2.TrafficInfo_Distance_Stat45_V2.phys = getValue( HMI_TrafficInfo_Distance_Stat45_V2 );
    _mTrafficInfo_AR2.TrafficInfo_Distance_Stat46_V2.phys = getValue( HMI_TrafficInfo_Distance_Stat46_V2 );
    _mTrafficInfo_AR2.TrafficInfo_Distance_Stat47_V2.phys = getValue( HMI_TrafficInfo_Distance_Stat47_V2 );
    _mTrafficInfo_AR2.TrafficInfo_Distance_Stat48_V2.phys = getValue( HMI_TrafficInfo_Distance_Stat48_V2 );
    _mTrafficInfo_AR2.TrafficInfo_Distance_Stat49_V2.phys = getValue( HMI_TrafficInfo_Distance_Stat49_V2 );
    _mTrafficInfo_AR2.TrafficInfo_Distance_Stat50_V2.phys = getValue( HMI_TrafficInfo_Distance_Stat50_V2 );
    _mTrafficInfo_AR2.TrafficInfo_MdSel.phys = getValue( HMI_TrafficInfo_MdSel );
    _mTrafficInfo_AR2.TrafficInfo_Stat01_V2.phys = getValue( HMI_TrafficInfo_Stat01_V2  );
    _mTrafficInfo_AR2.TrafficInfo_Stat02_V2.phys = getValue( HMI_TrafficInfo_Stat02_V2  );
    _mTrafficInfo_AR2.TrafficInfo_Stat03_V2.phys = getValue( HMI_TrafficInfo_Stat03_V2  );
    _mTrafficInfo_AR2.TrafficInfo_Stat04_V2.phys = getValue( HMI_TrafficInfo_Stat04_V2  );
    _mTrafficInfo_AR2.TrafficInfo_Stat05_V2.phys = getValue( HMI_TrafficInfo_Stat05_V2  );
    _mTrafficInfo_AR2.TrafficInfo_Stat06_V2.phys = getValue( HMI_TrafficInfo_Stat06_V2  );
    _mTrafficInfo_AR2.TrafficInfo_Stat07_V2.phys = getValue( HMI_TrafficInfo_Stat07_V2  );
    _mTrafficInfo_AR2.TrafficInfo_Stat08_V2.phys = getValue( HMI_TrafficInfo_Stat08_V2  );
    _mTrafficInfo_AR2.TrafficInfo_Stat09_V2.phys = getValue( HMI_TrafficInfo_Stat09_V2  );
    _mTrafficInfo_AR2.TrafficInfo_Stat10_V2.phys = getValue( HMI_TrafficInfo_Stat10_V2  );
	_mTrafficInfo_AR2.TrafficInfo_Stat11_V2.phys = getValue( HMI_TrafficInfo_Stat11_V2  );
    _mTrafficInfo_AR2.TrafficInfo_Stat12_V2.phys = getValue( HMI_TrafficInfo_Stat12_V2  );
    _mTrafficInfo_AR2.TrafficInfo_Stat13_V2.phys = getValue( HMI_TrafficInfo_Stat13_V2  );
    _mTrafficInfo_AR2.TrafficInfo_Stat14_V2.phys = getValue( HMI_TrafficInfo_Stat14_V2  );
    _mTrafficInfo_AR2.TrafficInfo_Stat15_V2.phys = getValue( HMI_TrafficInfo_Stat15_V2  );
    _mTrafficInfo_AR2.TrafficInfo_Stat16_V2.phys = getValue( HMI_TrafficInfo_Stat16_V2  );
    _mTrafficInfo_AR2.TrafficInfo_Stat17_V2.phys = getValue( HMI_TrafficInfo_Stat17_V2  );
    _mTrafficInfo_AR2.TrafficInfo_Stat18_V2.phys = getValue( HMI_TrafficInfo_Stat18_V2  );
    _mTrafficInfo_AR2.TrafficInfo_Stat19_V2.phys = getValue( HMI_TrafficInfo_Stat19_V2  );
    _mTrafficInfo_AR2.TrafficInfo_Stat20_V2.phys = getValue( HMI_TrafficInfo_Stat20_V2  );
	_mTrafficInfo_AR2.TrafficInfo_Stat21_V2.phys = getValue( HMI_TrafficInfo_Stat21_V2  );
    _mTrafficInfo_AR2.TrafficInfo_Stat22_V2.phys = getValue( HMI_TrafficInfo_Stat22_V2  );
    _mTrafficInfo_AR2.TrafficInfo_Stat23_V2.phys = getValue( HMI_TrafficInfo_Stat23_V2  );
    _mTrafficInfo_AR2.TrafficInfo_Stat24_V2.phys = getValue( HMI_TrafficInfo_Stat24_V2  );
    _mTrafficInfo_AR2.TrafficInfo_Stat25_V2.phys = getValue( HMI_TrafficInfo_Stat25_V2  );
    _mTrafficInfo_AR2.TrafficInfo_Stat26_V2.phys = getValue( HMI_TrafficInfo_Stat26_V2  );
    _mTrafficInfo_AR2.TrafficInfo_Stat27_V2.phys = getValue( HMI_TrafficInfo_Stat27_V2  );
    _mTrafficInfo_AR2.TrafficInfo_Stat28_V2.phys = getValue( HMI_TrafficInfo_Stat28_V2  );
    _mTrafficInfo_AR2.TrafficInfo_Stat29_V2.phys = getValue( HMI_TrafficInfo_Stat29_V2  );
    _mTrafficInfo_AR2.TrafficInfo_Stat30_V2.phys = getValue( HMI_TrafficInfo_Stat30_V2  );
	_mTrafficInfo_AR2.TrafficInfo_Stat31_V2.phys = getValue( HMI_TrafficInfo_Stat31_V2  );
    _mTrafficInfo_AR2.TrafficInfo_Stat32_V2.phys = getValue( HMI_TrafficInfo_Stat32_V2  );
    _mTrafficInfo_AR2.TrafficInfo_Stat33_V2.phys = getValue( HMI_TrafficInfo_Stat33_V2  );
    _mTrafficInfo_AR2.TrafficInfo_Stat34_V2.phys = getValue( HMI_TrafficInfo_Stat34_V2  );
    _mTrafficInfo_AR2.TrafficInfo_Stat35_V2.phys = getValue( HMI_TrafficInfo_Stat35_V2  );
    _mTrafficInfo_AR2.TrafficInfo_Stat36_V2.phys = getValue( HMI_TrafficInfo_Stat36_V2  );
    _mTrafficInfo_AR2.TrafficInfo_Stat37_V2.phys = getValue( HMI_TrafficInfo_Stat37_V2  );
    _mTrafficInfo_AR2.TrafficInfo_Stat38_V2.phys = getValue( HMI_TrafficInfo_Stat38_V2  );
    _mTrafficInfo_AR2.TrafficInfo_Stat39_V2.phys = getValue( HMI_TrafficInfo_Stat39_V2  );
    _mTrafficInfo_AR2.TrafficInfo_Stat40_V2.phys = getValue( HMI_TrafficInfo_Stat40_V2  );
	_mTrafficInfo_AR2.TrafficInfo_Stat41_V2.phys = getValue( HMI_TrafficInfo_Stat41_V2  );
    _mTrafficInfo_AR2.TrafficInfo_Stat42_V2.phys = getValue( HMI_TrafficInfo_Stat42_V2  );
    _mTrafficInfo_AR2.TrafficInfo_Stat43_V2.phys = getValue( HMI_TrafficInfo_Stat43_V2  );
    _mTrafficInfo_AR2.TrafficInfo_Stat44_V2.phys = getValue( HMI_TrafficInfo_Stat44_V2  );
    _mTrafficInfo_AR2.TrafficInfo_Stat45_V2.phys = getValue( HMI_TrafficInfo_Stat45_V2  );
    _mTrafficInfo_AR2.TrafficInfo_Stat46_V2.phys = getValue( HMI_TrafficInfo_Stat46_V2  );
    _mTrafficInfo_AR2.TrafficInfo_Stat47_V2.phys = getValue( HMI_TrafficInfo_Stat47_V2  );
    _mTrafficInfo_AR2.TrafficInfo_Stat48_V2.phys = getValue( HMI_TrafficInfo_Stat48_V2  );
    _mTrafficInfo_AR2.TrafficInfo_Stat49_V2.phys = getValue( HMI_TrafficInfo_Stat49_V2  );
    _mTrafficInfo_AR2.TrafficInfo_Stat50_V2.phys = getValue( HMI_TrafficInfo_Stat50_V2  );
    _mTrafficInfo_AR2.TrafficInfo_StatPosCurr_V2.phys = getValue( HMI_TrafficInfo_StatPosCurr_V2 );
	
}

TrafficInfo_AR2_saveEnvVars( dword hFile )
{
    filePutString("\n// Knoten TGW: TrafficInfo_AR2\n", 31, hFile);
    snprintf( buffer, elcount(buffer), "0.0000 HMI__STMSG_TrafficInfo_AR2 := %X\n", getValue( HMI__STMSG_TrafficInfo_AR2 ) );        filePutString( buffer, elcount(buffer), hFile);
    snprintf( buffer, elcount(buffer), "0.0000 HMI__STMSGT_TrafficInfo_AR2 := %X\n", getValue( HMI__STMSGT_TrafficInfo_AR2 ) );        filePutString( buffer, elcount(buffer), hFile);
    snprintf( buffer, elcount(buffer), "0.0000 HMI_TrafficInfo_Distance_Stat01_V2 := %X\n", getValue( HMI_TrafficInfo_Distance_Stat01_V2 ) );        filePutString( buffer, elcount(buffer), hFile);
    snprintf( buffer, elcount(buffer), "0.0000 HMI_TrafficInfo_Distance_Stat02_V2 := %X\n", getValue( HMI_TrafficInfo_Distance_Stat02_V2 ) );        filePutString( buffer, elcount(buffer), hFile);
    snprintf( buffer, elcount(buffer), "0.0000 HMI_TrafficInfo_Distance_Stat03_V2 := %X\n", getValue( HMI_TrafficInfo_Distance_Stat03_V2 ) );        filePutString( buffer, elcount(buffer), hFile);
    snprintf( buffer, elcount(buffer), "0.0000 HMI_TrafficInfo_Distance_Stat04_V2 := %X\n", getValue( HMI_TrafficInfo_Distance_Stat04_V2 ) );        filePutString( buffer, elcount(buffer), hFile);
    snprintf( buffer, elcount(buffer), "0.0000 HMI_TrafficInfo_Distance_Stat05_V2 := %X\n", getValue( HMI_TrafficInfo_Distance_Stat05_V2 ) );        filePutString( buffer, elcount(buffer), hFile);
    snprintf( buffer, elcount(buffer), "0.0000 HMI_TrafficInfo_Distance_Stat06_V2 := %X\n", getValue( HMI_TrafficInfo_Distance_Stat06_V2 ) );        filePutString( buffer, elcount(buffer), hFile);
    snprintf( buffer, elcount(buffer), "0.0000 HMI_TrafficInfo_Distance_Stat07_V2 := %X\n", getValue( HMI_TrafficInfo_Distance_Stat07_V2 ) );        filePutString( buffer, elcount(buffer), hFile);
    snprintf( buffer, elcount(buffer), "0.0000 HMI_TrafficInfo_Distance_Stat08_V2 := %X\n", getValue( HMI_TrafficInfo_Distance_Stat08_V2 ) );        filePutString( buffer, elcount(buffer), hFile);
    snprintf( buffer, elcount(buffer), "0.0000 HMI_TrafficInfo_Distance_Stat09_V2 := %X\n", getValue( HMI_TrafficInfo_Distance_Stat09_V2 ) );        filePutString( buffer, elcount(buffer), hFile);
    snprintf( buffer, elcount(buffer), "0.0000 HMI_TrafficInfo_Distance_Stat10_V2 := %X\n", getValue( HMI_TrafficInfo_Distance_Stat10_V2 ) );        filePutString( buffer, elcount(buffer), hFile);
    snprintf( buffer, elcount(buffer), "0.0000 HMI_TrafficInfo_Distance_Stat11_V2 := %X\n", getValue( HMI_TrafficInfo_Distance_Stat11_V2 ) );        filePutString( buffer, elcount(buffer), hFile);
    snprintf( buffer, elcount(buffer), "0.0000 HMI_TrafficInfo_Distance_Stat12_V2 := %X\n", getValue( HMI_TrafficInfo_Distance_Stat12_V2 ) );        filePutString( buffer, elcount(buffer), hFile);
    snprintf( buffer, elcount(buffer), "0.0000 HMI_TrafficInfo_Distance_Stat13_V2 := %X\n", getValue( HMI_TrafficInfo_Distance_Stat13_V2 ) );        filePutString( buffer, elcount(buffer), hFile);
    snprintf( buffer, elcount(buffer), "0.0000 HMI_TrafficInfo_Distance_Stat14_V2 := %X\n", getValue( HMI_TrafficInfo_Distance_Stat14_V2 ) );        filePutString( buffer, elcount(buffer), hFile);
    snprintf( buffer, elcount(buffer), "0.0000 HMI_TrafficInfo_Distance_Stat15_V2 := %X\n", getValue( HMI_TrafficInfo_Distance_Stat15_V2 ) );        filePutString( buffer, elcount(buffer), hFile);
    snprintf( buffer, elcount(buffer), "0.0000 HMI_TrafficInfo_Distance_Stat16_V2 := %X\n", getValue( HMI_TrafficInfo_Distance_Stat16_V2 ) );        filePutString( buffer, elcount(buffer), hFile);
    snprintf( buffer, elcount(buffer), "0.0000 HMI_TrafficInfo_Distance_Stat17_V2 := %X\n", getValue( HMI_TrafficInfo_Distance_Stat17_V2 ) );        filePutString( buffer, elcount(buffer), hFile);
    snprintf( buffer, elcount(buffer), "0.0000 HMI_TrafficInfo_Distance_Stat18_V2 := %X\n", getValue( HMI_TrafficInfo_Distance_Stat18_V2 ) );        filePutString( buffer, elcount(buffer), hFile);
    snprintf( buffer, elcount(buffer), "0.0000 HMI_TrafficInfo_Distance_Stat19_V2 := %X\n", getValue( HMI_TrafficInfo_Distance_Stat19_V2 ) );        filePutString( buffer, elcount(buffer), hFile);
    snprintf( buffer, elcount(buffer), "0.0000 HMI_TrafficInfo_Distance_Stat20_V2 := %X\n", getValue( HMI_TrafficInfo_Distance_Stat20_V2 ) );        filePutString( buffer, elcount(buffer), hFile);
    snprintf( buffer, elcount(buffer), "0.0000 HMI_TrafficInfo_Distance_Stat21_V2 := %X\n", getValue( HMI_TrafficInfo_Distance_Stat21_V2 ) );        filePutString( buffer, elcount(buffer), hFile);
    snprintf( buffer, elcount(buffer), "0.0000 HMI_TrafficInfo_Distance_Stat22_V2 := %X\n", getValue( HMI_TrafficInfo_Distance_Stat22_V2 ) );        filePutString( buffer, elcount(buffer), hFile);
    snprintf( buffer, elcount(buffer), "0.0000 HMI_TrafficInfo_Distance_Stat23_V2 := %X\n", getValue( HMI_TrafficInfo_Distance_Stat23_V2 ) );        filePutString( buffer, elcount(buffer), hFile);
    snprintf( buffer, elcount(buffer), "0.0000 HMI_TrafficInfo_Distance_Stat24_V2 := %X\n", getValue( HMI_TrafficInfo_Distance_Stat24_V2 ) );        filePutString( buffer, elcount(buffer), hFile);
    snprintf( buffer, elcount(buffer), "0.0000 HMI_TrafficInfo_Distance_Stat25_V2 := %X\n", getValue( HMI_TrafficInfo_Distance_Stat25_V2 ) );        filePutString( buffer, elcount(buffer), hFile);
    snprintf( buffer, elcount(buffer), "0.0000 HMI_TrafficInfo_Distance_Stat26_V2 := %X\n", getValue( HMI_TrafficInfo_Distance_Stat26_V2 ) );        filePutString( buffer, elcount(buffer), hFile);
    snprintf( buffer, elcount(buffer), "0.0000 HMI_TrafficInfo_Distance_Stat27_V2 := %X\n", getValue( HMI_TrafficInfo_Distance_Stat27_V2 ) );        filePutString( buffer, elcount(buffer), hFile);
    snprintf( buffer, elcount(buffer), "0.0000 HMI_TrafficInfo_Distance_Stat28_V2 := %X\n", getValue( HMI_TrafficInfo_Distance_Stat28_V2 ) );        filePutString( buffer, elcount(buffer), hFile);
    snprintf( buffer, elcount(buffer), "0.0000 HMI_TrafficInfo_Distance_Stat29_V2 := %X\n", getValue( HMI_TrafficInfo_Distance_Stat29_V2 ) );        filePutString( buffer, elcount(buffer), hFile);
    snprintf( buffer, elcount(buffer), "0.0000 HMI_TrafficInfo_Distance_Stat30_V2 := %X\n", getValue( HMI_TrafficInfo_Distance_Stat30_V2 ) );        filePutString( buffer, elcount(buffer), hFile);
    snprintf( buffer, elcount(buffer), "0.0000 HMI_TrafficInfo_Distance_Stat31_V2 := %X\n", getValue( HMI_TrafficInfo_Distance_Stat31_V2 ) );        filePutString( buffer, elcount(buffer), hFile);
    snprintf( buffer, elcount(buffer), "0.0000 HMI_TrafficInfo_Distance_Stat32_V2 := %X\n", getValue( HMI_TrafficInfo_Distance_Stat32_V2 ) );        filePutString( buffer, elcount(buffer), hFile);
    snprintf( buffer, elcount(buffer), "0.0000 HMI_TrafficInfo_Distance_Stat33_V2 := %X\n", getValue( HMI_TrafficInfo_Distance_Stat33_V2 ) );        filePutString( buffer, elcount(buffer), hFile);
    snprintf( buffer, elcount(buffer), "0.0000 HMI_TrafficInfo_Distance_Stat34_V2 := %X\n", getValue( HMI_TrafficInfo_Distance_Stat34_V2 ) );        filePutString( buffer, elcount(buffer), hFile);
    snprintf( buffer, elcount(buffer), "0.0000 HMI_TrafficInfo_Distance_Stat35_V2 := %X\n", getValue( HMI_TrafficInfo_Distance_Stat35_V2 ) );        filePutString( buffer, elcount(buffer), hFile);
    snprintf( buffer, elcount(buffer), "0.0000 HMI_TrafficInfo_Distance_Stat36_V2 := %X\n", getValue( HMI_TrafficInfo_Distance_Stat36_V2 ) );        filePutString( buffer, elcount(buffer), hFile);
    snprintf( buffer, elcount(buffer), "0.0000 HMI_TrafficInfo_Distance_Stat37_V2 := %X\n", getValue( HMI_TrafficInfo_Distance_Stat37_V2 ) );        filePutString( buffer, elcount(buffer), hFile);
    snprintf( buffer, elcount(buffer), "0.0000 HMI_TrafficInfo_Distance_Stat38_V2 := %X\n", getValue( HMI_TrafficInfo_Distance_Stat38_V2 ) );        filePutString( buffer, elcount(buffer), hFile);
    snprintf( buffer, elcount(buffer), "0.0000 HMI_TrafficInfo_Distance_Stat39_V2 := %X\n", getValue( HMI_TrafficInfo_Distance_Stat39_V2 ) );        filePutString( buffer, elcount(buffer), hFile);
    snprintf( buffer, elcount(buffer), "0.0000 HMI_TrafficInfo_Distance_Stat40_V2 := %X\n", getValue( HMI_TrafficInfo_Distance_Stat40_V2 ) );        filePutString( buffer, elcount(buffer), hFile);
    snprintf( buffer, elcount(buffer), "0.0000 HMI_TrafficInfo_Distance_Stat41_V2 := %X\n", getValue( HMI_TrafficInfo_Distance_Stat41_V2 ) );        filePutString( buffer, elcount(buffer), hFile);
    snprintf( buffer, elcount(buffer), "0.0000 HMI_TrafficInfo_Distance_Stat42_V2 := %X\n", getValue( HMI_TrafficInfo_Distance_Stat42_V2 ) );        filePutString( buffer, elcount(buffer), hFile);
    snprintf( buffer, elcount(buffer), "0.0000 HMI_TrafficInfo_Distance_Stat43_V2 := %X\n", getValue( HMI_TrafficInfo_Distance_Stat43_V2 ) );        filePutString( buffer, elcount(buffer), hFile);
    snprintf( buffer, elcount(buffer), "0.0000 HMI_TrafficInfo_Distance_Stat44_V2 := %X\n", getValue( HMI_TrafficInfo_Distance_Stat44_V2 ) );        filePutString( buffer, elcount(buffer), hFile);
    snprintf( buffer, elcount(buffer), "0.0000 HMI_TrafficInfo_Distance_Stat45_V2 := %X\n", getValue( HMI_TrafficInfo_Distance_Stat45_V2 ) );        filePutString( buffer, elcount(buffer), hFile);
    snprintf( buffer, elcount(buffer), "0.0000 HMI_TrafficInfo_Distance_Stat46_V2 := %X\n", getValue( HMI_TrafficInfo_Distance_Stat46_V2 ) );        filePutString( buffer, elcount(buffer), hFile);
    snprintf( buffer, elcount(buffer), "0.0000 HMI_TrafficInfo_Distance_Stat47_V2 := %X\n", getValue( HMI_TrafficInfo_Distance_Stat47_V2 ) );        filePutString( buffer, elcount(buffer), hFile);
    snprintf( buffer, elcount(buffer), "0.0000 HMI_TrafficInfo_Distance_Stat48_V2 := %X\n", getValue( HMI_TrafficInfo_Distance_Stat48_V2 ) );        filePutString( buffer, elcount(buffer), hFile);
    snprintf( buffer, elcount(buffer), "0.0000 HMI_TrafficInfo_Distance_Stat49_V2 := %X\n", getValue( HMI_TrafficInfo_Distance_Stat49_V2 ) );        filePutString( buffer, elcount(buffer), hFile);
    snprintf( buffer, elcount(buffer), "0.0000 HMI_TrafficInfo_Distance_Stat50_V2 := %X\n", getValue( HMI_TrafficInfo_Distance_Stat50_V2 ) );        filePutString( buffer, elcount(buffer), hFile);
    snprintf( buffer, elcount(buffer), "0.0000 HMI_TrafficInfo_MdSel := %X\n", getValue( HMI_TrafficInfo_MdSel ) );        
	filePutString( buffer, elcount(buffer), hFile);
	snprintf( buffer, elcount(buffer), "0.0000 HMI_TrafficInfo_Stat01_V2 := %X\n", getValue( HMI_TrafficInfo_Stat01_V2 ) );        
	filePutString( buffer, elcount(buffer), hFile);
    snprintf( buffer, elcount(buffer), "0.0000 HMI_TrafficInfo_Stat02_V2 := %X\n", getValue( HMI_TrafficInfo_Stat02_V2 ) );        
	filePutString( buffer, elcount(buffer), hFile);
    snprintf( buffer, elcount(buffer), "0.0000 HMI_TrafficInfo_Stat03_V2 := %X\n", getValue( HMI_TrafficInfo_Stat03_V2 ) );        
	filePutString( buffer, elcount(buffer), hFile);
    snprintf( buffer, elcount(buffer), "0.0000 HMI_TrafficInfo_Stat04_V2 := %X\n", getValue( HMI_TrafficInfo_Stat04_V2 ) );        
	filePutString( buffer, elcount(buffer), hFile);
    snprintf( buffer, elcount(buffer), "0.0000 HMI_TrafficInfo_Stat05_V2 := %X\n", getValue( HMI_TrafficInfo_Stat05_V2 ) );        
	filePutString( buffer, elcount(buffer), hFile);
    snprintf( buffer, elcount(buffer), "0.0000 HMI_TrafficInfo_Stat06_V2 := %X\n", getValue( HMI_TrafficInfo_Stat06_V2 ) );        
	filePutString( buffer, elcount(buffer), hFile);
    snprintf( buffer, elcount(buffer), "0.0000 HMI_TrafficInfo_Stat07_V2 := %X\n", getValue( HMI_TrafficInfo_Stat07_V2 ) );        
	filePutString( buffer, elcount(buffer), hFile);
    snprintf( buffer, elcount(buffer), "0.0000 HMI_TrafficInfo_Stat08_V2 := %X\n", getValue( HMI_TrafficInfo_Stat08_V2 ) );        
	filePutString( buffer, elcount(buffer), hFile);
    snprintf( buffer, elcount(buffer), "0.0000 HMI_TrafficInfo_Stat09_V2 := %X\n", getValue( HMI_TrafficInfo_Stat09_V2 ) );        
	filePutString( buffer, elcount(buffer), hFile);
    snprintf( buffer, elcount(buffer), "0.0000 HMI_TrafficInfo_Stat10_V2 := %X\n", getValue( HMI_TrafficInfo_Stat10_V2 ) );        
	filePutString( buffer, elcount(buffer), hFile);
    snprintf( buffer, elcount(buffer), "0.0000 HMI_TrafficInfo_Stat11_V2 := %X\n", getValue( HMI_TrafficInfo_Stat11_V2 ) );        
	filePutString( buffer, elcount(buffer), hFile);
    snprintf( buffer, elcount(buffer), "0.0000 HMI_TrafficInfo_Stat12_V2 := %X\n", getValue( HMI_TrafficInfo_Stat12_V2 ) );        
	filePutString( buffer, elcount(buffer), hFile);
    snprintf( buffer, elcount(buffer), "0.0000 HMI_TrafficInfo_Stat13_V2 := %X\n", getValue( HMI_TrafficInfo_Stat13_V2 ) );        
	filePutString( buffer, elcount(buffer), hFile);
    snprintf( buffer, elcount(buffer), "0.0000 HMI_TrafficInfo_Stat14_V2 := %X\n", getValue( HMI_TrafficInfo_Stat14_V2 ) );        
	filePutString( buffer, elcount(buffer), hFile);
    snprintf( buffer, elcount(buffer), "0.0000 HMI_TrafficInfo_Stat15_V2 := %X\n", getValue( HMI_TrafficInfo_Stat15_V2 ) );        
	filePutString( buffer, elcount(buffer), hFile);
    snprintf( buffer, elcount(buffer), "0.0000 HMI_TrafficInfo_Stat16_V2 := %X\n", getValue( HMI_TrafficInfo_Stat16_V2 ) );        
	filePutString( buffer, elcount(buffer), hFile);
    snprintf( buffer, elcount(buffer), "0.0000 HMI_TrafficInfo_Stat17_V2 := %X\n", getValue( HMI_TrafficInfo_Stat17_V2 ) );        
	filePutString( buffer, elcount(buffer), hFile);
    snprintf( buffer, elcount(buffer), "0.0000 HMI_TrafficInfo_Stat18_V2 := %X\n", getValue( HMI_TrafficInfo_Stat18_V2 ) );        
	filePutString( buffer, elcount(buffer), hFile);
    snprintf( buffer, elcount(buffer), "0.0000 HMI_TrafficInfo_Stat19_V2 := %X\n", getValue( HMI_TrafficInfo_Stat19_V2 ) );        
	filePutString( buffer, elcount(buffer), hFile);
    snprintf( buffer, elcount(buffer), "0.0000 HMI_TrafficInfo_Stat20_V2 := %X\n", getValue( HMI_TrafficInfo_Stat20_V2 ) );        
	filePutString( buffer, elcount(buffer), hFile);
    snprintf( buffer, elcount(buffer), "0.0000 HMI_TrafficInfo_Stat21_V2 := %X\n", getValue( HMI_TrafficInfo_Stat21_V2 ) );        
	filePutString( buffer, elcount(buffer), hFile);
    snprintf( buffer, elcount(buffer), "0.0000 HMI_TrafficInfo_Stat22_V2 := %X\n", getValue( HMI_TrafficInfo_Stat22_V2 ) );        
	filePutString( buffer, elcount(buffer), hFile);
    snprintf( buffer, elcount(buffer), "0.0000 HMI_TrafficInfo_Stat23_V2 := %X\n", getValue( HMI_TrafficInfo_Stat23_V2 ) );        
	filePutString( buffer, elcount(buffer), hFile);
    snprintf( buffer, elcount(buffer), "0.0000 HMI_TrafficInfo_Stat24_V2 := %X\n", getValue( HMI_TrafficInfo_Stat24_V2 ) );        
	filePutString( buffer, elcount(buffer), hFile);
    snprintf( buffer, elcount(buffer), "0.0000 HMI_TrafficInfo_Stat25_V2 := %X\n", getValue( HMI_TrafficInfo_Stat25_V2 ) );        
	filePutString( buffer, elcount(buffer), hFile);
    snprintf( buffer, elcount(buffer), "0.0000 HMI_TrafficInfo_Stat26_V2 := %X\n", getValue( HMI_TrafficInfo_Stat26_V2 ) );        
	filePutString( buffer, elcount(buffer), hFile);
    snprintf( buffer, elcount(buffer), "0.0000 HMI_TrafficInfo_Stat27_V2 := %X\n", getValue( HMI_TrafficInfo_Stat27_V2 ) );        
	filePutString( buffer, elcount(buffer), hFile);
    snprintf( buffer, elcount(buffer), "0.0000 HMI_TrafficInfo_Stat28_V2 := %X\n", getValue( HMI_TrafficInfo_Stat28_V2 ) );        
	filePutString( buffer, elcount(buffer), hFile);
    snprintf( buffer, elcount(buffer), "0.0000 HMI_TrafficInfo_Stat29_V2 := %X\n", getValue( HMI_TrafficInfo_Stat29_V2 ) );        
	filePutString( buffer, elcount(buffer), hFile);
    snprintf( buffer, elcount(buffer), "0.0000 HMI_TrafficInfo_Stat30_V2 := %X\n", getValue( HMI_TrafficInfo_Stat30_V2 ) );        
	filePutString( buffer, elcount(buffer), hFile);
    snprintf( buffer, elcount(buffer), "0.0000 HMI_TrafficInfo_Stat31_V2 := %X\n", getValue( HMI_TrafficInfo_Stat31_V2 ) );        
	filePutString( buffer, elcount(buffer), hFile);
    snprintf( buffer, elcount(buffer), "0.0000 HMI_TrafficInfo_Stat32_V2 := %X\n", getValue( HMI_TrafficInfo_Stat32_V2 ) );        
	filePutString( buffer, elcount(buffer), hFile);
    snprintf( buffer, elcount(buffer), "0.0000 HMI_TrafficInfo_Stat33_V2 := %X\n", getValue( HMI_TrafficInfo_Stat33_V2 ) );        
	filePutString( buffer, elcount(buffer), hFile);
    snprintf( buffer, elcount(buffer), "0.0000 HMI_TrafficInfo_Stat34_V2 := %X\n", getValue( HMI_TrafficInfo_Stat34_V2 ) );        
	filePutString( buffer, elcount(buffer), hFile);
    snprintf( buffer, elcount(buffer), "0.0000 HMI_TrafficInfo_Stat35_V2 := %X\n", getValue( HMI_TrafficInfo_Stat35_V2 ) );        
	filePutString( buffer, elcount(buffer), hFile);
    snprintf( buffer, elcount(buffer), "0.0000 HMI_TrafficInfo_Stat36_V2 := %X\n", getValue( HMI_TrafficInfo_Stat36_V2 ) );        
	filePutString( buffer, elcount(buffer), hFile);
    snprintf( buffer, elcount(buffer), "0.0000 HMI_TrafficInfo_Stat37_V2 := %X\n", getValue( HMI_TrafficInfo_Stat37_V2 ) );        
	filePutString( buffer, elcount(buffer), hFile);
    snprintf( buffer, elcount(buffer), "0.0000 HMI_TrafficInfo_Stat38_V2 := %X\n", getValue( HMI_TrafficInfo_Stat38_V2 ) );        
	filePutString( buffer, elcount(buffer), hFile);
    snprintf( buffer, elcount(buffer), "0.0000 HMI_TrafficInfo_Stat39_V2 := %X\n", getValue( HMI_TrafficInfo_Stat39_V2 ) );        
	filePutString( buffer, elcount(buffer), hFile);
    snprintf( buffer, elcount(buffer), "0.0000 HMI_TrafficInfo_Stat40_V2 := %X\n", getValue( HMI_TrafficInfo_Stat40_V2 ) );        
	filePutString( buffer, elcount(buffer), hFile);
    snprintf( buffer, elcount(buffer), "0.0000 HMI_TrafficInfo_Stat41_V2 := %X\n", getValue( HMI_TrafficInfo_Stat41_V2 ) );        
	filePutString( buffer, elcount(buffer), hFile);
    snprintf( buffer, elcount(buffer), "0.0000 HMI_TrafficInfo_Stat42_V2 := %X\n", getValue( HMI_TrafficInfo_Stat42_V2 ) );        
	filePutString( buffer, elcount(buffer), hFile);
    snprintf( buffer, elcount(buffer), "0.0000 HMI_TrafficInfo_Stat43_V2 := %X\n", getValue( HMI_TrafficInfo_Stat43_V2 ) );        
	filePutString( buffer, elcount(buffer), hFile);
    snprintf( buffer, elcount(buffer), "0.0000 HMI_TrafficInfo_Stat44_V2 := %X\n", getValue( HMI_TrafficInfo_Stat44_V2 ) );        
	filePutString( buffer, elcount(buffer), hFile);
    snprintf( buffer, elcount(buffer), "0.0000 HMI_TrafficInfo_Stat45_V2 := %X\n", getValue( HMI_TrafficInfo_Stat45_V2 ) );        
	filePutString( buffer, elcount(buffer), hFile);
    snprintf( buffer, elcount(buffer), "0.0000 HMI_TrafficInfo_Stat46_V2 := %X\n", getValue( HMI_TrafficInfo_Stat46_V2 ) );        
	filePutString( buffer, elcount(buffer), hFile);
    snprintf( buffer, elcount(buffer), "0.0000 HMI_TrafficInfo_Stat47_V2 := %X\n", getValue( HMI_TrafficInfo_Stat47_V2 ) );        
	filePutString( buffer, elcount(buffer), hFile);
    snprintf( buffer, elcount(buffer), "0.0000 HMI_TrafficInfo_Stat48_V2 := %X\n", getValue( HMI_TrafficInfo_Stat48_V2 ) );        
	filePutString( buffer, elcount(buffer), hFile);
    snprintf( buffer, elcount(buffer), "0.0000 HMI_TrafficInfo_Stat49_V2 := %X\n", getValue( HMI_TrafficInfo_Stat49_V2 ) );        
	filePutString( buffer, elcount(buffer), hFile);
    snprintf( buffer, elcount(buffer), "0.0000 HMI_TrafficInfo_Stat50_V2 := %X\n", getValue( HMI_TrafficInfo_Stat50_V2 ) );        
	filePutString( buffer, elcount(buffer), hFile);
    snprintf( buffer, elcount(buffer), "0.0000 HMI_TrafficInfo_StatPosCurr_V2 := %X\n", getValue( HMI_TrafficInfo_StatPosCurr_V2 ) );        
	filePutString( buffer, elcount(buffer), hFile);
    
}

on timer _tTrafficInfo_AR2
{
    putValue( HMI__STMSG_TrafficInfo_AR2, 0 );
}

on EnvVar HMI__STMSG_TrafficInfo_AR2
{
    long tDelay;
    if( getValue( this ) == 2 )
    {
        tDelay = getValue( HMI__STMSGT_TrafficInfo_AR2 );
        if( tDelay > 0 )    
            setTimer( _tTrafficInfo_AR2, tDelay );
        else
            putValue( HMI__STMSG_TrafficInfo_AR2, 0 );
    }
}

on envVar HMI__STMSG_PO_TrafficInfo_AR2
{
    if( getValue( this ) )
        openPanel("TrafficInfo_AR2");
}

on EnvVar HMI_TrafficInfo_Distance_Stat01_V2
{
   _mTrafficInfo_AR2.TrafficInfo_Distance_Stat01_V2.phys = getValue(this);
}

on EnvVar HMI_TrafficInfo_Distance_Stat02_V2
{
   _mTrafficInfo_AR2.TrafficInfo_Distance_Stat02_V2.phys = getValue(this);
}

on EnvVar HMI_TrafficInfo_Distance_Stat03_V2
{
   _mTrafficInfo_AR2.TrafficInfo_Distance_Stat03_V2.phys = getValue(this);
}

on EnvVar HMI_TrafficInfo_Distance_Stat04_V2
{
   _mTrafficInfo_AR2.TrafficInfo_Distance_Stat04_V2.phys = getValue(this);
}

on EnvVar HMI_TrafficInfo_Distance_Stat05_V2
{
   _mTrafficInfo_AR2.TrafficInfo_Distance_Stat05_V2.phys = getValue(this);
}

on EnvVar HMI_TrafficInfo_Distance_Stat06_V2
{
   _mTrafficInfo_AR2.TrafficInfo_Distance_Stat06_V2.phys = getValue(this);
}

on EnvVar HMI_TrafficInfo_Distance_Stat07_V2
{
   _mTrafficInfo_AR2.TrafficInfo_Distance_Stat07_V2.phys = getValue(this);
}

on EnvVar HMI_TrafficInfo_Distance_Stat08_V2
{
   _mTrafficInfo_AR2.TrafficInfo_Distance_Stat08_V2.phys = getValue(this);
}

on EnvVar HMI_TrafficInfo_Distance_Stat09_V2
{
   _mTrafficInfo_AR2.TrafficInfo_Distance_Stat09_V2.phys = getValue(this);
}

on EnvVar HMI_TrafficInfo_Distance_Stat10_V2
{
   _mTrafficInfo_AR2.TrafficInfo_Distance_Stat10_V2.phys = getValue(this);
}

on EnvVar HMI_TrafficInfo_Distance_Stat11_V2
{
   _mTrafficInfo_AR2.TrafficInfo_Distance_Stat11_V2.phys = getValue(this);
}

on EnvVar HMI_TrafficInfo_Distance_Stat12_V2
{
   _mTrafficInfo_AR2.TrafficInfo_Distance_Stat12_V2.phys = getValue(this);
}

on EnvVar HMI_TrafficInfo_Distance_Stat13_V2
{
   _mTrafficInfo_AR2.TrafficInfo_Distance_Stat13_V2.phys = getValue(this);
}

on EnvVar HMI_TrafficInfo_Distance_Stat14_V2
{
   _mTrafficInfo_AR2.TrafficInfo_Distance_Stat14_V2.phys = getValue(this);
}

on EnvVar HMI_TrafficInfo_Distance_Stat15_V2
{
   _mTrafficInfo_AR2.TrafficInfo_Distance_Stat15_V2.phys = getValue(this);
}

on EnvVar HMI_TrafficInfo_Distance_Stat16_V2
{
   _mTrafficInfo_AR2.TrafficInfo_Distance_Stat16_V2.phys = getValue(this);
}

on EnvVar HMI_TrafficInfo_Distance_Stat17_V2
{
   _mTrafficInfo_AR2.TrafficInfo_Distance_Stat17_V2.phys = getValue(this);
}

on EnvVar HMI_TrafficInfo_Distance_Stat18_V2
{
   _mTrafficInfo_AR2.TrafficInfo_Distance_Stat18_V2.phys = getValue(this);
}

on EnvVar HMI_TrafficInfo_Distance_Stat19_V2
{
   _mTrafficInfo_AR2.TrafficInfo_Distance_Stat19_V2.phys = getValue(this);
}

on EnvVar HMI_TrafficInfo_Distance_Stat20_V2
{
   _mTrafficInfo_AR2.TrafficInfo_Distance_Stat20_V2.phys = getValue(this);
}

on EnvVar HMI_TrafficInfo_Distance_Stat21_V2
{
   _mTrafficInfo_AR2.TrafficInfo_Distance_Stat21_V2.phys = getValue(this);
}

on EnvVar HMI_TrafficInfo_Distance_Stat22_V2
{
   _mTrafficInfo_AR2.TrafficInfo_Distance_Stat22_V2.phys = getValue(this);
}

on EnvVar HMI_TrafficInfo_Distance_Stat23_V2
{
   _mTrafficInfo_AR2.TrafficInfo_Distance_Stat23_V2.phys = getValue(this);
}

on EnvVar HMI_TrafficInfo_Distance_Stat24_V2
{
   _mTrafficInfo_AR2.TrafficInfo_Distance_Stat24_V2.phys = getValue(this);
}

on EnvVar HMI_TrafficInfo_Distance_Stat25_V2
{
   _mTrafficInfo_AR2.TrafficInfo_Distance_Stat25_V2.phys = getValue(this);
}

on EnvVar HMI_TrafficInfo_Distance_Stat26_V2
{
   _mTrafficInfo_AR2.TrafficInfo_Distance_Stat26_V2.phys = getValue(this);
}

on EnvVar HMI_TrafficInfo_Distance_Stat27_V2
{
   _mTrafficInfo_AR2.TrafficInfo_Distance_Stat27_V2.phys = getValue(this);
}

on EnvVar HMI_TrafficInfo_Distance_Stat28_V2
{
   _mTrafficInfo_AR2.TrafficInfo_Distance_Stat28_V2.phys = getValue(this);
}

on EnvVar HMI_TrafficInfo_Distance_Stat29_V2
{
   _mTrafficInfo_AR2.TrafficInfo_Distance_Stat29_V2.phys = getValue(this);
}

on EnvVar HMI_TrafficInfo_Distance_Stat30_V2
{
   _mTrafficInfo_AR2.TrafficInfo_Distance_Stat30_V2.phys = getValue(this);
}

on EnvVar HMI_TrafficInfo_Distance_Stat31_V2
{
   _mTrafficInfo_AR2.TrafficInfo_Distance_Stat31_V2.phys = getValue(this);
}

on EnvVar HMI_TrafficInfo_Distance_Stat32_V2
{
   _mTrafficInfo_AR2.TrafficInfo_Distance_Stat32_V2.phys = getValue(this);
}

on EnvVar HMI_TrafficInfo_Distance_Stat33_V2
{
   _mTrafficInfo_AR2.TrafficInfo_Distance_Stat33_V2.phys = getValue(this);
}

on EnvVar HMI_TrafficInfo_Distance_Stat34_V2
{
   _mTrafficInfo_AR2.TrafficInfo_Distance_Stat34_V2.phys = getValue(this);
}

on EnvVar HMI_TrafficInfo_Distance_Stat35_V2
{
   _mTrafficInfo_AR2.TrafficInfo_Distance_Stat35_V2.phys = getValue(this);
}

on EnvVar HMI_TrafficInfo_Distance_Stat36_V2
{
   _mTrafficInfo_AR2.TrafficInfo_Distance_Stat36_V2.phys = getValue(this);
}

on EnvVar HMI_TrafficInfo_Distance_Stat37_V2
{
   _mTrafficInfo_AR2.TrafficInfo_Distance_Stat37_V2.phys = getValue(this);
}

on EnvVar HMI_TrafficInfo_Distance_Stat38_V2
{
   _mTrafficInfo_AR2.TrafficInfo_Distance_Stat38_V2.phys = getValue(this);
}

on EnvVar HMI_TrafficInfo_Distance_Stat39_V2
{
   _mTrafficInfo_AR2.TrafficInfo_Distance_Stat39_V2.phys = getValue(this);
}

on EnvVar HMI_TrafficInfo_Distance_Stat40_V2
{
   _mTrafficInfo_AR2.TrafficInfo_Distance_Stat40_V2.phys = getValue(this);
}

on EnvVar HMI_TrafficInfo_Distance_Stat41_V2
{
   _mTrafficInfo_AR2.TrafficInfo_Distance_Stat41_V2.phys = getValue(this);
}

on EnvVar HMI_TrafficInfo_Distance_Stat42_V2
{
   _mTrafficInfo_AR2.TrafficInfo_Distance_Stat42_V2.phys = getValue(this);
}

on EnvVar HMI_TrafficInfo_Distance_Stat43_V2
{
   _mTrafficInfo_AR2.TrafficInfo_Distance_Stat43_V2.phys = getValue(this);
}

on EnvVar HMI_TrafficInfo_Distance_Stat44_V2
{
   _mTrafficInfo_AR2.TrafficInfo_Distance_Stat44_V2.phys = getValue(this);
}

on EnvVar HMI_TrafficInfo_Distance_Stat45_V2
{
   _mTrafficInfo_AR2.TrafficInfo_Distance_Stat45_V2.phys = getValue(this);
}

on EnvVar HMI_TrafficInfo_Distance_Stat46_V2
{
   _mTrafficInfo_AR2.TrafficInfo_Distance_Stat46_V2.phys = getValue(this);
}

on EnvVar HMI_TrafficInfo_Distance_Stat47_V2
{
   _mTrafficInfo_AR2.TrafficInfo_Distance_Stat47_V2.phys = getValue(this);
}

on EnvVar HMI_TrafficInfo_Distance_Stat48_V2
{
   _mTrafficInfo_AR2.TrafficInfo_Distance_Stat48_V2.phys = getValue(this);
}

on EnvVar HMI_TrafficInfo_Distance_Stat49_V2
{
   _mTrafficInfo_AR2.TrafficInfo_Distance_Stat49_V2.phys = getValue(this);
}

on EnvVar HMI_TrafficInfo_Distance_Stat50_V2
{
   _mTrafficInfo_AR2.TrafficInfo_Distance_Stat50_V2.phys = getValue(this);
}

on EnvVar HMI_TrafficInfo_MdSel
{
   _mTrafficInfo_AR2.TrafficInfo_MdSel.phys = getValue(this);
}

on EnvVar HMI_TrafficInfo_Stat01_V2
{
   _mTrafficInfo_AR2.TrafficInfo_Stat01_V2.phys = getValue(this);
}

on EnvVar HMI_TrafficInfo_Stat02_V2
{
   _mTrafficInfo_AR2.TrafficInfo_Stat02_V2.phys = getValue(this);
}

on EnvVar HMI_TrafficInfo_Stat03_V2
{
   _mTrafficInfo_AR2.TrafficInfo_Stat03_V2.phys = getValue(this);
}

on EnvVar HMI_TrafficInfo_Stat04_V2
{
   _mTrafficInfo_AR2.TrafficInfo_Stat04_V2.phys = getValue(this);
}

on EnvVar HMI_TrafficInfo_Stat05_V2
{
   _mTrafficInfo_AR2.TrafficInfo_Stat05_V2.phys = getValue(this);
}

on EnvVar HMI_TrafficInfo_Stat06_V2
{
   _mTrafficInfo_AR2.TrafficInfo_Stat06_V2.phys = getValue(this);
}

on EnvVar HMI_TrafficInfo_Stat07_V2
{
   _mTrafficInfo_AR2.TrafficInfo_Stat07_V2.phys = getValue(this);
}

on EnvVar HMI_TrafficInfo_Stat08_V2
{
   _mTrafficInfo_AR2.TrafficInfo_Stat08_V2.phys = getValue(this);
}

on EnvVar HMI_TrafficInfo_Stat09_V2
{
   _mTrafficInfo_AR2.TrafficInfo_Stat09_V2.phys = getValue(this);
}

on EnvVar HMI_TrafficInfo_Stat10_V2
{
   _mTrafficInfo_AR2.TrafficInfo_Stat10_V2.phys = getValue(this);
}

on EnvVar HMI_TrafficInfo_Stat11_V2
{
   _mTrafficInfo_AR2.TrafficInfo_Stat11_V2.phys = getValue(this);
}

on EnvVar HMI_TrafficInfo_Stat12_V2
{
   _mTrafficInfo_AR2.TrafficInfo_Stat12_V2.phys = getValue(this);
}

on EnvVar HMI_TrafficInfo_Stat13_V2
{
   _mTrafficInfo_AR2.TrafficInfo_Stat13_V2.phys = getValue(this);
}

on EnvVar HMI_TrafficInfo_Stat14_V2
{
   _mTrafficInfo_AR2.TrafficInfo_Stat14_V2.phys = getValue(this);
}

on EnvVar HMI_TrafficInfo_Stat15_V2
{
   _mTrafficInfo_AR2.TrafficInfo_Stat15_V2.phys = getValue(this);
}

on EnvVar HMI_TrafficInfo_Stat16_V2
{
   _mTrafficInfo_AR2.TrafficInfo_Stat16_V2.phys = getValue(this);
}

on EnvVar HMI_TrafficInfo_Stat17_V2
{
   _mTrafficInfo_AR2.TrafficInfo_Stat17_V2.phys = getValue(this);
}

on EnvVar HMI_TrafficInfo_Stat18_V2
{
   _mTrafficInfo_AR2.TrafficInfo_Stat18_V2.phys = getValue(this);
}

on EnvVar HMI_TrafficInfo_Stat19_V2
{
   _mTrafficInfo_AR2.TrafficInfo_Stat19_V2.phys = getValue(this);
}

on EnvVar HMI_TrafficInfo_Stat20_V2
{
   _mTrafficInfo_AR2.TrafficInfo_Stat20_V2.phys = getValue(this);
}

on EnvVar HMI_TrafficInfo_Stat21_V2
{
   _mTrafficInfo_AR2.TrafficInfo_Stat21_V2.phys = getValue(this);
}

on EnvVar HMI_TrafficInfo_Stat22_V2
{
   _mTrafficInfo_AR2.TrafficInfo_Stat22_V2.phys = getValue(this);
}

on EnvVar HMI_TrafficInfo_Stat23_V2
{
   _mTrafficInfo_AR2.TrafficInfo_Stat23_V2.phys = getValue(this);
}

on EnvVar HMI_TrafficInfo_Stat24_V2
{
   _mTrafficInfo_AR2.TrafficInfo_Stat24_V2.phys = getValue(this);
}

on EnvVar HMI_TrafficInfo_Stat25_V2
{
   _mTrafficInfo_AR2.TrafficInfo_Stat25_V2.phys = getValue(this);
}

on EnvVar HMI_TrafficInfo_Stat26_V2
{
   _mTrafficInfo_AR2.TrafficInfo_Stat26_V2.phys = getValue(this);
}

on EnvVar HMI_TrafficInfo_Stat27_V2
{
   _mTrafficInfo_AR2.TrafficInfo_Stat27_V2.phys = getValue(this);
}

on EnvVar HMI_TrafficInfo_Stat28_V2
{
   _mTrafficInfo_AR2.TrafficInfo_Stat28_V2.phys = getValue(this);
}

on EnvVar HMI_TrafficInfo_Stat29_V2
{
   _mTrafficInfo_AR2.TrafficInfo_Stat29_V2.phys = getValue(this);
}

on EnvVar HMI_TrafficInfo_Stat30_V2
{
   _mTrafficInfo_AR2.TrafficInfo_Stat30_V2.phys = getValue(this);
}

on EnvVar HMI_TrafficInfo_Stat31_V2
{
   _mTrafficInfo_AR2.TrafficInfo_Stat31_V2.phys = getValue(this);
}

on EnvVar HMI_TrafficInfo_Stat32_V2
{
   _mTrafficInfo_AR2.TrafficInfo_Stat32_V2.phys = getValue(this);
}

on EnvVar HMI_TrafficInfo_Stat33_V2
{
   _mTrafficInfo_AR2.TrafficInfo_Stat33_V2.phys = getValue(this);
}

on EnvVar HMI_TrafficInfo_Stat34_V2
{
   _mTrafficInfo_AR2.TrafficInfo_Stat34_V2.phys = getValue(this);
}

on EnvVar HMI_TrafficInfo_Stat35_V2
{
   _mTrafficInfo_AR2.TrafficInfo_Stat35_V2.phys = getValue(this);
}

on EnvVar HMI_TrafficInfo_Stat36_V2
{
   _mTrafficInfo_AR2.TrafficInfo_Stat36_V2.phys = getValue(this);
}

on EnvVar HMI_TrafficInfo_Stat37_V2
{
   _mTrafficInfo_AR2.TrafficInfo_Stat37_V2.phys = getValue(this);
}

on EnvVar HMI_TrafficInfo_Stat38_V2
{
   _mTrafficInfo_AR2.TrafficInfo_Stat38_V2.phys = getValue(this);
}

on EnvVar HMI_TrafficInfo_Stat39_V2
{
   _mTrafficInfo_AR2.TrafficInfo_Stat39_V2.phys = getValue(this);
}

on EnvVar HMI_TrafficInfo_Stat40_V2
{
   _mTrafficInfo_AR2.TrafficInfo_Stat40_V2.phys = getValue(this);
}

on EnvVar HMI_TrafficInfo_Stat41_V2
{
   _mTrafficInfo_AR2.TrafficInfo_Stat41_V2.phys = getValue(this);
}

on EnvVar HMI_TrafficInfo_Stat42_V2
{
   _mTrafficInfo_AR2.TrafficInfo_Stat42_V2.phys = getValue(this);
}

on EnvVar HMI_TrafficInfo_Stat43_V2
{
   _mTrafficInfo_AR2.TrafficInfo_Stat43_V2.phys = getValue(this);
}

on EnvVar HMI_TrafficInfo_Stat44_V2
{
   _mTrafficInfo_AR2.TrafficInfo_Stat44_V2.phys = getValue(this);
}

on EnvVar HMI_TrafficInfo_Stat45_V2
{
   _mTrafficInfo_AR2.TrafficInfo_Stat45_V2.phys = getValue(this);
}

on EnvVar HMI_TrafficInfo_Stat46_V2
{
   _mTrafficInfo_AR2.TrafficInfo_Stat46_V2.phys = getValue(this);
}

on EnvVar HMI_TrafficInfo_Stat47_V2
{
   _mTrafficInfo_AR2.TrafficInfo_Stat47_V2.phys = getValue(this);
}

on EnvVar HMI_TrafficInfo_Stat48_V2
{
   _mTrafficInfo_AR2.TrafficInfo_Stat48_V2.phys = getValue(this);
}

on EnvVar HMI_TrafficInfo_Stat49_V2
{
   _mTrafficInfo_AR2.TrafficInfo_Stat49_V2.phys = getValue(this);
}

on EnvVar HMI_TrafficInfo_Stat50_V2
{
   _mTrafficInfo_AR2.TrafficInfo_Stat50_V2.phys = getValue(this);
}

on EnvVar HMI_TrafficInfo_StatPosCurr_V2
{
   _mTrafficInfo_AR2.TrafficInfo_StatPosCurr_V2.phys = getValue(this);
}


TSCR_R_Rq2_AR_check_output()
{
    if( !getValue( HMI__STMSG_TSCR_R_Rq2_AR ) )
    {
        // Botschaft TSCR_R_Rq2_AR ID: 798 --- Sendeart 5 cyclicAndSpontanWithDelay --- 
        if( _TSCR_R_Rq2_AR_DelayCnt > 0) _TSCR_R_Rq2_AR_DelayCnt--; // Mindestsendeabstand
        _TSCR_R_Rq2_AR_Cnt--;
        if( _TSCR_R_Rq2_AR_Cnt < 1 )
        {
            if( _TSCR_R_Rq2_AR_DelayCnt < 1 )
            {
                // Nachricht wg. abgelaufenem Zyklus ausgeben (Mindestsendeabstand eingehalten)
                TSCR_R_Rq2_AR_output();
                _TSCR_R_Rq2_AR_SpontanFlag = 0; // Spontan-Flag zurücksetzen
                _TSCR_R_Rq2_AR_DelayCnt = _TSCR_R_Rq2_AR_MinDelay;
            }
            else
            {
                // Spontanflag setzen damit nach Ablauf Mindestsendeabstand gesendet wird
                 _TSCR_R_Rq2_AR_SpontanFlag = 1;
            }
            _TSCR_R_Rq2_AR_Cnt = _TSCR_R_Rq2_AR_CycleCount; // Zyklus-Zähler zurücksetzen
        }
        else if( _TSCR_R_Rq2_AR_SpontanFlag)
        {
            if( _TSCR_R_Rq2_AR_DelayCnt < 1 )
            {
                // Nachricht wg. spontaner Änderung ausgeben (Mindestsendeabstand eingehalten)
                TSCR_R_Rq2_AR_output();
                _TSCR_R_Rq2_AR_SpontanFlag = 0; // Spontan-Flag zurücksetzen
                _TSCR_R_Rq2_AR_DelayCnt = _TSCR_R_Rq2_AR_MinDelay;
            }
        }
    }
}

TSCR_R_Rq2_AR_init()
{    /* Botschaft TSCR_R_Rq2_AR ID: 798 --- Sendeart 5 cyclicAndSpontanWithDelay --- 
BA_ "ApplMessage" BO_ 798 0;
BA_ "NmAsrMessage" BO_ 798 0;
BA_ "GenMsgMinAcceptLength" BO_ 798 8;
BA_ "GenMsgILSupport" BO_ 798 1;
BA_ "DiagState" BO_ 798 0;
BA_ "DiagRequest" BO_ 798 0;
BA_ "DiagResponse" BO_ 798 0;
BA_ "GenMsgStartValue" BO_ 798 "0";
BA_ "GenMsgDelayTime" BO_ 798 100;
BA_ "GenMsgNrOfRepetition" BO_ 798 0;
BA_ "GenMsgCycleTime" BO_ 798 1000;
BA_ "GenMsgSendType" BO_ 798 5;
    */

    _TSCR_R_Rq2_AR_Timebase =          c_tDBKomTimer_20ms;
    _TSCR_R_Rq2_AR_CycleCount =      1000 / _TSCR_R_Rq2_AR_Timebase;
    _TSCR_R_Rq2_AR_StartDelay =         0 / _TSCR_R_Rq2_AR_Timebase;
    _TSCR_R_Rq2_AR_MinDelay =         100 / _TSCR_R_Rq2_AR_Timebase;
    _TSCR_R_Rq2_AR_Cnt = _TSCR_R_Rq2_AR_StartDelay;
    _TSCR_R_Rq2_AR_DelayCnt = 0;
    _TSCR_R_Rq2_AR_SpontanFlag = 0;

    putValue( HMI__STMSGSD_TSCR_R_Rq2_AR, _TSCR_R_Rq2_AR_StartDelay * _TSCR_R_Rq2_AR_Timebase ); 

    _mTSCR_R_Rq2_AR.RB_R_Sw_Psd_TSCR_R.phys = getValue( HMI_RB_R_Sw_Psd_TSCR_R );
    _mTSCR_R_Rq2_AR.SeatHt_RL_Posn_Rq_TSCR_R.phys = getValue( HMI_SeatHt_RL_Posn_Rq_TSCR_R );
    _mTSCR_R_Rq2_AR.SeatHt_RR_Posn_Rq_TSCR_R.phys = getValue( HMI_SeatHt_RR_Posn_Rq_TSCR_R );
    _mTSCR_R_Rq2_AR.SeatVn_RL_Posn_Rq_TSCR_R.phys = getValue( HMI_SeatVn_RL_Posn_Rq_TSCR_R );
    _mTSCR_R_Rq2_AR.SeatVn_RR_Posn_Rq_TSCR_R.phys = getValue( HMI_SeatVn_RR_Posn_Rq_TSCR_R );
    _mTSCR_R_Rq2_AR.SeatHt_RL_Rq_TSCR_R_V2.phys = getValue( HMI_SeatHt_RL_Rq_TSCR_R_V2 );
    _mTSCR_R_Rq2_AR.SeatHt_RR_Rq_TSCR_R_V2.phys = getValue( HMI_SeatHt_RR_Rq_TSCR_R_V2 );
    _mTSCR_R_Rq2_AR.SeatVn_RL_Rq_TSCR_R_V2.phys = getValue( HMI_SeatVn_RL_Rq_TSCR_R_V2 );
    _mTSCR_R_Rq2_AR.SeatVn_RR_Rq_TSCR_R_V2.phys = getValue( HMI_SeatVn_RR_Rq_TSCR_R_V2 );
}

TSCR_R_Rq2_AR_output()
{
    output( _mTSCR_R_Rq2_AR );
}

TSCR_R_Rq2_AR_saveEnvVars( dword hFile )
{
    filePutString("\n// Knoten EIS: TSCR_R_Rq2_AR\n", 27, hFile );
    snprintf( buffer, elcount( buffer ), "0.0000 HMI__STMSG_TSCR_R_Rq2_AR := %X\n", getValue( HMI__STMSG_TSCR_R_Rq2_AR ) );        filePutString ( buffer, elcount( buffer ), hFile );
    snprintf( buffer, elcount( buffer ), "0.0000 HMI__STMSGT_TSCR_R_Rq2_AR := %X\n", getValue( HMI__STMSGT_TSCR_R_Rq2_AR ) );        filePutString ( buffer, elcount( buffer ), hFile );
    snprintf( buffer, elcount( buffer ), "0.0000 HMI_RB_R_Sw_Psd_TSCR_R := %X\n", getValue( HMI_RB_R_Sw_Psd_TSCR_R ) );        filePutString ( buffer, elcount( buffer ), hFile );
    snprintf( buffer, elcount( buffer ), "0.0000 HMI_SeatHt_RL_Posn_Rq_TSCR_R := %X\n", getValue( HMI_SeatHt_RL_Posn_Rq_TSCR_R ) );        filePutString ( buffer, elcount( buffer ), hFile );
    snprintf( buffer, elcount( buffer ), "0.0000 HMI_SeatHt_RR_Posn_Rq_TSCR_R := %X\n", getValue( HMI_SeatHt_RR_Posn_Rq_TSCR_R ) );        filePutString ( buffer, elcount( buffer ), hFile );
    snprintf( buffer, elcount( buffer ), "0.0000 HMI_SeatVn_RL_Posn_Rq_TSCR_R := %X\n", getValue( HMI_SeatVn_RL_Posn_Rq_TSCR_R ) );        filePutString ( buffer, elcount( buffer ), hFile );
    snprintf( buffer, elcount( buffer ), "0.0000 HMI_SeatVn_RR_Posn_Rq_TSCR_R := %X\n", getValue( HMI_SeatVn_RR_Posn_Rq_TSCR_R ) );        filePutString ( buffer, elcount( buffer ), hFile );
    snprintf( buffer, elcount( buffer ), "0.0000 HMI_SeatHt_RL_Rq_TSCR_R_V2 := %X\n", getValue( HMI_SeatHt_RL_Rq_TSCR_R_V2 ) );        filePutString ( buffer, elcount( buffer ), hFile );
    snprintf( buffer, elcount( buffer ), "0.0000 HMI_SeatHt_RR_Rq_TSCR_R_V2 := %X\n", getValue( HMI_SeatHt_RR_Rq_TSCR_R_V2 ) );        filePutString ( buffer, elcount( buffer ), hFile );
    snprintf( buffer, elcount( buffer ), "0.0000 HMI_SeatVn_RL_Rq_TSCR_R_V2 := %X\n", getValue( HMI_SeatVn_RL_Rq_TSCR_R_V2 ) );        filePutString ( buffer, elcount( buffer ), hFile );
    snprintf( buffer, elcount( buffer ), "0.0000 HMI_SeatVn_RR_Rq_TSCR_R_V2 := %X\n", getValue( HMI_SeatVn_RR_Rq_TSCR_R_V2 ) );        filePutString ( buffer, elcount( buffer ), hFile );
}

on timer _tTSCR_R_Rq2_AR
{
    putValue( HMI__STMSG_TSCR_R_Rq2_AR, 0 );
}

on EnvVar HMI__STMSG_TSCR_R_Rq2_AR
{
    long tDelay;
    if( getValue( this ) == 2 )
    {
        tDelay = getValue( HMI__STMSGT_TSCR_R_Rq2_AR );
        if( tDelay > 0)    
            setTimer( _tTSCR_R_Rq2_AR, tDelay );
        else
            putValue( HMI__STMSG_TSCR_R_Rq2_AR, 0 );
    }
}

on envVar HMI__STMSG_PO_TSCR_R_Rq2_AR
{
    if( getValue( this ) )
        openPanel("TSCR_R_Rq2_AR");
}

on EnvVar HMI_RB_R_Sw_Psd_TSCR_R
{
    _mTSCR_R_Rq2_AR.RB_R_Sw_Psd_TSCR_R.phys = getValue(this);
    _TSCR_R_Rq2_AR_SpontanFlag = 1;
}

on EnvVar HMI_SeatHt_RL_Posn_Rq_TSCR_R
{
    _mTSCR_R_Rq2_AR.SeatHt_RL_Posn_Rq_TSCR_R.phys = getValue(this);
    _TSCR_R_Rq2_AR_SpontanFlag = 1;
}

on EnvVar HMI_SeatHt_RR_Posn_Rq_TSCR_R
{
    _mTSCR_R_Rq2_AR.SeatHt_RR_Posn_Rq_TSCR_R.phys = getValue(this);
    _TSCR_R_Rq2_AR_SpontanFlag = 1;
}

on EnvVar HMI_SeatVn_RL_Posn_Rq_TSCR_R
{
    _mTSCR_R_Rq2_AR.SeatVn_RL_Posn_Rq_TSCR_R.phys = getValue(this);
    _TSCR_R_Rq2_AR_SpontanFlag = 1;
}

on EnvVar HMI_SeatVn_RR_Posn_Rq_TSCR_R
{
    _mTSCR_R_Rq2_AR.SeatVn_RR_Posn_Rq_TSCR_R.phys = getValue(this);
    _TSCR_R_Rq2_AR_SpontanFlag = 1;
}

on EnvVar HMI_SeatHt_RL_Rq_TSCR_R_V2
{
    _mTSCR_R_Rq2_AR.SeatHt_RL_Rq_TSCR_R_V2.phys = getValue(this);
    _TSCR_R_Rq2_AR_SpontanFlag = 1;
}

on EnvVar HMI_SeatHt_RR_Rq_TSCR_R_V2
{
    _mTSCR_R_Rq2_AR.SeatHt_RR_Rq_TSCR_R_V2.phys = getValue(this);
    _TSCR_R_Rq2_AR_SpontanFlag = 1;
}

on EnvVar HMI_SeatVn_RL_Rq_TSCR_R_V2
{
    _mTSCR_R_Rq2_AR.SeatVn_RL_Rq_TSCR_R_V2.phys = getValue(this);
    _TSCR_R_Rq2_AR_SpontanFlag = 1;
}

on EnvVar HMI_SeatVn_RR_Rq_TSCR_R_V2
{
    _mTSCR_R_Rq2_AR.SeatVn_RR_Rq_TSCR_R_V2.phys = getValue(this);
    _TSCR_R_Rq2_AR_SpontanFlag = 1;
}

void TSCR_R_Rq3_AR_Activity(int active)
{
    if( active)
    {
        if( _TSCR_R_Rq3_AR_SigActivity == 0 )
            _TSCR_R_Rq3_AR_Cnt = 1;
        _TSCR_R_Rq3_AR_SigActivity++;
    }
    else
    {
        _TSCR_R_Rq3_AR_SigActivity--;
    }
}

int TSCR_R_Rq3_AR_Change(int lastValue, int sigValue, int inActValue)
{
    bActiveHelper = (sigValue != inActValue);
      if( !lastValue && bActiveHelper)
        TSCR_R_Rq3_AR_Activity(1 );
      else if( lastValue && !bActiveHelper)
        TSCR_R_Rq3_AR_Activity(0 );
    return bActiveHelper;
}

TSCR_R_Rq3_AR_check_output()
{
    if( !getValue( HMI__STMSG_TSCR_R_Rq3_AR ) )
    {
        // Botschaft TSCR_R_Rq3_AR ID: 374 --- Sendeart 2 cyclicIfActiveX --- 
        if( _TSCR_R_Rq3_AR_SigActivity )
            _TSCR_R_Rq3_AR_Cnt--;
        if( _TSCR_R_Rq3_AR_Cnt < 1 )
        {
            TSCR_R_Rq3_AR_output(); // Zyklus abgelaufen, Nachricht senden
            _TSCR_R_Rq3_AR_Cnt = _TSCR_R_Rq3_AR_CycleCount;
        }
    }
}

TSCR_R_Rq3_AR_init()
{   /* Botschaft TSCR_R_Rq3_AR ID: 374 --- Sendeart 2 cyclicIfActiveX --- 
BA_ "ApplMessage" BO_ 374 0;
BA_ "NmAsrMessage" BO_ 374 0;
BA_ "GenMsgMinAcceptLength" BO_ 374 2;
BA_ "GenMsgILSupport" BO_ 374 1;
BA_ "DiagState" BO_ 374 0;
BA_ "DiagRequest" BO_ 374 0;
BA_ "DiagResponse" BO_ 374 0;
BA_ "GenMsgStartValue" BO_ 374 "0";
BA_ "GenMsgStartDelayTime" BO_ 374 0;
BA_ "GenMsgDelayTime" BO_ 374 5;
BA_ "GenMsgCycleTime" BO_ 374 0;
BA_ "GenMsgCycleTimeActive" BO_ 374 100;
BA_ "GenMsgSendType" BO_ 374 2;
    */
    _TSCR_R_Rq3_AR_Timebase =            c_tDBKomTimer_20ms;
    _TSCR_R_Rq3_AR_CycleCount =          50 / _TSCR_R_Rq3_AR_Timebase;
    _TSCR_R_Rq3_AR_StartDelay =           0 / _TSCR_R_Rq3_AR_Timebase;
    _TSCR_R_Rq3_AR_Cnt = 0;
    _TSCR_R_Rq3_AR_SigActivity = 0;

    putValue( HMI__STMSGSD_TSCR_R_Rq3_AR, _TSCR_R_Rq3_AR_StartDelay * _TSCR_R_Rq3_AR_Timebase );

    _mTSCR_R_Rq3_AR.PW_Adj_RL_Dr_TSCR_R.phys = getValue( HMI_PW_Adj_RL_Dr_TSCR_R );                  _TSCR_R_Rq3_AR_PW_Adj_RL_Dr_TSCR_R_LastState = TSCR_R_Rq3_AR_Change( _TSCR_R_Rq3_AR_PW_Adj_RL_Dr_TSCR_R_LastState, _mTSCR_R_Rq3_AR.PW_Adj_RL_Dr_TSCR_R, _TSCR_R_Rq3_AR_PW_Adj_RL_Dr_TSCR_R_InactiveValue );
    _mTSCR_R_Rq3_AR.PW_Adj_RR_Dr_TSCR_R.phys = getValue( HMI_PW_Adj_RR_Dr_TSCR_R );                  _TSCR_R_Rq3_AR_PW_Adj_RR_Dr_TSCR_R_LastState = TSCR_R_Rq3_AR_Change( _TSCR_R_Rq3_AR_PW_Adj_RR_Dr_TSCR_R_LastState, _mTSCR_R_Rq3_AR.PW_Adj_RR_Dr_TSCR_R, _TSCR_R_Rq3_AR_PW_Adj_RR_Dr_TSCR_R_InactiveValue );
    _mTSCR_R_Rq3_AR.TSSR_Sw_Stat_TSCR_R.phys = getValue( HMI_TSSR_Sw_Stat_TSCR_R );                  _TSCR_R_Rq3_AR_TSSR_Sw_Stat_TSCR_R_LastState = TSCR_R_Rq3_AR_Change( _TSCR_R_Rq3_AR_TSSR_Sw_Stat_TSCR_R_LastState, _mTSCR_R_Rq3_AR.TSSR_Sw_Stat_TSCR_R, _TSCR_R_Rq3_AR_TSSR_Sw_Stat_TSCR_R_InactiveValue );
}

TSCR_R_Rq3_AR_output()
{
    output( _mTSCR_R_Rq3_AR );
}

TSCR_R_Rq3_AR_saveEnvVars( dword hFile )
{
    filePutString("\n// Knoten TGW: TSCR_R_Rq3_AR\n", 32, hFile);
    snprintf( buffer, elcount(buffer), "0.0000 HMI__STMSG_TSCR_R_Rq3_AR := %X\n", getValue( HMI__STMSG_TSCR_R_Rq3_AR ));        filePutString( buffer, elcount(buffer), hFile);
    snprintf( buffer, elcount(buffer), "0.0000 HMI__STMSGT_TSCR_R_Rq3_AR := %X\n", getValue( HMI__STMSGT_TSCR_R_Rq3_AR ));        filePutString( buffer, elcount(buffer), hFile);
    snprintf( buffer, elcount(buffer), "0.0000 HMI_PW_Adj_RL_Dr_TSCR_R := %X\n", getValue( HMI_PW_Adj_RL_Dr_TSCR_R ) );        filePutString( buffer, elcount(buffer), hFile);
    snprintf( buffer, elcount(buffer), "0.0000 HMI_PW_Adj_RR_Dr_TSCR_R := %X\n", getValue( HMI_PW_Adj_RR_Dr_TSCR_R ) );        filePutString( buffer, elcount(buffer), hFile);
    snprintf( buffer, elcount(buffer), "0.0000 HMI_TSSR_Sw_Stat_TSCR_R := %X\n", getValue( HMI_TSSR_Sw_Stat_TSCR_R ) );        filePutString( buffer, elcount(buffer), hFile);
}

on timer _tTSCR_R_Rq3_AR
{
    putValue( HMI__STMSG_TSCR_R_Rq3_AR, 0 );
}

on EnvVar HMI__STMSG_TSCR_R_Rq3_AR
{
    long tDelay;
    if( getValue( this ) == 2 )
    {
        tDelay = getValue( HMI__STMSGT_TSCR_R_Rq3_AR );
        if( tDelay > 0 )    
            setTimer( _tTSCR_R_Rq3_AR, tDelay );
        else
            putValue( HMI__STMSG_TSCR_R_Rq3_AR, 0 );
    }
}

on EnvVar HMI__ALLDEF_TSCR_R_Rq3_AR
{
    if( getValue(this))
    {
        // alle signale auf default einstellen
        putValue( HMI_PW_Adj_RL_Dr_TSCR_R, _TSCR_R_Rq3_AR_PW_Adj_RL_Dr_TSCR_R_InactiveValue );
        putValue( HMI_PW_Adj_RR_Dr_TSCR_R, _TSCR_R_Rq3_AR_PW_Adj_RR_Dr_TSCR_R_InactiveValue );
        putValue( HMI_TSSR_Sw_Stat_TSCR_R, _TSCR_R_Rq3_AR_TSSR_Sw_Stat_TSCR_R_InactiveValue );
    }
}

on envVar HMI__STMSG_PO_TSCR_R_Rq3_AR
{
    if( getValue( this ) )
        openPanel("TSCR_R_Rq3_AR");
}

on EnvVar HMI_PW_Adj_RL_Dr_TSCR_R
{
    _mTSCR_R_Rq3_AR.PW_Adj_RL_Dr_TSCR_R.phys = getValue(this);
    _TSCR_R_Rq3_AR_PW_Adj_RL_Dr_TSCR_R_LastState = TSCR_R_Rq3_AR_Change(_TSCR_R_Rq3_AR_PW_Adj_RL_Dr_TSCR_R_LastState, _mTSCR_R_Rq3_AR.PW_Adj_RL_Dr_TSCR_R, _TSCR_R_Rq3_AR_PW_Adj_RL_Dr_TSCR_R_InactiveValue );
}

on EnvVar HMI_PW_Adj_RR_Dr_TSCR_R
{
    _mTSCR_R_Rq3_AR.PW_Adj_RR_Dr_TSCR_R.phys = getValue(this);
    _TSCR_R_Rq3_AR_PW_Adj_RR_Dr_TSCR_R_LastState = TSCR_R_Rq3_AR_Change(_TSCR_R_Rq3_AR_PW_Adj_RR_Dr_TSCR_R_LastState, _mTSCR_R_Rq3_AR.PW_Adj_RR_Dr_TSCR_R, _TSCR_R_Rq3_AR_PW_Adj_RR_Dr_TSCR_R_InactiveValue );
}

on EnvVar HMI_TSSR_Sw_Stat_TSCR_R
{
    _mTSCR_R_Rq3_AR.TSSR_Sw_Stat_TSCR_R.phys = getValue(this);
    _TSCR_R_Rq3_AR_TSSR_Sw_Stat_TSCR_R_LastState = TSCR_R_Rq3_AR_Change(_TSCR_R_Rq3_AR_TSSR_Sw_Stat_TSCR_R_LastState, _mTSCR_R_Rq3_AR.TSSR_Sw_Stat_TSCR_R, _TSCR_R_Rq3_AR_TSSR_Sw_Stat_TSCR_R_InactiveValue );
}

TGW_Rq_AR2_check_output()
{
    if( !getValue( HMI__STMSG_TGW_Rq_AR2 ) )
    {
        // Botschaft TGW_Rq_AR2 ID: 2353004544 --- Sendeart 5 cyclicAndSpontanWithDelay --- 
        if( _TGW_Rq_AR2_DelayCnt > 0) _TGW_Rq_AR2_DelayCnt--; // Mindestsendeabstand
        _TGW_Rq_AR2_Cnt--;
        if( _TGW_Rq_AR2_Cnt < 1 )
        {
            if( _TGW_Rq_AR2_DelayCnt < 1 )
            {
                // Nachricht wg. abgelaufenem Zyklus ausgeben (Mindestsendeabstand eingehalten)
                TGW_Rq_AR2_output();
                _TGW_Rq_AR2_SpontanFlag = 0; // Spontan-Flag zurücksetzen
                _TGW_Rq_AR2_DelayCnt = _TGW_Rq_AR2_MinDelay;
            }
            else
            {
                // Spontanflag setzen damit nach Ablauf Mindestsendeabstand gesendet wird
                 _TGW_Rq_AR2_SpontanFlag = 1;
            }
            _TGW_Rq_AR2_Cnt = _TGW_Rq_AR2_CycleCount; // Zyklus-Zähler zurücksetzen
        }
        else if( _TGW_Rq_AR2_SpontanFlag)
        {
            if( _TGW_Rq_AR2_DelayCnt < 1 )
            {
                // Nachricht wg. spontaner Änderung ausgeben (Mindestsendeabstand eingehalten)
                TGW_Rq_AR2_output();
                _TGW_Rq_AR2_SpontanFlag = 0; // Spontan-Flag zurücksetzen
                _TGW_Rq_AR2_DelayCnt = _TGW_Rq_AR2_MinDelay;
            }
        }
    }
}

TGW_Rq_AR2_init()
{    /* Botschaft TGW_Rq_AR2 ID: 2353004544 --- Sendeart 5 cyclicAndSpontanWithDelay --- 
BA_ "ApplMessage" BO_ 2353004544 0;
BA_ "NmAsrMessage" BO_ 2353004544 0;
BA_ "GenMsgMinAcceptLength" BO_ 2353004544 8;
BA_ "GenMsgILSupport" BO_ 2353004544 1;
BA_ "DiagState" BO_ 2353004544 0;
BA_ "DiagRequest" BO_ 2353004544 0;
BA_ "DiagResponse" BO_ 2353004544 0;
BA_ "GenMsgStartValue" BO_ 2353004544 "0";
BA_ "GenMsgDelayTime" BO_ 2353004544 100;
BA_ "GenMsgNrOfRepetition" BO_ 2353004544 0;
BA_ "GenMsgCycleTime" BO_ 2353004544 1000;
BA_ "GenMsgSendType" BO_ 2353004544 5;
    */

    _TGW_Rq_AR2_Timebase =          c_tDBKomTimer_20ms;
    _TGW_Rq_AR2_CycleCount =      1000 / _TSCR_R_Rq2_AR_Timebase;
    _TGW_Rq_AR2_StartDelay =         0 / _TSCR_R_Rq2_AR_Timebase;
    _TGW_Rq_AR2_MinDelay =         100 / _TSCR_R_Rq2_AR_Timebase;
    _TGW_Rq_AR2_Cnt = _TSCR_R_Rq2_AR_StartDelay;
    _TGW_Rq_AR2_DelayCnt = 0;
    _TGW_Rq_AR2_SpontanFlag = 0;

    putValue( HMI__STMSGSD_TGW_Rq_AR2, _TGW_Rq_AR2_StartDelay * _TGW_Rq_AR2_Timebase ); 

    _mTGW_Rq_AR2.TLA_V2X_Dir.phys = getValue( HMI_TLA_V2X_Dir );
    _mTGW_Rq_AR2.TLA_V2X_Disp_Rq.phys = getValue( HMI_TLA_V2X_Disp_Rq );
    _mTGW_Rq_AR2.TLA_V2X_Dist.phys = getValue( HMI_TLA_V2X_Dist );
	_mTGW_Rq_AR2.TLA_V2X_Spd.phys = getValue( HMI_TLA_V2X_Spd );
	_mTGW_Rq_AR2.TLA_V2X_Time.phys = getValue( HMI_TLA_V2X_Time );
    
}


TGW_Rq_AR2_output()
{
    output( _mTGW_Rq_AR2 );
}

TGW_Rq_AR2_saveEnvVars( dword hFile )
{
    filePutString("\n// Knoten EIS: TGW_Rq_AR2\n", 33, hFile );
	
    snprintf( buffer, elcount( buffer ), "0.0000 HMI__STMSG_TGW_Rq_AR2 := %X\n", getValue( HMI__STMSG_TGW_Rq_AR2 ) );        filePutString ( buffer, elcount( buffer ), hFile );
    
	snprintf( buffer, elcount( buffer ), "0.0000 HMI__STMSGT_TGW_Rq_AR2 := %X\n", getValue( HMI__STMSGT_TGW_Rq_AR2 ) );        filePutString ( buffer, elcount( buffer ), hFile );
    
	snprintf( buffer, elcount( buffer ), "0.0000 HMI_TLA_V2X_Dir := %X\n", getValue( HMI_TLA_V2X_Dir ) );        filePutString ( buffer, elcount( buffer ), hFile );
    snprintf( buffer, elcount( buffer ), "0.0000 HMI_TLA_V2X_Disp_Rq := %X\n", getValue( HMI_TLA_V2X_Disp_Rq ) );        filePutString ( buffer, elcount( buffer ), hFile );
    snprintf( buffer, elcount( buffer ), "0.0000 HMI_TLA_V2X_Dist := %X\n", getValue( HMI_TLA_V2X_Dist ) );        filePutString ( buffer, elcount( buffer ), hFile );
    snprintf( buffer, elcount( buffer ), "0.0000 HMI_TLA_V2X_Spd := %X\n", getValue( HMI_TLA_V2X_Spd ) );        filePutString ( buffer, elcount( buffer ), hFile );
    snprintf( buffer, elcount( buffer ), "0.0000 HMI_TLA_V2X_Time := %X\n", getValue( HMI_TLA_V2X_Time ) );        filePutString ( buffer, elcount( buffer ), hFile );
    
}

on timer _tTGW_Rq_AR2
{
    putValue( HMI__STMSG_TGW_Rq_AR2, 0 );
}

on EnvVar HMI__STMSG_TGW_Rq_AR2
{
    long tDelay;
    if( getValue( this ) == 2 )
    {
        tDelay = getValue( HMI__STMSGT_TGW_Rq_AR2 );
        if( tDelay > 0)    
            setTimer( _tTGW_Rq_AR2, tDelay );
        else
            putValue( HMI__STMSG_TGW_Rq_AR2, 0 );
    }
}
//TGW_Rq_AR2
on envVar HMI__STMSG_PO_TGW_Rq_AR2
{
    if( getValue( this ) )
        openPanel("TGW_Rq_AR2");
}

on EnvVar HMI_TLA_V2X_Dir
{
    _mTGW_Rq_AR2.TLA_V2X_Dir.phys = getValue(this);
    _TGW_Rq_AR2_SpontanFlag = 1;
}

on EnvVar HMI_TLA_V2X_Disp_Rq
{
    _mTGW_Rq_AR2.TLA_V2X_Disp_Rq.phys = getValue(this);
    _TGW_Rq_AR2_SpontanFlag = 1;
}

on EnvVar HMI_TLA_V2X_Dist
{
    _mTGW_Rq_AR2.TLA_V2X_Dist.phys = getValue(this);
    _TGW_Rq_AR2_SpontanFlag = 1;
}

on EnvVar HMI_TLA_V2X_Spd
{
    _mTGW_Rq_AR2.TLA_V2X_Spd.phys = getValue(this);
    _TGW_Rq_AR2_SpontanFlag = 1;
}

on EnvVar HMI_TLA_V2X_Time
{
    _mTGW_Rq_AR2.TLA_V2X_Time.phys = getValue(this);
    _TGW_Rq_AR2_SpontanFlag = 1;
}

HU_State2_AR_check_output()
{
    if( !getValue( HMI__STMSG_HU_State2_AR ) )
    {
    //  message   HU_State2_AR ID: 2346450944 --- Sendeart 5 cyclicAndSpontanWithDelay --- 
        _HU_State2_AR_Cnt--;
        if( _HU_State2_AR_Cnt < 1 )
        {
            // Nachricht wg. abgelaufenem Zyklus ausgeben
            HU_State2_AR_output();
            _HU_State2_AR_Cnt = _HU_State2_AR_CycleCount; // Zyklus-Zähler zurücksetzen
            _HU_State2_AR_SpontanFlag = 0; // Spontan-Flag zurücksetzen
        }
        else if( _HU_State2_AR_SpontanFlag)
        {
            // Nachricht wg. spontaner Änderung ausgeben
            HU_State2_AR_output();
            _HU_State2_AR_SpontanFlag = 0; // Spontan-Flag zurücksetzen
        }
    }
}

HU_State2_AR_init()
{   /* Botschaft HU_State2_AR ID: 2346450944 --- Sendeart 5 cyclicAndSpontanWithDelay --- 
BA_ "ApplMessage" BO_ 2346450944 0;
BA_ "NmAsrMessage" BO_ 2346450944 0;
BA_ "GenMsgMinAcceptLength" BO_ 2346450944 8;
BA_ "GenMsgILSupport" BO_ 2346450944 1;
BA_ "DiagState" BO_ 2346450944 0;
BA_ "DiagRequest" BO_ 2346450944 0;
BA_ "DiagResponse" BO_ 2346450944 0;
BA_ "GenMsgStartValue" BO_ 2346450944 "0";
BA_ "GenMsgStartDelayTime" BO_ 2346450944 0;
BA_ "GenMsgDelayTime" BO_ 2346450944 5;
BA_ "GenMsgNrOfRepetitions" BO_ 2346450944 0;
BA_ "GenMsgCycleTime" BO_ 2346450944 500;
BA_ "GenMsgSendType" BO_ 2346450944 5;
    */
    _HU_State2_AR_Timebase =         c_tDBKomTimer_20ms;
    _HU_State2_AR_CycleCount =     500 / _HU_State2_AR_Timebase;
    _HU_State2_AR_StartDelay =       0 / _HU_State2_AR_Timebase;
    _HU_State2_AR_Cnt = _HU_State2_AR_StartDelay;
    _HU_State2_AR_SpontanFlag = 0;

    putValue( HMI__STMSGSD_HU_State2_AR, _HU_State2_AR_StartDelay * _HU_State2_AR_Timebase );

    _mHU_State2_AR.RaceApp_Avl_HU_AMG.phys = getValue( HMI_RaceApp_Avl_HU_AMG );
}

HU_State2_AR_output(void)
{
    output( _mHU_State2_AR );
}

HU_State2_AR_saveEnvVars( dword hFile )
{
    filePutString("\n// Knoten EIS: HU_State2_AR\n", 36, hFile );
    snprintf( buffer, elcount( buffer ), "0.0000 HMI__STMSG_HU_State2_AR := %X\n", getValue( HMI__STMSG_HU_State2_AR ) );        filePutString ( buffer, elcount( buffer ), hFile );
    snprintf( buffer, elcount( buffer ), "0.0000 HMI__STMSGT_HU_State2_AR := %X\n", getValue( HMI__STMSGT_HU_State2_AR ) );        filePutString ( buffer, elcount( buffer ), hFile );
    snprintf( buffer, elcount( buffer ), "0.0000 HMI_RaceApp_Avl_HU_AMG  := %X\n", getValue( HMI_RaceApp_Avl_HU_AMG ) );        filePutString ( buffer, elcount( buffer ), hFile );
}

on timer _tHU_State2_AR
{
    putValue( HMI__STMSG_HU_State2_AR, 0 );
}

on EnvVar HMI__STMSG_HU_State2_AR
{
    long tDelay;
    if( getValue( this ) == 2 )
    {
        tDelay = getValue( HMI__STMSGT_HU_State2_AR );
        if( tDelay > 0)    
            setTimer( _tHU_State2_AR, tDelay );
        else
            putValue( HMI__STMSG_HU_State2_AR, 0 );
    }
}

on envVar HMI__STMSG_PO_HU_State2_AR
{
    if( getValue( this ) )
        openPanel("HU_State2_AR");
}

on EnvVar HMI_RaceApp_Avl_HU_AMG
{
    _mHU_State2_AR.RaceApp_Avl_HU_AMG.phys = getValue(this);
}

DPC_Sw_HU_AMG_AR_check_output()
{
    if( !getValue( HMI__STMSG_DPC_Sw_HU_AMG_AR ) )
    {
        // Botschaft DPC_Sw_HU_AMG_AR ID: 631 --- Sendeart cyclicAndSpontanWithDelay --- 
        if( _DPC_Sw_HU_AMG_AR_DelayCnt > 0) _DPC_Sw_HU_AMG_AR_DelayCnt--; // Mindestsendeabstand
        _DPC_Sw_HU_AMG_AR_Cnt--;
        if( _DPC_Sw_HU_AMG_AR_Cnt < 1 )
        {
            if( _DPC_Sw_HU_AMG_AR_DelayCnt < 1 )
            {
                // Nachricht wg. abgelaufenem Zyklus ausgeben (Mindestsendeabstand eingehalten)
                DPC_Sw_HU_AMG_AR_output();
                _DPC_Sw_HU_AMG_AR_SpontanFlag = 0; // Spontan-Flag zurücksetzen
                _DPC_Sw_HU_AMG_AR_DelayCnt = _DPC_Sw_HU_AMG_AR_MinDelay;
            }
            else
            {
                // Spontanflag setzen damit nach Ablauf Mindestsendeabstand gesendet wird
                 _DPC_Sw_HU_AMG_AR_SpontanFlag = 1;
            }
            _DPC_Sw_HU_AMG_AR_Cnt = _DPC_Sw_HU_AMG_AR_CycleCount; // Zyklus-Zähler zurücksetzen
        }
        else if( _DPC_Sw_HU_AMG_AR_SpontanFlag)
        {
            if( _DPC_Sw_HU_AMG_AR_DelayCnt < 1 )
            {
                // Nachricht wg. spontaner Änderung ausgeben (Mindestsendeabstand eingehalten)
                DPC_Sw_HU_AMG_AR_output();
                _DPC_Sw_HU_AMG_AR_SpontanFlag = 0; // Spontan-Flag zurücksetzen
                _DPC_Sw_HU_AMG_AR_DelayCnt = _DPC_Sw_HU_AMG_AR_MinDelay;
            }
        }
    }
}

DPC_Sw_HU_AMG_AR_init()
{   /* message DPC_Sw_HU_AMG_AR ID: 631 --- Sendeart cyclicAndSpontanWithDelay --- 
BA_ "ApplMessage" BO_ 631 0;
BA_ "NmAsrMessage" BO_ 631 0;
BA_ "GenMsgMinAcceptLength" BO_ 631 8;
BA_ "GenMsgILSupport" BO_ 631 1;
BA_ "DiagState" BO_ 631 0;
BA_ "DiagRequest" BO_ 631 0;
BA_ "DiagResponse" BO_ 631 0;
BA_ "GenMsgStartValue" BO_ 631 "0";
BA_ "GenMsgStartDelayTime" BO_ 631 20;
BA_ "GenMsgDelayTime" BO_ 631 20;
BA_ "GenMsgNrOfRepetitions" BO_ 631 0;
BA_ "GenMsgCycleTime" BO_ 631 100;
BA_ "GenMsgSendType" BO_ 631 5;
    */
    _DPC_Sw_HU_AMG_AR_Timebase =         c_tDBKomTimer_20ms;
    _DPC_Sw_HU_AMG_AR_CycleCount =      100 / _DPC_Sw_HU_AMG_AR_Timebase;
    _DPC_Sw_HU_AMG_AR_MinDelay =         20 / _DPC_Sw_HU_AMG_AR_Timebase;
    _DPC_Sw_HU_AMG_AR_StartDelay =       20 / _DPC_Sw_HU_AMG_AR_Timebase;
    _DPC_Sw_HU_AMG_AR_Cnt = _DPC_Sw_HU_AMG_AR_StartDelay;
    _DPC_Sw_HU_AMG_AR_SpontanFlag = 0;
    _DPC_Sw_HU_AMG_AR_DelayCnt = 0;

    putValue( HMI__STMSGSD_DPC_Sw_HU_AMG_AR, _DPC_Sw_HU_AMG_AR_StartDelay * _DPC_Sw_HU_AMG_AR_Timebase );

    _mDPC_Sw_HU_AMG_AR.Aero_Sw_HU.phys = getValue( HMI_Aero_Sw_HU );
    _mDPC_Sw_HU_AMG_AR.AGA_Sw_HU.phys = getValue( HMI_AGA_Sw_HU );
    _mDPC_Sw_HU_AMG_AR.Chrg_Sw_Rq_HU_AMG.phys = getValue( HMI_Chrg_Sw_Rq_HU_AMG );
    _mDPC_Sw_HU_AMG_AR.CRC_DPC_Sw_HU.phys = getValue( HMI_CRC_DPC_Sw_HU );
    _mDPC_Sw_HU_AMG_AR.DPC_GlobalMd_Rs_HU_298.phys = getValue( HMI_DPC_GlobalMd_Rs_HU_298 );
    _mDPC_Sw_HU_AMG_AR.DPC_Md_Aero_Rq_HU.phys = getValue( HMI_DPC_Md_Aero_Rq_HU );
    _mDPC_Sw_HU_AMG_AR.ESP_Sw_HU.phys = getValue( HMI_ESP_Sw_HU );
    _mDPC_Sw_HU_AMG_AR.M_Sw_HU.phys = getValue( HMI_M_Sw_HU );
    _mDPC_Sw_HU_AMG_AR.Park_Front_Sw_Rq_HU_AMG.phys = getValue( HMI_Park_Front_Sw_Rq_HU_AMG );
    _mDPC_Sw_HU_AMG_AR.Rsrv0_DPC_Sw_HU.phys = getValue( HMI_Rsrv0_DPC_Sw_HU );
    _mDPC_Sw_HU_AMG_AR.Rsrv1_DPC_Sw_HU.phys = getValue( HMI_Rsrv1_DPC_Sw_HU );
    _mDPC_Sw_HU_AMG_AR.Rsrv6_DPC_Sw_HU.phys = getValue( HMI_Rsrv6_DPC_Sw_HU );
    _mDPC_Sw_HU_AMG_AR.Seat_D_Sw_Rq_HU_AMG.phys = getValue( HMI_Seat_D_Sw_Rq_HU_AMG );
    _mDPC_Sw_HU_AMG_AR.Seat_P_Sw_Rq_HU_AMG.phys = getValue( HMI_Seat_P_Sw_Rq_HU_AMG );
	_mDPC_Sw_HU_AMG_AR.Slick_Sw_Rq_HU_AMG.phys = getValue( HMI_Slick_Sw_Rq_HU_AMG );
    _mDPC_Sw_HU_AMG_AR.SQC_DPC_Sw_HU.phys = getValue( HMI_SQC_DPC_Sw_HU );
    _mDPC_Sw_HU_AMG_AR.Susp_Sw_HU.phys = getValue( HMI_Susp_Sw_HU );
    _mDPC_Sw_HU_AMG_AR.SuspLvl_Sw_HU.phys = getValue( HMI_SuspLvl_Sw_HU );
}

void DPC_Sw_HU_AMG_AR_output(void)
{
    output( _mDPC_Sw_HU_AMG_AR );
}

DPC_Sw_HU_AMG_AR_saveEnvVars( dword hFile )
{
    filePutString("\n// Knoten TGW: DPC_Sw_HU_AMG_AR\n", 25, hFile);
    snprintf( buffer, elcount(buffer), "0.0000 HMI__STMSG_DPC_Sw_HU_AMG_AR := %X\n", getValue( HMI__STMSG_DPC_Sw_HU_AMG_AR ));        filePutString( buffer, elcount(buffer), hFile);
    snprintf( buffer, elcount(buffer), "0.0000 HMI__STMSGT_DPC_Sw_HU_AMG_AR := %X\n", getValue( HMI__STMSGT_DPC_Sw_HU_AMG_AR ));        filePutString( buffer, elcount(buffer), hFile);
    snprintf( buffer, elcount(buffer), "0.0000 HMI_Aero_Sw_HU := %X\n", getValue( HMI_Aero_Sw_HU ) );        filePutString( buffer, elcount(buffer), hFile);
    snprintf( buffer, elcount(buffer), "0.0000 HMI_AGA_Sw_HU := %X\n", getValue( HMI_AGA_Sw_HU ) );        filePutString( buffer, elcount(buffer), hFile);
    snprintf( buffer, elcount(buffer), "0.0000 HMI_Chrg_Sw_Rq_HU_AMG := %X\n", getValue( HMI_Chrg_Sw_Rq_HU_AMG ) );        filePutString( buffer, elcount(buffer), hFile);
    snprintf( buffer, elcount(buffer), "0.0000 HMI_CRC_DPC_Sw_HU := %X\n", getValue( HMI_CRC_DPC_Sw_HU ) );        filePutString( buffer, elcount(buffer), hFile);
    snprintf( buffer, elcount(buffer), "0.0000 HMI_DPC_GlobalMd_Rs_HU_298 := %X\n", getValue( HMI_DPC_GlobalMd_Rs_HU_298 ) );        filePutString( buffer, elcount(buffer), hFile);
    snprintf( buffer, elcount(buffer), "0.0000 HMI_DPC_Md_Aero_Rq_HU := %X\n", getValue( HMI_DPC_Md_Aero_Rq_HU ) );        filePutString( buffer, elcount(buffer), hFile);
    snprintf( buffer, elcount(buffer), "0.0000 HMI_ESP_Sw_HU := %X\n", getValue( HMI_ESP_Sw_HU ) );        filePutString( buffer, elcount(buffer), hFile);
    snprintf( buffer, elcount(buffer), "0.0000 HMI_M_Sw_HU := %X\n", getValue( HMI_M_Sw_HU ) );        filePutString( buffer, elcount(buffer), hFile);
    snprintf( buffer, elcount(buffer), "0.0000 HMI_Park_Front_Sw_Rq_HU_AMG := %X\n", getValue( HMI_Park_Front_Sw_Rq_HU_AMG ) );        filePutString( buffer, elcount(buffer), hFile);
    snprintf( buffer, elcount(buffer), "0.0000 HMI_Rsrv0_DPC_Sw_HU := %X\n", getValue( HMI_Rsrv0_DPC_Sw_HU ) );        filePutString( buffer, elcount(buffer), hFile);
    snprintf( buffer, elcount(buffer), "0.0000 HMI_Rsrv1_DPC_Sw_HU := %X\n", getValue( HMI_Rsrv1_DPC_Sw_HU ) );        filePutString( buffer, elcount(buffer), hFile);
    snprintf( buffer, elcount(buffer), "0.0000 HMI_Rsrv6_DPC_Sw_HU := %X\n", getValue( HMI_Rsrv6_DPC_Sw_HU ) );        filePutString( buffer, elcount(buffer), hFile);
    snprintf( buffer, elcount(buffer), "0.0000 HMI_Seat_D_Sw_Rq_HU_AMG := %X\n", getValue( HMI_Seat_D_Sw_Rq_HU_AMG ) );        filePutString( buffer, elcount(buffer), hFile);
    snprintf( buffer, elcount(buffer), "0.0000 HMI_Seat_P_Sw_Rq_HU_AMG := %X\n", getValue( HMI_Seat_P_Sw_Rq_HU_AMG ) );        filePutString( buffer, elcount(buffer), hFile);
    snprintf( buffer, elcount(buffer), "0.0000 HMI_Slick_Sw_Rq_HU_AMG := %X\n", getValue( HMI_Slick_Sw_Rq_HU_AMG ) );        filePutString( buffer, elcount(buffer), hFile);
	snprintf( buffer, elcount(buffer), "0.0000 HMI_SQC_DPC_Sw_HU := %X\n", getValue( HMI_SQC_DPC_Sw_HU ) );        filePutString( buffer, elcount(buffer), hFile);
    snprintf( buffer, elcount(buffer), "0.0000 HMI_Susp_Sw_HU := %X\n", getValue( HMI_Susp_Sw_HU ) );        filePutString( buffer, elcount(buffer), hFile);
    snprintf( buffer, elcount(buffer), "0.0000 HMI_SuspLvl_Sw_HU := %X\n", getValue( HMI_SuspLvl_Sw_HU ) );        filePutString( buffer, elcount(buffer), hFile);
}

on timer _tDPC_Sw_HU_AMG_AR
{
    putValue( HMI__STMSG_DPC_Sw_HU_AMG_AR, 0 );
}

on EnvVar HMI__STMSG_DPC_Sw_HU_AMG_AR
{
    long tDelay;
    if( getValue( this ) == 2 )
    {
        tDelay = getValue( HMI__STMSGT_DPC_Sw_HU_AMG_AR );
        if( tDelay > 0 )    
            setTimer( _tDPC_Sw_HU_AMG_AR, tDelay );
        else
            putValue( HMI__STMSG_DPC_Sw_HU_AMG_AR, 0 );
    }
}

on envVar HMI__STMSG_PO_DPC_Sw_HU_AMG_AR
{
    if( getValue( this ) )
        openPanel("DPC_Sw_HU_AMG_AR");
}

on EnvVar HMI_Aero_Sw_HU
{
    _mDPC_Sw_HU_AMG_AR.Aero_Sw_HU.phys = getValue(this);
    _DPC_Sw_HU_AMG_AR_SpontanFlag = 1;
}

on EnvVar HMI_AGA_Sw_HU
{
    _mDPC_Sw_HU_AMG_AR.AGA_Sw_HU.phys = getValue(this);
    _DPC_Sw_HU_AMG_AR_SpontanFlag = 1;
}

on EnvVar HMI_Chrg_Sw_Rq_HU_AMG
{
    _mDPC_Sw_HU_AMG_AR.Chrg_Sw_Rq_HU_AMG.phys = getValue(this);
    _DPC_Sw_HU_AMG_AR_SpontanFlag = 1;
}

on EnvVar HMI_DPC_GlobalMd_Rs_HU_298
{
    _mDPC_Sw_HU_AMG_AR.DPC_GlobalMd_Rs_HU_298.phys = getValue(this);
    _DPC_Sw_HU_AMG_AR_SpontanFlag = 1;
}

on EnvVar HMI_CRC_DPC_Sw_HU
{
    _mDPC_Sw_HU_AMG_AR.CRC_DPC_Sw_HU.phys = getValue(this);
    _DPC_Sw_HU_AMG_AR_SpontanFlag = 1;
}

on EnvVar HMI_DPC_Md_Aero_Rq_HU
{
    _mDPC_Sw_HU_AMG_AR.DPC_Md_Aero_Rq_HU.phys = getValue(this);
    _DPC_Sw_HU_AMG_AR_SpontanFlag = 1;
}

on EnvVar HMI_ESP_Sw_HU
{
    _mDPC_Sw_HU_AMG_AR.ESP_Sw_HU.phys = getValue(this);
    _DPC_Sw_HU_AMG_AR_SpontanFlag = 1;
}

on EnvVar HMI_M_Sw_HU
{
    _mDPC_Sw_HU_AMG_AR.M_Sw_HU.phys = getValue(this);
    _DPC_Sw_HU_AMG_AR_SpontanFlag = 1;
}

on EnvVar HMI_Park_Front_Sw_Rq_HU_AMG
{
    _mDPC_Sw_HU_AMG_AR.Park_Front_Sw_Rq_HU_AMG.phys = getValue(this);
    _DPC_Sw_HU_AMG_AR_SpontanFlag = 1;
}

on EnvVar HMI_Rsrv0_DPC_Sw_HU
{
    _mDPC_Sw_HU_AMG_AR.Rsrv0_DPC_Sw_HU.phys = getValue(this);
    _DPC_Sw_HU_AMG_AR_SpontanFlag = 1;
}

on EnvVar HMI_Rsrv1_DPC_Sw_HU
{
    _mDPC_Sw_HU_AMG_AR.Rsrv1_DPC_Sw_HU.phys = getValue(this);
    _DPC_Sw_HU_AMG_AR_SpontanFlag = 1;
}

on EnvVar HMI_Rsrv6_DPC_Sw_HU
{
    _mDPC_Sw_HU_AMG_AR.Rsrv6_DPC_Sw_HU.phys = getValue(this);
    _DPC_Sw_HU_AMG_AR_SpontanFlag = 1;
}

on EnvVar HMI_Seat_D_Sw_Rq_HU_AMG
{
    _mDPC_Sw_HU_AMG_AR.Seat_D_Sw_Rq_HU_AMG.phys = getValue(this);
    _DPC_Sw_HU_AMG_AR_SpontanFlag = 1;
}

on EnvVar HMI_Seat_P_Sw_Rq_HU_AMG
{
    _mDPC_Sw_HU_AMG_AR.Seat_P_Sw_Rq_HU_AMG.phys = getValue(this);
    _DPC_Sw_HU_AMG_AR_SpontanFlag = 1;
}

on EnvVar HMI_Slick_Sw_Rq_HU_AMG
{
    _mDPC_Sw_HU_AMG_AR.Slick_Sw_Rq_HU_AMG.phys = getValue(this);
    _DPC_Sw_HU_AMG_AR_SpontanFlag = 1;
}

on EnvVar HMI_SQC_DPC_Sw_HU
{
    _mDPC_Sw_HU_AMG_AR.SQC_DPC_Sw_HU.phys = getValue(this);
    _DPC_Sw_HU_AMG_AR_SpontanFlag = 1;
}

on EnvVar HMI_Susp_Sw_HU
{
    _mDPC_Sw_HU_AMG_AR.Susp_Sw_HU.phys = getValue(this);
    _DPC_Sw_HU_AMG_AR_SpontanFlag = 1;
}

on EnvVar HMI_SuspLvl_Sw_HU
{
    _mDPC_Sw_HU_AMG_AR.SuspLvl_Sw_HU.phys = getValue(this);
    _DPC_Sw_HU_AMG_AR_SpontanFlag = 1;
}