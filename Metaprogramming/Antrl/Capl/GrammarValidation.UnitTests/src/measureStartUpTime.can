/*@!Encoding:1252*/

/**
 * Project: BMZ BMS - 5191
 * \file   measureStartUpTime.can
 * \author  Johannes Raab
 * \brief   Startup-Zeiten Messung Linde
 * 27.10.2015
 *
 * copyright (c) 2014 Preh GmbH all rights reserved.
 */

/* ----------------------------------------------------------------------------
 Affected documents:
 -------------------
 If appropriate further applicable documents incl. their version's information
 should be referenced. Especially a reference to corresponding specifications
 shall be given.

 Information for the configuration management-system:
 ----------------------------------------------------
 Repository path and filename:
 $Archive: BMZ_BMS/06_Software/10_Common/04_CAN/CANoe/measureStartUpTime.can$
 Workfile:                      
 $Workfile: measureStartUpTime.can$
 Branch:                        
 $Branch: BMZ_BMS$

 Documentation of modifications:
 -------------------------------
 (it will generated automatically during Check-In into the configuration management tool)
 $Revision: 2$
 $Date: Tuesday, October 27, 2015 14:00:04$
 
 $Log$
 RaabJ - Tuesday, October 27, 2015 14:00:04
 -Startup-Time Messung fuer Integrationstest hinzu

 */

includes
{
  
}

variables
{
  dword timestart;
  dword timestop;
  byte ucState;
  byte BMS_State;
  const byte STATE_IDLE = 0;
  const byte STATE_START_UP_READY = 1;
  const byte STATE_START_UP_RUN = 2;
  
  const byte BMS_STATE_READY = 0x4;
  const byte BMS_STATE_RUN = 0x10;
  
  message 0x60D mSDO;
  msTimer msTDelay;
}

on envVar StartupTimeTestReady {
  if (getValue(StartupTimeTestReady) == 1)
  {
    ucState = STATE_START_UP_READY;
    putValue(normalOperationEnable, 0);
    putValue(normalOperationEnable, 1);
    timestart = timeNow();
  }
}

on envVar StartupTimeTestRun {
  if (getValue(StartupTimeTestRun) == 1)
  {
    ucState = STATE_START_UP_RUN;
    putValue(normalOperationEnable, 0);
    putValue(normalOperationEnable, 1);
    timestart = timeNow();
  }
}

on envVar goToSleep {
  if (getValue(this) == 1){
    putValue(normalOperationEnable, 0);
    setTimer(msTDelay, 600);
  }
}

on timer msTDelay{
  sendSleepSDO();
}
on message LiIoBMS_PDO1 {
  
  if (ucState == STATE_START_UP_READY) {
    if (this.LiIoBMS_BatteryStatus == BMS_STATE_READY) {
      timestop = timeNow();
      putValueToControl("StartUpTimeTest","measTimeReadyLinde", (float)((timestop - timestart) /100.0));
      ucState = STATE_IDLE;
    }
  }
  else if (ucState == STATE_START_UP_RUN) {
    if (this.LiIoBMS_BatteryStatus != BMS_STATE_RUN) {
      sendRunSDO();
    }
    else {
      timestop = timeNow();
      putValueToControl("StartUpTimeTest","measTimeRunLinde", (float)((timestop - timestart) /100.0));
      ucState = STATE_IDLE;
    }
  }
  else {}
  
}

void sendSleepSDO (void)
{
  mSDO.DLC = 8;
  mSDO.byte(0) = 0x2F;
  mSDO.byte(1) = 0x09;
  mSDO.byte(2) = 0x26;
  mSDO.byte(3) = 0x04;
  mSDO.byte(4) = 1;
  output(mSDO);
}

void sendRunSDO (void)
{
  mSDO.DLC = 8;
  mSDO.byte(0) = 0x2F;
  mSDO.byte(1) = 0x00;
  mSDO.byte(2) = 0x22;
  mSDO.byte(3) = 0x01;
  mSDO.byte(4) = 1;
  output(mSDO);
}

