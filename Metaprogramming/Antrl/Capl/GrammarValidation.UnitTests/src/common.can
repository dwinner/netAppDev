/*@@var:*/
variables
{
 
  word LastKey = 0; 

 
  msTimer KeyReleaseTimer;
}
/*@@end*/

/*@@key:PageUp:*/
on key PageUp 
{
 @eKeyWheelEventCodeLeft_P1=1;
 LastKey = keypressed();
 if(!isTimerActive(KeyReleaseTimer))
   setTimer(KeyReleaseTimer,100);


}
/*@@end*/

/*@@key:PageDown:*/
on key PageDown
{
@eKeyWheelEventCodeLeft_M1=1;
LastKey = keypressed();
 if(!isTimerActive(KeyReleaseTimer))
    setTimer(KeyReleaseTimer,100);

}
/*@@end*/

/*@@key:'m':*/
on key 'm'
{
 @eKeyMenuState=1;
 LastKey = keypressed();
 if(!isTimerActive(KeyReleaseTimer))
   setTimer(KeyReleaseTimer,100);

}
/*@@end*/

/*@@timer:KeyReleaseTimer:*/
on timer KeyReleaseTimer
{
  write("Release Key: %d",LastKey);
  switch(LastKey)
  {



   case CursorUp   : @eKeyUpState=0;break;//Taste up 
   case CursorDown : @eKeyDownState=0;break;//Taste down
   case CursorRight: @eKeyMenuUpState=0;break;//Taste right
   case CursorLeft : @eKeyMenuDownState=0;break;//Taste left
   case PageUp     : @eKeyWheelEventCodeLeft_P1=0;break;//Taste m
   case PageDown   : @eKeyWheelEventCodeLeft_M1=0;break;//Taste m
   case 0xD        : @eKeyOkWheelLeftState=0; break;//Taste Enter
   case 'm'        : @eKeyMenuState=0;break;//Taste m
   case 'M'        : @eKeyMenuState=0;break;//Taste m

   default: break;
   }
   LastKey=0;
   cancelTimer( KeyReleaseTimer );
}
/*@@end*/

/*@@key:End:*/
on key 0x4F00
{
 if(@eNMHControllerNodeAwake)
   @eNMHControllerNodeAwake=0;
 else
   @eNMHControllerNodeAwake=1;

}
/*@@end*/

/*@@key:Home:*/
on key 0x4700
{
  if(@eZAS_Kl_15S==1)
    @eZAS_Kl_15S=0;
  else
    @eZAS_Kl_15S=1;

}
/*@@end*/

