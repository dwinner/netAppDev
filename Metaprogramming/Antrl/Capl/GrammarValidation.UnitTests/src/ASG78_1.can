/*@!Encoding:1252*/
includes
{
    #include "..\..\..\_DLL\latest_BAP_DLL.cin"
}

variables
{
	char  dbc_path[255] = "BAP\\_DBC\\BAP_only_MQB_MLBevo_v1.50.dbc";
	char  xml_path[255] = "BAP\\RemoteServices_P30DF31_V1.10_ASG78_1\\asg78_1\\bapxml\\BAP_SW17_RemoteServices_P30DF31_ASG_01_v1.0.xml";

	//@BAPSIMGEN_VAR_SECTION_BEGIN

	/***************************************************/
	/*            BapSimGen ASG template               */
	/***************************************************/

	/************** Ausgabe Konsolen (Traces) ***********/
	dword gBAP_Trace;
	dword gError_Trace;

	/************** Node Verwaltung ***************/
	//Power on/off
	byte gSG_PowerOnOff=0x01;     // wird mit Power_off/on gesetzt
	byte gBAP_Init=0;             // schon mal initialisiert?

	const Power_off = 0x00;
	const Power_on	= 0x01;

	mstimer TaskTimer;				//real communication timer

	/************** Request **************/
	const Requestbuffer_lines = 100;
	const BAP_buffer_size = 4096;

	/************ Speichern von Requests im "Ringbuffer" ***********/
	int   gBAP_Requestbuffer_status     [Requestbuffer_lines];		            // 0: kein Eintrag, 1:pending
	dword gBAP_Request_header			[Requestbuffer_lines] [6];				// beinhaltet auch skalare Daten
	dword gBAP_Request_data             [Requestbuffer_lines] [BAP_buffer_size];// ringbuffer Eintrag fuer BAP-Request


	/************** Indication **************/
	// enthaelt die derzeitige Indication
	dword gBAP_Indication_header[6];	
	byte  gBAP_Indication_data[BAP_buffer_size];		

	/************** Konstanten ****************/

	//BAP Data Type 
	const Bap_void				=0;
	const Bap_uint8				=1;
	const Bap_uint16			=2;
	const Bap_uint32			=3;
	const Bap_byteSequence		=4;
	const Bap_error				=5;
	const Bap_acknowledge		=6;

	char Datatype_Text[7][20] =
	{
		"void", "uint8", "uint16", "uint32", "byteSequence", "error", "acknowledge"
	};

	//BAP request types
	const DataSetGet_REQ  = 0x00;
	const DataSet_REQ	  = 0x01;
	const DataGet_REQ	  = 0x02;
	const Data_REQ		  = 0x03;
	const Changed_REQ	  = 0x04;
	const Start_REQ		  = 0x05;
	const StartResult_REQ = 0x06;
	const AbortResult_REQ = 0x07;
	const Processing_REQ  = 0x08;
	const Result_REQ      = 0x09;
	const DataAck_REQ     = 0x0A;
	const Ack_REQ         = 0x0B;
	const Invalid_REQ     = 0x1F;      // Interne Kennzeichnung fuer einen ungueltigen Request

	//eigene Error-Definition
	const Error_REQ=0x20;

	char Requesttype_Text[33][30] =
	{
		"DataSetGet_REQ", "DataSet_REQ", "DataGet_REQ", "Data_REQ",			/* 00 .. 03 */
		"Changed_REQ", "Start_REQ", "StartResult_REQ", "AbortResult_REQ",   /* 04 .. 07 */
		"Processing_REQ", "Result_REQ", "DataAck_REQ", "Ack_REQ", 			/* 08 .. 0b */
		"Invalid_REQ", "Invalid_REQ", "Invalid_REQ", "Invalid_REQ",  		/* 0c .. 0f */
		"Invalid_REQ", "Invalid_REQ", "Invalid_REQ", "Invalid_REQ",  		/* 10 .. 13 */
		"Invalid_REQ", "Invalid_REQ", "Invalid_REQ", "Invalid_REQ",  		/* 14 .. 17 */
		"Invalid_REQ", "Invalid_REQ", "Invalid_REQ", "Invalid_REQ", 		/* 18 .. 1b */
		"Invalid_REQ", "Invalid_REQ", "Invalid_REQ", "Invalid_REQ",  		/* 1c .. 1f */
		"Error_REQ"	  														/* 20 */
	};

	//BAP indication types
	const Data_IND			 = 0x00;
	const Reset_IND			 = 0x01;
	const DataAck_IND        = 0x02;
	const Result_IND		 = 0x03;
	const Processing_IND	 = 0x04;
  	const Changed_IND		 = 0x05;
  	const DataSetGet_IND	 = 0x06;
	const DataSet_IND		 = 0x07;
	const DataGet_IND		 = 0x08;
	const Ack_IND            = 0x09;
	const Processing_CNF_IND = 0x0A;
	const Start_IND			 = 0x0B;
	const StartResult_IND	 = 0x0C;
	const AbortResult_IND	 = 0x0D;
	const Invalid_IND		 = 0x1F; // Kennzeichnung fuer eine ungueltige Indication
	const Error_IND			 = 0x20;
	
	char Indicationtype_Text[33][30] =
	{
		"Data_IND", "Reset_IND", "DataAck_IND", "Result_IND",			 	/* 00 .. 03 */
		"Processing_IND", "Changed_IND", "DataSetGet_IND", "DataSet_IND", 	/* 04 .. 07 */
		"DataGet_IND", "Ack_IND", "Processing_CNF_IND", "Start_REQ",	 	/* 08 .. 0b */
		"StartResult_REQ", "AbortResult_REQ", "Invalid_REQ", "Invalid_REQ", /* 0c .. 0f */
		"Invalid_REQ", "Invalid_REQ", "Invalid_REQ", "Invalid_REQ",  		/* 10 .. 13 */
		"Invalid_REQ", "Invalid_REQ", "Invalid_REQ", "Invalid_REQ",  		/* 14 .. 17 */
		"Invalid_REQ", "Invalid_REQ", "Invalid_REQ", "Invalid_REQ", 		/* 18 .. 1b */
		"Invalid_REQ", "Invalid_REQ", "Invalid_REQ", "Invalid_REQ",  		/* 1c .. 1f */
		"Error_REQ"	  														/* 20 */
	};	
	
	char Acknowledgetype_Text[24][30] =
	{
		"Property_SetGet_ACK", "Array_SetGet_ACK", "Property_Set_ACK", "Array_Set_ACK",  			/* 00 .. 03 */
		"Method_Start_ACK", "Method_StartResult_ACK", "Method_AbortResult_ACK", "Property_Get_ACK",	/* 04 .. 07 */
		"Array_Get_ACK", "Cache_GetAll_ACK", "Property_Ack_ACK", "Property_Status_ACK",	   			/* 08 .. 0b */
		"Property_StatusAck_ACK", "Property_Error_ACK", "Array_Status_ACK", "Array_Changed_ACK",	/* 0c .. 0f */
		"Array_Error_ACK", "Method_Processing_ACK", "Method_Result_ACK", "Method_Error_ACK",  		/* 10 .. 13 */
		"Unknown_ACK", "Unknown_ACK", "Unknown_ACK", "Unknown_ACK"									/* 14 .. 17 */
	};

	/**************************** Global Function-ID's ******************************/
	/** TODO: already_pressed kann zwischen den Funktionen geshared werden          */

	byte already_pressed = 0;

	const FctID_GetAll									= 0x01;
	const FctID_BAP_Config								= 0x02;
	const FctID_FunctionList							= 0x03;
	const FctID_HeartBeat								= 0x04;
    
    char SGtype[4]="ASG";

	dword NODE_INDEX                =  0;
	char  NODE_NAME[100]            = "RemoteServices";
	const LSGID                     = 78;
	char  panel_name[100]           = "ASG78_1";
	char  bapconfig_panel_name[100]    = "panel1";
	char  common_panel_name[100]    = "panel2";
	const TaskTime                  = 10;
	const heartBeatFactor                               = 5;
	 const C_ASG_78_1_0_1_ID = 1;
	 byte C_ASG_78_1_0_1GetAll_BTN_already_pressed = 0;
	 char gCheckbox1[100] = "checkbox_C_ASG_78_1_0_1";
	 char gErrField1[100] = "errfield_C_ASG_78_1_0_1";
	 byte gC_ASG_78_1_0_1_ErrCode = 1;
	 const P_ASG_78_1_0_2_ID = 2;
	 byte P_ASG_78_1_0_2Get_BTN_already_pressed = 0;
	 char gCheckbox2[100] = "checkbox_P_ASG_78_1_0_2";
	 char gErrField2[100] = "errfield_P_ASG_78_1_0_2";
	 byte gP_ASG_78_1_0_2_ErrCode = 1;
	 const P_ASG_78_1_0_3_ID = 3;
	 byte P_ASG_78_1_0_3Get_BTN_already_pressed = 0;
	 char gCheckbox3[100] = "checkbox_P_ASG_78_1_0_3";
	 char gErrField3[100] = "errfield_P_ASG_78_1_0_3";
	 byte gP_ASG_78_1_0_3_ErrCode = 1;
	 const P_ASG_78_1_0_4_ID = 4;
	 byte P_ASG_78_1_0_4Get_BTN_already_pressed = 0;
	 char gCheckbox4[100] = "checkbox_P_ASG_78_1_0_4";
	 char gErrField4[100] = "errfield_P_ASG_78_1_0_4";
	 byte gP_ASG_78_1_0_4_ErrCode = 1;
	 const P_ASG_78_1_0_13_ID = 13;
	 byte P_ASG_78_1_0_13Get_BTN_already_pressed = 0;
	 byte P_ASG_78_1_0_13SetGet_BTN_already_pressed = 0;
	 char gCheckbox13[100] = "checkbox_P_ASG_78_1_0_13";
	 char gErrField13[100] = "errfield_P_ASG_78_1_0_13";
	 byte gP_ASG_78_1_0_13_ErrCode = 1;
	 char gPanel13[100] = "panel_P_ASG_78_1_0_13";
	 const P_ASG_78_1_0_14_ID = 14;
	 byte P_ASG_78_1_0_14Get_BTN_already_pressed = 0;
	 char gCheckbox14[100] = "checkbox_P_ASG_78_1_0_14";
	 char gErrField14[100] = "errfield_P_ASG_78_1_0_14";
	 byte gP_ASG_78_1_0_14_ErrCode = 1;
	 char gPanel14[100] = "panel_P_ASG_78_1_0_14";
	 const P_ASG_78_1_0_15_ID = 15;
	 byte P_ASG_78_1_0_15Get_BTN_already_pressed = 0;
	 char gCheckbox15[100] = "checkbox_P_ASG_78_1_0_15";
	 char gErrField15[100] = "errfield_P_ASG_78_1_0_15";
	 byte gP_ASG_78_1_0_15_ErrCode = 1;
	 char gPanel15[100] = "panel_P_ASG_78_1_0_15";
	 const M_ASG_78_1_0_16_ID = 16;
	 byte M_ASG_78_1_0_16AbortResult_BTN_already_pressed = 0;
	 byte M_ASG_78_1_0_16StartResult_BTN_already_pressed = 0;
	 char gCheckbox16[100] = "checkbox_M_ASG_78_1_0_16";
	 char gErrField16[100] = "errfield_M_ASG_78_1_0_16";
	 byte gM_ASG_78_1_0_16_ErrCode = 1;
	 char gPanel16[100] = "panel_M_ASG_78_1_0_16";
	 const P_ASG_78_1_0_17_ID = 17;
	 byte P_ASG_78_1_0_17Get_BTN_already_pressed = 0;
	 char gCheckbox17[100] = "checkbox_P_ASG_78_1_0_17";
	 char gErrField17[100] = "errfield_P_ASG_78_1_0_17";
	 byte gP_ASG_78_1_0_17_ErrCode = 1;
	 char gPanel17[100] = "panel_P_ASG_78_1_0_17";
	 const P_ASG_78_1_0_18_ID = 18;
	 byte P_ASG_78_1_0_18Get_BTN_already_pressed = 0;
	 byte P_ASG_78_1_0_18Set_BTN_already_pressed = 0;
	 char gCheckbox18[100] = "checkbox_P_ASG_78_1_0_18";
	 char gErrField18[100] = "errfield_P_ASG_78_1_0_18";
	 byte gP_ASG_78_1_0_18_ErrCode = 1;
	 char gPanel18[100] = "panel_P_ASG_78_1_0_18";
	 const M_ASG_78_1_0_19_ID = 19;
	 byte M_ASG_78_1_0_19AbortResult_BTN_already_pressed = 0;
	 byte M_ASG_78_1_0_19StartResult_BTN_already_pressed = 0;
	 char gCheckbox19[100] = "checkbox_M_ASG_78_1_0_19";
	 char gErrField19[100] = "errfield_M_ASG_78_1_0_19";
	 byte gM_ASG_78_1_0_19_ErrCode = 1;
	 char gPanel19[100] = "panel_M_ASG_78_1_0_19";
	 const P_ASG_78_1_0_20_ID = 20;
	 byte P_ASG_78_1_0_20Get_BTN_already_pressed = 0;
	 char gCheckbox20[100] = "checkbox_P_ASG_78_1_0_20";
	 char gErrField20[100] = "errfield_P_ASG_78_1_0_20";
	 byte gP_ASG_78_1_0_20_ErrCode = 1;
	 char gPanel20[100] = "panel_P_ASG_78_1_0_20";
	 const P_ASG_78_1_0_21_ID = 21;
	 byte P_ASG_78_1_0_21Get_BTN_already_pressed = 0;
	 byte P_ASG_78_1_0_21Set_BTN_already_pressed = 0;
	 char gCheckbox21[100] = "checkbox_P_ASG_78_1_0_21";
	 char gErrField21[100] = "errfield_P_ASG_78_1_0_21";
	 byte gP_ASG_78_1_0_21_ErrCode = 1;
	 char gPanel21[100] = "panel_P_ASG_78_1_0_21";
	 const P_ASG_78_1_0_22_ID = 22;
	 byte P_ASG_78_1_0_22Get_BTN_already_pressed = 0;
	 char gCheckbox22[100] = "checkbox_P_ASG_78_1_0_22";
	 char gErrField22[100] = "errfield_P_ASG_78_1_0_22";
	 byte gP_ASG_78_1_0_22_ErrCode = 1;
	 char gPanel22[100] = "panel_P_ASG_78_1_0_22";
	 const P_ASG_78_1_0_23_ID = 23;
	 byte P_ASG_78_1_0_23Get_BTN_already_pressed = 0;
	 byte P_ASG_78_1_0_23SetGet_BTN_already_pressed = 0;
	 char gCheckbox23[100] = "checkbox_P_ASG_78_1_0_23";
	 char gErrField23[100] = "errfield_P_ASG_78_1_0_23";
	 byte gP_ASG_78_1_0_23_ErrCode = 1;
	 char gPanel23[100] = "panel_P_ASG_78_1_0_23";
	 const M_ASG_78_1_0_24_ID = 24;
	 byte M_ASG_78_1_0_24AbortResult_BTN_already_pressed = 0;
	 byte M_ASG_78_1_0_24StartResult_BTN_already_pressed = 0;
	 char gCheckbox24[100] = "checkbox_M_ASG_78_1_0_24";
	 char gErrField24[100] = "errfield_M_ASG_78_1_0_24";
	 byte gM_ASG_78_1_0_24_ErrCode = 1;
	 char gPanel24[100] = "panel_M_ASG_78_1_0_24";
	 const M_ASG_78_1_0_25_ID = 25;
	 byte M_ASG_78_1_0_25AbortResult_BTN_already_pressed = 0;
	 byte M_ASG_78_1_0_25StartResult_BTN_already_pressed = 0;
	 char gCheckbox25[100] = "checkbox_M_ASG_78_1_0_25";
	 char gErrField25[100] = "errfield_M_ASG_78_1_0_25";
	 byte gM_ASG_78_1_0_25_ErrCode = 1;
	 char gPanel25[100] = "panel_M_ASG_78_1_0_25";


	/// Begin: Definition der BUS-Schnittstellen
	
	// FLEXRAY NOT ENABLED!
	
	// ETHERNET NOT ENABLED! 
	
	//// End Bus Schnittstellen
}

on preStart
{
	char Version[200];
	char Path[255];

	/***** Erzeugen der Ausgabeconsolen *****/	
	gBAP_Trace=writecreate("BAP-Trace");		//write-window for BAP-cummunication
	writeclear(gBAP_Trace);						//clear BAP-window in write-window
	
	gError_Trace=writecreate("Error");			//error-window for BAP-cummunication
	writeclear(gError_Trace);					//clear error-window in write-window
	
	writeclear(1);								//clear CAPL-window in write-window
	
	/**** Versionsstring von DLL holen und auf Bildschirm ausgeben ***/	
	BAP150_GetVersions(Version, 200);
	writelineEx(gBAP_Trace, 0, "Versionx:%s", Version);
											
    NODE_INDEX = BAP150_CreateNode();
    writelineEx(gBAP_Trace, 0, "ASG %d Nodeindex:%d", LSGID, Version);
    
	/**** Laden der CANoe Datenbank *****/
	getAbsFilePath(dbc_path, Path, 255);
	writelineEx(gBAP_Trace, 0, "Load BAP_DBC-File: %s", Path);
	if(BAP150_LoadDBC(NODE_INDEX, 1, Path)  != 0) {		writelineEx(gError_Trace, 0, "Fehler beim Laden: %s !", Path);
	}

	/**** Laden des BAP XML Files ****/
	getAbsFilePath(xml_path, Path, 255);
	writelineEx(gBAP_Trace, 0, "Load BAP-XML-File: %s", Path);
	if (BAP150_LoadConfig(NODE_INDEX, Path) != 0) {
	    writelineEx(gError_Trace, 0, "Fehler beim Laden: %s !", Path);
	}

	if (BAP150_AddCanMap(NODE_INDEX, 1, 1) != 0) {
		writelineEx(gError_Trace, 0, "Fehler beim Mappen!");
	}
	
	// FLEXRAY NOT ENABLED!
	
}

DisableFctCtrl ()
{
  	EnableControl(panel_name, common_panel_name, 0);
	EnableControl(panel_name,gErrField1,0);
	EnableControl(panel_name,gErrField2,0);
	EnableControl(panel_name,gErrField3,0);
	EnableControl(panel_name,gErrField4,0);
	EnableControl(panel_name,gErrField13,0);
	EnableControl(panel_name,gPanel13,0);
	EnableControl(panel_name,"panel_P_ASG_78_1_0_13",0);
	EnableControl(panel_name,gErrField14,0);
	EnableControl(panel_name,gPanel14,0);
	EnableControl(panel_name,"panel_P_ASG_78_1_0_14",0);
	EnableControl(panel_name,gErrField15,0);
	EnableControl(panel_name,gPanel15,0);
	EnableControl(panel_name,"panel_P_ASG_78_1_0_15",0);
	EnableControl(panel_name,gErrField16,0);
	EnableControl(panel_name,gPanel16,0);
	EnableControl(panel_name,"panel_M_ASG_78_1_0_16_Result",0);
	EnableControl(panel_name,"panel_M_ASG_78_1_0_16_Processing",0);
	EnableControl(panel_name,"panel_M_ASG_78_1_0_16_Start",0);
	EnableControl(panel_name,gErrField17,0);
	EnableControl(panel_name,gPanel17,0);
	EnableControl(panel_name,"panel_P_ASG_78_1_0_17",0);
	EnableControl(panel_name,gErrField18,0);
	EnableControl(panel_name,gPanel18,0);
	EnableControl(panel_name,"panel_P_ASG_78_1_0_18",0);
	EnableControl(panel_name,gErrField19,0);
	EnableControl(panel_name,gPanel19,0);
	EnableControl(panel_name,"panel_M_ASG_78_1_0_19_Result",0);
	EnableControl(panel_name,"panel_M_ASG_78_1_0_19_Processing",0);
	EnableControl(panel_name,"panel_M_ASG_78_1_0_19_Start",0);
	EnableControl(panel_name,gErrField20,0);
	EnableControl(panel_name,gPanel20,0);
	EnableControl(panel_name,"panel_P_ASG_78_1_0_20",0);
	EnableControl(panel_name,gErrField21,0);
	EnableControl(panel_name,gPanel21,0);
	EnableControl(panel_name,"panel_P_ASG_78_1_0_21",0);
	EnableControl(panel_name,gErrField22,0);
	EnableControl(panel_name,gPanel22,0);
	EnableControl(panel_name,"panel_P_ASG_78_1_0_22",0);
	EnableControl(panel_name,gErrField23,0);
	EnableControl(panel_name,gPanel23,0);
	EnableControl(panel_name,"panel_P_ASG_78_1_0_23",0);
	EnableControl(panel_name,gErrField24,0);
	EnableControl(panel_name,gPanel24,0);
	EnableControl(panel_name,"panel_M_ASG_78_1_0_24_Result",0);
	EnableControl(panel_name,"panel_M_ASG_78_1_0_24_Processing",0);
	EnableControl(panel_name,"panel_M_ASG_78_1_0_24_Start",0);
	EnableControl(panel_name,gErrField25,0);
	EnableControl(panel_name,gPanel25,0);
	EnableControl(panel_name,"panel_M_ASG_78_1_0_25_Result",0);
	EnableControl(panel_name,"panel_M_ASG_78_1_0_25_Processing",0);
	EnableControl(panel_name,"panel_M_ASG_78_1_0_25_Start",0);

}

EnableFctCtrl ()
{
  	EnableControl(panel_name, common_panel_name, 1);
		 EnableControl(panel_name,gPanel13,1);
		 EnableControl(panel_name,gErrField13,1);
		 EnableControl(panel_name,gPanel14,1);
		 EnableControl(panel_name,gErrField14,1);
		 EnableControl(panel_name,gPanel15,1);
		 EnableControl(panel_name,gErrField15,1);
		 EnableControl(panel_name,gPanel16,1);
		 EnableControl(panel_name,gErrField16,1);
		 EnableControl(panel_name,gPanel17,1);
		 EnableControl(panel_name,gErrField17,1);
		 EnableControl(panel_name,gPanel18,1);
		 EnableControl(panel_name,gErrField18,1);
		 EnableControl(panel_name,gPanel19,1);
		 EnableControl(panel_name,gErrField19,1);
		 EnableControl(panel_name,gPanel20,1);
		 EnableControl(panel_name,gErrField20,1);
		 EnableControl(panel_name,gPanel21,1);
		 EnableControl(panel_name,gErrField21,1);
		 EnableControl(panel_name,gPanel22,1);
		 EnableControl(panel_name,gErrField22,1);
		 EnableControl(panel_name,gPanel23,1);
		 EnableControl(panel_name,gErrField23,1);
		 EnableControl(panel_name,gPanel24,1);
		 EnableControl(panel_name,gErrField24,1);
		 EnableControl(panel_name,gPanel25,1);
		 EnableControl(panel_name,gErrField25,1);

}

EnableConfigCtrl ()
{
  	if(getValue(C_ASG_78_1_0_1_FctLstItemEn))
	{
		setControlForeColor(panel_name, gCheckbox1, MakeRGB(0,240,0));
	}
	else
	{
		setControlForeColor(panel_name, gCheckbox1, MakeRGB(250,0,0));
	}
	if(getValue(P_ASG_78_1_0_2_FctLstItemEn))
	{
		setControlForeColor(panel_name, gCheckbox2, MakeRGB(0,240,0));
	}
	else
	{
		setControlForeColor(panel_name, gCheckbox2, MakeRGB(250,0,0));
	}
	if(getValue(P_ASG_78_1_0_3_FctLstItemEn))
	{
		setControlForeColor(panel_name, gCheckbox3, MakeRGB(0,240,0));
	}
	else
	{
		setControlForeColor(panel_name, gCheckbox3, MakeRGB(250,0,0));
	}
	EnableControl(panel_name, "panel_P_ASG_78_1_0_4", 1);
	if(getValue(P_ASG_78_1_0_4_FctLstItemEn))
	{
		setControlForeColor(panel_name, gCheckbox4, MakeRGB(0,240,0));
	}
	else
	{
		setControlForeColor(panel_name, gCheckbox4, MakeRGB(250,0,0));
	}
	if(getValue(P_ASG_78_1_0_13_FctLstItemEn))
	{
		EnableControl(panel_name, "panel_P_ASG_78_1_0_13",1);
		EnableControl(panel_name,"errfield_P_ASG_78_1_0_13",1);
		setControlForeColor(panel_name, gCheckbox13, MakeRGB(0,240,0));
	}
	else
	{
		EnableControl(panel_name, "panel_P_ASG_78_1_0_13",0);
		EnableControl(panel_name,"errfield_P_ASG_78_1_0_13",0);
		setControlForeColor(panel_name, gCheckbox13, MakeRGB(250,0,0));
	}
	if(getValue(P_ASG_78_1_0_14_FctLstItemEn))
	{
		EnableControl(panel_name, "panel_P_ASG_78_1_0_14",1);
		EnableControl(panel_name,"errfield_P_ASG_78_1_0_14",1);
		setControlForeColor(panel_name, gCheckbox14, MakeRGB(0,240,0));
	}
	else
	{
		EnableControl(panel_name, "panel_P_ASG_78_1_0_14",0);
		EnableControl(panel_name,"errfield_P_ASG_78_1_0_14",0);
		setControlForeColor(panel_name, gCheckbox14, MakeRGB(250,0,0));
	}
	if(getValue(P_ASG_78_1_0_15_FctLstItemEn))
	{
		EnableControl(panel_name, "panel_P_ASG_78_1_0_15",1);
		EnableControl(panel_name,"errfield_P_ASG_78_1_0_15",1);
		setControlForeColor(panel_name, gCheckbox15, MakeRGB(0,240,0));
	}
	else
	{
		EnableControl(panel_name, "panel_P_ASG_78_1_0_15",0);
		EnableControl(panel_name,"errfield_P_ASG_78_1_0_15",0);
		setControlForeColor(panel_name, gCheckbox15, MakeRGB(250,0,0));
	}
	if(getValue(M_ASG_78_1_0_16_FctLstItemEn))
	{
		EnableControl(panel_name, "panel_M_ASG_78_1_0_16",1);
		EnableControl(panel_name,"errfield_M_ASG_78_1_0_16",1);
		EnableControl(panel_name,"panel_M_ASG_78_1_0_16_Processing",1);
		EnableControl(panel_name,"panel_M_ASG_78_1_0_16_Start",1);
		setControlForeColor(panel_name, gCheckbox16, MakeRGB(0,240,0));
	}
	else
	{
		EnableControl(panel_name, "panel_M_ASG_78_1_0_16",0);
		EnableControl(panel_name,"errfield_M_ASG_78_1_0_16",0);
		EnableControl(panel_name,"panel_M_ASG_78_1_0_16_Processing",0);
		EnableControl(panel_name,"panel_M_ASG_78_1_0_16_Start",0);
		setControlForeColor(panel_name, gCheckbox16, MakeRGB(250,0,0));
	}
	if(getValue(P_ASG_78_1_0_17_FctLstItemEn))
	{
		EnableControl(panel_name, "panel_P_ASG_78_1_0_17",1);
		EnableControl(panel_name,"errfield_P_ASG_78_1_0_17",1);
		setControlForeColor(panel_name, gCheckbox17, MakeRGB(0,240,0));
	}
	else
	{
		EnableControl(panel_name, "panel_P_ASG_78_1_0_17",0);
		EnableControl(panel_name,"errfield_P_ASG_78_1_0_17",0);
		setControlForeColor(panel_name, gCheckbox17, MakeRGB(250,0,0));
	}
	if(getValue(P_ASG_78_1_0_18_FctLstItemEn))
	{
		EnableControl(panel_name, "panel_P_ASG_78_1_0_18",1);
		EnableControl(panel_name,"errfield_P_ASG_78_1_0_18",1);
		setControlForeColor(panel_name, gCheckbox18, MakeRGB(0,240,0));
	}
	else
	{
		EnableControl(panel_name, "panel_P_ASG_78_1_0_18",0);
		EnableControl(panel_name,"errfield_P_ASG_78_1_0_18",0);
		setControlForeColor(panel_name, gCheckbox18, MakeRGB(250,0,0));
	}
	if(getValue(M_ASG_78_1_0_19_FctLstItemEn))
	{
		EnableControl(panel_name, "panel_M_ASG_78_1_0_19",1);
		EnableControl(panel_name,"errfield_M_ASG_78_1_0_19",1);
		EnableControl(panel_name,"panel_M_ASG_78_1_0_19_Processing",1);
		EnableControl(panel_name,"panel_M_ASG_78_1_0_19_Start",1);
		setControlForeColor(panel_name, gCheckbox19, MakeRGB(0,240,0));
	}
	else
	{
		EnableControl(panel_name, "panel_M_ASG_78_1_0_19",0);
		EnableControl(panel_name,"errfield_M_ASG_78_1_0_19",0);
		EnableControl(panel_name,"panel_M_ASG_78_1_0_19_Processing",0);
		EnableControl(panel_name,"panel_M_ASG_78_1_0_19_Start",0);
		setControlForeColor(panel_name, gCheckbox19, MakeRGB(250,0,0));
	}
	if(getValue(P_ASG_78_1_0_20_FctLstItemEn))
	{
		EnableControl(panel_name, "panel_P_ASG_78_1_0_20",1);
		EnableControl(panel_name,"errfield_P_ASG_78_1_0_20",1);
		setControlForeColor(panel_name, gCheckbox20, MakeRGB(0,240,0));
	}
	else
	{
		EnableControl(panel_name, "panel_P_ASG_78_1_0_20",0);
		EnableControl(panel_name,"errfield_P_ASG_78_1_0_20",0);
		setControlForeColor(panel_name, gCheckbox20, MakeRGB(250,0,0));
	}
	if(getValue(P_ASG_78_1_0_21_FctLstItemEn))
	{
		EnableControl(panel_name, "panel_P_ASG_78_1_0_21",1);
		EnableControl(panel_name,"errfield_P_ASG_78_1_0_21",1);
		setControlForeColor(panel_name, gCheckbox21, MakeRGB(0,240,0));
	}
	else
	{
		EnableControl(panel_name, "panel_P_ASG_78_1_0_21",0);
		EnableControl(panel_name,"errfield_P_ASG_78_1_0_21",0);
		setControlForeColor(panel_name, gCheckbox21, MakeRGB(250,0,0));
	}
	if(getValue(P_ASG_78_1_0_22_FctLstItemEn))
	{
		EnableControl(panel_name, "panel_P_ASG_78_1_0_22",1);
		EnableControl(panel_name,"errfield_P_ASG_78_1_0_22",1);
		setControlForeColor(panel_name, gCheckbox22, MakeRGB(0,240,0));
	}
	else
	{
		EnableControl(panel_name, "panel_P_ASG_78_1_0_22",0);
		EnableControl(panel_name,"errfield_P_ASG_78_1_0_22",0);
		setControlForeColor(panel_name, gCheckbox22, MakeRGB(250,0,0));
	}
	if(getValue(P_ASG_78_1_0_23_FctLstItemEn))
	{
		EnableControl(panel_name, "panel_P_ASG_78_1_0_23",1);
		EnableControl(panel_name,"errfield_P_ASG_78_1_0_23",1);
		setControlForeColor(panel_name, gCheckbox23, MakeRGB(0,240,0));
	}
	else
	{
		EnableControl(panel_name, "panel_P_ASG_78_1_0_23",0);
		EnableControl(panel_name,"errfield_P_ASG_78_1_0_23",0);
		setControlForeColor(panel_name, gCheckbox23, MakeRGB(250,0,0));
	}
	if(getValue(M_ASG_78_1_0_24_FctLstItemEn))
	{
		EnableControl(panel_name, "panel_M_ASG_78_1_0_24",1);
		EnableControl(panel_name,"errfield_M_ASG_78_1_0_24",1);
		EnableControl(panel_name,"panel_M_ASG_78_1_0_24_Processing",1);
		EnableControl(panel_name,"panel_M_ASG_78_1_0_24_Start",1);
		setControlForeColor(panel_name, gCheckbox24, MakeRGB(0,240,0));
	}
	else
	{
		EnableControl(panel_name, "panel_M_ASG_78_1_0_24",0);
		EnableControl(panel_name,"errfield_M_ASG_78_1_0_24",0);
		EnableControl(panel_name,"panel_M_ASG_78_1_0_24_Processing",0);
		EnableControl(panel_name,"panel_M_ASG_78_1_0_24_Start",0);
		setControlForeColor(panel_name, gCheckbox24, MakeRGB(250,0,0));
	}
	if(getValue(M_ASG_78_1_0_25_FctLstItemEn))
	{
		EnableControl(panel_name, "panel_M_ASG_78_1_0_25",1);
		EnableControl(panel_name,"errfield_M_ASG_78_1_0_25",1);
		EnableControl(panel_name,"panel_M_ASG_78_1_0_25_Processing",1);
		EnableControl(panel_name,"panel_M_ASG_78_1_0_25_Start",1);
		setControlForeColor(panel_name, gCheckbox25, MakeRGB(0,240,0));
	}
	else
	{
		EnableControl(panel_name, "panel_M_ASG_78_1_0_25",0);
		EnableControl(panel_name,"errfield_M_ASG_78_1_0_25",0);
		EnableControl(panel_name,"panel_M_ASG_78_1_0_25_Processing",0);
		EnableControl(panel_name,"panel_M_ASG_78_1_0_25_Start",0);
		setControlForeColor(panel_name, gCheckbox25, MakeRGB(250,0,0));
	}

}

DisableReservedFld ()
{
  	EnableControl(panel_name,"P_ASG_78_1_0_23_2_reserved",0);
	EnableControl(panel_name,"P_ASG_78_1_0_23_3_reserved",0);
	EnableControl(panel_name,"P_ASG_78_1_0_23_4_reserved",0);
	EnableControl(panel_name,"P_ASG_78_1_0_23_5_reserved",0);
	EnableControl(panel_name,"P_ASG_78_1_0_23_6_reserved",0);

}

resetErrfieldColor()
{
  	setControlBackColor(panel_name, "errfield_C_ASG_78_1_0_1", MakeRGB(255,255,255));
	setControlBackColor(panel_name, "errfield_P_ASG_78_1_0_2", MakeRGB(255,255,255));
	setControlBackColor(panel_name, "errfield_P_ASG_78_1_0_3", MakeRGB(255,255,255));
	setControlBackColor(panel_name, "errfield_P_ASG_78_1_0_4", MakeRGB(255,255,255));
	setControlBackColor(panel_name, "errfield_P_ASG_78_1_0_13", MakeRGB(255,255,255));
	setControlBackColor(panel_name, "errfield_P_ASG_78_1_0_14", MakeRGB(255,255,255));
	setControlBackColor(panel_name, "errfield_P_ASG_78_1_0_15", MakeRGB(255,255,255));
	setControlBackColor(panel_name, "errfield_M_ASG_78_1_0_16", MakeRGB(255,255,255));
	setControlBackColor(panel_name, "errfield_P_ASG_78_1_0_17", MakeRGB(255,255,255));
	setControlBackColor(panel_name, "errfield_P_ASG_78_1_0_18", MakeRGB(255,255,255));
	setControlBackColor(panel_name, "errfield_M_ASG_78_1_0_19", MakeRGB(255,255,255));
	setControlBackColor(panel_name, "errfield_P_ASG_78_1_0_20", MakeRGB(255,255,255));
	setControlBackColor(panel_name, "errfield_P_ASG_78_1_0_21", MakeRGB(255,255,255));
	setControlBackColor(panel_name, "errfield_P_ASG_78_1_0_22", MakeRGB(255,255,255));
	setControlBackColor(panel_name, "errfield_P_ASG_78_1_0_23", MakeRGB(255,255,255));
	setControlBackColor(panel_name, "errfield_M_ASG_78_1_0_24", MakeRGB(255,255,255));
	setControlBackColor(panel_name, "errfield_M_ASG_78_1_0_25", MakeRGB(255,255,255));

}

CANoe_Shutdown ()
{
	// Timer 
	canceltimer(TaskTimer);		//cancel real CAN-communication timer

	// Ruecksetzen der Hintergrundfarbe der Error-Felder
	resetErrfieldColor();
	// Deaktivierung aller Panel Elemente 
	DisableFctCtrl();
	EnableControl(panel_name, bapconfig_panel_name, 0); 
	EnableConfigCtrl();

}

on timer TaskTimer
{

	/*** Aufruf des BAP Task in DLL fuer NODE_INDEX ***/
	BAP150_Task(NODE_INDEX);	

	/*** Pollen ueber die anstehenden Indications (Lesen aus DLL, Auslesen eines Puffers der DLL) ***/
	BAP_DLL_Indication();	
	
	/*** Pollen ueber die anstehenden Requests (Schreiben in DLL, dort werden evt. Sendeauftraege gesetzt) ***/
	BAP_DLL_Request();
	
	/*** Abarbeiten der ausstehenden Sendeauftraege innerhalb der BAP DLL und Versenden ueber CANoe ***/
    if (getValue(eSendEnabled))
    {
        BAP_CAN_TX_Request();
    }

	/*** Der Empfang von CAN Daten geschieht ueber on message CAN message Mechanismen ***/
	// keine Funktion hier

	/*** Retriggern des Timers mit 10 ms ***/
	setTimer(TaskTimer, TaskTime); // @TODO bei anderer Taskzeit muss hier modifiziert werden
}

BAP_DLL_Indication()	//function to get received BAP-data from DLL (at BAL-interface)
{
	int i, length, datalength, temp;
	byte Indication_data[BAP_buffer_size];		// indication data from DLL
	dword Indication_header[6];					// indication header from DLL
	byte BAP_data_type;

	//init local variables
	length=0;
	datalength=0;
	temp=0;
	BAP_data_type=0;

	for(i=0;i<6;i++)
		Indication_header[i]=0;

	for(i=0;i<BAP_buffer_size;i++)
		Indication_data[i]=0;

	// BAP-Stack needs this information for successful BAP150_GetIndication 
	Indication_header[4]=BAP_buffer_size;

	while (BAP150_GetInd(NODE_INDEX, Indication_header, Indication_data) == 0)
	{		
		//read header and write in global variable
		for (i = 0; i < 6; i++) {
			gBAP_Indication_header[i]=Indication_header[i];	
		}

		// nur Bytesequneces haben Datenanteil
		if (gBAP_Indication_header[3] == Bap_byteSequence)
		{
			for (i = 0; i < BAP_buffer_size; i++) {
				gBAP_Indication_data[i]=Indication_data[i];	
			}
		}	
		// Verarbeiten der Indication
		Process_Current_Indication();

		// Vorbereiten fuer naechsten Durchlauf 
		Indication_header[4]=BAP_buffer_size;
	} 
}

ChangeConfig(long paramIndex,long config[])
{

        byte temp ;
        temp = BAP150_ChangeConfig(NODE_INDEX, paramIndex, config);
        if(temp == 0)
            writelineEx(gBAP_Trace, 0, "BAP150_ChangeConfig for %s succesful (LSG %d, NODE_INDEX %d)", NODE_NAME, LSGID, NODE_INDEX);
        else
            writelineEx(gError_Trace, 0, "BAP150_ChangeConfig error 0x%X for %s (LSG %d, NODE_INDEX %d)", temp, NODE_NAME, LSGID, NODE_INDEX);        
}

PrintIndicationError(char reason[])
{
	writelineEx(gError_Trace, 0, "%s - %s lsgId:%d fctid:%d indType:%s dataType:%s",
		reason, SGtype, gBAP_Indication_header[0], gBAP_Indication_header[1], Indicationtype_Text[gBAP_Indication_header[2]], Datatype_Text[gBAP_Indication_header[3]]);
}

BapOnOff(byte _on)
{
    int length, temp;

    /***** Einschalten ******/
    if(_on==1){
        // soll der BAP Stack wieder initlialisiert werden?                                 
        if(gBAP_Init==0){
            gBAP_Init=1;
            temp=BAP150_Init(NODE_INDEX, LSGID);
            if(temp==0)
                writelineEx(gBAP_Trace, 0, "BAP_Init for %s succesful (LSG %d, NODE_INDEX %d)", NODE_NAME, LSGID, NODE_INDEX);
            else
                writelineEx(gError_Trace, 0, "BAP_Init error 0x%X for %s (LSG %d, NODE_INDEX %d)", temp, NODE_NAME, LSGID, NODE_INDEX);         
        }

        // Initialisierung aller Variablen
        Initialize_Variables();                     

        // Aktivierung aller Panelelemente
		//EnableFctCtrl();
		initInvalidFields();
		EnableControl(panel_name, common_panel_name, 1);
		EnableControl(panel_name, bapconfig_panel_name, 1); 
		DisableReservedFld();

        //BAP-Shutdown
        temp = BAP150_Shutdown(NODE_INDEX, LSGID);
        if(temp==0)
            writelineEx(gBAP_Trace, 0, "BAP_Shutdown for %s succesful (LSG %d, NODE_INDEX %d)", NODE_NAME, LSGID, NODE_INDEX);
        else
            writelineEx(gError_Trace, 0, "BAP_Shutdown error 0x%X for %s (LSG %d, NODE_INDEX %d)", temp, NODE_NAME, LSGID, NODE_INDEX); 

        //BAP-Start
        temp = BAP150_Start(NODE_INDEX, LSGID);             
        if(temp == 0)
            writelineEx(gBAP_Trace, 0, "BAP_Start for %s succesful (LSG %d, NODE_INDEX %d)", NODE_NAME, LSGID, NODE_INDEX);
        else
            writelineEx(gError_Trace, 0, "BAP_Start error 0x%X for %s (LSG %d, NODE_INDEX %d)", temp, NODE_NAME, LSGID, NODE_INDEX);        
    
        // setze den Timer fuer den zyklischen Aufruf des CANoe-"Tasks"
        setTimer(TaskTimer, 10);                
    
        //  BAPFsg_ProcessDebug(NODE_INDEX,DEBUG_CAN_CHANNEL, DEBUG_ID, LSGID, DEBUG_SWITCH_ON);    
    }
    else{ /***** Ausschalten ****/
        
        BAP150_Shutdown(NODE_INDEX,LSGID);
        
        CANoe_Shutdown();
        
        // ETHERNET NOT ENABLED! (CALL_FCT_CLOSE_UPD_SOCKET_TOKEN)
    }

}

Initialize_Variables()	//initialize/reset all global variables
{
	int i;
	byte  Init_data[BAP_buffer_size];	// InitSend data for DLL

	/**** Request Buffer Geschichten initialisieren ****/
	for (i = 0; i < Requestbuffer_lines; i++)
	{
		gBAP_Requestbuffer_status[i] = 0;
	}
	for (i = 0; i < BAP_buffer_size; i++)
	{
		Init_data[i] = 0;
	}
	
	/* Wert im Eingabefeld initialisieren*/
	putValue(P_ASG_78_1_0_13, 0);
	getValue(P_ASG_78_1_0_18,Init_data);
	putValue(P_ASG_78_1_0_18,Init_data, 36);
	getValue(P_ASG_78_1_0_21,Init_data);
	putValue(P_ASG_78_1_0_21,Init_data, 700);
	getValue(P_ASG_78_1_0_23,Init_data);
	putValue(P_ASG_78_1_0_23,Init_data, 6);
	/* Farbe setzen*/
	putValue(C_ASG_78_1_0_1_State,"");
	setControlBackColor(panel_name, "errfield_C_ASG_78_1_0_1_State", MakeRGB(255,255,255));

}

initInvalidFields()	//initialize/reset all global variables
{
	    setControlBackColor(panel_name, "panel1_edit", MakeRGB(220,220,220));
    setControlBackColor(panel_name, "panel_P_ASG_78_1_0_4", MakeRGB(220,220,220));
    setControlBackColor(panel_name, "panel_P_ASG_78_1_0_13", MakeRGB(220,220,220));
    setControlBackColor(panel_name, "panel_P_ASG_78_1_0_14", MakeRGB(220,220,220));
    setControlBackColor(panel_name, "panel_P_ASG_78_1_0_15", MakeRGB(220,220,220));
    setControlBackColor(panel_name, "panel_M_ASG_78_1_0_16_Result",MakeRGB(220,220,220));
    setControlBackColor(panel_name, "panel_M_ASG_78_1_0_16_Processing",MakeRGB(220,220,220));
    setControlBackColor(panel_name, "panel_P_ASG_78_1_0_17", MakeRGB(220,220,220));
    setControlBackColor(panel_name, "panel_P_ASG_78_1_0_18", MakeRGB(220,220,220));
    setControlBackColor(panel_name, "panel_M_ASG_78_1_0_19_Result",MakeRGB(220,220,220));
    setControlBackColor(panel_name, "panel_M_ASG_78_1_0_19_Processing",MakeRGB(220,220,220));
    setControlBackColor(panel_name, "panel_P_ASG_78_1_0_20", MakeRGB(220,220,220));
    setControlBackColor(panel_name, "panel_P_ASG_78_1_0_21", MakeRGB(220,220,220));
    setControlBackColor(panel_name, "panel_P_ASG_78_1_0_22", MakeRGB(220,220,220));
    setControlBackColor(panel_name, "panel_P_ASG_78_1_0_23", MakeRGB(220,220,220));
    setControlBackColor(panel_name, "panel_M_ASG_78_1_0_24_Result",MakeRGB(220,220,220));
    setControlBackColor(panel_name, "panel_M_ASG_78_1_0_24_Processing",MakeRGB(220,220,220));
    setControlBackColor(panel_name, "panel_M_ASG_78_1_0_25_Result",MakeRGB(220,220,220));
    setControlBackColor(panel_name, "panel_M_ASG_78_1_0_25_Processing",MakeRGB(220,220,220));

}

on start
{
	// noch nicht eingeschaltet
	gSG_PowerOnOff=0;
	// noch nicht initialisiert
	gBAP_Init=0;
	// open the panel, nur fuer CANoe-Version >= 5.1 erlaubt
	//openPanel(panel_name);
	// deaktiviere alle aktiven Panel Elemente, ausser AN/AUSS
    CANoe_Shutdown();
    // ungueltige Felder initialisieren
    initInvalidFields();    
    
// ETHERNET AND FLEXRAY NOT ENABLED!
}

BAP_CAN_TX_Request()	//Function to send BAP-data over CAN
{
   int i;
   byte TX_Data[8];				// CAN-data
   byte TX_Data_FR[10];    		// FlexRay-Data
   dword TX_Header[3];			// CAN-header
   message 0x100 TX_Message;	// dummy-message, Adresse wird noch modifiziert
   
   byte send_result;
   
   // ONLY CAN IS ENABLED! 
   		TX_Header[2] = 8; // max-Length of TX_Data

		// Pollen ueber die Queue, die von der DLL zur Verfuegung gestellt wird
		// Diese Daten muessen ueber den CAN Bus gesendet werden
	   	while (BAP150_CAN_GetTxDat(NODE_INDEX,TX_Header,TX_Data) == 0) {	
			TX_Message.CAN = TX_Header[0]; 		//CAN channel
			TX_Message.ID =TX_Header[1]; 			//Can ID
			TX_Message.DLC = TX_Header[2]; 		// received length
			
			for (i=0; i<TX_Message.DLC; i++) {	//CAN data-bytes
		  		TX_Message.byte(i) = TX_Data[i];
		  	}
		  	
		  	output(TX_Message);					//send CAN message
		  	
		  	//Versions Output
		  	if(TX_Data[0] == 0x40 && TX_Data[1] == 0x00 && TX_Header[2] == 4)
		  	{
		    	writelineEx(gBAP_Trace, 0,"Major Version: %i, Minor Version: %i", TX_Data[2], TX_Data[3]);
		  	}       
		  	TX_Header[2] = 8; // max-Length of TX_Data
	   	} 
   // ONLY CAN IS ENABLED!
   // FLEXRAY NOT ENABLED! (TX_FR_TOKEN)
   // ETHERNET NOT ENABLED! (TX_IP_TOKEN)
}

ringbuffer_write (byte lsgID, byte fctID, byte request, byte dataType, word length, dword singleData, byte data[])
{
	int bufferline, i;

	bufferline = getNextWriteIndex();	//get next free position in ring-buffer

	if (bufferline == -1) 
	{
		writelineEx(gError_Trace, 0, "Crititcal Error: No free buffer found!");
		return;
	}
		
	gBAP_Request_header[bufferline][0] = lsgID;	// LSG
	gBAP_Request_header[bufferline][1] = fctID;	// FCT
	gBAP_Request_header[bufferline][3] = dataType; // dataType

    //writelineEx(gBAP_Trace, 0, "Write request in buffer ASG NODEINDEX:%d lsgid:%d fctid:%d requesttype:%d datatype:%d length:%d", 
    //        NODE_INDEX,lsgID,fctID,request,dataType,length);
	switch (dataType)
	{
		case Bap_void:
			gBAP_Request_header[bufferline][2] = request;	// request
			gBAP_Request_header[bufferline][4] = 0;	// length
				// Void
			// @TODO?		
			break;
		case Bap_uint8:
			gBAP_Request_header[bufferline][2] = request;		// request
			gBAP_Request_header[bufferline][5] = singleData;	// Daten		
			break;
		case Bap_uint16:
			gBAP_Request_header[bufferline][2] = request;		// request
			gBAP_Request_header[bufferline][5] = singleData;	// Daten
			break;			
		case Bap_uint32:
			gBAP_Request_header[bufferline][2] = request;		// request
			gBAP_Request_header[bufferline][5] = singleData;	// Daten		
			break;	
		case Bap_byteSequence:
			gBAP_Request_header[bufferline][2] = request;	// request
			gBAP_Request_header[bufferline][4] = length;	// length
			// Daten der ByteSequence kopieren
			for(i = 0; i < BAP_buffer_size; i++)									
				gBAP_Request_data[bufferline][i] = data[i];
		case Bap_error:
			gBAP_Request_header[bufferline][5] = singleData;	// Errorcode						
			break;
		default:
			break;
	}

			

}

float round (float value, float step)
{
	return _floor(value / step + 0.5) * step;
}

Request_Void (byte lsgID, byte fctID, byte request)
{
	int i;
	byte dataArray [BAP_buffer_size];

	// Initialisieren eines Arrays
	for(i=0;i<BAP_buffer_size;i++) dataArray [i]=0;

	ringbuffer_write (lsgID, fctID, request, Bap_void, 0, 0, dataArray);	
}

Request_Int8 (byte lsgID, byte fctID, byte request, dword data)
{
	int i;
	byte dataArray [BAP_buffer_size];

	// Initialisieren eines Arrays
	for(i=0;i<BAP_buffer_size;i++) dataArray [i]=0;

	ringbuffer_write (lsgID, fctID, request, Bap_uint8, 0, data, dataArray);

}

Request_Int16 (byte lsgID, byte fctID, byte request, dword data)
{
	int i;
	byte dataArray [BAP_buffer_size];

	// Initialisieren eines Arrays
	for(i=0;i<BAP_buffer_size;i++) dataArray [i]=0;

	ringbuffer_write (lsgID, fctID, request, Bap_uint16, 0, data, dataArray);

}

Request_Int32 (byte lsgID, byte fctID, byte request, dword data)
{
	int i;
	byte dataArray [BAP_buffer_size];

	// Initialisieren eines Arrays
	for(i=0;i<BAP_buffer_size;i++) dataArray [i]=0;

	ringbuffer_write (lsgID, fctID, request, Bap_uint32, 0, data, dataArray);
}

Request_ByteSequence (byte lsgID, byte fctID, byte request, byte data[], word length)
{
	int i;
	byte dataArray [BAP_buffer_size];

	// Initialisieren eines Arrays
	for(i=0;i<BAP_buffer_size;i++) dataArray [i]=0;

	// Fuellen des Arrays
	for(i=0;i<length;i++) dataArray [i]=data[i];

	ringbuffer_write (lsgID, fctID, request, Bap_byteSequence, length, 0, dataArray);
}

Request_Error (byte lsgID, byte fctID, byte errorCode)
{
	int i;
	byte dataArray [BAP_buffer_size];

	// Initialisieren eines Arrays
	for(i=0;i<BAP_buffer_size;i++) dataArray [i]=0;

	ringbuffer_write (lsgID, fctID, 0, Bap_error, 0, errorCode, dataArray);
}

DisplayRequestErrorCode(dword fctID, dword errCode)
{
       switch(fctID)
   {
       case C_ASG_78_1_0_1_ID:
           gC_ASG_78_1_0_1_ErrCode = 0;
           putValue(C_ASG_78_1_0_1_ErrCode,  errCode);
           setControlBackColor(panel_name,"errfield_C_ASG_78_1_0_1", MakeRGB(255,79,79));
       break;
       case P_ASG_78_1_0_2_ID:
           gP_ASG_78_1_0_2_ErrCode = 0;
           putValue(P_ASG_78_1_0_2_ErrCode,  errCode);
           setControlBackColor(panel_name,"errfield_P_ASG_78_1_0_2", MakeRGB(255,79,79));
       break;
       case P_ASG_78_1_0_3_ID:
           gP_ASG_78_1_0_3_ErrCode = 0;
           putValue(P_ASG_78_1_0_3_ErrCode,  errCode);
           setControlBackColor(panel_name,"errfield_P_ASG_78_1_0_3", MakeRGB(255,79,79));
       break;
       case P_ASG_78_1_0_4_ID:
           gP_ASG_78_1_0_4_ErrCode = 0;
           putValue(P_ASG_78_1_0_4_ErrCode,  errCode);
           setControlBackColor(panel_name,"errfield_P_ASG_78_1_0_4", MakeRGB(255,79,79));
       break;
       case P_ASG_78_1_0_13_ID:
           gP_ASG_78_1_0_13_ErrCode = 0;
           putValue(P_ASG_78_1_0_13_ErrCode,  errCode);
           setControlBackColor(panel_name,"errfield_P_ASG_78_1_0_13", MakeRGB(255,79,79));
       break;
       case P_ASG_78_1_0_14_ID:
           gP_ASG_78_1_0_14_ErrCode = 0;
           putValue(P_ASG_78_1_0_14_ErrCode,  errCode);
           setControlBackColor(panel_name,"errfield_P_ASG_78_1_0_14", MakeRGB(255,79,79));
       break;
       case P_ASG_78_1_0_15_ID:
           gP_ASG_78_1_0_15_ErrCode = 0;
           putValue(P_ASG_78_1_0_15_ErrCode,  errCode);
           setControlBackColor(panel_name,"errfield_P_ASG_78_1_0_15", MakeRGB(255,79,79));
       break;
       case M_ASG_78_1_0_16_ID:
           gM_ASG_78_1_0_16_ErrCode = 0;
           putValue(M_ASG_78_1_0_16_ErrCode,  errCode);
           setControlBackColor(panel_name,"errfield_M_ASG_78_1_0_16", MakeRGB(255,79,79));
           putValue(M_ASG_78_1_0_16_State,  "ReqErr");
       break;
       case P_ASG_78_1_0_17_ID:
           gP_ASG_78_1_0_17_ErrCode = 0;
           putValue(P_ASG_78_1_0_17_ErrCode,  errCode);
           setControlBackColor(panel_name,"errfield_P_ASG_78_1_0_17", MakeRGB(255,79,79));
       break;
       case P_ASG_78_1_0_18_ID:
           gP_ASG_78_1_0_18_ErrCode = 0;
           putValue(P_ASG_78_1_0_18_ErrCode,  errCode);
           setControlBackColor(panel_name,"errfield_P_ASG_78_1_0_18", MakeRGB(255,79,79));
       break;
       case M_ASG_78_1_0_19_ID:
           gM_ASG_78_1_0_19_ErrCode = 0;
           putValue(M_ASG_78_1_0_19_ErrCode,  errCode);
           setControlBackColor(panel_name,"errfield_M_ASG_78_1_0_19", MakeRGB(255,79,79));
           putValue(M_ASG_78_1_0_19_State,  "ReqErr");
       break;
       case P_ASG_78_1_0_20_ID:
           gP_ASG_78_1_0_20_ErrCode = 0;
           putValue(P_ASG_78_1_0_20_ErrCode,  errCode);
           setControlBackColor(panel_name,"errfield_P_ASG_78_1_0_20", MakeRGB(255,79,79));
       break;
       case P_ASG_78_1_0_21_ID:
           gP_ASG_78_1_0_21_ErrCode = 0;
           putValue(P_ASG_78_1_0_21_ErrCode,  errCode);
           setControlBackColor(panel_name,"errfield_P_ASG_78_1_0_21", MakeRGB(255,79,79));
       break;
       case P_ASG_78_1_0_22_ID:
           gP_ASG_78_1_0_22_ErrCode = 0;
           putValue(P_ASG_78_1_0_22_ErrCode,  errCode);
           setControlBackColor(panel_name,"errfield_P_ASG_78_1_0_22", MakeRGB(255,79,79));
       break;
       case P_ASG_78_1_0_23_ID:
           gP_ASG_78_1_0_23_ErrCode = 0;
           putValue(P_ASG_78_1_0_23_ErrCode,  errCode);
           setControlBackColor(panel_name,"errfield_P_ASG_78_1_0_23", MakeRGB(255,79,79));
       break;
       case M_ASG_78_1_0_24_ID:
           gM_ASG_78_1_0_24_ErrCode = 0;
           putValue(M_ASG_78_1_0_24_ErrCode,  errCode);
           setControlBackColor(panel_name,"errfield_M_ASG_78_1_0_24", MakeRGB(255,79,79));
           putValue(M_ASG_78_1_0_24_State,  "ReqErr");
       break;
       case M_ASG_78_1_0_25_ID:
           gM_ASG_78_1_0_25_ErrCode = 0;
           putValue(M_ASG_78_1_0_25_ErrCode,  errCode);
           setControlBackColor(panel_name,"errfield_M_ASG_78_1_0_25", MakeRGB(255,79,79));
           putValue(M_ASG_78_1_0_25_State,  "ReqErr");
       break;
       default:
           writelineEx(gError_Trace, 0, "%s%d/%d Unknown Functionid in  displayErrorCode", SGtype, LSGID,fctID);
   }

}

BAP_DLL_Request ()
{
	int i;
    int l=0;
	byte temp;
	byte Request_data[4096];	//Request data for DLL
	dword Request_header[6];	//Request header for DLL
	byte dataValid;
	int nextElementToRead;
	
	// defaultmaessig ist senden OK
	dataValid = 1;

	// loeschen der Daten "Container"
	for(i=0;i<6;i++)
		Request_header[i]=0;
	for(i=0;i<BAP_buffer_size;i++)
		Request_data[i]=0;

    
	// Verarbeiten aller noch offenen Requests	
	while ((nextElementToRead = getNextReadIndex()) != -1) 
	{
		// Fuer alle Datentypen gleich
		Request_header[0]=gBAP_Request_header [nextElementToRead][0];		//LSG-ID
		Request_header[1]=gBAP_Request_header [nextElementToRead][1];		//Function-ID
		Request_header[2]=gBAP_Request_header [nextElementToRead][2];		//request type
		Request_header[3]=gBAP_Request_header [nextElementToRead][3];		//BAP data type

		switch(gBAP_Request_header[nextElementToRead][3]){
			case Bap_uint32:
                l=2;
            case Bap_uint16:
                l++;
            case Bap_uint8:
			case Bap_error: // Request (2) wird dabei ignoriert
                l++;
			case Bap_void:  // Datenfeld (5) wird dabei ignoriert
				Request_header[4]=l;												//	not used
				Request_header[5]=gBAP_Request_header [nextElementToRead][5];		// Daten
			break;
			case Bap_byteSequence:									
				Request_header[4]=gBAP_Request_header [nextElementToRead][4];		// length
				Request_header[5]=0;												// not used

				// data-array for BAP-DLL funcion 'BAP_Request'
				for(i=0;i<BAP_buffer_size;i++)
					Request_data[i]=gBAP_Request_data [nextElementToRead][i];
				break;			
			default:
				writelineEx(gError_Trace, 0, "BAP_DLL_Request: invalid BAP-Data-Type: %d", gBAP_Request_header[nextElementToRead][3]);
				dataValid = 0;
			break;			
		}
		
		if(dataValid){
            // wie heisst der Request?
            writelineEx(gBAP_Trace, 0, "%s%d/%d BAP_Request %s datatype:%s length:%d", SGtype, Request_header[0],Request_header[1],Requesttype_Text[Request_header[2]],Datatype_Text[Request_header[3]],Request_header[4]);
			temp = BAP150_Request(NODE_INDEX, Request_header, Request_data);	//send data to BAP-DLL	
			// BAP-Request failed
            if(temp != 0){
                // Fehlercode: Request failed
                writelineEx(gError_Trace, 0, "%s%d/%d Error during BAP_Request errorcode: 0x%X", SGtype, Request_header[0],Request_header[1],temp);
                DisplayRequestErrorCode(Request_header[1],temp);
            } 
		}

	}
} 

int getNextReadIndex ()
{
	int i, ret;
	// der Puffer wird nach dem naechsten zu lesenden Eintrag durchsucht
	// Existiert keiner wird -1 zurueckgegeben
	ret = -1;

	for (i = 0; i < Requestbuffer_lines; i++)
	{
		if (gBAP_Requestbuffer_status[i] == 1)
		{
			// zum verschicken
			ret = i;
			// und wieder freigeben
			gBAP_Requestbuffer_status[i] = 0;
			break;
		}
	}

	return (ret);
}

int getNextWriteIndex ()
{
	int i, ret;
	// der Puffer wird nach dem naechsten freien Eintrag durchsucht
	// Existiert keiner wird -1 zurueckgegeben
	ret = -1;

	for (i = 0; i < Requestbuffer_lines; i++)
	{
		if (gBAP_Requestbuffer_status[i] == 0)
		{
			// zum schreiben
			ret = i;
			// belegen
			gBAP_Requestbuffer_status[i] = 1;
			break;
		}
	}

	return (ret);
}

byte  isBitForFctSetted(word fctid, byte fctList[])
{
    byte byteNo ;
    byte bitno ;
    byte fctValue ;

    byteNo = fctid / 8;
    bitno = fctid % 8;

    fctValue = 0x80 >> bitno;

    return (fctList[byteNo] & fctValue)?1:0;
}

UpdateAllProperties()
{
	Request_Void(LSGID,P_ASG_78_1_0_2_ID,DataGet_REQ);
	Request_Void(LSGID,P_ASG_78_1_0_3_ID,DataGet_REQ);
	Request_Void(LSGID,P_ASG_78_1_0_4_ID,DataGet_REQ);
	Request_Void(LSGID,P_ASG_78_1_0_13_ID,DataGet_REQ);
	Request_Void(LSGID,P_ASG_78_1_0_14_ID,DataGet_REQ);
	Request_Void(LSGID,P_ASG_78_1_0_15_ID,DataGet_REQ);
	Request_Void(LSGID,P_ASG_78_1_0_17_ID,DataGet_REQ);
	Request_Void(LSGID,P_ASG_78_1_0_18_ID,DataGet_REQ);
	Request_Void(LSGID,P_ASG_78_1_0_20_ID,DataGet_REQ);
	Request_Void(LSGID,P_ASG_78_1_0_21_ID,DataGet_REQ);
	Request_Void(LSGID,P_ASG_78_1_0_22_ID,DataGet_REQ);
	Request_Void(LSGID,P_ASG_78_1_0_23_ID,DataGet_REQ);

}

Process_Current_Indication ()
{
   int rxsize;
   int txsize;
   byte temp[BAP_buffer_size];
   char buffer[BAP_buffer_size];
   if(strncmp(Datatype_Text[gBAP_Indication_header[3]], "acknowledge", 4)!=0) 
       writelineEx(gBAP_Trace, 0, "NodeIndex: %d: CurrentIndication %s lsgid:%d fctid:%d indType:%s dataType=%s length=%d",
               NODE_INDEX, SGtype, gBAP_Indication_header[0], gBAP_Indication_header[1], Indicationtype_Text[gBAP_Indication_header[2]], Datatype_Text[gBAP_Indication_header[3]], gBAP_Indication_header[4]);
   else 
       writelineEx(gBAP_Trace, 0, "Internal acknowledge %s-%d fctid:%d indType:%s dataType=%s length=%d",
               SGtype, gBAP_Indication_header[0], gBAP_Indication_header[1], Acknowledgetype_Text[gBAP_Indication_header[5]], Datatype_Text[gBAP_Indication_header[3]], gBAP_Indication_header[4]);
   switch(gBAP_Indication_header[0])  // LSGID
   {
   case LSGID:
       switch(gBAP_Indication_header[1]) // FCTID
       {
    case C_ASG_78_1_0_1_ID: 
        switch(gBAP_Indication_header[3]) // Datentyp 
        {
        case Bap_void:
            switch (gBAP_Indication_header[2]) // IndType
            {
                case Data_IND: // Indicationtyp pruefen
                    //Now every Property with Cache is updated
                    UpdateAllProperties();
                    putValue(C_ASG_78_1_0_1_State, "StatusAll");
                    setControlBackColor(panel_name, "errfield_C_ASG_78_1_0_1_State", MakeRGB(255,255,255));
                    break;
                default:
                    PrintIndicationError("Illegal IndType");
                    break;
            }
            break;
            case Bap_error:
               snprintf(buffer,BAP_buffer_size-1,"Error %02x", gBAP_Indication_header[5]);
               putValue(C_ASG_78_1_0_1_State, buffer);
               setControlBackColor(panel_name, "errfield_C_ASG_78_1_0_1_State", MakeRGB(255,79,79));
               break;
            case Bap_acknowledge:
                break;
            default:
                PrintIndicationError("Illegal DataType");
                break;
        }
    break;
    case P_ASG_78_1_0_2_ID: 
        switch(gBAP_Indication_header[3]) // Datentyp 
        {
        case Bap_byteSequence:
            switch (gBAP_Indication_header[2]) // IndType
            {
                case Reset_IND: // Nur fuer FctId 2 (BAPConfig) relevant
                   putValue(C_ASG_78_1_0_1_State, "");
                   setControlBackColor(panel_name, "errfield_C_ASG_78_1_0_1_State", MakeRGB(255,255,255));
                   initInvalidFields();
                   // Fall through
                case Data_IND: // Indicationtyp pruefen
                    // Daten setzen
                    putValue(BAPCFG_ASG_78_1_0_ProtocolMajor, gBAP_Indication_data[0]);
                    putValue(BAPCFG_ASG_78_1_0_ProtocolMinor, gBAP_Indication_data[1]);
                    putValue(BAPCFG_ASG_78_1_0_LsgClassMajor, gBAP_Indication_data[2]);
                    putValue(BAPCFG_ASG_78_1_0_LsgClassMinor, gBAP_Indication_data[3]);
                    putValue(BAPCFG_ASG_78_1_0_DFMajor, gBAP_Indication_data[4]);
                    putValue(BAPCFG_ASG_78_1_0_DFMinor, gBAP_Indication_data[5]);
                    setControlBackColor(panel_name, "errfield_P_ASG_78_1_0_2", MakeRGB(255,255,255));  
                    setControlBackColor(panel_name, "panel1_edit", MakeRGB(255,255,255));  
                    break;
                default:
                    PrintIndicationError("Illegal IndType");
                    break;
            }
            break;
            case Bap_error:
                putValue(P_ASG_78_1_0_2_ErrCode,  gBAP_Indication_header[5]);
                setControlBackColor(panel_name, "errfield_P_ASG_78_1_0_2", MakeRGB(255,79,79));  
                setControlBackColor(panel_name, "panel1_edit", MakeRGB(220,220,220));  
                break;
            case Bap_acknowledge:
                break;
            default:
                PrintIndicationError("Illegal DataType");
                break;
        }
    break;
    case P_ASG_78_1_0_3_ID: 
       switch(gBAP_Indication_header[3]) // Datentyp
       {
            case Bap_byteSequence:
                switch (gBAP_Indication_header[2]) // IndType
                {
                    case Data_IND: // Indicationtyp pruefen
                    case Reset_IND: // Nur fuer FctId 2 (BAPConfig) relevant
                    {
                        setControlBackColor(panel_name, "errfield_P_ASG_78_1_0_3", MakeRGB(255,255,255));
                        if(isBitForFctSetted(M_ASG_78_1_0_25_ID,gBAP_Indication_data))
                        {
                            putValue(M_ASG_78_1_0_25_FctLstItemEn, 1);
                            setControlForeColor(panel_name, gCheckbox25,MakeRGB(0,240,0));
                            EnableControl(panel_name, gPanel25, 1);
                            EnableControl(panel_name, "panel_M_ASG_78_1_0_25_Result",1);
                            EnableControl(panel_name, "panel_M_ASG_78_1_0_25_Processing",1);
                            EnableControl(panel_name, "panel_M_ASG_78_1_0_25_Start",1);
                        }
                        else
                        {
                            putValue(M_ASG_78_1_0_25_FctLstItemEn, 0);
                            setControlForeColor(panel_name, gCheckbox25,MakeRGB(250,0,0));
                            EnableControl(panel_name, gPanel25, 0);
                            EnableControl(panel_name, "panel_M_ASG_78_1_0_25_Result",0);
                            EnableControl(panel_name, "panel_M_ASG_78_1_0_25_Processing",0);
                            EnableControl(panel_name, "panel_M_ASG_78_1_0_25_Start",0);
                        }

                        if(isBitForFctSetted(M_ASG_78_1_0_24_ID,gBAP_Indication_data))
                        {
                            putValue(M_ASG_78_1_0_24_FctLstItemEn, 1);
                            setControlForeColor(panel_name, gCheckbox24,MakeRGB(0,240,0));
                            EnableControl(panel_name, gPanel24, 1);
                            EnableControl(panel_name, "panel_M_ASG_78_1_0_24_Result",1);
                            EnableControl(panel_name, "panel_M_ASG_78_1_0_24_Processing",1);
                            EnableControl(panel_name, "panel_M_ASG_78_1_0_24_Start",1);
                        }
                        else
                        {
                            putValue(M_ASG_78_1_0_24_FctLstItemEn, 0);
                            setControlForeColor(panel_name, gCheckbox24,MakeRGB(250,0,0));
                            EnableControl(panel_name, gPanel24, 0);
                            EnableControl(panel_name, "panel_M_ASG_78_1_0_24_Result",0);
                            EnableControl(panel_name, "panel_M_ASG_78_1_0_24_Processing",0);
                            EnableControl(panel_name, "panel_M_ASG_78_1_0_24_Start",0);
                        }

                        if(isBitForFctSetted(P_ASG_78_1_0_23_ID,gBAP_Indication_data))
                        {
                            putValue(P_ASG_78_1_0_23_FctLstItemEn, 1);
                            setControlForeColor(panel_name, gCheckbox23,MakeRGB(0,240,0));
                            EnableControl(panel_name, gPanel23, 1);
                            EnableControl(panel_name, "panel_P_ASG_78_1_0_23",1);
                        }
                        else
                        {
                            putValue(P_ASG_78_1_0_23_FctLstItemEn, 0);
                            setControlForeColor(panel_name, gCheckbox23,MakeRGB(250,0,0));
                            EnableControl(panel_name, gPanel23, 0);
                            EnableControl(panel_name, "panel_P_ASG_78_1_0_23",0);
                        }

                        if(isBitForFctSetted(P_ASG_78_1_0_22_ID,gBAP_Indication_data))
                        {
                            putValue(P_ASG_78_1_0_22_FctLstItemEn, 1);
                            setControlForeColor(panel_name, gCheckbox22,MakeRGB(0,240,0));
                            EnableControl(panel_name, gPanel22, 1);
                            EnableControl(panel_name, "panel_P_ASG_78_1_0_22",1);
                        }
                        else
                        {
                            putValue(P_ASG_78_1_0_22_FctLstItemEn, 0);
                            setControlForeColor(panel_name, gCheckbox22,MakeRGB(250,0,0));
                            EnableControl(panel_name, gPanel22, 0);
                            EnableControl(panel_name, "panel_P_ASG_78_1_0_22",0);
                        }

                        if(isBitForFctSetted(P_ASG_78_1_0_21_ID,gBAP_Indication_data))
                        {
                            putValue(P_ASG_78_1_0_21_FctLstItemEn, 1);
                            setControlForeColor(panel_name, gCheckbox21,MakeRGB(0,240,0));
                            EnableControl(panel_name, gPanel21, 1);
                            EnableControl(panel_name, "panel_P_ASG_78_1_0_21",1);
                        }
                        else
                        {
                            putValue(P_ASG_78_1_0_21_FctLstItemEn, 0);
                            setControlForeColor(panel_name, gCheckbox21,MakeRGB(250,0,0));
                            EnableControl(panel_name, gPanel21, 0);
                            EnableControl(panel_name, "panel_P_ASG_78_1_0_21",0);
                        }

                        if(isBitForFctSetted(M_ASG_78_1_0_19_ID,gBAP_Indication_data))
                        {
                            putValue(M_ASG_78_1_0_19_FctLstItemEn, 1);
                            setControlForeColor(panel_name, gCheckbox19,MakeRGB(0,240,0));
                            EnableControl(panel_name, gPanel19, 1);
                            EnableControl(panel_name, "panel_M_ASG_78_1_0_19_Result",1);
                            EnableControl(panel_name, "panel_M_ASG_78_1_0_19_Processing",1);
                            EnableControl(panel_name, "panel_M_ASG_78_1_0_19_Start",1);
                        }
                        else
                        {
                            putValue(M_ASG_78_1_0_19_FctLstItemEn, 0);
                            setControlForeColor(panel_name, gCheckbox19,MakeRGB(250,0,0));
                            EnableControl(panel_name, gPanel19, 0);
                            EnableControl(panel_name, "panel_M_ASG_78_1_0_19_Result",0);
                            EnableControl(panel_name, "panel_M_ASG_78_1_0_19_Processing",0);
                            EnableControl(panel_name, "panel_M_ASG_78_1_0_19_Start",0);
                        }

                        if(isBitForFctSetted(P_ASG_78_1_0_20_ID,gBAP_Indication_data))
                        {
                            putValue(P_ASG_78_1_0_20_FctLstItemEn, 1);
                            setControlForeColor(panel_name, gCheckbox20,MakeRGB(0,240,0));
                            EnableControl(panel_name, gPanel20, 1);
                            EnableControl(panel_name, "panel_P_ASG_78_1_0_20",1);
                        }
                        else
                        {
                            putValue(P_ASG_78_1_0_20_FctLstItemEn, 0);
                            setControlForeColor(panel_name, gCheckbox20,MakeRGB(250,0,0));
                            EnableControl(panel_name, gPanel20, 0);
                            EnableControl(panel_name, "panel_P_ASG_78_1_0_20",0);
                        }

                        if(isBitForFctSetted(P_ASG_78_1_0_18_ID,gBAP_Indication_data))
                        {
                            putValue(P_ASG_78_1_0_18_FctLstItemEn, 1);
                            setControlForeColor(panel_name, gCheckbox18,MakeRGB(0,240,0));
                            EnableControl(panel_name, gPanel18, 1);
                            EnableControl(panel_name, "panel_P_ASG_78_1_0_18",1);
                        }
                        else
                        {
                            putValue(P_ASG_78_1_0_18_FctLstItemEn, 0);
                            setControlForeColor(panel_name, gCheckbox18,MakeRGB(250,0,0));
                            EnableControl(panel_name, gPanel18, 0);
                            EnableControl(panel_name, "panel_P_ASG_78_1_0_18",0);
                        }

                        if(isBitForFctSetted(P_ASG_78_1_0_17_ID,gBAP_Indication_data))
                        {
                            putValue(P_ASG_78_1_0_17_FctLstItemEn, 1);
                            setControlForeColor(panel_name, gCheckbox17,MakeRGB(0,240,0));
                            EnableControl(panel_name, gPanel17, 1);
                            EnableControl(panel_name, "panel_P_ASG_78_1_0_17",1);
                        }
                        else
                        {
                            putValue(P_ASG_78_1_0_17_FctLstItemEn, 0);
                            setControlForeColor(panel_name, gCheckbox17,MakeRGB(250,0,0));
                            EnableControl(panel_name, gPanel17, 0);
                            EnableControl(panel_name, "panel_P_ASG_78_1_0_17",0);
                        }

                        if(isBitForFctSetted(M_ASG_78_1_0_16_ID,gBAP_Indication_data))
                        {
                            putValue(M_ASG_78_1_0_16_FctLstItemEn, 1);
                            setControlForeColor(panel_name, gCheckbox16,MakeRGB(0,240,0));
                            EnableControl(panel_name, gPanel16, 1);
                            EnableControl(panel_name, "panel_M_ASG_78_1_0_16_Result",1);
                            EnableControl(panel_name, "panel_M_ASG_78_1_0_16_Processing",1);
                            EnableControl(panel_name, "panel_M_ASG_78_1_0_16_Start",1);
                        }
                        else
                        {
                            putValue(M_ASG_78_1_0_16_FctLstItemEn, 0);
                            setControlForeColor(panel_name, gCheckbox16,MakeRGB(250,0,0));
                            EnableControl(panel_name, gPanel16, 0);
                            EnableControl(panel_name, "panel_M_ASG_78_1_0_16_Result",0);
                            EnableControl(panel_name, "panel_M_ASG_78_1_0_16_Processing",0);
                            EnableControl(panel_name, "panel_M_ASG_78_1_0_16_Start",0);
                        }

                        if(isBitForFctSetted(P_ASG_78_1_0_15_ID,gBAP_Indication_data))
                        {
                            putValue(P_ASG_78_1_0_15_FctLstItemEn, 1);
                            setControlForeColor(panel_name, gCheckbox15,MakeRGB(0,240,0));
                            EnableControl(panel_name, gPanel15, 1);
                            EnableControl(panel_name, "panel_P_ASG_78_1_0_15",1);
                        }
                        else
                        {
                            putValue(P_ASG_78_1_0_15_FctLstItemEn, 0);
                            setControlForeColor(panel_name, gCheckbox15,MakeRGB(250,0,0));
                            EnableControl(panel_name, gPanel15, 0);
                            EnableControl(panel_name, "panel_P_ASG_78_1_0_15",0);
                        }

                        if(isBitForFctSetted(P_ASG_78_1_0_14_ID,gBAP_Indication_data))
                        {
                            putValue(P_ASG_78_1_0_14_FctLstItemEn, 1);
                            setControlForeColor(panel_name, gCheckbox14,MakeRGB(0,240,0));
                            EnableControl(panel_name, gPanel14, 1);
                            EnableControl(panel_name, "panel_P_ASG_78_1_0_14",1);
                        }
                        else
                        {
                            putValue(P_ASG_78_1_0_14_FctLstItemEn, 0);
                            setControlForeColor(panel_name, gCheckbox14,MakeRGB(250,0,0));
                            EnableControl(panel_name, gPanel14, 0);
                            EnableControl(panel_name, "panel_P_ASG_78_1_0_14",0);
                        }

                        if(isBitForFctSetted(P_ASG_78_1_0_4_ID,gBAP_Indication_data))
                        {
                            putValue(P_ASG_78_1_0_4_FctLstItemEn, 1);
                            setControlForeColor(panel_name, gCheckbox4,MakeRGB(0,240,0));
                        }
                        else
                        {
                            putValue(P_ASG_78_1_0_4_FctLstItemEn, 0);
                            setControlForeColor(panel_name, gCheckbox4,MakeRGB(250,0,0));
                        }

                        if(isBitForFctSetted(P_ASG_78_1_0_13_ID,gBAP_Indication_data))
                        {
                            putValue(P_ASG_78_1_0_13_FctLstItemEn, 1);
                            setControlForeColor(panel_name, gCheckbox13,MakeRGB(0,240,0));
                            EnableControl(panel_name, gPanel13, 1);
                            EnableControl(panel_name, "panel_P_ASG_78_1_0_13",1);
                        }
                        else
                        {
                            putValue(P_ASG_78_1_0_13_FctLstItemEn, 0);
                            setControlForeColor(panel_name, gCheckbox13,MakeRGB(250,0,0));
                            EnableControl(panel_name, gPanel13, 0);
                            EnableControl(panel_name, "panel_P_ASG_78_1_0_13",0);
                        }

                        if(isBitForFctSetted(P_ASG_78_1_0_3_ID,gBAP_Indication_data))
                        {
                            putValue(P_ASG_78_1_0_3_FctLstItemEn, 1);
                            setControlForeColor(panel_name, gCheckbox3,MakeRGB(0,240,0));
                        }
                        else
                        {
                            putValue(P_ASG_78_1_0_3_FctLstItemEn, 0);
                            setControlForeColor(panel_name, gCheckbox3,MakeRGB(250,0,0));
                        }

                        if(isBitForFctSetted(P_ASG_78_1_0_2_ID,gBAP_Indication_data))
                        {
                            putValue(P_ASG_78_1_0_2_FctLstItemEn, 1);
                            setControlForeColor(panel_name, gCheckbox2,MakeRGB(0,240,0));
                        }
                        else
                        {
                            putValue(P_ASG_78_1_0_2_FctLstItemEn, 0);
                            setControlForeColor(panel_name, gCheckbox2,MakeRGB(250,0,0));
                        }

                        if(isBitForFctSetted(C_ASG_78_1_0_1_ID,gBAP_Indication_data))
                        {
                            putValue(C_ASG_78_1_0_1_FctLstItemEn, 1);
                            setControlForeColor(panel_name, gCheckbox1,MakeRGB(0,240,0));
                        }
                        else
                        {
                            putValue(C_ASG_78_1_0_1_FctLstItemEn, 0);
                            setControlForeColor(panel_name, gCheckbox1,MakeRGB(250,0,0));
                        }

                     }
                        break;
                    default:
                      writelineEx(gError_Trace, 0, "NodeIndex: %d: Illegal IndType : lsgid:%d fctid:%d indType:%d",
                           NODE_INDEX, gBAP_Indication_header[0], gBAP_Indication_header[1], gBAP_Indication_header[2]);
                       break;
                  }
                  break;
            case Bap_error:
                putValue(P_ASG_78_1_0_3_ErrCode,  gBAP_Indication_header[5]);
                setControlBackColor(panel_name, "errfield_P_ASG_78_1_0_3", MakeRGB(255,79,79));
                break;
            case Bap_acknowledge:
            	 break;
            default:
                PrintIndicationError("Illegal DataType");
                break;
       }
       break;
    case P_ASG_78_1_0_4_ID: 
        switch(gBAP_Indication_header[3]) // Datentyp 
        {
           case Bap_uint8:
                   switch(gBAP_Indication_header[2]) // IndType
                   {
                       case Data_IND: // Indicationtyp pruefen
                           // Daten setzen
                           putValue(P_ASG_78_1_0_4, gBAP_Indication_header[5]);
                           setControlBackColor(panel_name, "errfield_P_ASG_78_1_0_4", MakeRGB(255,255,255));  
                           setControlBackColor(panel_name, "panel_P_ASG_78_1_0_4", MakeRGB(255,255,255));  
                           break;                              
                       default:
                           PrintIndicationError("Illegal IndType");
                           break;
                   }
                   break;
            case Bap_error:
                putValue(P_ASG_78_1_0_4_ErrCode,  gBAP_Indication_header[5]);
                setControlBackColor(panel_name, "errfield_P_ASG_78_1_0_4", MakeRGB(255,79,79));  
                setControlBackColor(panel_name, "panel_P_ASG_78_1_0_4", MakeRGB(220,220,220));  
                if(gBAP_Indication_header[5]==0x21)
                {
                   putValue(C_ASG_78_1_0_1_State, "");
                   setControlBackColor(panel_name, "errfield_C_ASG_78_1_0_1_State", MakeRGB(255,255,255));
                }
                break;
            case Bap_acknowledge:
                break;
            default:
                PrintIndicationError("Illegal DataType");
                break;
        }
    break;
    case P_ASG_78_1_0_13_ID: 
        switch(gBAP_Indication_header[3]) // Datentyp 
        {
            case Bap_uint8:
                    switch(gBAP_Indication_header[2]) // IndType
                    {
                        case Data_IND: // Indicationtyp pruefen
                            // Daten setzen
                            putValue(P_ASG_78_1_0_13, gBAP_Indication_header[5]);
                            setControlBackColor(panel_name, "errfield_P_ASG_78_1_0_13", MakeRGB(255,255,255));  
                            setControlBackColor(panel_name, "panel_P_ASG_78_1_0_13", MakeRGB(255,255,255));  
                            break;                              
                        default:
                            PrintIndicationError("Illegal IndType");
                            break;
                    }
                    break;
            case Bap_error:
                gP_ASG_78_1_0_13_ErrCode = 0;
                putValue(P_ASG_78_1_0_13_ErrCode,  gBAP_Indication_header[5]);
                setControlBackColor(panel_name, "errfield_P_ASG_78_1_0_13", MakeRGB(255,79,79));  
                setControlBackColor(panel_name, "panel_P_ASG_78_1_0_13", MakeRGB(220,220,220));  
                break;
            case Bap_acknowledge:
                break;
            default:
                    PrintIndicationError("Illegal DataType");
                    break;
        }
    break;
    case P_ASG_78_1_0_14_ID: 
        switch(gBAP_Indication_header[3]) // Datentyp 
        {
            case Bap_uint8:
                    switch(gBAP_Indication_header[2]) // IndType
                    {
                        case Data_IND: // Indicationtyp pruefen
                            // Daten setzen
                            putValue(P_ASG_78_1_0_14, gBAP_Indication_header[5]);
                            setControlBackColor(panel_name, "errfield_P_ASG_78_1_0_14", MakeRGB(255,255,255));  
                            setControlBackColor(panel_name, "panel_P_ASG_78_1_0_14", MakeRGB(255,255,255));  
                            break;                              
                        default:
                            PrintIndicationError("Illegal IndType");
                            break;
                    }
                    break;
            case Bap_error:
                gP_ASG_78_1_0_14_ErrCode = 0;
                putValue(P_ASG_78_1_0_14_ErrCode,  gBAP_Indication_header[5]);
                setControlBackColor(panel_name, "errfield_P_ASG_78_1_0_14", MakeRGB(255,79,79));  
                setControlBackColor(panel_name, "panel_P_ASG_78_1_0_14", MakeRGB(220,220,220));  
                break;
            case Bap_acknowledge:
                break;
            default:
                    PrintIndicationError("Illegal DataType");
                    break;
        }
    break;
    case P_ASG_78_1_0_15_ID: 
        switch(gBAP_Indication_header[3]) // Datentyp 
        {
            case Bap_uint8:
                    switch(gBAP_Indication_header[2]) // IndType
                    {
                        case Data_IND: // Indicationtyp pruefen
                            // Daten setzen
                            putValue(P_ASG_78_1_0_15, gBAP_Indication_header[5]);
                            setControlBackColor(panel_name, "errfield_P_ASG_78_1_0_15", MakeRGB(255,255,255));  
                            setControlBackColor(panel_name, "panel_P_ASG_78_1_0_15", MakeRGB(255,255,255));  
                            break;                              
                        default:
                            PrintIndicationError("Illegal IndType");
                            break;
                    }
                    break;
            case Bap_error:
                gP_ASG_78_1_0_15_ErrCode = 0;
                putValue(P_ASG_78_1_0_15_ErrCode,  gBAP_Indication_header[5]);
                setControlBackColor(panel_name, "errfield_P_ASG_78_1_0_15", MakeRGB(255,79,79));  
                setControlBackColor(panel_name, "panel_P_ASG_78_1_0_15", MakeRGB(220,220,220));  
                break;
            case Bap_acknowledge:
                break;
            default:
                    PrintIndicationError("Illegal DataType");
                    break;
        }
    break;
    case M_ASG_78_1_0_16_ID: 
            switch(gBAP_Indication_header[3]) // Datentyp
            {
                case Bap_byteSequence:
                    switch (gBAP_Indication_header[2]) // IndType
                    {
                        case Result_IND: 
                            putValue(M_ASG_78_1_0_16_State, "Result");
                            // Daten setzen
                            putValue(M_ASG_78_1_0_16_Result, gBAP_Indication_data, gBAP_Indication_header[4]);
                            setControlBackColor(panel_name, "errfield_M_ASG_78_1_0_16", MakeRGB(255,255,255));  
                            setControlBackColor(panel_name, "panel_M_ASG_78_1_0_16_Result", MakeRGB(255,255,255));  
                            break;
                        case Processing_IND:    
                            putValue(M_ASG_78_1_0_16_State, "Running");
                            // Wert von Processing anzeigen
                            putValue(M_ASG_78_1_0_16_Processing, gBAP_Indication_data, gBAP_Indication_header[4]);
                            setControlBackColor(panel_name, "errfield_M_ASG_78_1_0_16", MakeRGB(255,255,255));  
                            setControlBackColor(panel_name, "panel_M_ASG_78_1_0_16_Processing", MakeRGB(255,255,255));  
                            break;
                        default:
                            PrintIndicationError("Illegal IndType");
                            break;
                    }
                    break;
            case Bap_error:
                gM_ASG_78_1_0_16_ErrCode = 0;
                putValue(M_ASG_78_1_0_16_State, "Error");
                putValue(M_ASG_78_1_0_16_ErrCode,  gBAP_Indication_header[5]);
                setControlBackColor(panel_name, "errfield_M_ASG_78_1_0_16", MakeRGB(255,79,79));  
                setControlBackColor(panel_name, "panel_M_ASG_78_1_0_16_Result", MakeRGB(220,220,220));  
                setControlBackColor(panel_name, "panel_M_ASG_78_1_0_16_Processing", MakeRGB(220,220,220));  
                break;
            case Bap_acknowledge:
                break;
            default:
                    PrintIndicationError("Illegal DataType");
                    break;
            }
    break;
    case P_ASG_78_1_0_17_ID: 
        switch(gBAP_Indication_header[3]) // Datentyp 
        {
            case Bap_byteSequence:
                switch (gBAP_Indication_header[2]) // IndType
                {
                    case Data_IND: // Indicationtyp pruefen
                        // Daten setzen
                        putValue(P_ASG_78_1_0_17, gBAP_Indication_data, gBAP_Indication_header[4]);
                        setControlBackColor(panel_name, "errfield_P_ASG_78_1_0_17", MakeRGB(255,255,255));  
                        setControlBackColor(panel_name, "panel_P_ASG_78_1_0_17", MakeRGB(255,255,255));  
                        break;
                    default:
                        PrintIndicationError("Illegal IndType");
                        break;
                }
                break;
            case Bap_error:
                gP_ASG_78_1_0_17_ErrCode = 0;
                putValue(P_ASG_78_1_0_17_ErrCode,  gBAP_Indication_header[5]);
                setControlBackColor(panel_name, "errfield_P_ASG_78_1_0_17", MakeRGB(255,79,79));  
                setControlBackColor(panel_name, "panel_P_ASG_78_1_0_17", MakeRGB(220,220,220));  
                break;
            case Bap_acknowledge:
                break;
            default:
                PrintIndicationError("Illegal DataType");
                break;
        }
    break;
    case P_ASG_78_1_0_18_ID: 
        switch(gBAP_Indication_header[3]) // Datentyp 
        {
            case Bap_byteSequence:
                switch (gBAP_Indication_header[2]) // IndType
                {
                    case Data_IND: // Indicationtyp pruefen
                        // Daten setzen
                        putValue(P_ASG_78_1_0_18, gBAP_Indication_data, gBAP_Indication_header[4]);
                        setControlBackColor(panel_name, "errfield_P_ASG_78_1_0_18", MakeRGB(255,255,255));  
                        setControlBackColor(panel_name, "panel_P_ASG_78_1_0_18", MakeRGB(255,255,255));  
                        break;
                    default:
                        PrintIndicationError("Illegal IndType");
                        break;
                }
                break;
            case Bap_error:
                gP_ASG_78_1_0_18_ErrCode = 0;
                putValue(P_ASG_78_1_0_18_ErrCode,  gBAP_Indication_header[5]);
                setControlBackColor(panel_name, "errfield_P_ASG_78_1_0_18", MakeRGB(255,79,79));  
                setControlBackColor(panel_name, "panel_P_ASG_78_1_0_18", MakeRGB(220,220,220));  
                break;
            case Bap_acknowledge:
                break;
            default:
                PrintIndicationError("Illegal DataType");
                break;
        }
    break;
    case M_ASG_78_1_0_19_ID: 
            switch(gBAP_Indication_header[3]) // Datentyp
            {
                case Bap_byteSequence:
                    switch (gBAP_Indication_header[2]) // IndType
                    {
                        case Result_IND: 
                            putValue(M_ASG_78_1_0_19_State, "Result");
                            // Daten setzen
                            putValue(M_ASG_78_1_0_19_Result, gBAP_Indication_data, gBAP_Indication_header[4]);
                            setControlBackColor(panel_name, "errfield_M_ASG_78_1_0_19", MakeRGB(255,255,255));  
                            setControlBackColor(panel_name, "panel_M_ASG_78_1_0_19_Result", MakeRGB(255,255,255));  
                            break;
                        case Processing_IND:    
                            putValue(M_ASG_78_1_0_19_State, "Running");
                            // Wert von Processing anzeigen
                            putValue(M_ASG_78_1_0_19_Processing, gBAP_Indication_data, gBAP_Indication_header[4]);
                            setControlBackColor(panel_name, "errfield_M_ASG_78_1_0_19", MakeRGB(255,255,255));  
                            setControlBackColor(panel_name, "panel_M_ASG_78_1_0_19_Processing", MakeRGB(255,255,255));  
                            break;
                        default:
                            PrintIndicationError("Illegal IndType");
                            break;
                    }
                    break;
            case Bap_error:
                gM_ASG_78_1_0_19_ErrCode = 0;
                putValue(M_ASG_78_1_0_19_State, "Error");
                putValue(M_ASG_78_1_0_19_ErrCode,  gBAP_Indication_header[5]);
                setControlBackColor(panel_name, "errfield_M_ASG_78_1_0_19", MakeRGB(255,79,79));  
                setControlBackColor(panel_name, "panel_M_ASG_78_1_0_19_Result", MakeRGB(220,220,220));  
                setControlBackColor(panel_name, "panel_M_ASG_78_1_0_19_Processing", MakeRGB(220,220,220));  
                break;
            case Bap_acknowledge:
                break;
            default:
                    PrintIndicationError("Illegal DataType");
                    break;
            }
    break;
    case P_ASG_78_1_0_20_ID: 
        switch(gBAP_Indication_header[3]) // Datentyp 
        {
            case Bap_byteSequence:
                switch (gBAP_Indication_header[2]) // IndType
                {
                    case Data_IND: // Indicationtyp pruefen
                        // Daten setzen
                        putValue(P_ASG_78_1_0_20, gBAP_Indication_data, gBAP_Indication_header[4]);
                        setControlBackColor(panel_name, "errfield_P_ASG_78_1_0_20", MakeRGB(255,255,255));  
                        setControlBackColor(panel_name, "panel_P_ASG_78_1_0_20", MakeRGB(255,255,255));  
                        break;
                    default:
                        PrintIndicationError("Illegal IndType");
                        break;
                }
                break;
            case Bap_error:
                gP_ASG_78_1_0_20_ErrCode = 0;
                putValue(P_ASG_78_1_0_20_ErrCode,  gBAP_Indication_header[5]);
                setControlBackColor(panel_name, "errfield_P_ASG_78_1_0_20", MakeRGB(255,79,79));  
                setControlBackColor(panel_name, "panel_P_ASG_78_1_0_20", MakeRGB(220,220,220));  
                break;
            case Bap_acknowledge:
                break;
            default:
                PrintIndicationError("Illegal DataType");
                break;
        }
    break;
    case P_ASG_78_1_0_21_ID: 
        switch(gBAP_Indication_header[3]) // Datentyp 
        {
            case Bap_byteSequence:
                switch (gBAP_Indication_header[2]) // IndType
                {
                    case Data_IND: // Indicationtyp pruefen
                        // Daten setzen
                        putValue(P_ASG_78_1_0_21, gBAP_Indication_data, gBAP_Indication_header[4]);
                        setControlBackColor(panel_name, "errfield_P_ASG_78_1_0_21", MakeRGB(255,255,255));  
                        setControlBackColor(panel_name, "panel_P_ASG_78_1_0_21", MakeRGB(255,255,255));  
                        break;
                    default:
                        PrintIndicationError("Illegal IndType");
                        break;
                }
                break;
            case Bap_error:
                gP_ASG_78_1_0_21_ErrCode = 0;
                putValue(P_ASG_78_1_0_21_ErrCode,  gBAP_Indication_header[5]);
                setControlBackColor(panel_name, "errfield_P_ASG_78_1_0_21", MakeRGB(255,79,79));  
                setControlBackColor(panel_name, "panel_P_ASG_78_1_0_21", MakeRGB(220,220,220));  
                break;
            case Bap_acknowledge:
                break;
            default:
                PrintIndicationError("Illegal DataType");
                break;
        }
    break;
    case P_ASG_78_1_0_22_ID: 
        switch(gBAP_Indication_header[3]) // Datentyp 
        {
            case Bap_byteSequence:
                switch (gBAP_Indication_header[2]) // IndType
                {
                    case Data_IND: // Indicationtyp pruefen
                        // Daten setzen
                        putValue(P_ASG_78_1_0_22, gBAP_Indication_data, gBAP_Indication_header[4]);
                        setControlBackColor(panel_name, "errfield_P_ASG_78_1_0_22", MakeRGB(255,255,255));  
                        setControlBackColor(panel_name, "panel_P_ASG_78_1_0_22", MakeRGB(255,255,255));  
                        break;
                    default:
                        PrintIndicationError("Illegal IndType");
                        break;
                }
                break;
            case Bap_error:
                gP_ASG_78_1_0_22_ErrCode = 0;
                putValue(P_ASG_78_1_0_22_ErrCode,  gBAP_Indication_header[5]);
                setControlBackColor(panel_name, "errfield_P_ASG_78_1_0_22", MakeRGB(255,79,79));  
                setControlBackColor(panel_name, "panel_P_ASG_78_1_0_22", MakeRGB(220,220,220));  
                break;
            case Bap_acknowledge:
                break;
            default:
                PrintIndicationError("Illegal DataType");
                break;
        }
    break;
    case P_ASG_78_1_0_23_ID: 
        switch(gBAP_Indication_header[3]) // Datentyp 
        {
            case Bap_byteSequence:
                switch (gBAP_Indication_header[2]) // IndType
                {
                    case Data_IND: // Indicationtyp pruefen
                        // Daten setzen
                        putValue(P_ASG_78_1_0_23, gBAP_Indication_data, gBAP_Indication_header[4]);
                        setControlBackColor(panel_name, "errfield_P_ASG_78_1_0_23", MakeRGB(255,255,255));  
                        setControlBackColor(panel_name, "panel_P_ASG_78_1_0_23", MakeRGB(255,255,255));  
                        break;
                    default:
                        PrintIndicationError("Illegal IndType");
                        break;
                }
                break;
            case Bap_error:
                gP_ASG_78_1_0_23_ErrCode = 0;
                putValue(P_ASG_78_1_0_23_ErrCode,  gBAP_Indication_header[5]);
                setControlBackColor(panel_name, "errfield_P_ASG_78_1_0_23", MakeRGB(255,79,79));  
                setControlBackColor(panel_name, "panel_P_ASG_78_1_0_23", MakeRGB(220,220,220));  
                break;
            case Bap_acknowledge:
                break;
            default:
                PrintIndicationError("Illegal DataType");
                break;
        }
    break;
    case M_ASG_78_1_0_24_ID: 
            switch(gBAP_Indication_header[3]) // Datentyp
            {
                case Bap_byteSequence:
                    switch (gBAP_Indication_header[2]) // IndType
                    {
                        case Result_IND: 
                            putValue(M_ASG_78_1_0_24_State, "Result");
                            // Daten setzen
                            putValue(M_ASG_78_1_0_24_Result, gBAP_Indication_data, gBAP_Indication_header[4]);
                            setControlBackColor(panel_name, "errfield_M_ASG_78_1_0_24", MakeRGB(255,255,255));  
                            setControlBackColor(panel_name, "panel_M_ASG_78_1_0_24_Result", MakeRGB(255,255,255));  
                            break;
                        case Processing_IND:    
                            putValue(M_ASG_78_1_0_24_State, "Running");
                            // Wert von Processing anzeigen
                            putValue(M_ASG_78_1_0_24_Processing, gBAP_Indication_data, gBAP_Indication_header[4]);
                            setControlBackColor(panel_name, "errfield_M_ASG_78_1_0_24", MakeRGB(255,255,255));  
                            setControlBackColor(panel_name, "panel_M_ASG_78_1_0_24_Processing", MakeRGB(255,255,255));  
                            break;
                        default:
                            PrintIndicationError("Illegal IndType");
                            break;
                    }
                    break;
            case Bap_error:
                gM_ASG_78_1_0_24_ErrCode = 0;
                putValue(M_ASG_78_1_0_24_State, "Error");
                putValue(M_ASG_78_1_0_24_ErrCode,  gBAP_Indication_header[5]);
                setControlBackColor(panel_name, "errfield_M_ASG_78_1_0_24", MakeRGB(255,79,79));  
                setControlBackColor(panel_name, "panel_M_ASG_78_1_0_24_Result", MakeRGB(220,220,220));  
                setControlBackColor(panel_name, "panel_M_ASG_78_1_0_24_Processing", MakeRGB(220,220,220));  
                break;
            case Bap_acknowledge:
                break;
            default:
                    PrintIndicationError("Illegal DataType");
                    break;
            }
    break;
    case M_ASG_78_1_0_25_ID: 
            switch(gBAP_Indication_header[3]) // Datentyp
            {
                case Bap_byteSequence:
                    switch (gBAP_Indication_header[2]) // IndType
                    {
                        case Result_IND: 
                            putValue(M_ASG_78_1_0_25_State, "Result");
                            // Daten setzen
                            putValue(M_ASG_78_1_0_25_Result, gBAP_Indication_data, gBAP_Indication_header[4]);
                            setControlBackColor(panel_name, "errfield_M_ASG_78_1_0_25", MakeRGB(255,255,255));  
                            setControlBackColor(panel_name, "panel_M_ASG_78_1_0_25_Result", MakeRGB(255,255,255));  
                            break;
                        case Processing_IND:    
                            putValue(M_ASG_78_1_0_25_State, "Running");
                            // Wert von Processing anzeigen
                            putValue(M_ASG_78_1_0_25_Processing, gBAP_Indication_data, gBAP_Indication_header[4]);
                            setControlBackColor(panel_name, "errfield_M_ASG_78_1_0_25", MakeRGB(255,255,255));  
                            setControlBackColor(panel_name, "panel_M_ASG_78_1_0_25_Processing", MakeRGB(255,255,255));  
                            break;
                        default:
                            PrintIndicationError("Illegal IndType");
                            break;
                    }
                    break;
            case Bap_error:
                gM_ASG_78_1_0_25_ErrCode = 0;
                putValue(M_ASG_78_1_0_25_State, "Error");
                putValue(M_ASG_78_1_0_25_ErrCode,  gBAP_Indication_header[5]);
                setControlBackColor(panel_name, "errfield_M_ASG_78_1_0_25", MakeRGB(255,79,79));  
                setControlBackColor(panel_name, "panel_M_ASG_78_1_0_25_Result", MakeRGB(220,220,220));  
                setControlBackColor(panel_name, "panel_M_ASG_78_1_0_25_Processing", MakeRGB(220,220,220));  
                break;
            case Bap_acknowledge:
                break;
            default:
                    PrintIndicationError("Illegal DataType");
                    break;
            }
    break;
       default:
           writelineEx(gError_Trace, 0, "NodeIndex: %d: Illegal Fct: lsgid:%d fctid:%d indType:%d",
           NODE_INDEX, gBAP_Indication_header[0], gBAP_Indication_header[1], gBAP_Indication_header[2]);
           break;
       }
       break;
   default:
       writelineEx(gError_Trace, 0, "NodeIndex: %d: Illegal LSGID: lsgid:%d fctid:%d indType:%s", NODE_INDEX, gBAP_Indication_header[0], gBAP_Indication_header[1], Indicationtype_Text[gBAP_Indication_header[2]]);
       break;
   }
}

on message BAP_RemoteServices_FSG_01
{
   int i, temp;
   byte RX_Data[8];            // received CAN-DATA
   dword RX_Header[3];         // received CAN-Header
   if(gSG_PowerOnOff==Power_on){
       RX_Header[0]=this.CAN;
       RX_Header[1]=this.ID;
       RX_Header[2]=this.DLC; // received length
       for (i=0; i<this.DLC; i++) {
           RX_Data[i]=this.byte(i);
       }
       temp=BAP150_CAN_SetRxDat(NODE_INDEX, RX_Header, RX_Data);
   }
}

intertelegram_err(long fctId)
{
    long data[4];
    data[0]=LSGID;
    data[1]=fctId;
    data[2]=1;
    data[3]=940;
    ChangeConfig(0x0020,data);
}

sequence_err(long fctId, long size)
{
    long data[5];
    long lastSeg;

    lastSeg = size-5;

    data[0]=LSGID;
    data[1]=fctId;
    data[2]=lastSeg/7+1;
    data[3]=1;
    data[4]=(lastSeg/7+4) & 15;
    ChangeConfig(0x0021,data);
}

intertelegram_err_off(long fctId)
{
    long data[4];
    data[0]=LSGID;
    data[1]=fctId;
    data[2]=5000;
    data[3]=0;
    ChangeConfig(0x0020,data);
}

sequence_err_off(long fctId)
{
    long data[5];

    data[0]=LSGID;
    data[1]=fctId;
    data[2]=5000;
    data[3]=0;
    data[4]=0;
    ChangeConfig(0x0021,data);
}

// START OF BUS CONFIG PANEL CAPL

// ETHERNET AND FLEXRAY NOT ENABLED! (ENABLE_BUS_SELECTOR_PANEL_TOKEN)

// ETHERNET AND FLEXRAY NOT ENABLED! (ENABLE_CAN_FRAME_TOKEN)

// ETHERNET AND FLEXRAY NOT ENABLED! (ENABLE_FR_FRAME_TOKEN)

// ETHERNET AND FLEXRAY NOT ENABLED! (ENABLE_ETHERNET_FRAME_TOKEN)

// ETHERNET AND FLEXRAY NOT ENABLED! (ENABLE_IP_FORMAT_TOKEN)

// ETHERNET AND FLEXRAY NOT ENABLED! (ON_ENVVAR_BUSTYPE_TOKEN)

// ETHERNET NOT ENABLED! (ON_ENVVAR_ETHERNET_APPLY_BTN_TOKEN)

// ETHERNET NOT ENABLED! (ON_ENVVAR_ETHERNET_RESET_BTN_TOKEN)

// ETHERNET NOT ENABLED! (ON_ENVVAR_IP_INTERFACE_LIST_TOKEN)

// ETHERNET NOT ENABLED! (ON_ENVVAR_IP_FORMAT_TOKEN)

// ETHERNET NOT ENABLED! (ON_UDP_RECEIVE_FROM_TOKEN)

// ETHERNET NOT ENABLED!

on envVar ON_OFF_ASG78_1
{
   BapOnOff(getvalue(this));
   gSG_PowerOnOff=getvalue(ON_OFF_ASG78_1);
}

on envVar C_ASG_78_1_0_1GetAll_BTN
{
 if (C_ASG_78_1_0_1GetAll_BTN_already_pressed == 0)
  {
     C_ASG_78_1_0_1GetAll_BTN_already_pressed = 1;
     Request_Void(LSGID, C_ASG_78_1_0_1_ID, DataGet_REQ); 
     putValue(C_ASG_78_1_0_1_State, "GetAll");
     setControlBackColor(panel_name, "errfield_C_ASG_78_1_0_1_State", MakeRGB(255,255,255));
 }
 else
 {
     C_ASG_78_1_0_1GetAll_BTN_already_pressed = 0;
 }
}

on envVar P_ASG_78_1_0_2Get_BTN
{
 if (P_ASG_78_1_0_2Get_BTN_already_pressed == 0)
  {
       putValue(P_ASG_78_1_0_2_ErrCode,0);
       SetControlBackColor(panel_name,"errField_P_ASG_78_1_0_2",MakeRGB(255,255,255));
       P_ASG_78_1_0_2Get_BTN_already_pressed = 1;
 }
 else
 {
       Request_Void(LSGID, P_ASG_78_1_0_2_ID, DataGet_REQ); 
       P_ASG_78_1_0_2Get_BTN_already_pressed = 0;
 }
}

on envVar P_ASG_78_1_0_3Get_BTN
{
 if (P_ASG_78_1_0_3Get_BTN_already_pressed == 0)
  {
       putValue(P_ASG_78_1_0_3_ErrCode,0);
       SetControlBackColor(panel_name,"errField_P_ASG_78_1_0_3",MakeRGB(255,255,255));
       P_ASG_78_1_0_3Get_BTN_already_pressed = 1;
 }
 else
 {
       Request_Void(LSGID, P_ASG_78_1_0_3_ID, DataGet_REQ); 
       P_ASG_78_1_0_3Get_BTN_already_pressed = 0;
 }
}

on envVar P_ASG_78_1_0_4Get_BTN
{
 if (P_ASG_78_1_0_4Get_BTN_already_pressed == 0)
  {
       putValue(P_ASG_78_1_0_4_ErrCode,0);
       SetControlBackColor(panel_name,"errField_P_ASG_78_1_0_4",MakeRGB(255,255,255));
       P_ASG_78_1_0_4Get_BTN_already_pressed = 1;
 }
 else
 {
       Request_Void(LSGID, P_ASG_78_1_0_4_ID, DataGet_REQ); 
       P_ASG_78_1_0_4Get_BTN_already_pressed = 0;
 }
}

on envVar P_ASG_78_1_0_13Get_BTN
{
 if (P_ASG_78_1_0_13Get_BTN_already_pressed == 0)
  {
       putValue(P_ASG_78_1_0_13_ErrCode,0);
       SetControlBackColor(panel_name,"errField_P_ASG_78_1_0_13",MakeRGB(255,255,255));
       P_ASG_78_1_0_13Get_BTN_already_pressed = 1;
 }
 else
 {
       Request_Void(LSGID, P_ASG_78_1_0_13_ID, DataGet_REQ); 
       P_ASG_78_1_0_13Get_BTN_already_pressed = 0;
 }
}

on envVar P_ASG_78_1_0_13SetGet_BTN
{
    if (P_ASG_78_1_0_13SetGet_BTN_already_pressed == 0)
    {
       putValue(P_ASG_78_1_0_13_ErrCode,0);
       SetControlBackColor(panel_name,"errField_P_ASG_78_1_0_13",MakeRGB(255,255,255));
       P_ASG_78_1_0_13SetGet_BTN_already_pressed = 1;
    }
    else
    {
       Request_Int8(LSGID, P_ASG_78_1_0_13_ID, DataSetGet_REQ, getValue(P_ASG_78_1_0_13));
       P_ASG_78_1_0_13SetGet_BTN_already_pressed = 0;
    }
}

on envVar P_ASG_78_1_0_13 // bus value of FSG_Control (13).
{
	// opcodes: Error-Status
	byte param1; // Controlcode
	// DATATYPE_UINTXX
	param1 = getValue(P_ASG_78_1_0_13);
	putValue(P_ASG_78_1_0_13_1, param1);
}

on envVar P_ASG_78_1_0_13_1_0
{
	byte bitval;
	//thisval steht hier fuer den bitfield-wert, 
	//aus Generierungsgruenden hier keine einheitliche Bezeichnung moeglich.
	byte thisval; // Controlcode
	bitval= getValue(this);
	thisval = getValue(P_ASG_78_1_0_13_1);
	thisval = thisval&~(1<<0)|(bitval<<0);
	putValue(P_ASG_78_1_0_13_1,thisval);
}

on envVar P_ASG_78_1_0_13_1_4
{
	byte bitval;
	//thisval steht hier fuer den bitfield-wert, 
	//aus Generierungsgruenden hier keine einheitliche Bezeichnung moeglich.
	byte thisval; // Controlcode
	bitval= getValue(this);
	thisval = getValue(P_ASG_78_1_0_13_1);
	thisval = thisval&~(1<<4)|(bitval<<4);
	putValue(P_ASG_78_1_0_13_1,thisval);
}

on envVar P_ASG_78_1_0_13_1 // FSG_Control.Controlcode
{
	byte superval;

	//Update Childvalue (BitField)
	byte mask=0x01;
	int i = 0;
	byte thisval; // Controlcode
	thisval = getValue(this);
	if(thisval&(mask<<0))
		putValue(P_ASG_78_1_0_13_1_0, 1);
	else
		putValue(P_ASG_78_1_0_13_1_0, 0);
	if(thisval&(mask<<4))
		putValue(P_ASG_78_1_0_13_1_4, 1);
	else
		putValue(P_ASG_78_1_0_13_1_4, 0);

    // Update superval
	superval = getValue(P_ASG_78_1_0_13);
	superval = thisval;
	putValue(P_ASG_78_1_0_13,superval);
}

on envVar P_ASG_78_1_0_14Get_BTN
{
 if (P_ASG_78_1_0_14Get_BTN_already_pressed == 0)
  {
       putValue(P_ASG_78_1_0_14_ErrCode,0);
       SetControlBackColor(panel_name,"errField_P_ASG_78_1_0_14",MakeRGB(255,255,255));
       P_ASG_78_1_0_14Get_BTN_already_pressed = 1;
 }
 else
 {
       Request_Void(LSGID, P_ASG_78_1_0_14_ID, DataGet_REQ); 
       P_ASG_78_1_0_14Get_BTN_already_pressed = 0;
 }
}

on envVar P_ASG_78_1_0_14 // bus value of FSG_Setup (14).
{
	// opcodes: Error-Status
	byte param1; // Setup
	// DATATYPE_UINTXX
	param1 = getValue(P_ASG_78_1_0_14);
	putValue(P_ASG_78_1_0_14_1, param1);
}

on envVar P_ASG_78_1_0_14_1 // FSG_Setup.Setup
{
	byte superval;

	//Update Childvalue (BitField)
	byte mask=0x01;
	int i = 0;
	byte thisval; // Setup
	thisval = getValue(this);

    // Update superval
	superval = getValue(P_ASG_78_1_0_14);
	superval = thisval;
	putValue(P_ASG_78_1_0_14,superval);
}

on envVar P_ASG_78_1_0_15Get_BTN
{
 if (P_ASG_78_1_0_15Get_BTN_already_pressed == 0)
  {
       putValue(P_ASG_78_1_0_15_ErrCode,0);
       SetControlBackColor(panel_name,"errField_P_ASG_78_1_0_15",MakeRGB(255,255,255));
       P_ASG_78_1_0_15Get_BTN_already_pressed = 1;
 }
 else
 {
       Request_Void(LSGID, P_ASG_78_1_0_15_ID, DataGet_REQ); 
       P_ASG_78_1_0_15Get_BTN_already_pressed = 0;
 }
}

on envVar P_ASG_78_1_0_15 // bus value of FSG_OperationState (15).
{
	// opcodes: Error-Status
	byte param1; // OP_State
	// DATATYPE_UINTXX
	param1 = getValue(P_ASG_78_1_0_15);
	putValue(P_ASG_78_1_0_15_1, param1);
}

on envVar P_ASG_78_1_0_15_1 // FSG_OperationState.OP_State
{
	byte superval;

	//Update Childvalue (Enum)
	byte thisval; // OP_State
	thisval = getValue(this);

    // Update superval
	superval = getValue(P_ASG_78_1_0_15);
	superval = thisval;
	putValue(P_ASG_78_1_0_15,superval);
}

on envVar M_ASG_78_1_0_16AbortResult_BTN
{
    if (M_ASG_78_1_0_16AbortResult_BTN_already_pressed == 0)
    {
         putValue(M_ASG_78_1_0_16_ErrCode,0);
         SetControlBackColor(panel_name,"errField_M_ASG_78_1_0_16",MakeRGB(255,255,255));
         M_ASG_78_1_0_16AbortResult_BTN_already_pressed = 1;
    }
    else
    {
         putValue(M_ASG_78_1_0_16_State, "AbortResult");
         Request_Void(LSGID, M_ASG_78_1_0_16_ID, AbortResult_REQ);
         M_ASG_78_1_0_16AbortResult_BTN_already_pressed = 0;
    }
}

on envVar M_ASG_78_1_0_16StartResult_BTN
{
    byte temp[6];
    if (M_ASG_78_1_0_16StartResult_BTN_already_pressed == 0)
    {
        putValue(M_ASG_78_1_0_16_ErrCode,0);
        SetControlBackColor(panel_name,"errField_M_ASG_78_1_0_16",MakeRGB(255,255,255));
        M_ASG_78_1_0_16StartResult_BTN_already_pressed = 1;
    }
    else
    {
        getValue(M_ASG_78_1_0_16_Start, temp);
        Request_ByteSequence(LSGID, M_ASG_78_1_0_16_ID, StartResult_REQ, temp, getValueSize(M_ASG_78_1_0_16_Start));
        putValue(M_ASG_78_1_0_16_State, "Started");
        M_ASG_78_1_0_16StartResult_BTN_already_pressed = 0;
    }
}

on envVar M_ASG_78_1_0_16_Result // bus value of StartEngineChallenge (16).
{
	// opcodes: Error-Processing-Result
	byte param1[11]; // DataAcknowledge
	word len1;
	byte cnt1;
	// DATATYPE_BYTESEQUENCE / DATATYPE_FIXEDBYTESEQUENCE
	int i;
	byte superval[11];
	int currentPos;
	currentPos = 0;
	for( i = 0; i < 11; i++ ) {
		superval[i] = 0;
	}
	getValue(M_ASG_78_1_0_16_Result, superval);
	///////// Start param1 - STRING /////////
	getValue(M_ASG_78_1_0_16_Result_1, param1);
	if((superval[currentPos] & 0x80) > 0)
	{
		if(10>127) /* Max Fct-Katalog Laenge: 10*/
		{
			len1 = ( (superval[currentPos]&0x7F) <<8) + superval[currentPos+1];
			currentPos = currentPos + 2;
			cnt1 = 1;
		}
		else
		{
			len1 = 10;
			writelineEx(gBAP_Trace, 0, "Anzahl der Laengeninformation-Bytes in M_ASG_78_1_0_16_Result ueberschreitet die erlaubte 1 Byte vom Fct-Kalatog.");
		}
	}
	else
	{
		len1 = superval[currentPos]&0x7F;
		currentPos = currentPos + 1;
		cnt1 = 0;
	}
	
	if(len1 > 10)
	{
		writelineEx(gBAP_Trace, 0, "Laenge:%d bei der Byte Position:%d ueberschreitet die Maximale erlaubte Laenge von Fct-Kalatog", len1, currentPos);
		len1 = 10;
	
		if(len1 < 128) cnt1 = 0;
		else cnt1 = 1;
	}
	
	for(i = 0; i < len1; i++)
	{
		param1[i] = superval[currentPos++];
	}
	
	putValue(M_ASG_78_1_0_16_Result_1_len, len1);
	putValue(M_ASG_78_1_0_16_Result_1_cnt, cnt1);
	
	if(len1 > getValueSize(M_ASG_78_1_0_16_Result_1))
		putValue(M_ASG_78_1_0_16_Result_1, param1, len1);
	else
		putValue(M_ASG_78_1_0_16_Result_1, param1, getValueSize(M_ASG_78_1_0_16_Result_1));

}

// Updates the bus value field and other dependencies.
M_ASG_78_1_0_16_Result_BuildFct()
{
	byte param1[11]; // DataAcknowledge
	word len1;
	byte cnt1;

	int i;
	byte superval[11];
	int currentPos;
	currentPos = 0;
// gen_BuildFunc_SetSuperVals 
	getValue(M_ASG_78_1_0_16_Result_1, param1);
	len1 = getValue(M_ASG_78_1_0_16_Result_1_len);
	cnt1= getValue(M_ASG_78_1_0_16_Result_1_cnt);
	
	/* check box aktiviert*/
	if (cnt1 == 1)
	{
		/* 0 bis 10 (MaxString - 1B oder 2B) */
		if(len1 >= 0 && len1 <= 10)
		{
			//writelineEx(gBAP_Trace, 0, "[Debug-1] Len1: %d", len1);
			superval[currentPos] = (len1&0x7f00) | 0x80;
			superval[currentPos+1] = len1 & 0x00ff;
		}
		else
		{
			writelineEx(gBAP_Trace, 0, "Eingegebene Laenge: %d von M_ASG_78_1_0_16_Result_1 ist ungueltig. Die max. erlaubte Laenge ist %d.", len1, 10);
			return;
		}
	}
	else if(cnt1 == 0) /*check box deaktiviert*/
	{
		if(len1 >= 0 && len1 <= 127)
		{
			//writelineEx(gBAP_Trace, 0, "[Debug-1] Len1: %d", len1);
			superval[currentPos]= len1 & 0x00ff;
			putValue(M_ASG_78_1_0_16_Result_1_len, len1);
		}
		else if(len1 > 127 && len1 <= 10)
		{
			superval[currentPos] = (len1&0x7f00) | 0x80;
			superval[currentPos+1] = len1 & 0x00ff;
			putValue(M_ASG_78_1_0_16_Result_1_len, len1);
			putValue(M_ASG_78_1_0_16_Result_1_cnt, 1);
		}
		else
		{
			writelineEx(gBAP_Trace, 0, "Eingegebene Laenge: %d von M_ASG_78_1_0_16_Result_1 ist ungueltig. Die max. erlaubte Laenge ist %d.", len1, 10);
			return;
		}
	}
	currentPos += cnt1+1;
	for(i = 0; i < len1; i++)
	{
		superval[currentPos++]= param1[i];
	}

	putValue(M_ASG_78_1_0_16_Result, superval, currentPos);
}

// Ueberwachung der CheckBox fuer String
on envVar  M_ASG_78_1_0_16_Result_1_cnt
{
	word len;
	byte cnt;
	len = getValue(M_ASG_78_1_0_16_Result_1_len);
	cnt = getValue(M_ASG_78_1_0_16_Result_1_cnt);

	/* wird nur gerufen, wenn check box deaktiviert mit Length>127*/ 
	if( cnt == 0) 
	{
		if(len > 127 )
		{
			putValue(M_ASG_78_1_0_16_Result_1_len, 127);
		}
	}

	M_ASG_78_1_0_16_Result_BuildFct();
}

// Ueberwachung der Eingabefeld fuer String Data
on envVar M_ASG_78_1_0_16_Result_1_len
{
	word len;
	len = getValue(this);
	/* Validierung der Eingabe*/
	if(len > 10)
	{
		writelineEx(gBAP_Trace, 0, "Eingegebene Laenge: %d von M_ASG_78_1_0_16_Result_1 ist ungueltig. Die max. erlaubte Laenge ist %d. ", len, 10);
		putValue(this, 10);
	}
	M_ASG_78_1_0_16_Result_BuildFct();
}

on envVar M_ASG_78_1_0_16_Result_1 // StartEngineChallenge.DataAcknowledge
{
	putValue(M_ASG_78_1_0_16_Result_1_len, getValueSize(this));
	M_ASG_78_1_0_16_Result_BuildFct();
}

on envVar M_ASG_78_1_0_16_Processing // bus value of StartEngineChallenge (16).
{
	// opcodes: Error-Processing-Result
	byte param1; // Reserve1
	// DATATYPE_BYTESEQUENCE / DATATYPE_FIXEDBYTESEQUENCE
	int i;
	byte superval[11];
	int currentPos;
	currentPos = 0;
	for( i = 0; i < 11; i++ ) {
		superval[i] = 0;
	}
	getValue(M_ASG_78_1_0_16_Processing, superval);
	///////// Start param1 - UINT8 /////////
	param1 = superval[currentPos++];
	putValue(M_ASG_78_1_0_16_Processing_1, round((param1 * 1.0) - (0) + (0), 1.0));
}

// Updates the bus value field and other dependencies.
M_ASG_78_1_0_16_Processing_BuildFct()
{
	byte param1; // Reserve1

	int i;
	byte superval[11];
	int currentPos;
	currentPos = 0;
// gen_BuildFunc_SetSuperVals 
	@M_ASG_78_1_0_16_Processing_1_range = round(@M_ASG_78_1_0_16_Processing_1 + (0), 1.0); // slider value + min = real value
	param1 = 0; // underlying parameter has constant value 0.
	superval[currentPos++]=param1;
	putValue(M_ASG_78_1_0_16_Processing, superval, currentPos);
}

// Ueberwachung der Darstellungsvariable der Range.
on envVar M_ASG_78_1_0_16_Processing_1_range // StartEngineChallenge.Reserve1 
{
	@M_ASG_78_1_0_16_Processing_1 = @M_ASG_78_1_0_16_Processing_1_range - (0); // slider = range - min
}

on envVar M_ASG_78_1_0_16_Processing_1 // StartEngineChallenge.Reserve1
{
	M_ASG_78_1_0_16_Processing_BuildFct();
}

on envVar M_ASG_78_1_0_16_Start // bus value of StartEngineChallenge (16).
{
	// opcodes: AbortResult-StartResult
	byte param1[6]; // DataRequest
	// DATATYPE_BYTESEQUENCE / DATATYPE_FIXEDBYTESEQUENCE
	int i;
	byte superval[6];
	int currentPos;
	currentPos = 0;
	for( i = 0; i < 6; i++ ) {
		superval[i] = 0;
	}
	getValue(M_ASG_78_1_0_16_Start, superval);
	///////// Start param1 - STRING (fixedBytesequnece)/////////
	for( i = 0; i < 6; i++ )
	{
		param1[i] = superval[currentPos++];
	}
	putValue(M_ASG_78_1_0_16_Start_1, param1, 6);
}

on envVar M_ASG_78_1_0_16_Start_1 // StartEngineChallenge.DataRequest
{
	byte superval[6];

	//Update Childvalue (String)
	word i;
	byte thisval[6];
	getValue(this, thisval);

    // Update superval
	getValue(M_ASG_78_1_0_16_Start, superval);
	for( i = 0; i < 6; i++ )
	{
		superval[i+0] = thisval[i];
	}
	putValue(M_ASG_78_1_0_16_Start,superval);
}

on envVar P_ASG_78_1_0_17Get_BTN
{
 if (P_ASG_78_1_0_17Get_BTN_already_pressed == 0)
  {
       putValue(P_ASG_78_1_0_17_ErrCode,0);
       SetControlBackColor(panel_name,"errField_P_ASG_78_1_0_17",MakeRGB(255,255,255));
       P_ASG_78_1_0_17Get_BTN_already_pressed = 1;
 }
 else
 {
       Request_Void(LSGID, P_ASG_78_1_0_17_ID, DataGet_REQ); 
       P_ASG_78_1_0_17Get_BTN_already_pressed = 0;
 }
}

on envVar P_ASG_78_1_0_17 // bus value of StartEngineAuthentication (17).
{
	// opcodes: Error-Status
	byte param1[41]; // Data
	word len1;
	byte cnt1;
	byte param2; // Status
	// DATATYPE_BYTESEQUENCE / DATATYPE_FIXEDBYTESEQUENCE
	int i;
	byte superval[42];
	int currentPos;
	currentPos = 0;
	for( i = 0; i < 42; i++ ) {
		superval[i] = 0;
	}
	getValue(P_ASG_78_1_0_17, superval);
	///////// Start param1 - STRING /////////
	getValue(P_ASG_78_1_0_17_1, param1);
	if((superval[currentPos] & 0x80) > 0)
	{
		if(40>127) /* Max Fct-Katalog Laenge: 40*/
		{
			len1 = ( (superval[currentPos]&0x7F) <<8) + superval[currentPos+1];
			currentPos = currentPos + 2;
			cnt1 = 1;
		}
		else
		{
			len1 = 40;
			writelineEx(gBAP_Trace, 0, "Anzahl der Laengeninformation-Bytes in P_ASG_78_1_0_17 ueberschreitet die erlaubte 1 Byte vom Fct-Kalatog.");
		}
	}
	else
	{
		len1 = superval[currentPos]&0x7F;
		currentPos = currentPos + 1;
		cnt1 = 0;
	}
	
	if(len1 > 40)
	{
		writelineEx(gBAP_Trace, 0, "Laenge:%d bei der Byte Position:%d ueberschreitet die Maximale erlaubte Laenge von Fct-Kalatog", len1, currentPos);
		len1 = 40;
	
		if(len1 < 128) cnt1 = 0;
		else cnt1 = 1;
	}
	
	for(i = 0; i < len1; i++)
	{
		param1[i] = superval[currentPos++];
	}
	
	putValue(P_ASG_78_1_0_17_1_len, len1);
	putValue(P_ASG_78_1_0_17_1_cnt, cnt1);
	
	if(len1 > getValueSize(P_ASG_78_1_0_17_1))
		putValue(P_ASG_78_1_0_17_1, param1, len1);
	else
		putValue(P_ASG_78_1_0_17_1, param1, getValueSize(P_ASG_78_1_0_17_1));

	///////// Start param2 - UINT8 /////////
	param2 = superval[currentPos++];
	putValue(P_ASG_78_1_0_17_2, param2);
}

// Updates the bus value field and other dependencies.
P_ASG_78_1_0_17_BuildFct()
{
	byte param1[41]; // Data
	word len1;
	byte cnt1;
	byte param2; // Status

	int i;
	byte superval[42];
	int currentPos;
	currentPos = 0;
// gen_BuildFunc_SetSuperVals 
	getValue(P_ASG_78_1_0_17_1, param1);
	len1 = getValue(P_ASG_78_1_0_17_1_len);
	cnt1= getValue(P_ASG_78_1_0_17_1_cnt);
	
	/* check box aktiviert*/
	if (cnt1 == 1)
	{
		/* 0 bis 40 (MaxString - 1B oder 2B) */
		if(len1 >= 0 && len1 <= 40)
		{
			//writelineEx(gBAP_Trace, 0, "[Debug-1] Len1: %d", len1);
			superval[currentPos] = (len1&0x7f00) | 0x80;
			superval[currentPos+1] = len1 & 0x00ff;
		}
		else
		{
			writelineEx(gBAP_Trace, 0, "Eingegebene Laenge: %d von P_ASG_78_1_0_17_1 ist ungueltig. Die max. erlaubte Laenge ist %d.", len1, 40);
			return;
		}
	}
	else if(cnt1 == 0) /*check box deaktiviert*/
	{
		if(len1 >= 0 && len1 <= 127)
		{
			//writelineEx(gBAP_Trace, 0, "[Debug-1] Len1: %d", len1);
			superval[currentPos]= len1 & 0x00ff;
			putValue(P_ASG_78_1_0_17_1_len, len1);
		}
		else if(len1 > 127 && len1 <= 40)
		{
			superval[currentPos] = (len1&0x7f00) | 0x80;
			superval[currentPos+1] = len1 & 0x00ff;
			putValue(P_ASG_78_1_0_17_1_len, len1);
			putValue(P_ASG_78_1_0_17_1_cnt, 1);
		}
		else
		{
			writelineEx(gBAP_Trace, 0, "Eingegebene Laenge: %d von P_ASG_78_1_0_17_1 ist ungueltig. Die max. erlaubte Laenge ist %d.", len1, 40);
			return;
		}
	}
	currentPos += cnt1+1;
	for(i = 0; i < len1; i++)
	{
		superval[currentPos++]= param1[i];
	}

// gen_BuildFunc_SetSuperVals 
	param2 = getValue(P_ASG_78_1_0_17_2);
	superval[currentPos++]=param2;
	putValue(P_ASG_78_1_0_17, superval, currentPos);
}

// Ueberwachung der CheckBox fuer String
on envVar  P_ASG_78_1_0_17_1_cnt
{
	word len;
	byte cnt;
	len = getValue(P_ASG_78_1_0_17_1_len);
	cnt = getValue(P_ASG_78_1_0_17_1_cnt);

	/* wird nur gerufen, wenn check box deaktiviert mit Length>127*/ 
	if( cnt == 0) 
	{
		if(len > 127 )
		{
			putValue(P_ASG_78_1_0_17_1_len, 127);
		}
	}

	P_ASG_78_1_0_17_BuildFct();
}

// Ueberwachung der Eingabefeld fuer String Data
on envVar P_ASG_78_1_0_17_1_len
{
	word len;
	len = getValue(this);
	/* Validierung der Eingabe*/
	if(len > 40)
	{
		writelineEx(gBAP_Trace, 0, "Eingegebene Laenge: %d von P_ASG_78_1_0_17_1 ist ungueltig. Die max. erlaubte Laenge ist %d. ", len, 40);
		putValue(this, 40);
	}
	P_ASG_78_1_0_17_BuildFct();
}

on envVar P_ASG_78_1_0_17_1 // StartEngineAuthentication.Data
{
	putValue(P_ASG_78_1_0_17_1_len, getValueSize(this));
	P_ASG_78_1_0_17_BuildFct();
}

on envVar P_ASG_78_1_0_17_2 // StartEngineAuthentication.Status
{
	P_ASG_78_1_0_17_BuildFct();
}

on envVar P_ASG_78_1_0_18Get_BTN
{
 if (P_ASG_78_1_0_18Get_BTN_already_pressed == 0)
  {
       putValue(P_ASG_78_1_0_18_ErrCode,0);
       SetControlBackColor(panel_name,"errField_P_ASG_78_1_0_18",MakeRGB(255,255,255));
       P_ASG_78_1_0_18Get_BTN_already_pressed = 1;
 }
 else
 {
       Request_Void(LSGID, P_ASG_78_1_0_18_ID, DataGet_REQ); 
       P_ASG_78_1_0_18Get_BTN_already_pressed = 0;
 }
}

on envVar P_ASG_78_1_0_18Set_BTN
{
	byte BAPTemp[36];
    if (P_ASG_78_1_0_18Set_BTN_already_pressed == 0)
    {
       putValue(P_ASG_78_1_0_18_ErrCode,0);
       SetControlBackColor(panel_name,"errField_P_ASG_78_1_0_18",MakeRGB(255,255,255));
       P_ASG_78_1_0_18Set_BTN_already_pressed = 1;
    }
    else
    {
	   P_ASG_78_1_0_18_BuildFct();
       getValue(P_ASG_78_1_0_18, BAPTemp);
       Request_ByteSequence(LSGID, P_ASG_78_1_0_18_ID, DataSet_REQ, BAPTemp, getValueSize(P_ASG_78_1_0_18));
       if(getValue(P_ASG_78_1_0_18_IntTlgEn)) //getValue(IT))
       {
          intertelegram_err(P_ASG_78_1_0_18_ID);
       }
       if(getValue(P_ASG_78_1_0_18_SegmEn))   //getvalue(SG)
       {
          sequence_err(P_ASG_78_1_0_18_ID,elCount(BAPTemp));
       }
       P_ASG_78_1_0_18Set_BTN_already_pressed = 0;
    }
}

// Man darf gleichzeitig nur Checkbox fuer SegmError oder IntertelegramError aktiviert werden
on envVar P_ASG_78_1_0_18_IntTlgEn
{
       if(getValue(this)) 
       {
           putValue(P_ASG_78_1_0_18_SegmEn,0);
           intertelegram_err(P_ASG_78_1_0_18_ID);
       }
       else
       {
           intertelegram_err_off(P_ASG_78_1_0_18_ID);
       }
}

// Man darf gleichzeitig nur Checkbox fuer SegmError oder IntertelegramError aktiviert werden
on envVar P_ASG_78_1_0_18_SegmEn
{
       if(getValue(this)) 
       {
           putValue(P_ASG_78_1_0_18_IntTlgEn,0);
           sequence_err(P_ASG_78_1_0_18_ID,getValueSize(P_ASG_78_1_0_18_SegmEn));
       }
       else
       {
              sequence_err_off(P_ASG_78_1_0_18_ID);
       }
}

on envVar P_ASG_78_1_0_18 // bus value of StartEngineSignature (18).
{
	// opcodes: Error-Status
	byte param1[36]; // Data
	word len1;
	byte cnt1;
	// DATATYPE_BYTESEQUENCE / DATATYPE_FIXEDBYTESEQUENCE
	int i;
	byte superval[36];
	int currentPos;
	currentPos = 0;
	for( i = 0; i < 36; i++ ) {
		superval[i] = 0;
	}
	getValue(P_ASG_78_1_0_18, superval);
	///////// Start param1 - STRING /////////
	getValue(P_ASG_78_1_0_18_1, param1);
	if((superval[currentPos] & 0x80) > 0)
	{
		if(35>127) /* Max Fct-Katalog Laenge: 35*/
		{
			len1 = ( (superval[currentPos]&0x7F) <<8) + superval[currentPos+1];
			currentPos = currentPos + 2;
			cnt1 = 1;
		}
		else
		{
			len1 = 35;
			writelineEx(gBAP_Trace, 0, "Anzahl der Laengeninformation-Bytes in P_ASG_78_1_0_18 ueberschreitet die erlaubte 1 Byte vom Fct-Kalatog.");
		}
	}
	else
	{
		len1 = superval[currentPos]&0x7F;
		currentPos = currentPos + 1;
		cnt1 = 0;
	}
	
	if(len1 > 35)
	{
		writelineEx(gBAP_Trace, 0, "Laenge:%d bei der Byte Position:%d ueberschreitet die Maximale erlaubte Laenge von Fct-Kalatog", len1, currentPos);
		len1 = 35;
	
		if(len1 < 128) cnt1 = 0;
		else cnt1 = 1;
	}
	
	for(i = 0; i < len1; i++)
	{
		param1[i] = superval[currentPos++];
	}
	
	putValue(P_ASG_78_1_0_18_1_len, len1);
	putValue(P_ASG_78_1_0_18_1_cnt, cnt1);
	
	if(len1 > getValueSize(P_ASG_78_1_0_18_1))
		putValue(P_ASG_78_1_0_18_1, param1, len1);
	else
		putValue(P_ASG_78_1_0_18_1, param1, getValueSize(P_ASG_78_1_0_18_1));

}

// Updates the bus value field and other dependencies.
P_ASG_78_1_0_18_BuildFct()
{
	byte param1[36]; // Data
	word len1;
	byte cnt1;

	int i;
	byte superval[36];
	int currentPos;
	currentPos = 0;
// gen_BuildFunc_SetSuperVals 
	getValue(P_ASG_78_1_0_18_1, param1);
	len1 = getValue(P_ASG_78_1_0_18_1_len);
	cnt1= getValue(P_ASG_78_1_0_18_1_cnt);
	
	/* check box aktiviert*/
	if (cnt1 == 1)
	{
		/* 0 bis 35 (MaxString - 1B oder 2B) */
		if(len1 >= 0 && len1 <= 35)
		{
			//writelineEx(gBAP_Trace, 0, "[Debug-1] Len1: %d", len1);
			superval[currentPos] = (len1&0x7f00) | 0x80;
			superval[currentPos+1] = len1 & 0x00ff;
		}
		else
		{
			writelineEx(gBAP_Trace, 0, "Eingegebene Laenge: %d von P_ASG_78_1_0_18_1 ist ungueltig. Die max. erlaubte Laenge ist %d.", len1, 35);
			return;
		}
	}
	else if(cnt1 == 0) /*check box deaktiviert*/
	{
		if(len1 >= 0 && len1 <= 127)
		{
			//writelineEx(gBAP_Trace, 0, "[Debug-1] Len1: %d", len1);
			superval[currentPos]= len1 & 0x00ff;
			putValue(P_ASG_78_1_0_18_1_len, len1);
		}
		else if(len1 > 127 && len1 <= 35)
		{
			superval[currentPos] = (len1&0x7f00) | 0x80;
			superval[currentPos+1] = len1 & 0x00ff;
			putValue(P_ASG_78_1_0_18_1_len, len1);
			putValue(P_ASG_78_1_0_18_1_cnt, 1);
		}
		else
		{
			writelineEx(gBAP_Trace, 0, "Eingegebene Laenge: %d von P_ASG_78_1_0_18_1 ist ungueltig. Die max. erlaubte Laenge ist %d.", len1, 35);
			return;
		}
	}
	currentPos += cnt1+1;
	for(i = 0; i < len1; i++)
	{
		superval[currentPos++]= param1[i];
	}

	putValue(P_ASG_78_1_0_18, superval, currentPos);
}

// Ueberwachung der CheckBox fuer String
on envVar  P_ASG_78_1_0_18_1_cnt
{
	word len;
	byte cnt;
	len = getValue(P_ASG_78_1_0_18_1_len);
	cnt = getValue(P_ASG_78_1_0_18_1_cnt);

	/* wird nur gerufen, wenn check box deaktiviert mit Length>127*/ 
	if( cnt == 0) 
	{
		if(len > 127 )
		{
			putValue(P_ASG_78_1_0_18_1_len, 127);
		}
	}

	P_ASG_78_1_0_18_BuildFct();
}

// Ueberwachung der Eingabefeld fuer String Data
on envVar P_ASG_78_1_0_18_1_len
{
	word len;
	len = getValue(this);
	/* Validierung der Eingabe*/
	if(len > 35)
	{
		writelineEx(gBAP_Trace, 0, "Eingegebene Laenge: %d von P_ASG_78_1_0_18_1 ist ungueltig. Die max. erlaubte Laenge ist %d. ", len, 35);
		putValue(this, 35);
	}
	P_ASG_78_1_0_18_BuildFct();
}

on envVar P_ASG_78_1_0_18_1 // StartEngineSignature.Data
{
	putValue(P_ASG_78_1_0_18_1_len, getValueSize(this));
	P_ASG_78_1_0_18_BuildFct();
}

on envVar M_ASG_78_1_0_19AbortResult_BTN
{
    if (M_ASG_78_1_0_19AbortResult_BTN_already_pressed == 0)
    {
         putValue(M_ASG_78_1_0_19_ErrCode,0);
         SetControlBackColor(panel_name,"errField_M_ASG_78_1_0_19",MakeRGB(255,255,255));
         M_ASG_78_1_0_19AbortResult_BTN_already_pressed = 1;
    }
    else
    {
         putValue(M_ASG_78_1_0_19_State, "AbortResult");
         Request_Void(LSGID, M_ASG_78_1_0_19_ID, AbortResult_REQ);
         M_ASG_78_1_0_19AbortResult_BTN_already_pressed = 0;
    }
}

on envVar M_ASG_78_1_0_19StartResult_BTN
{
    byte temp[9];
    if (M_ASG_78_1_0_19StartResult_BTN_already_pressed == 0)
    {
       putValue(M_ASG_78_1_0_19_ErrCode,0);
       SetControlBackColor(panel_name,"errField_M_ASG_78_1_0_19",MakeRGB(255,255,255));
       M_ASG_78_1_0_19StartResult_BTN_already_pressed = 1;
    }
    else
    {
		M_ASG_78_1_0_19_Start_BuildFct();
       getValue(M_ASG_78_1_0_19_Start, temp);
       Request_ByteSequence(LSGID, M_ASG_78_1_0_19_ID, StartResult_REQ, temp, getValueSize(M_ASG_78_1_0_19_Start));
       putValue(M_ASG_78_1_0_19_State, "Started");
       if(getValue(M_ASG_78_1_0_19_IntTlgEn)) //getValue(IT))
       {
           intertelegram_err(M_ASG_78_1_0_19_ID);
       }
       if(getValue(M_ASG_78_1_0_19_SegmEn))   //getvalue(SG)
       {
           sequence_err(M_ASG_78_1_0_19_ID,getValueSize(M_ASG_78_1_0_19_Start));
       }
       M_ASG_78_1_0_19StartResult_BTN_already_pressed = 0;
    }
}

// Man darf gleichzeitig nur Checkbox fuer SegmError oder IntertelegramError aktiviert werden
on envVar M_ASG_78_1_0_19_IntTlgEn
{
       if(getValue(this)) 
       {
           putValue(M_ASG_78_1_0_19_SegmEn,0);
           intertelegram_err(M_ASG_78_1_0_19_ID);
       }
       else
       {
           intertelegram_err_off(M_ASG_78_1_0_19_ID);
       }
}

// Man darf gleichzeitig nur Checkbox fuer SegmError oder IntertelegramError aktiviert werden
on envVar M_ASG_78_1_0_19_SegmEn
{
       if(getValue(this)) 
       {
           putValue(M_ASG_78_1_0_19_IntTlgEn,0);
           sequence_err(M_ASG_78_1_0_19_ID,getValueSize(M_ASG_78_1_0_19_SegmEn));
       }
       else
       {
              sequence_err_off(M_ASG_78_1_0_19_ID);
       }
}

on envVar M_ASG_78_1_0_19_Result // bus value of MobileDeviceKeyChallenge (19).
{
	// opcodes: Error-Processing-Result
	byte param1[700]; // DataAcknowledge
	word len1;
	byte cnt1;
	// DATATYPE_BYTESEQUENCE / DATATYPE_FIXEDBYTESEQUENCE
	int i;
	byte superval[700];
	int currentPos;
	currentPos = 0;
	for( i = 0; i < 700; i++ ) {
		superval[i] = 0;
	}
	getValue(M_ASG_78_1_0_19_Result, superval);
	///////// Start param1 - STRING /////////
	getValue(M_ASG_78_1_0_19_Result_1, param1);
	if((superval[currentPos] & 0x80) > 0)
	{
		if(698>127) /* Max Fct-Katalog Laenge: 698*/
		{
			len1 = ( (superval[currentPos]&0x7F) <<8) + superval[currentPos+1];
			currentPos = currentPos + 2;
			cnt1 = 1;
		}
		else
		{
			len1 = 698;
			writelineEx(gBAP_Trace, 0, "Anzahl der Laengeninformation-Bytes in M_ASG_78_1_0_19_Result ueberschreitet die erlaubte 1 Byte vom Fct-Kalatog.");
		}
	}
	else
	{
		len1 = superval[currentPos]&0x7F;
		currentPos = currentPos + 1;
		cnt1 = 0;
	}
	
	if(len1 > 698)
	{
		writelineEx(gBAP_Trace, 0, "Laenge:%d bei der Byte Position:%d ueberschreitet die Maximale erlaubte Laenge von Fct-Kalatog", len1, currentPos);
		len1 = 698;
	
		if(len1 < 128) cnt1 = 0;
		else cnt1 = 1;
	}
	
	for(i = 0; i < len1; i++)
	{
		param1[i] = superval[currentPos++];
	}
	
	putValue(M_ASG_78_1_0_19_Result_1_len, len1);
	putValue(M_ASG_78_1_0_19_Result_1_cnt, cnt1);
	
	if(len1 > getValueSize(M_ASG_78_1_0_19_Result_1))
		putValue(M_ASG_78_1_0_19_Result_1, param1, len1);
	else
		putValue(M_ASG_78_1_0_19_Result_1, param1, getValueSize(M_ASG_78_1_0_19_Result_1));

}

// Updates the bus value field and other dependencies.
M_ASG_78_1_0_19_Result_BuildFct()
{
	byte param1[700]; // DataAcknowledge
	word len1;
	byte cnt1;

	int i;
	byte superval[700];
	int currentPos;
	currentPos = 0;
// gen_BuildFunc_SetSuperVals 
	getValue(M_ASG_78_1_0_19_Result_1, param1);
	len1 = getValue(M_ASG_78_1_0_19_Result_1_len);
	cnt1= getValue(M_ASG_78_1_0_19_Result_1_cnt);
	
	/* check box aktiviert*/
	if (cnt1 == 1)
	{
		/* 0 bis 698 (MaxString - 1B oder 2B) */
		if(len1 >= 0 && len1 <= 698)
		{
			//writelineEx(gBAP_Trace, 0, "[Debug-1] Len1: %d", len1);
			superval[currentPos] = (len1&0x7f00) | 0x80;
			superval[currentPos+1] = len1 & 0x00ff;
		}
		else
		{
			writelineEx(gBAP_Trace, 0, "Eingegebene Laenge: %d von M_ASG_78_1_0_19_Result_1 ist ungueltig. Die max. erlaubte Laenge ist %d.", len1, 698);
			return;
		}
	}
	else if(cnt1 == 0) /*check box deaktiviert*/
	{
		if(len1 >= 0 && len1 <= 127)
		{
			//writelineEx(gBAP_Trace, 0, "[Debug-1] Len1: %d", len1);
			superval[currentPos]= len1 & 0x00ff;
			putValue(M_ASG_78_1_0_19_Result_1_len, len1);
		}
		else if(len1 > 127 && len1 <= 698)
		{
			superval[currentPos] = (len1&0x7f00) | 0x80;
			superval[currentPos+1] = len1 & 0x00ff;
			putValue(M_ASG_78_1_0_19_Result_1_len, len1);
			putValue(M_ASG_78_1_0_19_Result_1_cnt, 1);
		}
		else
		{
			writelineEx(gBAP_Trace, 0, "Eingegebene Laenge: %d von M_ASG_78_1_0_19_Result_1 ist ungueltig. Die max. erlaubte Laenge ist %d.", len1, 698);
			return;
		}
	}
	currentPos += cnt1+1;
	for(i = 0; i < len1; i++)
	{
		superval[currentPos++]= param1[i];
	}

	putValue(M_ASG_78_1_0_19_Result, superval, currentPos);
}

// Ueberwachung der CheckBox fuer String
on envVar  M_ASG_78_1_0_19_Result_1_cnt
{
	word len;
	byte cnt;
	len = getValue(M_ASG_78_1_0_19_Result_1_len);
	cnt = getValue(M_ASG_78_1_0_19_Result_1_cnt);

	/* wird nur gerufen, wenn check box deaktiviert mit Length>127*/ 
	if( cnt == 0) 
	{
		if(len > 127 )
		{
			putValue(M_ASG_78_1_0_19_Result_1_len, 127);
		}
	}

	M_ASG_78_1_0_19_Result_BuildFct();
}

// Ueberwachung der Eingabefeld fuer String Data
on envVar M_ASG_78_1_0_19_Result_1_len
{
	word len;
	len = getValue(this);
	/* Validierung der Eingabe*/
	if(len > 698)
	{
		writelineEx(gBAP_Trace, 0, "Eingegebene Laenge: %d von M_ASG_78_1_0_19_Result_1 ist ungueltig. Die max. erlaubte Laenge ist %d. ", len, 698);
		putValue(this, 698);
	}
	M_ASG_78_1_0_19_Result_BuildFct();
}

on envVar M_ASG_78_1_0_19_Result_1 // MobileDeviceKeyChallenge.DataAcknowledge
{
	putValue(M_ASG_78_1_0_19_Result_1_len, getValueSize(this));
	M_ASG_78_1_0_19_Result_BuildFct();
}

on envVar M_ASG_78_1_0_19_Processing // bus value of MobileDeviceKeyChallenge (19).
{
	// opcodes: Error-Processing-Result
	byte param1; // Reserve1
	// DATATYPE_BYTESEQUENCE / DATATYPE_FIXEDBYTESEQUENCE
	int i;
	byte superval[700];
	int currentPos;
	currentPos = 0;
	for( i = 0; i < 700; i++ ) {
		superval[i] = 0;
	}
	getValue(M_ASG_78_1_0_19_Processing, superval);
	///////// Start param1 - UINT8 /////////
	param1 = superval[currentPos++];
	putValue(M_ASG_78_1_0_19_Processing_1, round((param1 * 1.0) - (0) + (0), 1.0));
}

// Updates the bus value field and other dependencies.
M_ASG_78_1_0_19_Processing_BuildFct()
{
	byte param1; // Reserve1

	int i;
	byte superval[700];
	int currentPos;
	currentPos = 0;
// gen_BuildFunc_SetSuperVals 
	@M_ASG_78_1_0_19_Processing_1_range = round(@M_ASG_78_1_0_19_Processing_1 + (0), 1.0); // slider value + min = real value
	param1 = 0; // underlying parameter has constant value 0.
	superval[currentPos++]=param1;
	putValue(M_ASG_78_1_0_19_Processing, superval, currentPos);
}

// Ueberwachung der Darstellungsvariable der Range.
on envVar M_ASG_78_1_0_19_Processing_1_range // MobileDeviceKeyChallenge.Reserve1 
{
	@M_ASG_78_1_0_19_Processing_1 = @M_ASG_78_1_0_19_Processing_1_range - (0); // slider = range - min
}

on envVar M_ASG_78_1_0_19_Processing_1 // MobileDeviceKeyChallenge.Reserve1
{
	M_ASG_78_1_0_19_Processing_BuildFct();
}

on envVar M_ASG_78_1_0_19_Start // bus value of MobileDeviceKeyChallenge (19).
{
	// opcodes: AbortResult-StartResult
	byte param1[9]; // DataRequest
	word len1;
	byte cnt1;
	// DATATYPE_BYTESEQUENCE / DATATYPE_FIXEDBYTESEQUENCE
	int i;
	byte superval[9];
	int currentPos;
	currentPos = 0;
	for( i = 0; i < 9; i++ ) {
		superval[i] = 0;
	}
	getValue(M_ASG_78_1_0_19_Start, superval);
	///////// Start param1 - STRING /////////
	getValue(M_ASG_78_1_0_19_Start_1, param1);
	if((superval[currentPos] & 0x80) > 0)
	{
		if(8>127) /* Max Fct-Katalog Laenge: 8*/
		{
			len1 = ( (superval[currentPos]&0x7F) <<8) + superval[currentPos+1];
			currentPos = currentPos + 2;
			cnt1 = 1;
		}
		else
		{
			len1 = 8;
			writelineEx(gBAP_Trace, 0, "Anzahl der Laengeninformation-Bytes in M_ASG_78_1_0_19_Start ueberschreitet die erlaubte 1 Byte vom Fct-Kalatog.");
		}
	}
	else
	{
		len1 = superval[currentPos]&0x7F;
		currentPos = currentPos + 1;
		cnt1 = 0;
	}
	
	if(len1 > 8)
	{
		writelineEx(gBAP_Trace, 0, "Laenge:%d bei der Byte Position:%d ueberschreitet die Maximale erlaubte Laenge von Fct-Kalatog", len1, currentPos);
		len1 = 8;
	
		if(len1 < 128) cnt1 = 0;
		else cnt1 = 1;
	}
	
	for(i = 0; i < len1; i++)
	{
		param1[i] = superval[currentPos++];
	}
	
	putValue(M_ASG_78_1_0_19_Start_1_len, len1);
	putValue(M_ASG_78_1_0_19_Start_1_cnt, cnt1);
	
	if(len1 > getValueSize(M_ASG_78_1_0_19_Start_1))
		putValue(M_ASG_78_1_0_19_Start_1, param1, len1);
	else
		putValue(M_ASG_78_1_0_19_Start_1, param1, getValueSize(M_ASG_78_1_0_19_Start_1));

}

// Updates the bus value field and other dependencies.
M_ASG_78_1_0_19_Start_BuildFct()
{
	byte param1[9]; // DataRequest
	word len1;
	byte cnt1;

	int i;
	byte superval[9];
	int currentPos;
	currentPos = 0;
// gen_BuildFunc_SetSuperVals 
	getValue(M_ASG_78_1_0_19_Start_1, param1);
	len1 = getValue(M_ASG_78_1_0_19_Start_1_len);
	cnt1= getValue(M_ASG_78_1_0_19_Start_1_cnt);
	
	/* check box aktiviert*/
	if (cnt1 == 1)
	{
		/* 0 bis 8 (MaxString - 1B oder 2B) */
		if(len1 >= 0 && len1 <= 8)
		{
			//writelineEx(gBAP_Trace, 0, "[Debug-1] Len1: %d", len1);
			superval[currentPos] = (len1&0x7f00) | 0x80;
			superval[currentPos+1] = len1 & 0x00ff;
		}
		else
		{
			writelineEx(gBAP_Trace, 0, "Eingegebene Laenge: %d von M_ASG_78_1_0_19_Start_1 ist ungueltig. Die max. erlaubte Laenge ist %d.", len1, 8);
			return;
		}
	}
	else if(cnt1 == 0) /*check box deaktiviert*/
	{
		if(len1 >= 0 && len1 <= 127)
		{
			//writelineEx(gBAP_Trace, 0, "[Debug-1] Len1: %d", len1);
			superval[currentPos]= len1 & 0x00ff;
			putValue(M_ASG_78_1_0_19_Start_1_len, len1);
		}
		else if(len1 > 127 && len1 <= 8)
		{
			superval[currentPos] = (len1&0x7f00) | 0x80;
			superval[currentPos+1] = len1 & 0x00ff;
			putValue(M_ASG_78_1_0_19_Start_1_len, len1);
			putValue(M_ASG_78_1_0_19_Start_1_cnt, 1);
		}
		else
		{
			writelineEx(gBAP_Trace, 0, "Eingegebene Laenge: %d von M_ASG_78_1_0_19_Start_1 ist ungueltig. Die max. erlaubte Laenge ist %d.", len1, 8);
			return;
		}
	}
	currentPos += cnt1+1;
	for(i = 0; i < len1; i++)
	{
		superval[currentPos++]= param1[i];
	}

	putValue(M_ASG_78_1_0_19_Start, superval, currentPos);
}

// Ueberwachung der CheckBox fuer String
on envVar  M_ASG_78_1_0_19_Start_1_cnt
{
	word len;
	byte cnt;
	len = getValue(M_ASG_78_1_0_19_Start_1_len);
	cnt = getValue(M_ASG_78_1_0_19_Start_1_cnt);

	/* wird nur gerufen, wenn check box deaktiviert mit Length>127*/ 
	if( cnt == 0) 
	{
		if(len > 127 )
		{
			putValue(M_ASG_78_1_0_19_Start_1_len, 127);
		}
	}

	M_ASG_78_1_0_19_Start_BuildFct();
}

// Ueberwachung der Eingabefeld fuer String Data
on envVar M_ASG_78_1_0_19_Start_1_len
{
	word len;
	len = getValue(this);
	/* Validierung der Eingabe*/
	if(len > 8)
	{
		writelineEx(gBAP_Trace, 0, "Eingegebene Laenge: %d von M_ASG_78_1_0_19_Start_1 ist ungueltig. Die max. erlaubte Laenge ist %d. ", len, 8);
		putValue(this, 8);
	}
	M_ASG_78_1_0_19_Start_BuildFct();
}

on envVar M_ASG_78_1_0_19_Start_1 // MobileDeviceKeyChallenge.DataRequest
{
	putValue(M_ASG_78_1_0_19_Start_1_len, getValueSize(this));
	M_ASG_78_1_0_19_Start_BuildFct();
}

on envVar P_ASG_78_1_0_20Get_BTN
{
 if (P_ASG_78_1_0_20Get_BTN_already_pressed == 0)
  {
       putValue(P_ASG_78_1_0_20_ErrCode,0);
       SetControlBackColor(panel_name,"errField_P_ASG_78_1_0_20",MakeRGB(255,255,255));
       P_ASG_78_1_0_20Get_BTN_already_pressed = 1;
 }
 else
 {
       Request_Void(LSGID, P_ASG_78_1_0_20_ID, DataGet_REQ); 
       P_ASG_78_1_0_20Get_BTN_already_pressed = 0;
 }
}

on envVar P_ASG_78_1_0_20 // bus value of MobileDeviceKeyAuthentication (20).
{
	// opcodes: Error-Status
	byte param1[46]; // Data
	word len1;
	byte cnt1;
	byte param2; // Status
	// DATATYPE_BYTESEQUENCE / DATATYPE_FIXEDBYTESEQUENCE
	int i;
	byte superval[47];
	int currentPos;
	currentPos = 0;
	for( i = 0; i < 47; i++ ) {
		superval[i] = 0;
	}
	getValue(P_ASG_78_1_0_20, superval);
	///////// Start param1 - STRING /////////
	getValue(P_ASG_78_1_0_20_1, param1);
	if((superval[currentPos] & 0x80) > 0)
	{
		if(45>127) /* Max Fct-Katalog Laenge: 45*/
		{
			len1 = ( (superval[currentPos]&0x7F) <<8) + superval[currentPos+1];
			currentPos = currentPos + 2;
			cnt1 = 1;
		}
		else
		{
			len1 = 45;
			writelineEx(gBAP_Trace, 0, "Anzahl der Laengeninformation-Bytes in P_ASG_78_1_0_20 ueberschreitet die erlaubte 1 Byte vom Fct-Kalatog.");
		}
	}
	else
	{
		len1 = superval[currentPos]&0x7F;
		currentPos = currentPos + 1;
		cnt1 = 0;
	}
	
	if(len1 > 45)
	{
		writelineEx(gBAP_Trace, 0, "Laenge:%d bei der Byte Position:%d ueberschreitet die Maximale erlaubte Laenge von Fct-Kalatog", len1, currentPos);
		len1 = 45;
	
		if(len1 < 128) cnt1 = 0;
		else cnt1 = 1;
	}
	
	for(i = 0; i < len1; i++)
	{
		param1[i] = superval[currentPos++];
	}
	
	putValue(P_ASG_78_1_0_20_1_len, len1);
	putValue(P_ASG_78_1_0_20_1_cnt, cnt1);
	
	if(len1 > getValueSize(P_ASG_78_1_0_20_1))
		putValue(P_ASG_78_1_0_20_1, param1, len1);
	else
		putValue(P_ASG_78_1_0_20_1, param1, getValueSize(P_ASG_78_1_0_20_1));

	///////// Start param2 - UINT8 /////////
	param2 = superval[currentPos++];
	putValue(P_ASG_78_1_0_20_2, param2);
}

// Updates the bus value field and other dependencies.
P_ASG_78_1_0_20_BuildFct()
{
	byte param1[46]; // Data
	word len1;
	byte cnt1;
	byte param2; // Status

	int i;
	byte superval[47];
	int currentPos;
	currentPos = 0;
// gen_BuildFunc_SetSuperVals 
	getValue(P_ASG_78_1_0_20_1, param1);
	len1 = getValue(P_ASG_78_1_0_20_1_len);
	cnt1= getValue(P_ASG_78_1_0_20_1_cnt);
	
	/* check box aktiviert*/
	if (cnt1 == 1)
	{
		/* 0 bis 45 (MaxString - 1B oder 2B) */
		if(len1 >= 0 && len1 <= 45)
		{
			//writelineEx(gBAP_Trace, 0, "[Debug-1] Len1: %d", len1);
			superval[currentPos] = (len1&0x7f00) | 0x80;
			superval[currentPos+1] = len1 & 0x00ff;
		}
		else
		{
			writelineEx(gBAP_Trace, 0, "Eingegebene Laenge: %d von P_ASG_78_1_0_20_1 ist ungueltig. Die max. erlaubte Laenge ist %d.", len1, 45);
			return;
		}
	}
	else if(cnt1 == 0) /*check box deaktiviert*/
	{
		if(len1 >= 0 && len1 <= 127)
		{
			//writelineEx(gBAP_Trace, 0, "[Debug-1] Len1: %d", len1);
			superval[currentPos]= len1 & 0x00ff;
			putValue(P_ASG_78_1_0_20_1_len, len1);
		}
		else if(len1 > 127 && len1 <= 45)
		{
			superval[currentPos] = (len1&0x7f00) | 0x80;
			superval[currentPos+1] = len1 & 0x00ff;
			putValue(P_ASG_78_1_0_20_1_len, len1);
			putValue(P_ASG_78_1_0_20_1_cnt, 1);
		}
		else
		{
			writelineEx(gBAP_Trace, 0, "Eingegebene Laenge: %d von P_ASG_78_1_0_20_1 ist ungueltig. Die max. erlaubte Laenge ist %d.", len1, 45);
			return;
		}
	}
	currentPos += cnt1+1;
	for(i = 0; i < len1; i++)
	{
		superval[currentPos++]= param1[i];
	}

// gen_BuildFunc_SetSuperVals 
	param2 = getValue(P_ASG_78_1_0_20_2);
	superval[currentPos++]=param2;
	putValue(P_ASG_78_1_0_20, superval, currentPos);
}

// Ueberwachung der CheckBox fuer String
on envVar  P_ASG_78_1_0_20_1_cnt
{
	word len;
	byte cnt;
	len = getValue(P_ASG_78_1_0_20_1_len);
	cnt = getValue(P_ASG_78_1_0_20_1_cnt);

	/* wird nur gerufen, wenn check box deaktiviert mit Length>127*/ 
	if( cnt == 0) 
	{
		if(len > 127 )
		{
			putValue(P_ASG_78_1_0_20_1_len, 127);
		}
	}

	P_ASG_78_1_0_20_BuildFct();
}

// Ueberwachung der Eingabefeld fuer String Data
on envVar P_ASG_78_1_0_20_1_len
{
	word len;
	len = getValue(this);
	/* Validierung der Eingabe*/
	if(len > 45)
	{
		writelineEx(gBAP_Trace, 0, "Eingegebene Laenge: %d von P_ASG_78_1_0_20_1 ist ungueltig. Die max. erlaubte Laenge ist %d. ", len, 45);
		putValue(this, 45);
	}
	P_ASG_78_1_0_20_BuildFct();
}

on envVar P_ASG_78_1_0_20_1 // MobileDeviceKeyAuthentication.Data
{
	putValue(P_ASG_78_1_0_20_1_len, getValueSize(this));
	P_ASG_78_1_0_20_BuildFct();
}

on envVar P_ASG_78_1_0_20_2 // MobileDeviceKeyAuthentication.Status
{
	P_ASG_78_1_0_20_BuildFct();
}

on envVar P_ASG_78_1_0_21Get_BTN
{
 if (P_ASG_78_1_0_21Get_BTN_already_pressed == 0)
  {
       putValue(P_ASG_78_1_0_21_ErrCode,0);
       SetControlBackColor(panel_name,"errField_P_ASG_78_1_0_21",MakeRGB(255,255,255));
       P_ASG_78_1_0_21Get_BTN_already_pressed = 1;
 }
 else
 {
       Request_Void(LSGID, P_ASG_78_1_0_21_ID, DataGet_REQ); 
       P_ASG_78_1_0_21Get_BTN_already_pressed = 0;
 }
}

on envVar P_ASG_78_1_0_21Set_BTN
{
	byte BAPTemp[700];
    if (P_ASG_78_1_0_21Set_BTN_already_pressed == 0)
    {
       putValue(P_ASG_78_1_0_21_ErrCode,0);
       SetControlBackColor(panel_name,"errField_P_ASG_78_1_0_21",MakeRGB(255,255,255));
       P_ASG_78_1_0_21Set_BTN_already_pressed = 1;
    }
    else
    {
	   P_ASG_78_1_0_21_BuildFct();
       getValue(P_ASG_78_1_0_21, BAPTemp);
       Request_ByteSequence(LSGID, P_ASG_78_1_0_21_ID, DataSet_REQ, BAPTemp, getValueSize(P_ASG_78_1_0_21));
       if(getValue(P_ASG_78_1_0_21_IntTlgEn)) //getValue(IT))
       {
          intertelegram_err(P_ASG_78_1_0_21_ID);
       }
       if(getValue(P_ASG_78_1_0_21_SegmEn))   //getvalue(SG)
       {
          sequence_err(P_ASG_78_1_0_21_ID,elCount(BAPTemp));
       }
       P_ASG_78_1_0_21Set_BTN_already_pressed = 0;
    }
}

// Man darf gleichzeitig nur Checkbox fuer SegmError oder IntertelegramError aktiviert werden
on envVar P_ASG_78_1_0_21_IntTlgEn
{
       if(getValue(this)) 
       {
           putValue(P_ASG_78_1_0_21_SegmEn,0);
           intertelegram_err(P_ASG_78_1_0_21_ID);
       }
       else
       {
           intertelegram_err_off(P_ASG_78_1_0_21_ID);
       }
}

// Man darf gleichzeitig nur Checkbox fuer SegmError oder IntertelegramError aktiviert werden
on envVar P_ASG_78_1_0_21_SegmEn
{
       if(getValue(this)) 
       {
           putValue(P_ASG_78_1_0_21_IntTlgEn,0);
           sequence_err(P_ASG_78_1_0_21_ID,getValueSize(P_ASG_78_1_0_21_SegmEn));
       }
       else
       {
              sequence_err_off(P_ASG_78_1_0_21_ID);
       }
}

on envVar P_ASG_78_1_0_21 // bus value of MobileDeviceKeyCommand (21).
{
	// opcodes: Error-Status
	byte param1[700]; // Data
	word len1;
	byte cnt1;
	// DATATYPE_BYTESEQUENCE / DATATYPE_FIXEDBYTESEQUENCE
	int i;
	byte superval[700];
	int currentPos;
	currentPos = 0;
	for( i = 0; i < 700; i++ ) {
		superval[i] = 0;
	}
	getValue(P_ASG_78_1_0_21, superval);
	///////// Start param1 - STRING /////////
	getValue(P_ASG_78_1_0_21_1, param1);
	if((superval[currentPos] & 0x80) > 0)
	{
		if(698>127) /* Max Fct-Katalog Laenge: 698*/
		{
			len1 = ( (superval[currentPos]&0x7F) <<8) + superval[currentPos+1];
			currentPos = currentPos + 2;
			cnt1 = 1;
		}
		else
		{
			len1 = 698;
			writelineEx(gBAP_Trace, 0, "Anzahl der Laengeninformation-Bytes in P_ASG_78_1_0_21 ueberschreitet die erlaubte 1 Byte vom Fct-Kalatog.");
		}
	}
	else
	{
		len1 = superval[currentPos]&0x7F;
		currentPos = currentPos + 1;
		cnt1 = 0;
	}
	
	if(len1 > 698)
	{
		writelineEx(gBAP_Trace, 0, "Laenge:%d bei der Byte Position:%d ueberschreitet die Maximale erlaubte Laenge von Fct-Kalatog", len1, currentPos);
		len1 = 698;
	
		if(len1 < 128) cnt1 = 0;
		else cnt1 = 1;
	}
	
	for(i = 0; i < len1; i++)
	{
		param1[i] = superval[currentPos++];
	}
	
	putValue(P_ASG_78_1_0_21_1_len, len1);
	putValue(P_ASG_78_1_0_21_1_cnt, cnt1);
	
	if(len1 > getValueSize(P_ASG_78_1_0_21_1))
		putValue(P_ASG_78_1_0_21_1, param1, len1);
	else
		putValue(P_ASG_78_1_0_21_1, param1, getValueSize(P_ASG_78_1_0_21_1));

}

// Updates the bus value field and other dependencies.
P_ASG_78_1_0_21_BuildFct()
{
	byte param1[700]; // Data
	word len1;
	byte cnt1;

	int i;
	byte superval[700];
	int currentPos;
	currentPos = 0;
// gen_BuildFunc_SetSuperVals 
	getValue(P_ASG_78_1_0_21_1, param1);
	len1 = getValue(P_ASG_78_1_0_21_1_len);
	cnt1= getValue(P_ASG_78_1_0_21_1_cnt);
	
	/* check box aktiviert*/
	if (cnt1 == 1)
	{
		/* 0 bis 698 (MaxString - 1B oder 2B) */
		if(len1 >= 0 && len1 <= 698)
		{
			//writelineEx(gBAP_Trace, 0, "[Debug-1] Len1: %d", len1);
			superval[currentPos] = (len1&0x7f00) | 0x80;
			superval[currentPos+1] = len1 & 0x00ff;
		}
		else
		{
			writelineEx(gBAP_Trace, 0, "Eingegebene Laenge: %d von P_ASG_78_1_0_21_1 ist ungueltig. Die max. erlaubte Laenge ist %d.", len1, 698);
			return;
		}
	}
	else if(cnt1 == 0) /*check box deaktiviert*/
	{
		if(len1 >= 0 && len1 <= 127)
		{
			//writelineEx(gBAP_Trace, 0, "[Debug-1] Len1: %d", len1);
			superval[currentPos]= len1 & 0x00ff;
			putValue(P_ASG_78_1_0_21_1_len, len1);
		}
		else if(len1 > 127 && len1 <= 698)
		{
			superval[currentPos] = (len1&0x7f00) | 0x80;
			superval[currentPos+1] = len1 & 0x00ff;
			putValue(P_ASG_78_1_0_21_1_len, len1);
			putValue(P_ASG_78_1_0_21_1_cnt, 1);
		}
		else
		{
			writelineEx(gBAP_Trace, 0, "Eingegebene Laenge: %d von P_ASG_78_1_0_21_1 ist ungueltig. Die max. erlaubte Laenge ist %d.", len1, 698);
			return;
		}
	}
	currentPos += cnt1+1;
	for(i = 0; i < len1; i++)
	{
		superval[currentPos++]= param1[i];
	}

	putValue(P_ASG_78_1_0_21, superval, currentPos);
}

// Ueberwachung der CheckBox fuer String
on envVar  P_ASG_78_1_0_21_1_cnt
{
	word len;
	byte cnt;
	len = getValue(P_ASG_78_1_0_21_1_len);
	cnt = getValue(P_ASG_78_1_0_21_1_cnt);

	/* wird nur gerufen, wenn check box deaktiviert mit Length>127*/ 
	if( cnt == 0) 
	{
		if(len > 127 )
		{
			putValue(P_ASG_78_1_0_21_1_len, 127);
		}
	}

	P_ASG_78_1_0_21_BuildFct();
}

// Ueberwachung der Eingabefeld fuer String Data
on envVar P_ASG_78_1_0_21_1_len
{
	word len;
	len = getValue(this);
	/* Validierung der Eingabe*/
	if(len > 698)
	{
		writelineEx(gBAP_Trace, 0, "Eingegebene Laenge: %d von P_ASG_78_1_0_21_1 ist ungueltig. Die max. erlaubte Laenge ist %d. ", len, 698);
		putValue(this, 698);
	}
	P_ASG_78_1_0_21_BuildFct();
}

on envVar P_ASG_78_1_0_21_1 // MobileDeviceKeyCommand.Data
{
	putValue(P_ASG_78_1_0_21_1_len, getValueSize(this));
	P_ASG_78_1_0_21_BuildFct();
}

on envVar P_ASG_78_1_0_22Get_BTN
{
 if (P_ASG_78_1_0_22Get_BTN_already_pressed == 0)
  {
       putValue(P_ASG_78_1_0_22_ErrCode,0);
       SetControlBackColor(panel_name,"errField_P_ASG_78_1_0_22",MakeRGB(255,255,255));
       P_ASG_78_1_0_22Get_BTN_already_pressed = 1;
 }
 else
 {
       Request_Void(LSGID, P_ASG_78_1_0_22_ID, DataGet_REQ); 
       P_ASG_78_1_0_22Get_BTN_already_pressed = 0;
 }
}

on envVar P_ASG_78_1_0_22 // bus value of MobileDeviceKeyActiveKeyID (22).
{
	// opcodes: Error-Status
	byte param1; // VehicleKeyType
	byte param2[17]; // VehicleKeyID
	word len2;
	byte cnt2;
	// DATATYPE_BYTESEQUENCE / DATATYPE_FIXEDBYTESEQUENCE
	int i;
	byte superval[18];
	int currentPos;
	currentPos = 0;
	for( i = 0; i < 18; i++ ) {
		superval[i] = 0;
	}
	getValue(P_ASG_78_1_0_22, superval);
	///////// Start param1 - UINT8 /////////
	param1 = superval[currentPos++];
	putValue(P_ASG_78_1_0_22_1, param1);
	///////// Start param2 - STRING /////////
	getValue(P_ASG_78_1_0_22_2, param2);
	if((superval[currentPos] & 0x80) > 0)
	{
		if(16>127) /* Max Fct-Katalog Laenge: 16*/
		{
			len2 = ( (superval[currentPos]&0x7F) <<8) + superval[currentPos+1];
			currentPos = currentPos + 2;
			cnt2 = 1;
		}
		else
		{
			len2 = 16;
			writelineEx(gBAP_Trace, 0, "Anzahl der Laengeninformation-Bytes in P_ASG_78_1_0_22 ueberschreitet die erlaubte 1 Byte vom Fct-Kalatog.");
		}
	}
	else
	{
		len2 = superval[currentPos]&0x7F;
		currentPos = currentPos + 1;
		cnt2 = 0;
	}
	
	if(len2 > 16)
	{
		writelineEx(gBAP_Trace, 0, "Laenge:%d bei der Byte Position:%d ueberschreitet die Maximale erlaubte Laenge von Fct-Kalatog", len2, currentPos);
		len2 = 16;
	
		if(len2 < 128) cnt2 = 0;
		else cnt2 = 1;
	}
	
	for(i = 0; i < len2; i++)
	{
		param2[i] = superval[currentPos++];
	}
	
	putValue(P_ASG_78_1_0_22_2_len, len2);
	putValue(P_ASG_78_1_0_22_2_cnt, cnt2);
	
	if(len2 > getValueSize(P_ASG_78_1_0_22_2))
		putValue(P_ASG_78_1_0_22_2, param2, len2);
	else
		putValue(P_ASG_78_1_0_22_2, param2, getValueSize(P_ASG_78_1_0_22_2));

}

// Updates the bus value field and other dependencies.
P_ASG_78_1_0_22_BuildFct()
{
	byte param1; // VehicleKeyType
	byte param2[17]; // VehicleKeyID
	word len2;
	byte cnt2;

	int i;
	byte superval[18];
	int currentPos;
	currentPos = 0;
// gen_BuildFunc_SetSuperVals 
	param1 = getValue(P_ASG_78_1_0_22_1);
	superval[currentPos++]=param1;
// gen_BuildFunc_SetSuperVals 
	getValue(P_ASG_78_1_0_22_2, param2);
	len2 = getValue(P_ASG_78_1_0_22_2_len);
	cnt2= getValue(P_ASG_78_1_0_22_2_cnt);
	
	/* check box aktiviert*/
	if (cnt2 == 1)
	{
		/* 0 bis 16 (MaxString - 1B oder 2B) */
		if(len2 >= 0 && len2 <= 16)
		{
			//writelineEx(gBAP_Trace, 0, "[Debug-1] Len2: %d", len2);
			superval[currentPos] = (len2&0x7f00) | 0x80;
			superval[currentPos+1] = len2 & 0x00ff;
		}
		else
		{
			writelineEx(gBAP_Trace, 0, "Eingegebene Laenge: %d von P_ASG_78_1_0_22_2 ist ungueltig. Die max. erlaubte Laenge ist %d.", len2, 16);
			return;
		}
	}
	else if(cnt2 == 0) /*check box deaktiviert*/
	{
		if(len2 >= 0 && len2 <= 127)
		{
			//writelineEx(gBAP_Trace, 0, "[Debug-1] Len2: %d", len2);
			superval[currentPos]= len2 & 0x00ff;
			putValue(P_ASG_78_1_0_22_2_len, len2);
		}
		else if(len2 > 127 && len2 <= 16)
		{
			superval[currentPos] = (len2&0x7f00) | 0x80;
			superval[currentPos+1] = len2 & 0x00ff;
			putValue(P_ASG_78_1_0_22_2_len, len2);
			putValue(P_ASG_78_1_0_22_2_cnt, 1);
		}
		else
		{
			writelineEx(gBAP_Trace, 0, "Eingegebene Laenge: %d von P_ASG_78_1_0_22_2 ist ungueltig. Die max. erlaubte Laenge ist %d.", len2, 16);
			return;
		}
	}
	currentPos += cnt2+1;
	for(i = 0; i < len2; i++)
	{
		superval[currentPos++]= param2[i];
	}

	putValue(P_ASG_78_1_0_22, superval, currentPos);
}

on envVar P_ASG_78_1_0_22_1 // MobileDeviceKeyActiveKeyID.VehicleKeyType
{
	P_ASG_78_1_0_22_BuildFct();
}

// Ueberwachung der CheckBox fuer String
on envVar  P_ASG_78_1_0_22_2_cnt
{
	word len;
	byte cnt;
	len = getValue(P_ASG_78_1_0_22_2_len);
	cnt = getValue(P_ASG_78_1_0_22_2_cnt);

	/* wird nur gerufen, wenn check box deaktiviert mit Length>127*/ 
	if( cnt == 0) 
	{
		if(len > 127 )
		{
			putValue(P_ASG_78_1_0_22_2_len, 127);
		}
	}

	P_ASG_78_1_0_22_BuildFct();
}

// Ueberwachung der Eingabefeld fuer String Data
on envVar P_ASG_78_1_0_22_2_len
{
	word len;
	len = getValue(this);
	/* Validierung der Eingabe*/
	if(len > 16)
	{
		writelineEx(gBAP_Trace, 0, "Eingegebene Laenge: %d von P_ASG_78_1_0_22_2 ist ungueltig. Die max. erlaubte Laenge ist %d. ", len, 16);
		putValue(this, 16);
	}
	P_ASG_78_1_0_22_BuildFct();
}

on envVar P_ASG_78_1_0_22_2 // MobileDeviceKeyActiveKeyID.VehicleKeyID
{
	putValue(P_ASG_78_1_0_22_2_len, getValueSize(this));
	P_ASG_78_1_0_22_BuildFct();
}

on envVar P_ASG_78_1_0_23Get_BTN
{
 if (P_ASG_78_1_0_23Get_BTN_already_pressed == 0)
  {
       putValue(P_ASG_78_1_0_23_ErrCode,0);
       SetControlBackColor(panel_name,"errField_P_ASG_78_1_0_23",MakeRGB(255,255,255));
       P_ASG_78_1_0_23Get_BTN_already_pressed = 1;
 }
 else
 {
       Request_Void(LSGID, P_ASG_78_1_0_23_ID, DataGet_REQ); 
       P_ASG_78_1_0_23Get_BTN_already_pressed = 0;
 }
}

on envVar P_ASG_78_1_0_23SetGet_BTN
{
	byte BAPTemp[6];
    if (P_ASG_78_1_0_23SetGet_BTN_already_pressed == 0)
    {
       putValue(P_ASG_78_1_0_23_ErrCode,0);
       SetControlBackColor(panel_name,"errField_P_ASG_78_1_0_23",MakeRGB(255,255,255));
       P_ASG_78_1_0_23SetGet_BTN_already_pressed = 1;
    }
    else
    {
       getValue(P_ASG_78_1_0_23, BAPTemp);
       Request_ByteSequence(LSGID, P_ASG_78_1_0_23_ID, DataSetGet_REQ, BAPTemp, getValueSize(P_ASG_78_1_0_23));
       P_ASG_78_1_0_23SetGet_BTN_already_pressed = 0;
    }
}

on envVar P_ASG_78_1_0_23 // bus value of MobileDeviceKeySetup (23).
{
	// opcodes: Error-Status
	byte param1; // Setup
	byte param2; // ModificationReason_Setup
	byte param3; // ModificationState_Setup
	byte param4; // ModificationReason_Smartcard
	byte param5; // ModificationState_Smartcard
	byte param6; // ModificationReason_Reset
	byte param7; // ModificationState_Reset
	byte param8; // Extension1
	byte param9; // Extension2
	// DATATYPE_BYTESEQUENCE / DATATYPE_FIXEDBYTESEQUENCE
	int i;
	byte superval[6];
	int currentPos;
	currentPos = 0;
	for( i = 0; i < 6; i++ ) {
		superval[i] = 0;
	}
	getValue(P_ASG_78_1_0_23, superval);
	///////// Start param1 - UINT8 /////////
	param1 = superval[currentPos++];
	putValue(P_ASG_78_1_0_23_1, param1);
	///////// Start param2 - NIBBLE /////////
	param2 = (superval[currentPos] & 0xf0)>>4;
	putValue(P_ASG_78_1_0_23_2, param2);
	///////// Start param3 - NIBBLE /////////
	param3 = superval[currentPos++] & 0x0f;
	putValue(P_ASG_78_1_0_23_3, param3);
	///////// Start param4 - NIBBLE /////////
	param4 = (superval[currentPos] & 0xf0)>>4;
	putValue(P_ASG_78_1_0_23_4, param4);
	///////// Start param5 - NIBBLE /////////
	param5 = superval[currentPos++] & 0x0f;
	putValue(P_ASG_78_1_0_23_5, param5);
	///////// Start param6 - NIBBLE /////////
	param6 = (superval[currentPos] & 0xf0)>>4;
	putValue(P_ASG_78_1_0_23_6, param6);
	///////// Start param7 - NIBBLE /////////
	param7 = superval[currentPos++] & 0x0f;
	putValue(P_ASG_78_1_0_23_7, param7);
	///////// Start param8 - UINT8 /////////
	param8 = superval[currentPos++];
	putValue(P_ASG_78_1_0_23_8, round((param8 * 1.0) - (0) + (0), 1.0));
	///////// Start param9 - UINT8 /////////
	param9 = superval[currentPos++];
	putValue(P_ASG_78_1_0_23_9, round((param9 * 1.0) - (0) + (0), 1.0));
}

on envVar P_ASG_78_1_0_23_1_0
{
	byte bitval;
	//thisval steht hier fuer den bitfield-wert, 
	//aus Generierungsgruenden hier keine einheitliche Bezeichnung moeglich.
	byte thisval; // Setup
	bitval= getValue(this);
	thisval = getValue(P_ASG_78_1_0_23_1);
	thisval = thisval&~(1<<0)|(bitval<<0);
	putValue(P_ASG_78_1_0_23_1,thisval);
}

on envVar P_ASG_78_1_0_23_1_1
{
	byte bitval;
	//thisval steht hier fuer den bitfield-wert, 
	//aus Generierungsgruenden hier keine einheitliche Bezeichnung moeglich.
	byte thisval; // Setup
	bitval= getValue(this);
	thisval = getValue(P_ASG_78_1_0_23_1);
	thisval = thisval&~(1<<1)|(bitval<<1);
	putValue(P_ASG_78_1_0_23_1,thisval);
}

on envVar P_ASG_78_1_0_23_1_2
{
	byte bitval;
	//thisval steht hier fuer den bitfield-wert, 
	//aus Generierungsgruenden hier keine einheitliche Bezeichnung moeglich.
	byte thisval; // Setup
	bitval= getValue(this);
	thisval = getValue(P_ASG_78_1_0_23_1);
	thisval = thisval&~(1<<2)|(bitval<<2);
	putValue(P_ASG_78_1_0_23_1,thisval);
}

on envVar P_ASG_78_1_0_23_1 // MobileDeviceKeySetup.Setup
{
	byte superval[6];

	//Update Childvalue (BitField)
	byte mask=0x01;
	int i = 0;
	byte thisval; // Setup
	thisval = getValue(this);
	if(thisval&(mask<<0))
		putValue(P_ASG_78_1_0_23_1_0, 1);
	else
		putValue(P_ASG_78_1_0_23_1_0, 0);
	if(thisval&(mask<<1))
		putValue(P_ASG_78_1_0_23_1_1, 1);
	else
		putValue(P_ASG_78_1_0_23_1_1, 0);
	if(thisval&(mask<<2))
		putValue(P_ASG_78_1_0_23_1_2, 1);
	else
		putValue(P_ASG_78_1_0_23_1_2, 0);

    // Update superval
	getValue(P_ASG_78_1_0_23, superval);
	superval[0]=thisval;
	putValue(P_ASG_78_1_0_23,superval);
}

on envVar P_ASG_78_1_0_23_2 // MobileDeviceKeySetup.ModificationReason_Setup
{
	byte superval[6];

	//Update Childvalue (Enum)
	byte thisval; // ModificationReason_Setup
	thisval = 0x0f & getValue(this);

    // Update superval
	getValue(P_ASG_78_1_0_23, superval);
	superval[1]= superval[1]&0x0f;
	superval[1]= superval[1]|(thisval<<4);
	putValue(P_ASG_78_1_0_23,superval);
}

on envVar P_ASG_78_1_0_23_3_0
{
	byte bitval;
	//thisval steht hier fuer den bitfield-wert, 
	//aus Generierungsgruenden hier keine einheitliche Bezeichnung moeglich.
	byte thisval; // ModificationState_Setup
	bitval= getValue(this);
	thisval = getValue(P_ASG_78_1_0_23_3);
	thisval = thisval&~(1<<0)|(bitval<<0);
	putValue(P_ASG_78_1_0_23_3,thisval);
}

on envVar P_ASG_78_1_0_23_3 // MobileDeviceKeySetup.ModificationState_Setup
{
	byte superval[6];

	//Update Childvalue (BitField)
	byte mask=0x01;
	int i = 0;
	byte thisval; // ModificationState_Setup
	thisval = getValue(this);
	if(thisval&(mask<<0))
		putValue(P_ASG_78_1_0_23_3_0, 1);
	else
		putValue(P_ASG_78_1_0_23_3_0, 0);

    // Update superval
	getValue(P_ASG_78_1_0_23, superval);
	superval[1]= superval[1]&0xf0;
	superval[1]= superval[1]|thisval;
	putValue(P_ASG_78_1_0_23,superval);
}

on envVar P_ASG_78_1_0_23_4 // MobileDeviceKeySetup.ModificationReason_Smartcard
{
	byte superval[6];

	//Update Childvalue (Enum)
	byte thisval; // ModificationReason_Smartcard
	thisval = 0x0f & getValue(this);

    // Update superval
	getValue(P_ASG_78_1_0_23, superval);
	superval[2]= superval[2]&0x0f;
	superval[2]= superval[2]|(thisval<<4);
	putValue(P_ASG_78_1_0_23,superval);
}

on envVar P_ASG_78_1_0_23_5_0
{
	byte bitval;
	//thisval steht hier fuer den bitfield-wert, 
	//aus Generierungsgruenden hier keine einheitliche Bezeichnung moeglich.
	byte thisval; // ModificationState_Smartcard
	bitval= getValue(this);
	thisval = getValue(P_ASG_78_1_0_23_5);
	thisval = thisval&~(1<<0)|(bitval<<0);
	putValue(P_ASG_78_1_0_23_5,thisval);
}

on envVar P_ASG_78_1_0_23_5 // MobileDeviceKeySetup.ModificationState_Smartcard
{
	byte superval[6];

	//Update Childvalue (BitField)
	byte mask=0x01;
	int i = 0;
	byte thisval; // ModificationState_Smartcard
	thisval = getValue(this);
	if(thisval&(mask<<0))
		putValue(P_ASG_78_1_0_23_5_0, 1);
	else
		putValue(P_ASG_78_1_0_23_5_0, 0);

    // Update superval
	getValue(P_ASG_78_1_0_23, superval);
	superval[2]= superval[2]&0xf0;
	superval[2]= superval[2]|thisval;
	putValue(P_ASG_78_1_0_23,superval);
}

on envVar P_ASG_78_1_0_23_6 // MobileDeviceKeySetup.ModificationReason_Reset
{
	byte superval[6];

	//Update Childvalue (Enum)
	byte thisval; // ModificationReason_Reset
	thisval = 0x0f & getValue(this);

    // Update superval
	getValue(P_ASG_78_1_0_23, superval);
	superval[3]= superval[3]&0x0f;
	superval[3]= superval[3]|(thisval<<4);
	putValue(P_ASG_78_1_0_23,superval);
}

on envVar P_ASG_78_1_0_23_7_0
{
	byte bitval;
	//thisval steht hier fuer den bitfield-wert, 
	//aus Generierungsgruenden hier keine einheitliche Bezeichnung moeglich.
	byte thisval; // ModificationState_Reset
	bitval= getValue(this);
	thisval = getValue(P_ASG_78_1_0_23_7);
	thisval = thisval&~(1<<0)|(bitval<<0);
	putValue(P_ASG_78_1_0_23_7,thisval);
}

on envVar P_ASG_78_1_0_23_7 // MobileDeviceKeySetup.ModificationState_Reset
{
	byte superval[6];

	//Update Childvalue (BitField)
	byte mask=0x01;
	int i = 0;
	byte thisval; // ModificationState_Reset
	thisval = getValue(this);
	if(thisval&(mask<<0))
		putValue(P_ASG_78_1_0_23_7_0, 1);
	else
		putValue(P_ASG_78_1_0_23_7_0, 0);

    // Update superval
	getValue(P_ASG_78_1_0_23, superval);
	superval[3]= superval[3]&0xf0;
	superval[3]= superval[3]|thisval;
	putValue(P_ASG_78_1_0_23,superval);
}

// Ueberwachung der Darstellungsvariable der Range.
on envVar P_ASG_78_1_0_23_8_range // MobileDeviceKeySetup.Extension1 
{
	@P_ASG_78_1_0_23_8 = @P_ASG_78_1_0_23_8_range - (0); // slider = range - min
}

on envVar P_ASG_78_1_0_23_8 // MobileDeviceKeySetup.Extension1
{
	byte superval[6];

	//Update Childvalue (Number)
	byte thisval; // Extension1
	float slider_value;

	slider_value = 0; // Konstanter Parameter.
	@P_ASG_78_1_0_23_8_range = slider_value + (0); // real value := slider value + range min.
	thisval = (byte)round((slider_value + (0) - (0)) / (1.0), 1); // bus value := (slider value + min - offset) / step.

    // Update superval
	getValue(P_ASG_78_1_0_23, superval);
	superval[4]=thisval;
	putValue(P_ASG_78_1_0_23,superval);
}

// Ueberwachung der Darstellungsvariable der Range.
on envVar P_ASG_78_1_0_23_9_range // MobileDeviceKeySetup.Extension2 
{
	@P_ASG_78_1_0_23_9 = @P_ASG_78_1_0_23_9_range - (0); // slider = range - min
}

on envVar P_ASG_78_1_0_23_9 // MobileDeviceKeySetup.Extension2
{
	byte superval[6];

	//Update Childvalue (Number)
	byte thisval; // Extension2
	float slider_value;

	slider_value = 0; // Konstanter Parameter.
	@P_ASG_78_1_0_23_9_range = slider_value + (0); // real value := slider value + range min.
	thisval = (byte)round((slider_value + (0) - (0)) / (1.0), 1); // bus value := (slider value + min - offset) / step.

    // Update superval
	getValue(P_ASG_78_1_0_23, superval);
	superval[5]=thisval;
	putValue(P_ASG_78_1_0_23,superval);
}

on envVar M_ASG_78_1_0_24AbortResult_BTN
{
    if (M_ASG_78_1_0_24AbortResult_BTN_already_pressed == 0)
    {
         putValue(M_ASG_78_1_0_24_ErrCode,0);
         SetControlBackColor(panel_name,"errField_M_ASG_78_1_0_24",MakeRGB(255,255,255));
         M_ASG_78_1_0_24AbortResult_BTN_already_pressed = 1;
    }
    else
    {
         putValue(M_ASG_78_1_0_24_State, "AbortResult");
         Request_Void(LSGID, M_ASG_78_1_0_24_ID, AbortResult_REQ);
         M_ASG_78_1_0_24AbortResult_BTN_already_pressed = 0;
    }
}

on envVar M_ASG_78_1_0_24StartResult_BTN
{
    byte temp[9];
    if (M_ASG_78_1_0_24StartResult_BTN_already_pressed == 0)
    {
       putValue(M_ASG_78_1_0_24_ErrCode,0);
       SetControlBackColor(panel_name,"errField_M_ASG_78_1_0_24",MakeRGB(255,255,255));
       M_ASG_78_1_0_24StartResult_BTN_already_pressed = 1;
    }
    else
    {
		M_ASG_78_1_0_24_Start_BuildFct();
       getValue(M_ASG_78_1_0_24_Start, temp);
       Request_ByteSequence(LSGID, M_ASG_78_1_0_24_ID, StartResult_REQ, temp, getValueSize(M_ASG_78_1_0_24_Start));
       putValue(M_ASG_78_1_0_24_State, "Started");
       if(getValue(M_ASG_78_1_0_24_IntTlgEn)) //getValue(IT))
       {
           intertelegram_err(M_ASG_78_1_0_24_ID);
       }
       if(getValue(M_ASG_78_1_0_24_SegmEn))   //getvalue(SG)
       {
           sequence_err(M_ASG_78_1_0_24_ID,getValueSize(M_ASG_78_1_0_24_Start));
       }
       M_ASG_78_1_0_24StartResult_BTN_already_pressed = 0;
    }
}

// Man darf gleichzeitig nur Checkbox fuer SegmError oder IntertelegramError aktiviert werden
on envVar M_ASG_78_1_0_24_IntTlgEn
{
       if(getValue(this)) 
       {
           putValue(M_ASG_78_1_0_24_SegmEn,0);
           intertelegram_err(M_ASG_78_1_0_24_ID);
       }
       else
       {
           intertelegram_err_off(M_ASG_78_1_0_24_ID);
       }
}

// Man darf gleichzeitig nur Checkbox fuer SegmError oder IntertelegramError aktiviert werden
on envVar M_ASG_78_1_0_24_SegmEn
{
       if(getValue(this)) 
       {
           putValue(M_ASG_78_1_0_24_IntTlgEn,0);
           sequence_err(M_ASG_78_1_0_24_ID,getValueSize(M_ASG_78_1_0_24_SegmEn));
       }
       else
       {
              sequence_err_off(M_ASG_78_1_0_24_ID);
       }
}

on envVar M_ASG_78_1_0_24_Result // bus value of VTANAuthenticationData (24).
{
	// opcodes: Error-Processing-Result
	byte param1[46]; // VTANAuthenticationData
	word len1;
	byte cnt1;
	byte param2; // ResultCode
	// DATATYPE_BYTESEQUENCE / DATATYPE_FIXEDBYTESEQUENCE
	int i;
	byte superval[47];
	int currentPos;
	currentPos = 0;
	for( i = 0; i < 47; i++ ) {
		superval[i] = 0;
	}
	getValue(M_ASG_78_1_0_24_Result, superval);
	///////// Start param1 - STRING /////////
	getValue(M_ASG_78_1_0_24_Result_1, param1);
	if((superval[currentPos] & 0x80) > 0)
	{
		if(45>127) /* Max Fct-Katalog Laenge: 45*/
		{
			len1 = ( (superval[currentPos]&0x7F) <<8) + superval[currentPos+1];
			currentPos = currentPos + 2;
			cnt1 = 1;
		}
		else
		{
			len1 = 45;
			writelineEx(gBAP_Trace, 0, "Anzahl der Laengeninformation-Bytes in M_ASG_78_1_0_24_Result ueberschreitet die erlaubte 1 Byte vom Fct-Kalatog.");
		}
	}
	else
	{
		len1 = superval[currentPos]&0x7F;
		currentPos = currentPos + 1;
		cnt1 = 0;
	}
	
	if(len1 > 45)
	{
		writelineEx(gBAP_Trace, 0, "Laenge:%d bei der Byte Position:%d ueberschreitet die Maximale erlaubte Laenge von Fct-Kalatog", len1, currentPos);
		len1 = 45;
	
		if(len1 < 128) cnt1 = 0;
		else cnt1 = 1;
	}
	
	for(i = 0; i < len1; i++)
	{
		param1[i] = superval[currentPos++];
	}
	
	putValue(M_ASG_78_1_0_24_Result_1_len, len1);
	putValue(M_ASG_78_1_0_24_Result_1_cnt, cnt1);
	
	if(len1 > getValueSize(M_ASG_78_1_0_24_Result_1))
		putValue(M_ASG_78_1_0_24_Result_1, param1, len1);
	else
		putValue(M_ASG_78_1_0_24_Result_1, param1, getValueSize(M_ASG_78_1_0_24_Result_1));

	///////// Start param2 - UINT8 /////////
	param2 = superval[currentPos++];
	putValue(M_ASG_78_1_0_24_Result_2, param2);
}

// Updates the bus value field and other dependencies.
M_ASG_78_1_0_24_Result_BuildFct()
{
	byte param1[46]; // VTANAuthenticationData
	word len1;
	byte cnt1;
	byte param2; // ResultCode

	int i;
	byte superval[47];
	int currentPos;
	currentPos = 0;
// gen_BuildFunc_SetSuperVals 
	getValue(M_ASG_78_1_0_24_Result_1, param1);
	len1 = getValue(M_ASG_78_1_0_24_Result_1_len);
	cnt1= getValue(M_ASG_78_1_0_24_Result_1_cnt);
	
	/* check box aktiviert*/
	if (cnt1 == 1)
	{
		/* 0 bis 45 (MaxString - 1B oder 2B) */
		if(len1 >= 0 && len1 <= 45)
		{
			//writelineEx(gBAP_Trace, 0, "[Debug-1] Len1: %d", len1);
			superval[currentPos] = (len1&0x7f00) | 0x80;
			superval[currentPos+1] = len1 & 0x00ff;
		}
		else
		{
			writelineEx(gBAP_Trace, 0, "Eingegebene Laenge: %d von M_ASG_78_1_0_24_Result_1 ist ungueltig. Die max. erlaubte Laenge ist %d.", len1, 45);
			return;
		}
	}
	else if(cnt1 == 0) /*check box deaktiviert*/
	{
		if(len1 >= 0 && len1 <= 127)
		{
			//writelineEx(gBAP_Trace, 0, "[Debug-1] Len1: %d", len1);
			superval[currentPos]= len1 & 0x00ff;
			putValue(M_ASG_78_1_0_24_Result_1_len, len1);
		}
		else if(len1 > 127 && len1 <= 45)
		{
			superval[currentPos] = (len1&0x7f00) | 0x80;
			superval[currentPos+1] = len1 & 0x00ff;
			putValue(M_ASG_78_1_0_24_Result_1_len, len1);
			putValue(M_ASG_78_1_0_24_Result_1_cnt, 1);
		}
		else
		{
			writelineEx(gBAP_Trace, 0, "Eingegebene Laenge: %d von M_ASG_78_1_0_24_Result_1 ist ungueltig. Die max. erlaubte Laenge ist %d.", len1, 45);
			return;
		}
	}
	currentPos += cnt1+1;
	for(i = 0; i < len1; i++)
	{
		superval[currentPos++]= param1[i];
	}

// gen_BuildFunc_SetSuperVals 
	param2 = getValue(M_ASG_78_1_0_24_Result_2);
	superval[currentPos++]=param2;
	putValue(M_ASG_78_1_0_24_Result, superval, currentPos);
}

// Ueberwachung der CheckBox fuer String
on envVar  M_ASG_78_1_0_24_Result_1_cnt
{
	word len;
	byte cnt;
	len = getValue(M_ASG_78_1_0_24_Result_1_len);
	cnt = getValue(M_ASG_78_1_0_24_Result_1_cnt);

	/* wird nur gerufen, wenn check box deaktiviert mit Length>127*/ 
	if( cnt == 0) 
	{
		if(len > 127 )
		{
			putValue(M_ASG_78_1_0_24_Result_1_len, 127);
		}
	}

	M_ASG_78_1_0_24_Result_BuildFct();
}

// Ueberwachung der Eingabefeld fuer String Data
on envVar M_ASG_78_1_0_24_Result_1_len
{
	word len;
	len = getValue(this);
	/* Validierung der Eingabe*/
	if(len > 45)
	{
		writelineEx(gBAP_Trace, 0, "Eingegebene Laenge: %d von M_ASG_78_1_0_24_Result_1 ist ungueltig. Die max. erlaubte Laenge ist %d. ", len, 45);
		putValue(this, 45);
	}
	M_ASG_78_1_0_24_Result_BuildFct();
}

on envVar M_ASG_78_1_0_24_Result_1 // VTANAuthenticationData.VTANAuthenticationData
{
	putValue(M_ASG_78_1_0_24_Result_1_len, getValueSize(this));
	M_ASG_78_1_0_24_Result_BuildFct();
}

on envVar M_ASG_78_1_0_24_Result_2 // VTANAuthenticationData.ResultCode
{
	M_ASG_78_1_0_24_Result_BuildFct();
}

on envVar M_ASG_78_1_0_24_Processing // bus value of VTANAuthenticationData (24).
{
	// opcodes: Error-Processing-Result
	byte param1; // Reserve1
	byte param2; // Reserve2
	// DATATYPE_BYTESEQUENCE / DATATYPE_FIXEDBYTESEQUENCE
	int i;
	byte superval[47];
	int currentPos;
	currentPos = 0;
	for( i = 0; i < 47; i++ ) {
		superval[i] = 0;
	}
	getValue(M_ASG_78_1_0_24_Processing, superval);
	///////// Start param1 - UINT8 /////////
	param1 = superval[currentPos++];
	putValue(M_ASG_78_1_0_24_Processing_1, round((param1 * 1.0) - (0) + (0), 1.0));
	///////// Start param2 - UINT8 /////////
	param2 = superval[currentPos++];
	putValue(M_ASG_78_1_0_24_Processing_2, round((param2 * 1.0) - (0) + (0), 1.0));
}

// Updates the bus value field and other dependencies.
M_ASG_78_1_0_24_Processing_BuildFct()
{
	byte param1; // Reserve1
	byte param2; // Reserve2

	int i;
	byte superval[47];
	int currentPos;
	currentPos = 0;
// gen_BuildFunc_SetSuperVals 
	@M_ASG_78_1_0_24_Processing_1_range = round(@M_ASG_78_1_0_24_Processing_1 + (0), 1.0); // slider value + min = real value
	param1 = 0; // underlying parameter has constant value 0.
	superval[currentPos++]=param1;
// gen_BuildFunc_SetSuperVals 
	@M_ASG_78_1_0_24_Processing_2_range = round(@M_ASG_78_1_0_24_Processing_2 + (0), 1.0); // slider value + min = real value
	param2 = 0; // underlying parameter has constant value 0.
	superval[currentPos++]=param2;
	putValue(M_ASG_78_1_0_24_Processing, superval, currentPos);
}

// Ueberwachung der Darstellungsvariable der Range.
on envVar M_ASG_78_1_0_24_Processing_1_range // VTANAuthenticationData.Reserve1 
{
	@M_ASG_78_1_0_24_Processing_1 = @M_ASG_78_1_0_24_Processing_1_range - (0); // slider = range - min
}

on envVar M_ASG_78_1_0_24_Processing_1 // VTANAuthenticationData.Reserve1
{
	M_ASG_78_1_0_24_Processing_BuildFct();
}

// Ueberwachung der Darstellungsvariable der Range.
on envVar M_ASG_78_1_0_24_Processing_2_range // VTANAuthenticationData.Reserve2 
{
	@M_ASG_78_1_0_24_Processing_2 = @M_ASG_78_1_0_24_Processing_2_range - (0); // slider = range - min
}

on envVar M_ASG_78_1_0_24_Processing_2 // VTANAuthenticationData.Reserve2
{
	M_ASG_78_1_0_24_Processing_BuildFct();
}

on envVar M_ASG_78_1_0_24_Start // bus value of VTANAuthenticationData (24).
{
	// opcodes: AbortResult-StartResult
	byte param1[9]; // Challenge
	word len1;
	byte cnt1;
	// DATATYPE_BYTESEQUENCE / DATATYPE_FIXEDBYTESEQUENCE
	int i;
	byte superval[9];
	int currentPos;
	currentPos = 0;
	for( i = 0; i < 9; i++ ) {
		superval[i] = 0;
	}
	getValue(M_ASG_78_1_0_24_Start, superval);
	///////// Start param1 - STRING /////////
	getValue(M_ASG_78_1_0_24_Start_1, param1);
	if((superval[currentPos] & 0x80) > 0)
	{
		if(8>127) /* Max Fct-Katalog Laenge: 8*/
		{
			len1 = ( (superval[currentPos]&0x7F) <<8) + superval[currentPos+1];
			currentPos = currentPos + 2;
			cnt1 = 1;
		}
		else
		{
			len1 = 8;
			writelineEx(gBAP_Trace, 0, "Anzahl der Laengeninformation-Bytes in M_ASG_78_1_0_24_Start ueberschreitet die erlaubte 1 Byte vom Fct-Kalatog.");
		}
	}
	else
	{
		len1 = superval[currentPos]&0x7F;
		currentPos = currentPos + 1;
		cnt1 = 0;
	}
	
	if(len1 > 8)
	{
		writelineEx(gBAP_Trace, 0, "Laenge:%d bei der Byte Position:%d ueberschreitet die Maximale erlaubte Laenge von Fct-Kalatog", len1, currentPos);
		len1 = 8;
	
		if(len1 < 128) cnt1 = 0;
		else cnt1 = 1;
	}
	
	for(i = 0; i < len1; i++)
	{
		param1[i] = superval[currentPos++];
	}
	
	putValue(M_ASG_78_1_0_24_Start_1_len, len1);
	putValue(M_ASG_78_1_0_24_Start_1_cnt, cnt1);
	
	if(len1 > getValueSize(M_ASG_78_1_0_24_Start_1))
		putValue(M_ASG_78_1_0_24_Start_1, param1, len1);
	else
		putValue(M_ASG_78_1_0_24_Start_1, param1, getValueSize(M_ASG_78_1_0_24_Start_1));

}

// Updates the bus value field and other dependencies.
M_ASG_78_1_0_24_Start_BuildFct()
{
	byte param1[9]; // Challenge
	word len1;
	byte cnt1;

	int i;
	byte superval[9];
	int currentPos;
	currentPos = 0;
// gen_BuildFunc_SetSuperVals 
	getValue(M_ASG_78_1_0_24_Start_1, param1);
	len1 = getValue(M_ASG_78_1_0_24_Start_1_len);
	cnt1= getValue(M_ASG_78_1_0_24_Start_1_cnt);
	
	/* check box aktiviert*/
	if (cnt1 == 1)
	{
		/* 0 bis 8 (MaxString - 1B oder 2B) */
		if(len1 >= 0 && len1 <= 8)
		{
			//writelineEx(gBAP_Trace, 0, "[Debug-1] Len1: %d", len1);
			superval[currentPos] = (len1&0x7f00) | 0x80;
			superval[currentPos+1] = len1 & 0x00ff;
		}
		else
		{
			writelineEx(gBAP_Trace, 0, "Eingegebene Laenge: %d von M_ASG_78_1_0_24_Start_1 ist ungueltig. Die max. erlaubte Laenge ist %d.", len1, 8);
			return;
		}
	}
	else if(cnt1 == 0) /*check box deaktiviert*/
	{
		if(len1 >= 0 && len1 <= 127)
		{
			//writelineEx(gBAP_Trace, 0, "[Debug-1] Len1: %d", len1);
			superval[currentPos]= len1 & 0x00ff;
			putValue(M_ASG_78_1_0_24_Start_1_len, len1);
		}
		else if(len1 > 127 && len1 <= 8)
		{
			superval[currentPos] = (len1&0x7f00) | 0x80;
			superval[currentPos+1] = len1 & 0x00ff;
			putValue(M_ASG_78_1_0_24_Start_1_len, len1);
			putValue(M_ASG_78_1_0_24_Start_1_cnt, 1);
		}
		else
		{
			writelineEx(gBAP_Trace, 0, "Eingegebene Laenge: %d von M_ASG_78_1_0_24_Start_1 ist ungueltig. Die max. erlaubte Laenge ist %d.", len1, 8);
			return;
		}
	}
	currentPos += cnt1+1;
	for(i = 0; i < len1; i++)
	{
		superval[currentPos++]= param1[i];
	}

	putValue(M_ASG_78_1_0_24_Start, superval, currentPos);
}

// Ueberwachung der CheckBox fuer String
on envVar  M_ASG_78_1_0_24_Start_1_cnt
{
	word len;
	byte cnt;
	len = getValue(M_ASG_78_1_0_24_Start_1_len);
	cnt = getValue(M_ASG_78_1_0_24_Start_1_cnt);

	/* wird nur gerufen, wenn check box deaktiviert mit Length>127*/ 
	if( cnt == 0) 
	{
		if(len > 127 )
		{
			putValue(M_ASG_78_1_0_24_Start_1_len, 127);
		}
	}

	M_ASG_78_1_0_24_Start_BuildFct();
}

// Ueberwachung der Eingabefeld fuer String Data
on envVar M_ASG_78_1_0_24_Start_1_len
{
	word len;
	len = getValue(this);
	/* Validierung der Eingabe*/
	if(len > 8)
	{
		writelineEx(gBAP_Trace, 0, "Eingegebene Laenge: %d von M_ASG_78_1_0_24_Start_1 ist ungueltig. Die max. erlaubte Laenge ist %d. ", len, 8);
		putValue(this, 8);
	}
	M_ASG_78_1_0_24_Start_BuildFct();
}

on envVar M_ASG_78_1_0_24_Start_1 // VTANAuthenticationData.Challenge
{
	putValue(M_ASG_78_1_0_24_Start_1_len, getValueSize(this));
	M_ASG_78_1_0_24_Start_BuildFct();
}

on envVar M_ASG_78_1_0_25AbortResult_BTN
{
    if (M_ASG_78_1_0_25AbortResult_BTN_already_pressed == 0)
    {
         putValue(M_ASG_78_1_0_25_ErrCode,0);
         SetControlBackColor(panel_name,"errField_M_ASG_78_1_0_25",MakeRGB(255,255,255));
         M_ASG_78_1_0_25AbortResult_BTN_already_pressed = 1;
    }
    else
    {
         putValue(M_ASG_78_1_0_25_State, "AbortResult");
         Request_Void(LSGID, M_ASG_78_1_0_25_ID, AbortResult_REQ);
         M_ASG_78_1_0_25AbortResult_BTN_already_pressed = 0;
    }
}

on envVar M_ASG_78_1_0_25StartResult_BTN
{
    byte temp[700];
    if (M_ASG_78_1_0_25StartResult_BTN_already_pressed == 0)
    {
       putValue(M_ASG_78_1_0_25_ErrCode,0);
       SetControlBackColor(panel_name,"errField_M_ASG_78_1_0_25",MakeRGB(255,255,255));
       M_ASG_78_1_0_25StartResult_BTN_already_pressed = 1;
    }
    else
    {
		M_ASG_78_1_0_25_Start_BuildFct();
       getValue(M_ASG_78_1_0_25_Start, temp);
       Request_ByteSequence(LSGID, M_ASG_78_1_0_25_ID, StartResult_REQ, temp, getValueSize(M_ASG_78_1_0_25_Start));
       putValue(M_ASG_78_1_0_25_State, "Started");
       if(getValue(M_ASG_78_1_0_25_IntTlgEn)) //getValue(IT))
       {
           intertelegram_err(M_ASG_78_1_0_25_ID);
       }
       if(getValue(M_ASG_78_1_0_25_SegmEn))   //getvalue(SG)
       {
           sequence_err(M_ASG_78_1_0_25_ID,getValueSize(M_ASG_78_1_0_25_Start));
       }
       M_ASG_78_1_0_25StartResult_BTN_already_pressed = 0;
    }
}

// Man darf gleichzeitig nur Checkbox fuer SegmError oder IntertelegramError aktiviert werden
on envVar M_ASG_78_1_0_25_IntTlgEn
{
       if(getValue(this)) 
       {
           putValue(M_ASG_78_1_0_25_SegmEn,0);
           intertelegram_err(M_ASG_78_1_0_25_ID);
       }
       else
       {
           intertelegram_err_off(M_ASG_78_1_0_25_ID);
       }
}

// Man darf gleichzeitig nur Checkbox fuer SegmError oder IntertelegramError aktiviert werden
on envVar M_ASG_78_1_0_25_SegmEn
{
       if(getValue(this)) 
       {
           putValue(M_ASG_78_1_0_25_IntTlgEn,0);
           sequence_err(M_ASG_78_1_0_25_ID,getValueSize(M_ASG_78_1_0_25_SegmEn));
       }
       else
       {
              sequence_err_off(M_ASG_78_1_0_25_ID);
       }
}

on envVar M_ASG_78_1_0_25_Result // bus value of VTANDecryption (25).
{
	// opcodes: Error-Processing-Result
	byte param1; // VTANType
	byte param2[31]; // VTAN
	word len2;
	byte cnt2;
	byte param3[243]; // Param1
	word len3;
	byte cnt3;
	byte param4[243]; // Param2
	word len4;
	byte cnt4;
	byte param5; // ResultCode
	// DATATYPE_BYTESEQUENCE / DATATYPE_FIXEDBYTESEQUENCE
	int i;
	byte superval[519];
	int currentPos;
	currentPos = 0;
	for( i = 0; i < 519; i++ ) {
		superval[i] = 0;
	}
	getValue(M_ASG_78_1_0_25_Result, superval);
	///////// Start param1 - UINT8 /////////
	param1 = superval[currentPos++];
	putValue(M_ASG_78_1_0_25_Result_1, param1);
	///////// Start param2 - STRING /////////
	getValue(M_ASG_78_1_0_25_Result_2, param2);
	if((superval[currentPos] & 0x80) > 0)
	{
		if(30>127) /* Max Fct-Katalog Laenge: 30*/
		{
			len2 = ( (superval[currentPos]&0x7F) <<8) + superval[currentPos+1];
			currentPos = currentPos + 2;
			cnt2 = 1;
		}
		else
		{
			len2 = 30;
			writelineEx(gBAP_Trace, 0, "Anzahl der Laengeninformation-Bytes in M_ASG_78_1_0_25_Result ueberschreitet die erlaubte 1 Byte vom Fct-Kalatog.");
		}
	}
	else
	{
		len2 = superval[currentPos]&0x7F;
		currentPos = currentPos + 1;
		cnt2 = 0;
	}
	
	if(len2 > 30)
	{
		writelineEx(gBAP_Trace, 0, "Laenge:%d bei der Byte Position:%d ueberschreitet die Maximale erlaubte Laenge von Fct-Kalatog", len2, currentPos);
		len2 = 30;
	
		if(len2 < 128) cnt2 = 0;
		else cnt2 = 1;
	}
	
	for(i = 0; i < len2; i++)
	{
		param2[i] = superval[currentPos++];
	}
	
	putValue(M_ASG_78_1_0_25_Result_2_len, len2);
	putValue(M_ASG_78_1_0_25_Result_2_cnt, cnt2);
	
	if(len2 > getValueSize(M_ASG_78_1_0_25_Result_2))
		putValue(M_ASG_78_1_0_25_Result_2, param2, len2);
	else
		putValue(M_ASG_78_1_0_25_Result_2, param2, getValueSize(M_ASG_78_1_0_25_Result_2));

	///////// Start param3 - STRING /////////
	getValue(M_ASG_78_1_0_25_Result_3, param3);
	if((superval[currentPos] & 0x80) > 0)
	{
		if(241>127) /* Max Fct-Katalog Laenge: 241*/
		{
			len3 = ( (superval[currentPos]&0x7F) <<8) + superval[currentPos+1];
			currentPos = currentPos + 2;
			cnt3 = 1;
		}
		else
		{
			len3 = 241;
			writelineEx(gBAP_Trace, 0, "Anzahl der Laengeninformation-Bytes in M_ASG_78_1_0_25_Result ueberschreitet die erlaubte 1 Byte vom Fct-Kalatog.");
		}
	}
	else
	{
		len3 = superval[currentPos]&0x7F;
		currentPos = currentPos + 1;
		cnt3 = 0;
	}
	
	if(len3 > 241)
	{
		writelineEx(gBAP_Trace, 0, "Laenge:%d bei der Byte Position:%d ueberschreitet die Maximale erlaubte Laenge von Fct-Kalatog", len3, currentPos);
		len3 = 241;
	
		if(len3 < 128) cnt3 = 0;
		else cnt3 = 1;
	}
	
	for(i = 0; i < len3; i++)
	{
		param3[i] = superval[currentPos++];
	}
	
	putValue(M_ASG_78_1_0_25_Result_3_len, len3);
	putValue(M_ASG_78_1_0_25_Result_3_cnt, cnt3);
	
	if(len3 > getValueSize(M_ASG_78_1_0_25_Result_3))
		putValue(M_ASG_78_1_0_25_Result_3, param3, len3);
	else
		putValue(M_ASG_78_1_0_25_Result_3, param3, getValueSize(M_ASG_78_1_0_25_Result_3));

	///////// Start param4 - STRING /////////
	getValue(M_ASG_78_1_0_25_Result_4, param4);
	if((superval[currentPos] & 0x80) > 0)
	{
		if(241>127) /* Max Fct-Katalog Laenge: 241*/
		{
			len4 = ( (superval[currentPos]&0x7F) <<8) + superval[currentPos+1];
			currentPos = currentPos + 2;
			cnt4 = 1;
		}
		else
		{
			len4 = 241;
			writelineEx(gBAP_Trace, 0, "Anzahl der Laengeninformation-Bytes in M_ASG_78_1_0_25_Result ueberschreitet die erlaubte 1 Byte vom Fct-Kalatog.");
		}
	}
	else
	{
		len4 = superval[currentPos]&0x7F;
		currentPos = currentPos + 1;
		cnt4 = 0;
	}
	
	if(len4 > 241)
	{
		writelineEx(gBAP_Trace, 0, "Laenge:%d bei der Byte Position:%d ueberschreitet die Maximale erlaubte Laenge von Fct-Kalatog", len4, currentPos);
		len4 = 241;
	
		if(len4 < 128) cnt4 = 0;
		else cnt4 = 1;
	}
	
	for(i = 0; i < len4; i++)
	{
		param4[i] = superval[currentPos++];
	}
	
	putValue(M_ASG_78_1_0_25_Result_4_len, len4);
	putValue(M_ASG_78_1_0_25_Result_4_cnt, cnt4);
	
	if(len4 > getValueSize(M_ASG_78_1_0_25_Result_4))
		putValue(M_ASG_78_1_0_25_Result_4, param4, len4);
	else
		putValue(M_ASG_78_1_0_25_Result_4, param4, getValueSize(M_ASG_78_1_0_25_Result_4));

	///////// Start param5 - UINT8 /////////
	param5 = superval[currentPos++];
	putValue(M_ASG_78_1_0_25_Result_5, param5);
}

// Updates the bus value field and other dependencies.
M_ASG_78_1_0_25_Result_BuildFct()
{
	byte param1; // VTANType
	byte param2[31]; // VTAN
	word len2;
	byte cnt2;
	byte param3[243]; // Param1
	word len3;
	byte cnt3;
	byte param4[243]; // Param2
	word len4;
	byte cnt4;
	byte param5; // ResultCode

	int i;
	byte superval[519];
	int currentPos;
	currentPos = 0;
// gen_BuildFunc_SetSuperVals 
	param1 = getValue(M_ASG_78_1_0_25_Result_1);
	superval[currentPos++]=param1;
// gen_BuildFunc_SetSuperVals 
	getValue(M_ASG_78_1_0_25_Result_2, param2);
	len2 = getValue(M_ASG_78_1_0_25_Result_2_len);
	cnt2= getValue(M_ASG_78_1_0_25_Result_2_cnt);
	
	/* check box aktiviert*/
	if (cnt2 == 1)
	{
		/* 0 bis 30 (MaxString - 1B oder 2B) */
		if(len2 >= 0 && len2 <= 30)
		{
			//writelineEx(gBAP_Trace, 0, "[Debug-1] Len2: %d", len2);
			superval[currentPos] = (len2&0x7f00) | 0x80;
			superval[currentPos+1] = len2 & 0x00ff;
		}
		else
		{
			writelineEx(gBAP_Trace, 0, "Eingegebene Laenge: %d von M_ASG_78_1_0_25_Result_2 ist ungueltig. Die max. erlaubte Laenge ist %d.", len2, 30);
			return;
		}
	}
	else if(cnt2 == 0) /*check box deaktiviert*/
	{
		if(len2 >= 0 && len2 <= 127)
		{
			//writelineEx(gBAP_Trace, 0, "[Debug-1] Len2: %d", len2);
			superval[currentPos]= len2 & 0x00ff;
			putValue(M_ASG_78_1_0_25_Result_2_len, len2);
		}
		else if(len2 > 127 && len2 <= 30)
		{
			superval[currentPos] = (len2&0x7f00) | 0x80;
			superval[currentPos+1] = len2 & 0x00ff;
			putValue(M_ASG_78_1_0_25_Result_2_len, len2);
			putValue(M_ASG_78_1_0_25_Result_2_cnt, 1);
		}
		else
		{
			writelineEx(gBAP_Trace, 0, "Eingegebene Laenge: %d von M_ASG_78_1_0_25_Result_2 ist ungueltig. Die max. erlaubte Laenge ist %d.", len2, 30);
			return;
		}
	}
	currentPos += cnt2+1;
	for(i = 0; i < len2; i++)
	{
		superval[currentPos++]= param2[i];
	}

// gen_BuildFunc_SetSuperVals 
	getValue(M_ASG_78_1_0_25_Result_3, param3);
	len3 = getValue(M_ASG_78_1_0_25_Result_3_len);
	cnt3= getValue(M_ASG_78_1_0_25_Result_3_cnt);
	
	/* check box aktiviert*/
	if (cnt3 == 1)
	{
		/* 0 bis 241 (MaxString - 1B oder 2B) */
		if(len3 >= 0 && len3 <= 241)
		{
			//writelineEx(gBAP_Trace, 0, "[Debug-1] Len3: %d", len3);
			superval[currentPos] = (len3&0x7f00) | 0x80;
			superval[currentPos+1] = len3 & 0x00ff;
		}
		else
		{
			writelineEx(gBAP_Trace, 0, "Eingegebene Laenge: %d von M_ASG_78_1_0_25_Result_3 ist ungueltig. Die max. erlaubte Laenge ist %d.", len3, 241);
			return;
		}
	}
	else if(cnt3 == 0) /*check box deaktiviert*/
	{
		if(len3 >= 0 && len3 <= 127)
		{
			//writelineEx(gBAP_Trace, 0, "[Debug-1] Len3: %d", len3);
			superval[currentPos]= len3 & 0x00ff;
			putValue(M_ASG_78_1_0_25_Result_3_len, len3);
		}
		else if(len3 > 127 && len3 <= 241)
		{
			superval[currentPos] = (len3&0x7f00) | 0x80;
			superval[currentPos+1] = len3 & 0x00ff;
			putValue(M_ASG_78_1_0_25_Result_3_len, len3);
			putValue(M_ASG_78_1_0_25_Result_3_cnt, 1);
		}
		else
		{
			writelineEx(gBAP_Trace, 0, "Eingegebene Laenge: %d von M_ASG_78_1_0_25_Result_3 ist ungueltig. Die max. erlaubte Laenge ist %d.", len3, 241);
			return;
		}
	}
	currentPos += cnt3+1;
	for(i = 0; i < len3; i++)
	{
		superval[currentPos++]= param3[i];
	}

// gen_BuildFunc_SetSuperVals 
	getValue(M_ASG_78_1_0_25_Result_4, param4);
	len4 = getValue(M_ASG_78_1_0_25_Result_4_len);
	cnt4= getValue(M_ASG_78_1_0_25_Result_4_cnt);
	
	/* check box aktiviert*/
	if (cnt4 == 1)
	{
		/* 0 bis 241 (MaxString - 1B oder 2B) */
		if(len4 >= 0 && len4 <= 241)
		{
			//writelineEx(gBAP_Trace, 0, "[Debug-1] Len4: %d", len4);
			superval[currentPos] = (len4&0x7f00) | 0x80;
			superval[currentPos+1] = len4 & 0x00ff;
		}
		else
		{
			writelineEx(gBAP_Trace, 0, "Eingegebene Laenge: %d von M_ASG_78_1_0_25_Result_4 ist ungueltig. Die max. erlaubte Laenge ist %d.", len4, 241);
			return;
		}
	}
	else if(cnt4 == 0) /*check box deaktiviert*/
	{
		if(len4 >= 0 && len4 <= 127)
		{
			//writelineEx(gBAP_Trace, 0, "[Debug-1] Len4: %d", len4);
			superval[currentPos]= len4 & 0x00ff;
			putValue(M_ASG_78_1_0_25_Result_4_len, len4);
		}
		else if(len4 > 127 && len4 <= 241)
		{
			superval[currentPos] = (len4&0x7f00) | 0x80;
			superval[currentPos+1] = len4 & 0x00ff;
			putValue(M_ASG_78_1_0_25_Result_4_len, len4);
			putValue(M_ASG_78_1_0_25_Result_4_cnt, 1);
		}
		else
		{
			writelineEx(gBAP_Trace, 0, "Eingegebene Laenge: %d von M_ASG_78_1_0_25_Result_4 ist ungueltig. Die max. erlaubte Laenge ist %d.", len4, 241);
			return;
		}
	}
	currentPos += cnt4+1;
	for(i = 0; i < len4; i++)
	{
		superval[currentPos++]= param4[i];
	}

// gen_BuildFunc_SetSuperVals 
	param5 = getValue(M_ASG_78_1_0_25_Result_5);
	superval[currentPos++]=param5;
	putValue(M_ASG_78_1_0_25_Result, superval, currentPos);
}

on envVar M_ASG_78_1_0_25_Result_1 // VTANDecryption.VTANType
{
	M_ASG_78_1_0_25_Result_BuildFct();
}

// Ueberwachung der CheckBox fuer String
on envVar  M_ASG_78_1_0_25_Result_2_cnt
{
	word len;
	byte cnt;
	len = getValue(M_ASG_78_1_0_25_Result_2_len);
	cnt = getValue(M_ASG_78_1_0_25_Result_2_cnt);

	/* wird nur gerufen, wenn check box deaktiviert mit Length>127*/ 
	if( cnt == 0) 
	{
		if(len > 127 )
		{
			putValue(M_ASG_78_1_0_25_Result_2_len, 127);
		}
	}

	M_ASG_78_1_0_25_Result_BuildFct();
}

// Ueberwachung der Eingabefeld fuer String Data
on envVar M_ASG_78_1_0_25_Result_2_len
{
	word len;
	len = getValue(this);
	/* Validierung der Eingabe*/
	if(len > 30)
	{
		writelineEx(gBAP_Trace, 0, "Eingegebene Laenge: %d von M_ASG_78_1_0_25_Result_2 ist ungueltig. Die max. erlaubte Laenge ist %d. ", len, 30);
		putValue(this, 30);
	}
	M_ASG_78_1_0_25_Result_BuildFct();
}

on envVar M_ASG_78_1_0_25_Result_2 // VTANDecryption.VTAN
{
	putValue(M_ASG_78_1_0_25_Result_2_len, getValueSize(this));
	M_ASG_78_1_0_25_Result_BuildFct();
}

// Ueberwachung der CheckBox fuer String
on envVar  M_ASG_78_1_0_25_Result_3_cnt
{
	word len;
	byte cnt;
	len = getValue(M_ASG_78_1_0_25_Result_3_len);
	cnt = getValue(M_ASG_78_1_0_25_Result_3_cnt);

	/* wird nur gerufen, wenn check box deaktiviert mit Length>127*/ 
	if( cnt == 0) 
	{
		if(len > 127 )
		{
			putValue(M_ASG_78_1_0_25_Result_3_len, 127);
		}
	}

	M_ASG_78_1_0_25_Result_BuildFct();
}

// Ueberwachung der Eingabefeld fuer String Data
on envVar M_ASG_78_1_0_25_Result_3_len
{
	word len;
	len = getValue(this);
	/* Validierung der Eingabe*/
	if(len > 241)
	{
		writelineEx(gBAP_Trace, 0, "Eingegebene Laenge: %d von M_ASG_78_1_0_25_Result_3 ist ungueltig. Die max. erlaubte Laenge ist %d. ", len, 241);
		putValue(this, 241);
	}
	M_ASG_78_1_0_25_Result_BuildFct();
}

on envVar M_ASG_78_1_0_25_Result_3 // VTANDecryption.Param1
{
	putValue(M_ASG_78_1_0_25_Result_3_len, getValueSize(this));
	M_ASG_78_1_0_25_Result_BuildFct();
}

// Ueberwachung der CheckBox fuer String
on envVar  M_ASG_78_1_0_25_Result_4_cnt
{
	word len;
	byte cnt;
	len = getValue(M_ASG_78_1_0_25_Result_4_len);
	cnt = getValue(M_ASG_78_1_0_25_Result_4_cnt);

	/* wird nur gerufen, wenn check box deaktiviert mit Length>127*/ 
	if( cnt == 0) 
	{
		if(len > 127 )
		{
			putValue(M_ASG_78_1_0_25_Result_4_len, 127);
		}
	}

	M_ASG_78_1_0_25_Result_BuildFct();
}

// Ueberwachung der Eingabefeld fuer String Data
on envVar M_ASG_78_1_0_25_Result_4_len
{
	word len;
	len = getValue(this);
	/* Validierung der Eingabe*/
	if(len > 241)
	{
		writelineEx(gBAP_Trace, 0, "Eingegebene Laenge: %d von M_ASG_78_1_0_25_Result_4 ist ungueltig. Die max. erlaubte Laenge ist %d. ", len, 241);
		putValue(this, 241);
	}
	M_ASG_78_1_0_25_Result_BuildFct();
}

on envVar M_ASG_78_1_0_25_Result_4 // VTANDecryption.Param2
{
	putValue(M_ASG_78_1_0_25_Result_4_len, getValueSize(this));
	M_ASG_78_1_0_25_Result_BuildFct();
}

on envVar M_ASG_78_1_0_25_Result_5 // VTANDecryption.ResultCode
{
	M_ASG_78_1_0_25_Result_BuildFct();
}

on envVar M_ASG_78_1_0_25_Processing // bus value of VTANDecryption (25).
{
	// opcodes: Error-Processing-Result
	byte param1; // Reserve1
	byte param2; // Reserve2
	byte param3; // Reserve3
	byte param4; // Reserve4
	byte param5; // Reserve5
	// DATATYPE_BYTESEQUENCE / DATATYPE_FIXEDBYTESEQUENCE
	int i;
	byte superval[519];
	int currentPos;
	currentPos = 0;
	for( i = 0; i < 519; i++ ) {
		superval[i] = 0;
	}
	getValue(M_ASG_78_1_0_25_Processing, superval);
	///////// Start param1 - UINT8 /////////
	param1 = superval[currentPos++];
	putValue(M_ASG_78_1_0_25_Processing_1, round((param1 * 1.0) - (0) + (0), 1.0));
	///////// Start param2 - UINT8 /////////
	param2 = superval[currentPos++];
	putValue(M_ASG_78_1_0_25_Processing_2, round((param2 * 1.0) - (0) + (0), 1.0));
	///////// Start param3 - UINT8 /////////
	param3 = superval[currentPos++];
	putValue(M_ASG_78_1_0_25_Processing_3, round((param3 * 1.0) - (0) + (0), 1.0));
	///////// Start param4 - UINT8 /////////
	param4 = superval[currentPos++];
	putValue(M_ASG_78_1_0_25_Processing_4, round((param4 * 1.0) - (0) + (0), 1.0));
	///////// Start param5 - UINT8 /////////
	param5 = superval[currentPos++];
	putValue(M_ASG_78_1_0_25_Processing_5, round((param5 * 1.0) - (0) + (0), 1.0));
}

// Updates the bus value field and other dependencies.
M_ASG_78_1_0_25_Processing_BuildFct()
{
	byte param1; // Reserve1
	byte param2; // Reserve2
	byte param3; // Reserve3
	byte param4; // Reserve4
	byte param5; // Reserve5

	int i;
	byte superval[519];
	int currentPos;
	currentPos = 0;
// gen_BuildFunc_SetSuperVals 
	@M_ASG_78_1_0_25_Processing_1_range = round(@M_ASG_78_1_0_25_Processing_1 + (0), 1.0); // slider value + min = real value
	param1 = 0; // underlying parameter has constant value 0.
	superval[currentPos++]=param1;
// gen_BuildFunc_SetSuperVals 
	@M_ASG_78_1_0_25_Processing_2_range = round(@M_ASG_78_1_0_25_Processing_2 + (0), 1.0); // slider value + min = real value
	param2 = 0; // underlying parameter has constant value 0.
	superval[currentPos++]=param2;
// gen_BuildFunc_SetSuperVals 
	@M_ASG_78_1_0_25_Processing_3_range = round(@M_ASG_78_1_0_25_Processing_3 + (0), 1.0); // slider value + min = real value
	param3 = 0; // underlying parameter has constant value 0.
	superval[currentPos++]=param3;
// gen_BuildFunc_SetSuperVals 
	@M_ASG_78_1_0_25_Processing_4_range = round(@M_ASG_78_1_0_25_Processing_4 + (0), 1.0); // slider value + min = real value
	param4 = 0; // underlying parameter has constant value 0.
	superval[currentPos++]=param4;
// gen_BuildFunc_SetSuperVals 
	@M_ASG_78_1_0_25_Processing_5_range = round(@M_ASG_78_1_0_25_Processing_5 + (0), 1.0); // slider value + min = real value
	param5 = 0; // underlying parameter has constant value 0.
	superval[currentPos++]=param5;
	putValue(M_ASG_78_1_0_25_Processing, superval, currentPos);
}

// Ueberwachung der Darstellungsvariable der Range.
on envVar M_ASG_78_1_0_25_Processing_1_range // VTANDecryption.Reserve1 
{
	@M_ASG_78_1_0_25_Processing_1 = @M_ASG_78_1_0_25_Processing_1_range - (0); // slider = range - min
}

on envVar M_ASG_78_1_0_25_Processing_1 // VTANDecryption.Reserve1
{
	M_ASG_78_1_0_25_Processing_BuildFct();
}

// Ueberwachung der Darstellungsvariable der Range.
on envVar M_ASG_78_1_0_25_Processing_2_range // VTANDecryption.Reserve2 
{
	@M_ASG_78_1_0_25_Processing_2 = @M_ASG_78_1_0_25_Processing_2_range - (0); // slider = range - min
}

on envVar M_ASG_78_1_0_25_Processing_2 // VTANDecryption.Reserve2
{
	M_ASG_78_1_0_25_Processing_BuildFct();
}

// Ueberwachung der Darstellungsvariable der Range.
on envVar M_ASG_78_1_0_25_Processing_3_range // VTANDecryption.Reserve3 
{
	@M_ASG_78_1_0_25_Processing_3 = @M_ASG_78_1_0_25_Processing_3_range - (0); // slider = range - min
}

on envVar M_ASG_78_1_0_25_Processing_3 // VTANDecryption.Reserve3
{
	M_ASG_78_1_0_25_Processing_BuildFct();
}

// Ueberwachung der Darstellungsvariable der Range.
on envVar M_ASG_78_1_0_25_Processing_4_range // VTANDecryption.Reserve4 
{
	@M_ASG_78_1_0_25_Processing_4 = @M_ASG_78_1_0_25_Processing_4_range - (0); // slider = range - min
}

on envVar M_ASG_78_1_0_25_Processing_4 // VTANDecryption.Reserve4
{
	M_ASG_78_1_0_25_Processing_BuildFct();
}

// Ueberwachung der Darstellungsvariable der Range.
on envVar M_ASG_78_1_0_25_Processing_5_range // VTANDecryption.Reserve5 
{
	@M_ASG_78_1_0_25_Processing_5 = @M_ASG_78_1_0_25_Processing_5_range - (0); // slider = range - min
}

on envVar M_ASG_78_1_0_25_Processing_5 // VTANDecryption.Reserve5
{
	M_ASG_78_1_0_25_Processing_BuildFct();
}

on envVar M_ASG_78_1_0_25_Start // bus value of VTANDecryption (25).
{
	// opcodes: AbortResult-StartResult
	byte param1[700]; // VTANDataEncrypted
	word len1;
	byte cnt1;
	// DATATYPE_BYTESEQUENCE / DATATYPE_FIXEDBYTESEQUENCE
	int i;
	byte superval[700];
	int currentPos;
	currentPos = 0;
	for( i = 0; i < 700; i++ ) {
		superval[i] = 0;
	}
	getValue(M_ASG_78_1_0_25_Start, superval);
	///////// Start param1 - STRING /////////
	getValue(M_ASG_78_1_0_25_Start_1, param1);
	if((superval[currentPos] & 0x80) > 0)
	{
		if(698>127) /* Max Fct-Katalog Laenge: 698*/
		{
			len1 = ( (superval[currentPos]&0x7F) <<8) + superval[currentPos+1];
			currentPos = currentPos + 2;
			cnt1 = 1;
		}
		else
		{
			len1 = 698;
			writelineEx(gBAP_Trace, 0, "Anzahl der Laengeninformation-Bytes in M_ASG_78_1_0_25_Start ueberschreitet die erlaubte 1 Byte vom Fct-Kalatog.");
		}
	}
	else
	{
		len1 = superval[currentPos]&0x7F;
		currentPos = currentPos + 1;
		cnt1 = 0;
	}
	
	if(len1 > 698)
	{
		writelineEx(gBAP_Trace, 0, "Laenge:%d bei der Byte Position:%d ueberschreitet die Maximale erlaubte Laenge von Fct-Kalatog", len1, currentPos);
		len1 = 698;
	
		if(len1 < 128) cnt1 = 0;
		else cnt1 = 1;
	}
	
	for(i = 0; i < len1; i++)
	{
		param1[i] = superval[currentPos++];
	}
	
	putValue(M_ASG_78_1_0_25_Start_1_len, len1);
	putValue(M_ASG_78_1_0_25_Start_1_cnt, cnt1);
	
	if(len1 > getValueSize(M_ASG_78_1_0_25_Start_1))
		putValue(M_ASG_78_1_0_25_Start_1, param1, len1);
	else
		putValue(M_ASG_78_1_0_25_Start_1, param1, getValueSize(M_ASG_78_1_0_25_Start_1));

}

// Updates the bus value field and other dependencies.
M_ASG_78_1_0_25_Start_BuildFct()
{
	byte param1[700]; // VTANDataEncrypted
	word len1;
	byte cnt1;

	int i;
	byte superval[700];
	int currentPos;
	currentPos = 0;
// gen_BuildFunc_SetSuperVals 
	getValue(M_ASG_78_1_0_25_Start_1, param1);
	len1 = getValue(M_ASG_78_1_0_25_Start_1_len);
	cnt1= getValue(M_ASG_78_1_0_25_Start_1_cnt);
	
	/* check box aktiviert*/
	if (cnt1 == 1)
	{
		/* 0 bis 698 (MaxString - 1B oder 2B) */
		if(len1 >= 0 && len1 <= 698)
		{
			//writelineEx(gBAP_Trace, 0, "[Debug-1] Len1: %d", len1);
			superval[currentPos] = (len1&0x7f00) | 0x80;
			superval[currentPos+1] = len1 & 0x00ff;
		}
		else
		{
			writelineEx(gBAP_Trace, 0, "Eingegebene Laenge: %d von M_ASG_78_1_0_25_Start_1 ist ungueltig. Die max. erlaubte Laenge ist %d.", len1, 698);
			return;
		}
	}
	else if(cnt1 == 0) /*check box deaktiviert*/
	{
		if(len1 >= 0 && len1 <= 127)
		{
			//writelineEx(gBAP_Trace, 0, "[Debug-1] Len1: %d", len1);
			superval[currentPos]= len1 & 0x00ff;
			putValue(M_ASG_78_1_0_25_Start_1_len, len1);
		}
		else if(len1 > 127 && len1 <= 698)
		{
			superval[currentPos] = (len1&0x7f00) | 0x80;
			superval[currentPos+1] = len1 & 0x00ff;
			putValue(M_ASG_78_1_0_25_Start_1_len, len1);
			putValue(M_ASG_78_1_0_25_Start_1_cnt, 1);
		}
		else
		{
			writelineEx(gBAP_Trace, 0, "Eingegebene Laenge: %d von M_ASG_78_1_0_25_Start_1 ist ungueltig. Die max. erlaubte Laenge ist %d.", len1, 698);
			return;
		}
	}
	currentPos += cnt1+1;
	for(i = 0; i < len1; i++)
	{
		superval[currentPos++]= param1[i];
	}

	putValue(M_ASG_78_1_0_25_Start, superval, currentPos);
}

// Ueberwachung der CheckBox fuer String
on envVar  M_ASG_78_1_0_25_Start_1_cnt
{
	word len;
	byte cnt;
	len = getValue(M_ASG_78_1_0_25_Start_1_len);
	cnt = getValue(M_ASG_78_1_0_25_Start_1_cnt);

	/* wird nur gerufen, wenn check box deaktiviert mit Length>127*/ 
	if( cnt == 0) 
	{
		if(len > 127 )
		{
			putValue(M_ASG_78_1_0_25_Start_1_len, 127);
		}
	}

	M_ASG_78_1_0_25_Start_BuildFct();
}

// Ueberwachung der Eingabefeld fuer String Data
on envVar M_ASG_78_1_0_25_Start_1_len
{
	word len;
	len = getValue(this);
	/* Validierung der Eingabe*/
	if(len > 698)
	{
		writelineEx(gBAP_Trace, 0, "Eingegebene Laenge: %d von M_ASG_78_1_0_25_Start_1 ist ungueltig. Die max. erlaubte Laenge ist %d. ", len, 698);
		putValue(this, 698);
	}
	M_ASG_78_1_0_25_Start_BuildFct();
}

on envVar M_ASG_78_1_0_25_Start_1 // VTANDecryption.VTANDataEncrypted
{
	putValue(M_ASG_78_1_0_25_Start_1_len, getValueSize(this));
	M_ASG_78_1_0_25_Start_BuildFct();
}

/**
*
* Template-Funktion zum automatischen befuellen der Array-Daten, die in einer Arrayfunktion genutzt werden.
* Die Funktion wird durch den von BAPSimGen generierten Code aufgerufen.
*
* Parameter:
* - structArray: Muss mindestens nMax * Arraygroesse Bytes Platz haben, wird vom BAPSimGen automatisch generiert
* - structElementsSizeArray: Enthaelt die Groesseangabe jedes Array-Elements. Die Arraygroesse entspricht der Elementanzahl im Array.
*       Byte & Nibble = 1; Word = 2; usw. Bei Strings wird die maximale Stringlaenge angegeben.
* - structElementsTypeArray: Gibt den Datentyp eines Array-Elements zurueck. Die Arraygroesse entspricht der Elmentanzahl im Array.
*                               0x0 = Zahlenwert, also ein Slider, Enum, Bitfield,...
*                               0xE = String (darauf folgt immer eine 2, mit der Angabe der benutzen Bytes im String)
*                               0xF = Laenge der Nutzdaten des Strings, nur return Wert
* - fctID: Kann zur Fallunterscheidung der Funktions-IDs verwendet werden.
* - nMax: Array-Index
*
* Die Funktion kann im Switch-Case beliebig erweitert werden. Der Switch-Case wertet den Parameter fctID aus.
*           
*                    
**/
initStruct(byte structArray[], dword structElementsSizeArray[], byte structElementsTypeArray[], dword structElementsMaxSizeArray[], word fctID, word nMax )
{
    byte rand8;
    word rand16;
    word randSize;
    word index;           //indexNr die an die String Parameter angehaengt wird.
    dword destArraySize;   //groesse von structArray
    dword destStructSize;  //groesse eines "Structs" also destArraySize / Anzahl Elemente (nMax))
    dword rand32;    
    dword i;
    dword pos;    //aktuelle Position im structArray
    dword elpos;  //aktuelle Position in den structElementsXXXArray's
    
    destArraySize = elCount(structArray);
    destStructSize = destArraySize / nMax;    

    Switch(fctID){

        //Idee ist, die Arrays je nach Funcion-ID speziell initalisieren zu koennen.
        //hierbei koennten die Daten z.B. aus einer Datei eingelesen werden,
        //oder auch ueber spezielle init Funktionen mit festen Werten initialisiert werden.
        //Der Default-Fall befuellt das Array mit Random-Werten und Strings mit einem vordefinierten Wort (hier test,)

        default :
        {
            pos = 0; 
            for(i = 1; i <= nMax; i++)
            {
                //walk through the array
                
                elpos = 0;
                while(pos < (destStructSize * i) )
                {   
                    //check Element type
                    if( structElementsTypeArray[elpos] == 0x0)          
                    { //Params like int, word, etc.
                        //check element length
                        Switch(structElementsSizeArray[elpos])
                        {
                            case(1) : //byte / nibble
                                rand8 = random(structElementsMaxSizeArray[elpos]);
                                structArray[pos] = rand8;
                                pos++;
                                break;

                            case(2) : //word / int
                                rand16 = random(structElementsMaxSizeArray[elpos]);
                                int2byte(structArray, pos, rand16);
                                pos += 2;
                                break;

                            case (4) : //dword / long
                                rand32 = random(structElementsMaxSizeArray[elpos]);
                                long2byte(structArray, pos, rand32);
                                pos += 4;
                                break;                        
                         }
                    }
                    else if(structElementsTypeArray[elpos] == 0xE)          
                    { //String Params like byte[]
                        randSize = random(structElementsSizeArray[elpos]);
                        if(randSize < 2) randSize = 2; 
                        index = i-1;
                        setRandomString(structArray ,pos ,structElementsSizeArray[elpos], randSize, index);
                        pos += structElementsSizeArray[elpos];
                    }
                    else if(structElementsTypeArray[elpos] == 0xF)          
                    {
                        int2byte(structArray, pos, randSize);
                        pos += 2;
                        //write("Pos: %d Strlth: %d Type: %d ",pos-1,randSize,structElementsTypeArray[elpos]);
                    
                    }
                    elpos++;
                }
            }   
        break;
        }            
    }
}

long2Byte(byte in[], dword pos, dword value)
{
    if( (elCount(in)-pos) < 4)
        write("Array out ouf bounds - too small!");
    in[pos] = value;
    in[++pos] = (value >> 8);
    in[++pos] = (value >> 16);
    in[++pos] = (value >> 24);
}

int2byte (byte in[],dword pos,word value)
{
    if( (elCount(in)-pos) < 2 )
        write("Array out of bounds - too small!");
    in[pos] = value;
    in[++pos] = (value >> 8);        
}

setRandomString (byte in[], dword pos, word strSize, word randSize, word count)
{
    word endPos, endString, j;
    byte testString[4]={'t','e','s','t'};
    
    endPos = pos + strSize;
    endString = pos + randSize;
    j=0;
    
    int2ascii(in, pos, count);
    pos += 2;
    
    for(pos; pos < endPos ;pos ++)
    {
        if(j > 3 )
            j = 0;
        if(pos < endString)
            in[pos] = testString[j++];
        else
            in[pos] = 0x0;
    }
}

int2ascii (byte in[], dword pos, word value)
{
    //Konvertiert nur die erste und zweite Dezimalstelle, also Zahlen zw. 0 und 99.
    
    //auf 2 Stellen kuerzen
    value = value%100;
    //10er schreiben
    in[pos] = (value/10) + 48;    //  0x30 hex = 48 dez = ascii null
    //1er schreiben
    in[pos+1] = (value%10) + 48;  //  0x30 hex = 48 dez = ascii null
}

