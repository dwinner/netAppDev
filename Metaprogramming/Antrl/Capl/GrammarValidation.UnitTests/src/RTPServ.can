/*@!Encoding:1252*/
variables
{
  //
  // Constants
  //
  
  const dword kMediaStreamIndex    = 0xFFFFFFFC; /* The first video stream*/
  const long  kBufferSize          = 32*1024;
  const long  kBufferCount         = 2;
  const word  kStreamUniqueId      = 0x0001;
  const word  kRTPPort             = 42800;
  const word  kRTPSrcPort          = 42993;
  //
  // Global variables
  //
  
  dword   gMediaReaderHandle; // Handle for the media-reader, which reads the media file
  dword   gTalkerHandle;      // Handle of the AVB talker, which sends the AVB stream
  
  byte    gReadBuffer[kBufferCount][kBufferSize]; // Two buffers, which are toggled between
                                                  // reading data from the media-reader and
                                                  // sending the AVB stream with the talker
  byte    gReadBufferSendingIndex = 0;            // Index of buffer which is just send
  
  word    gPlayingLoop;        // Flag for loop the file replay
  char    gMediaFilename[256]; // Filename of the file to replay
  dword   gMediaIsVideo = 0;
}

on start
{
    AvbSetVerbosity( 0 /* silent */ );
   
    PtpSetProperty( "PortRole", @sysvar::CAMF::PtpRole );  // Set PTP port role
     
    if (@sysvar::CAMF::StreamActive) // Start AVB stream
        TalkerOpen();

    gPlayingLoop = @sysvar::CAMF::PlayingLoop;
}

on preStop
{
    TalkerClose();
}

on sysvar sysvar::CAMF::PtpRole
{
    PtpSetProperty( "PortRole", @this );  // Set PTP port role
}

on sysvar sysvar::CAMF::StreamActive
{
    switch(@this)
    {
        case 0: TalkerClose();
                enableControl( "CAMF", "PlayButton", 0 );
                break;
        case 1: TalkerOpen();
                enableControl( "CAMF", "PlayButton", 1 );
                break;
    }
}

on sysvar sysvar::CAMF::PlayingLoop
{
    gPlayingLoop = @this;
}

on sysvar_update sysvar::CAMF::StartPlaying
{
    if (@this == 1)
    {
        TalkerLoadFile( gMediaFilename );
    }
}

on sysvar_update sysvar::CAMF::Filename
{
    sysGetVariableString( this, gMediaFilename, elcount(gMediaFilename) );
}

/// <Talker>
void TalkerOpen()
{
    dword result;
    dword mediaTypeHandle;
    byte  remoteAddress[16];
  
    if( gTalkerHandle )
    {
        return; // talker already opened
    }

    result = AvbSetProperty( "StreamReservation", 0 ); // disable StreamReservation
  
    if( result != 0 )
    {
        write( "<%BASE_FILE_NAME%> AvbSetProperty(StreamReservation) failed, result %d", AvbGetLastError() );
        return;
    }

    //---------------------- Create Talker ------------------------------//

    gTalkerHandle = AvbOpenTalker( kStreamUniqueId );
  
    if (gTalkerHandle == 0)
    {
        write( "<%BASE_FILE_NAME%> AvbOpenTalker failed, result %d", AvbGetLastError() );
        return;
    }
    result = AvbSetProperty( gTalkerHandle, "RtpPort", kRTPSrcPort ); // set RTP port 
  
    if (result != 0)
    {
        write( "<%BASE_FILE_NAME%> AvbSetProperty( 'RtpPort' ) failed", AvbGetLastError() );
        return;
    }
  
    //---------------------- Load file to replay ------------------------------//

    if (sysGetVariableString( sysvar::CAMF::Filename, gMediaFilename, elcount(gMediaFilename)) != 0)
    {
        write( "<%BASE_FILE_NAME%> sysGetVariableString failed" );
        return;
    }
    TalkerLoadFile( gMediaFilename );

    //---------------------- Get and set media type ------------------------------//
  
  // get media type of first video stream in file
  mediaTypeHandle = MediaGetMediaType( gMediaReaderHandle, kMediaStreamIndex );
  
   write("<%BASE_FILE_NAME%> mediaTypeHandle = %d ",mediaTypeHandle);
  
  if (result != 0)
  {
    write( "<%BASE_FILE_NAME%> MediaGetMediaType failed, result %d", MediaGetLastError() );    
    return;
  }
  
  // check, if it is audio or video
  {
    char majorType[20];
    
    gMediaIsVideo = 0;
    if (MediaGetProperty( mediaTypeHandle, "MajorType", elcount(majorType), majorType ) == 0)
    {
      gMediaIsVideo = (strncmp( majorType, "MediaType_Video", elcount(majorType)) == 0) ? 1 : 0;
    }
  }
  
  // write information about the media file to the panel
  DumpFormatInfo( mediaTypeHandle );
  
  // set the media type of the AVB talker stream to the
  // format setting of the media file.
  result = AvbSetMediaType( gTalkerHandle, mediaTypeHandle );
  
  if (result != 0)
  {
    write( "<%BASE_FILE_NAME%> AvbSetMediaType failed, result %d", AvbGetLastError() );
    return;
  }
    
  // release media type handle
  result = MediaReleaseMediaType( mediaTypeHandle );    
      
  if (result != 0)
  {
    write( "<%BASE_FILE_NAME%> MediaReleaseMediaType failed, result %d", MediaGetLastError() );
    return;
  }

    //---------------------- Start sending stream
  //
  
  //ipGetAddressAsArray( "FC00::0003:0003", remoteAddress );
 // ipGetAddressAsArray( "FF00::0001", remoteAddress );
 ipGetAddressAsArray( "ff14::2:4", remoteAddress );
  
//ipGetAddressAsArray( "fd53:7cb8:383:5::15", remoteAddress );
  
  result = AvbConnect( gTalkerHandle, remoteAddress, kRTPPort, "OnTalkerConnect" );

  if (result != 0 && result != 460609)
  {
    write( "<%BASE_FILE_NAME%> AvbConnect failed, result %d", AvbGetLastError() );
    return;
  }
  
  if (result != 460609)
  {
    // if result ist not operation-pending, we call OnTalkerConnect directly
    // to start sedning the AVB stream.
    OnTalkerConnect(gTalkerHandle, 0);
  }
}

/// <Talker>
void TalkerClose()
{
  dword result;
    
  //----------------------
  // Stop media-reader and release it
  //

  TalkerStopPlaying();

  //----------------------
  // Close AVB talker
  //
  
  if (gTalkerHandle)
  {
    result = AvbCloseTalker( gTalkerHandle );

    if (result != 0)
    {
      write( "<%BASE_FILE_NAME%> AvbCloseTalker failed, result %d", AvbGetLastError() );
      return;
    }
    
    gTalkerHandle = 0;
  }
}

/// <Talker>
void TalkerLoadFile( char filename[] )
{
  if (!gTalkerHandle)
  {
    return;
  }
  
  // Release previously loaded file
  if (gMediaReaderHandle)
  {
    TalkerStopPlaying();
  }
  
  //----------------------
  // Load file
  //
  
  gMediaReaderHandle = MediaCreateSourceReaderFromURL( filename );
  
  if (gMediaReaderHandle == 0)
  {
    write( "<%BASE_FILE_NAME%> MediaCreateSourceReaderFromURL failed, result %d", MediaGetLastError() );
    return;
  }
}

/// <Talker>
void TalkerStopPlaying()
{
  dword result;
  
  if (gMediaReaderHandle)
  {
    // release media source reader
    result = MediaReleaseSourceReader( gMediaReaderHandle );

    if (result != 0)
    {
      write( "<%BASE_FILE_NAME%> MediaReleaseSourceReader failed, result", MediaGetLastError() );
      return;
    }

    gMediaReaderHandle = 0;
  }
}

/// <Talker_Callbacks>
void OnTalkerConnect(dword talkerHandle, dword result)
{
  if (result != 0)
  {
    write( "<%BASE_FILE_NAME%> OnTalkerConnect returned an error, result %d", result );
    return;
  }
  
  TalkerMediaRead( gReadBuffer[0] );
  TalkerMediaRead( gReadBuffer[1] );
}

/// <Talker_Callbacks>
void OnTalkerSend(dword talkerHandle, long _result, byte buffer[], dword length)
{
  // toggle current active send buffer
  gReadBufferSendingIndex = !gReadBufferSendingIndex;
  
  if (gMediaReaderHandle)
  {
    // if a media-reader is available, read more data.
    TalkerMediaRead( buffer );
  }
  else
  {
    // if no media-reader is available, repeat sending the (empty) buffer.
    TalkerSend( gReadBuffer[gReadBufferSendingIndex], (gMediaIsVideo) ? 0 : kBufferSize );
  }
}

/// <Talker_Callbacks>
void OnReadComplete( dword readerHandle, long result, dword streamIndex, dword streamFlags, int64 timestamp, byte buffer[], dword length )
{
  if (result == 0)
  {
    // end of stream is reached, if stream-flag 2 is set
    switch(streamFlags)
    {
      case 0x00000001: // SOURCE_READERF_ERROR
        break;
      case 0x00000002: //SOURCE_READERF_ENDOFSTREAM
        {
          if (gPlayingLoop)
          {
            byte endStreamCount = 0;
            
            // because, we have 2 buffers for reading, stream-flag end-of-stream (2)
            // occurs twice. Only with the second call, we have to stop or restart.
            endStreamCount += 1;

            if (endStreamCount > 1)
            {
              endStreamCount = 0;
             
              // restart file
              TalkerLoadFile( gMediaFilename );
            }
          }
          else
          {
            // stop playing. AVB stream will be continued to send, but with empty data.
            TalkerStopPlaying();
            
            // send buffer with silence
            TalkerResetTxBuffer( !gReadBufferSendingIndex );
          }

          TalkerSend(buffer, length);
        }
        break;
      case 0x00000004: // SOURCE_READERF_NEWSTREAM
      case 0x00000010: // SOURCE_READERF_NATIVEMEDIATYPECHANGED
      case 0x00000020: // SOURCE_READERF_CURRENTMEDIATYPECHANGED
      case 0x00000100: // MF_SOURCE_READERF_STREAMTICK
      case 0x00000200: // SOURCE_READERF_ALLEFFECTSREMOVED
        break;
      default:
        TalkerSend(buffer, length);
        break;
    }
  }
}

/// <Talker_Helper>
void TalkerMediaRead(byte buffer[])
{  
  if (gMediaReaderHandle)
  {
    dword result;
    
    result = MediaRead( gMediaReaderHandle, kMediaStreamIndex, buffer, kBufferSize, "OnReadComplete" );

    if (result != 0)
    {
      write( "<%BASE_FILE_NAME%> MediaRead failed, result %d", result );
    }
  }
}

/// <Talker_Helper>
void TalkerSend(byte buffer[], dword length)
{  
    dword result;

    result = AvbSend(gTalkerHandle, buffer, length, "OnTalkerSend");
    
    if ((result != 0) && (result != 460609/* pending*/))
    {
        write( "<%BASE_FILE_NAME%> AvbSend failed, result %d %d", AvbGetLastError(), length );
    }
    else if (result != 460609)
    {
        // if result is not operation-pending, we call OnTalkerSend directly
        OnTalkerSend( gTalkerHandle, 0, buffer, length );
    }
}

/// <Talker_Helper>
void TalkerResetTxBuffer( word bufferIndex )
{
    dword i;
  
    for( i = 0; i < kBufferSize; i++ )
    {
        gReadBuffer[bufferIndex][i] = 0;
    }
}

/// <Talker_Helper>
void DumpFormatInfo( dword handle )
{
    char  propNamesStr[2][100] = { "MajorType", "Subtype" };
    char  propNames[4][100]    = { "AvgBitrate", "Mpeg2Level", "Mpeg2Profile", "InterlaceMode" };
    dword propVal;
    char  propString[100];
    char  buffer[100];
    dword i;

    for( i = 0; i < elcount(propNamesStr); i++ ) // String properties
    {
        if (MediaGetProperty( handle, propNamesStr[i], elcount(propString), propString ) == 0)
        {
            snprintf( buffer, elcount(buffer), "%s = %s\n", propNamesStr[i], propString );
            putValueToControl( "Head Unit", "CAPLOutputView", buffer);
        }
    }
    for( i = 0; i < elcount(propNames); i++ ) // Integer properties
    {
        if (MediaGetProperty( handle, propNames[i], propVal ) == 0)
        {
            snprintf( buffer, elcount(buffer), "%s = %d\n", propNames[i], propVal );
            putValueToControl( "Head Unit", "CAPLOutputView", buffer);
        }
    }
}