/*@!Encoding:1252*/
includes
{
    #include "messages\message_Klima_03.cin"
    #include "messages\message_Klima_06.cin"
    #include "messages\message_Klima_12.cin"
    #include "messages\message_Klima_16.cin"
    
    #include "messages\message_Thermo_Verbrauch_01.cin"
}

variables
{
/*
Copyright ( C ) Continental AG 2019



Date of creation :  20.04.2019

Created by :                 Hans Jürgen Hipp


Version info

1.0        03.2018      Inital version
// #VERSION#
// #VERSION_END#
*/


    const TRUE    = 0xAA;
    const FALSE   = 0x00;
    const cManual = 0x00;
    const cAuto   = 0xAA;

    msTimer t_DBKomTimer_20ms;      // Timer zum zyklischen Aufruf der DBKom-Task
    int c_tDBKomTimer_20ms = 20;    // msec
    msTimer t_DBKomTimer_5ms;       // Timer zum zyklischen Aufruf der DBKom-Task
    int c_tDBKomTimer_5ms = 5;      // msec


    // BA_DEF_ BO_  "GenMsgSendType" ENUM
    //  0 : cyclicX
    //  1 : none
    //  2 : none
    //  3 : none
    //  4 : none
    //  5 : none
    //  6 : none
    //  7 : IfActive
    //  8 : NoMsgSendType
    //  9 : cyclicAndSpontanWithDelay
    //  10 : none

// #VAR_DEF#

//  message   Klemmen_Status_01  ID: 960 --- Sendeart 0 cyclicX --- 
/*    message   Klemmen_Status_01 _mKlemmen_Status_01;
    int      _Klemmen_Status_01_Timebase;
    int      _Klemmen_Status_01_CycleCount;
    int      _Klemmen_Status_01_StartDelay;
    int      _Klemmen_Status_01_MinDelay;
    int      _Klemmen_Status_01_Cnt;
    int      _Klemmen_Status_01_SpontanFlag;
    int      _Klemmen_Status_01_DelayCnt;

    byte     _Klemmen_Status_01_E2E_Armed;
    byte     _Klemmen_Status_01_CRC_ErrorCnt;
    byte     _Klemmen_Status_01_SQC_TriggPos;
    int      _Klemmen_Status_01_SQC_WrongSeqJump;
    byte     _Klemmen_Status_01_SQC_RepeatedCnt;
    byte     _Klemmen_Status_01_MSG_DropCnt;
    byte     _Klemmen_Status_01_CRC_Offset[16] = { 0xC3, 0xC3, 0xC3, 0xC3, 0xC3, 0xC3, 0xC3, 0xC3, 0xC3, 0xC3, 0xC3, 0xC3, 0xC3, 0xC3, 0xC3, 0xC3 };
    byte     _Klemmen_Status_01_DLC;
    msTimer _tKlemmen_Status_01;*/
/*
BO_ 2617128449 CCP_Klima_DTO_01: 8 Klima
 SG_ CCP_Klima_DTO_01_Data : 0|64@1+ (1,0) [0|0] ""  Vector__XXX

BO_ 1646 Klima_03: 8 Klima   -- > message_Klima_03.cin

BO_ 1649 Klima_06: 8 Klima
 SG_ KL_Betriebsmodus_FH : 29|3@1+ (1,0) [0|7] ""  Gateway
 SG_ KL_STH_Betriebsdauer_lang : 43|7@1+ (1,0) [0|127] "Unit_Minut"  Gateway
 SG_ KL_Stopp_Wiederstart_Anz_01 : 32|1@1+ (1,0) [0|1] ""  Gateway
 SG_ KL_Stopp_Wiederstart_Anz_02 : 33|1@1+ (1,0) [0|1] ""  Gateway
 SG_ KL_Stopp_Wiederstart_Anz_03 : 34|1@1+ (1,0) [0|1] ""  Gateway
 SG_ KL_Stopp_Wiederstart_Anz_04 : 35|1@1+ (1,0) [0|1] ""  Gateway
 SG_ KL_Stopp_Wiederstart_Anz_05 : 36|1@1+ (1,0) [0|1] ""  Gateway
 SG_ KL_Stopp_Wiederstart_Anz_06 : 37|1@1+ (1,0) [0|1] ""  Gateway
 SG_ KL_Stopp_Wiederstart_Anz_07 : 38|1@1+ (1,0) [0|1] ""  Gateway
 SG_ KL_Stopp_Wiederstart_Anz_08 : 39|1@1+ (1,0) [0|1] ""  Gateway
 SG_ KL_Stopp_Wiederstart_Anz_09 : 40|1@1+ (1,0) [0|1] ""  Gateway
 SG_ KL_Stopp_Wiederstart_Anz_Std1 : 41|1@1+ (1,0) [0|1] ""  Gateway
 SG_ KL_Stopp_Wiederstart_Anz_Std2 : 42|1@1+ (1,0) [0|1] ""  Gateway
 SG_ KL_ZZ_Betriebsmodus : 21|3@1+ (1,0) [0|7] ""  Gateway
 SG_ KL_ZZ_Minute : 0|6@1+ (1,0) [0|59] "Unit_Minut"  Gateway
 SG_ KL_ZZ_Monat : 8|4@1+ (1,0) [1|12] "Unit_Month"  Gateway
 SG_ KL_ZZ_Status_Timer : 6|2@1+ (1,0) [0|3] ""  Gateway
 SG_ KL_ZZ_Stunde : 16|5@1+ (1,0) [0|23] "Unit_Hours"  Gateway
 SG_ KL_ZZ_Tag : 24|5@1+ (1,0) [1|31] "Unit_Day"  Gateway

BO_ 949 Klima_11: 8 Klima
 SG_ KL_AC_Schalter : 2|1@1+ (1,0) [0|1] ""  Gateway
 SG_ KL_Anf_KL : 40|8@1+ (0.4,0) [0|102] "Unit_PerCent"  Gateway
 SG_ KL_Ausstattung_Klima : 51|3@1+ (1,0) [0|7] ""  Gateway
 SG_ KL_Charisma_FahrPr : 16|4@1+ (1,0) [0|15] ""  Gateway
 SG_ KL_Charisma_Status : 20|2@1+ (1,0) [0|3] ""  Gateway
 SG_ KL_Drehz_Anh : 0|1@1+ (1,0) [0|1] ""  Gateway
 SG_ KL_el_Zuheizer_Stufe : 48|3@1+ (1,0) [0|7] ""  Gateway
 SG_ KL_Freilauf_Info : 38|2@1+ (1,0) [0|3] ""  Gateway
 SG_ KL_Komp_Moment_alt : 3|1@1+ (1,0) [0|1] ""  Gateway
 SG_ KL_Kompressorkupplung_linear : 8|8@1+ (20,0) [0|4000] "Unit_MilliAmper"  Gateway
 SG_ KL_Last_Kompr : 24|8@1+ (0.25,0) [0|63.5] "Unit_NewtoMeter"  Gateway,KFG
 SG_ KL_nachtr_Stopp_Anf : 22|1@1+ (1,0) [0|1] ""  Gateway
 SG_ KL_Spannungs_Anf : 32|2@1+ (1,0) [0|3] ""  Gateway
 SG_ KL_StartStopp_Info : 36|2@1+ (1,0) [0|3] ""  Gateway
 SG_ KL_T_Charge : 23|1@1+ (1,0) [0|1] ""  Gateway
 SG_ KL_Thermomanagement : 34|2@1+ (1,0) [0|3] ""  Gateway
 SG_ KL_Variante_Standheizung : 54|2@1+ (1,0) [0|3] ""  Gateway,KFG
 SG_ KL_Vorwarn_Komp_ein : 1|1@1+ (1,0) [0|1] ""  Gateway
 SG_ KL_Vorwarn_Zuheizer_ein : 6|1@1+ (1,0) [0|1] ""  Gateway
 SG_ KL_Zustand : 7|1@1+ (1,0) [0|1] ""  Gateway,KFG

BO_ 1640 Klima_12: 8 Klima
 SG_ FSH_Taster : 5|1@1+ (1,0) [0|1] ""  Gateway
 SG_ HSH_Taster : 3|2@1+ (1,0) [0|3] ""  Gateway
 SG_ KL_Beschlagsgefahr : 7|1@1+ (1,0) [0|1] ""  Gateway
 SG_ KL_Geblspng_Fond_Soll : 32|8@1+ (0.05,1.45) [1.5|14] "Unit_Volt"  BCM,Gateway,HDSG,STSG_HBFS,STSG_HFS
 SG_ KL_Geblspng_Soll : 24|8@1+ (0.05,1.45) [1.5|14] "Unit_Volt"  BCM,Gateway,HDSG,STSG_HBFS,STSG_HFS
 SG_ KL_I_Geblaese : 40|8@1+ (0.25,0) [0|63.5] "Unit_Amper"  Gateway
 SG_ KL_Kompressorstrom_soll : 48|10@1+ (1,0) [0|1021] ""  Gateway
 SG_ KL_LRH_Stufe : 1|2@1+ (1,0) [0|3] ""  BCM,Gateway,Kombi
 SG_ KL_LRH_Taster : 0|1@1+ (1,0) [0|1] ""  BCM,Gateway
 SG_ KL_PTC_Verbauinfo : 62|2@1+ (1,0) [0|3] ""  Gateway
 SG_ KL_SIH_Soll_li : 8|3@1+ (1,0) [0|7] ""  Gateway
 SG_ KL_SIH_Soll_re : 11|3@1+ (1,0) [0|7] ""  Gateway
 SG_ KL_SIL_Soll_li : 16|3@1+ (1,0) [0|7] ""  BCM,Gateway,KFG
 SG_ KL_SIL_Soll_re : 19|3@1+ (1,0) [0|7] ""  BCM,Gateway
 SG_ KL_Umluftklappe_Status : 58|4@1+ (1,0) [0|15] ""  Gateway,HDSG,KFG
 SG_ KL_Zuheizer_Freigabe : 6|1@1+ (1,0) [0|1] ""  Gateway
 SG_ KRH_Soll_li : 14|2@1+ (1,0) [0|3] ""  BCM,Gateway
 SG_ KRH_Soll_re : 22|2@1+ (1,0) [0|3] ""  BCM,Gateway

BO_ 2527679635 Klima_16: 8 Klima
 SG_ FSH_Status : 28|2@1+ (1,0) [0|3] ""  Gateway,KFG
 SG_ HSH_Relais_Anf : 27|1@1+ (1,0) [0|1] ""  BCM,Gateway
 SG_ KL_AL_HL_Anf : 18|2@1+ (1,0) [0|3] ""  BCM,Gateway
 SG_ KL_AL_HR_Anf : 16|2@1+ (1,0) [0|3] ""  BCM,Gateway
 SG_ KL_AL_VL_Anf : 14|2@1+ (1,0) [0|3] ""  BCM,Gateway
 SG_ KL_AL_VR_Anf : 12|2@1+ (1,0) [0|3] ""  BCM,Gateway
 SG_ KL_Defrost_LED : 25|1@1+ (1,0) [0|1] ""  BCM,Gateway
 SG_ KL_FSH_LED : 36|1@1+ (1,0) [0|1] ""  BCM,Gateway
 SG_ KL_FSH_Soll : 21|1@1+ (1,0) [0|1] ""  Gateway
 SG_ KL_Heizstufe_LSH : 45|4@1+ (1,0) [0|15] ""  Gateway
 SG_ KL_HSH_LED : 26|1@1+ (1,0) [0|1] ""  BCM,Gateway
 SG_ KL_HSH_Soll : 20|1@1+ (1,0) [0|1] ""  Gateway
 SG_ KL_HUP_aktiv : 37|1@1+ (1,0) [0|1] ""  Gateway
 SG_ KL_Klappe_Status : 40|3@1+ (1,0) [0|7] ""  Gateway
 SG_ KL_LSH_Ansteuerung : 43|2@1+ (1,0) [0|3] ""  Gateway
 SG_ KL_LSH_Betriebsdauer : 49|7@1+ (1,0) [0|120] "Unit_Minut"  Gateway
 SG_ KL_LSH_DBetr_Bestaet : 39|1@1+ (1,0) [0|1] ""  Gateway
 SG_ KL_LSH_DBetr_Ein : 38|1@1+ (1,0) [0|1] ""  Gateway
 SG_ KL_Temp_ZH_Soll : 56|8@1+ (0.5,0) [0.5|127.5] "Unit_DegreCelsi"  Gateway
 SG_ KL_VoKo_LED : 24|1@1+ (1,0) [0|1] ""  BCM,Gateway,Kombi
 SG_ KL_ZR_Anforderung : 22|2@1+ (1,0) [0|3] ""  Gateway
 SG_ SIH_Stufe_LED_li : 30|3@1+ (1,0) [0|7] ""  Gateway
 SG_ SIH_Stufe_LED_re : 33|3@1+ (1,0) [0|7] ""  Gateway

BO_ 1511 Klima_EV_03: 8 Klima
 SG_ KL_BattKond_WaPu_DZMax : 34|6@1+ (2,0) [0|126] "Unit_PerCent"  Gateway
 SG_ KL_EKK_Strom : 8|8@1+ (0.25,0) [0|63.75] "Unit_Amper"  Gateway
 SG_ KL_Fehler_HV_EKK : 30|2@1+ (1,0) [0|3] ""  Gateway
 SG_ KL_Fehler_HV_Heizer : 32|2@1+ (1,0) [0|3] ""  Gateway
 SG_ KL_HV_Heizer_Strom : 0|8@1+ (0.25,0) [0|63.75] "Unit_Amper"  Gateway
 SG_ KL_KM_ASV_01_Status : 48|2@1+ (1,0) [0|3] ""  Gateway
 SG_ KL_KM_ASV_02_Status : 50|2@1+ (1,0) [0|3] ""  Gateway
 SG_ KL_Pumpe_02_Soll : 16|7@1+ (1,0) [0|127] "Unit_PerCent"  Gateway
 SG_ KL_Senderkennung : 27|1@1+ (1,0) [0|1] ""  Gateway
 SG_ KL_Ventil_03_Soll : 23|1@1+ (1,0) [0|1] ""  Gateway
 SG_ KL_Ventil_10_Status : 24|3@1+ (1,0) [0|7] ""  Gateway
 SG_ KL_Vorwarn_HVHeizer_Leistung : 52|4@1+ (1,0) [0|15] ""  Gateway
 SG_ WP_KJ_Soll : 28|2@1+ (1,0) [0|3] ""  Gateway
 SG_ WP_Kuehlerluefter_Anf : 40|8@1+ (0.4,0) [0|102] "Unit_PerCent"  Gateway

BO_ 1514 Klima_EV_04: 8 Klima
 SG_ KBT_Defrost_aktiv : 33|1@1+ (1,0) [0|1] ""  Gateway
 SG_ KL_Fehler_NTKreis : 7|1@1+ (1,0) [0|1] ""  Gateway
 SG_ KL_Heizbedarf : 40|10@1+ (0.1,0) [0|102.3] "Unit_DegreCelsi"  Gateway
 SG_ KL_Innentemp_KBT_Sensor : 50|10@1+ (0.1,-40) [-40|62.3] "Unit_DegreCelsi"  Gateway
 SG_ KL_KLE_Fehler_Anf : 6|1@1+ (1,0) [0|1] ""  Gateway
 SG_ KL_Kundenwunsch_Kuehlen : 4|1@1+ (1,0) [0|1] ""  Gateway
 SG_ KL_Mot_Tk_Soll_li : 8|8@1+ (0.5,0) [0|127.5] "Unit_PerCent"  Gateway
 SG_ KL_Mot_Tk_Soll_re : 16|8@1+ (0.5,0) [0|127.5] "Unit_PerCent"  Gateway
 SG_ KL_OBD_Status : 5|1@1+ (1,0) [0|1] ""  Gateway
 SG_ KL_Standklima_RemoteModus : 30|3@1+ (1,0) [0|7] ""  Gateway
 SG_ KL_Standklima_Status_02 : 27|3@1+ (1,0) [0|7] ""  Gateway
 SG_ KL_VK_Anf : 24|3@1+ (1,0) [0|7] ""  Gateway
 SG_ KL_VK_Betriebsdauer : 34|6@1+ (1,0) [0|63] "Unit_Minut"  Gateway
 SG_ KL_Vorkond_Strategie : 60|4@1+ (1,0) [0|15] ""  Gateway

BO_ 1515 Klima_EV_05: 8 Klima
 SG_ KL_Abl_Ist_li : 24|10@1+ (0.1,-20) [-20|82] "Unit_DegreCelsi"  Vector__XXX
 SG_ KL_Abl_Ist_re : 34|10@1+ (0.1,-20) [-20|82] "Unit_DegreCelsi"  Vector__XXX
 SG_ KL_Abl_Soll_li : 0|8@1+ (0.5,0) [0|86] "Unit_DegreCelsi"  Vector__XXX
 SG_ KL_Abl_Soll_re : 8|8@1+ (0.5,0) [0|86] "Unit_DegreCelsi"  Vector__XXX
 SG_ KL_TaupEps_Korr : 54|10@1+ (0.1,-50) [-50|52] "Unit_DegreCelsi"  Vector__XXX
 SG_ KL_Verdampfer_Ist : 44|10@1+ (0.1,-40) [-40|62] "Unit_DegreCelsi"  Vector__XXX
 SG_ KL_Verdampfer_Soll : 16|8@1+ (0.5,-40) [-40|87.5] "Unit_DegreCelsi"  Vector__XXX

BO_ 2589283627 Klima_EV_06: 8 Klima
 SG_ KL_Heizen_Status : 24|4@1+ (1,0) [0|15] ""  Gateway
 SG_ KL_HV_Energie_Anf : 40|8@1+ (50,0) [0|12750] "Unit_WattHour"  Gateway
 SG_ KL_IstLeistung : 50|8@1+ (50,0) [0|12750] "Unit_Watt"  Gateway
 SG_ KL_K_Status : 28|4@1+ (1,0) [0|15] ""  Gateway
 SG_ Kl_Klima_Aktiv : 35|1@1+ (1,0) [0|1] ""  Gateway
 SG_ KL_Kuehlungs_Status : 36|4@1+ (1,0) [0|15] ""  Gateway
 SG_ KL_Leistung_Klima_Anf : 16|8@1+ (50,0) [0|12750] "Unit_Watt"  Gateway
 SG_ KL_Status_Battkuehlung : 32|3@1+ (1,0) [0|7] ""  Gateway
 SG_ KL_Temp_Kundenwunsch : 58|6@1+ (0.5,15) [15|30.5] "Unit_DegreCelsi"  Gateway
 SG_ TME_HVEM_HV_Anf : 48|2@1+ (1,0) [0|3] ""  Gateway

BO_ 2527679641 Klima_hinten_04: 8 Klima
 SG_ KL_SL_Soll_hl : 57|3@1+ (1,0) [0|7] ""  Gateway
 SG_ KL_SL_Soll_hr : 60|3@1+ (1,0) [0|7] ""  Gateway
 SG_ KLh_SIH_Stufe_hl : 51|3@1+ (1,0) [0|7] ""  Gateway
 SG_ KLh_SIH_Stufe_hr : 54|3@1+ (1,0) [0|7] ""  Gateway
 SG_ KLhs_02_alt : 63|1@1+ (1,0) [0|1] ""  Gateway

BO_ 2589283728 Klima_SDA_01: 8 Klima
 SG_ KL_SDA_AQS_COBereich : 24|2@1+ (1,0) [0|3] ""  Gateway
 SG_ KL_SDA_AQS_COStatus : 26|4@1+ (1,0) [0|15] ""  Gateway
 SG_ KL_SDA_AQS_NoxBereich : 22|2@1+ (1,0) [0|3] ""  Gateway
 SG_ KL_SDA_AQS_NoxStatus : 30|4@1+ (1,0) [0|15] ""  Gateway
 SG_ KL_SDA_AQS_Traffic : 20|2@1+ (1,0) [0|3] ""  Gateway
 SG_ KL_SDA_AQS_VOZBereich : 18|2@1+ (1,0) [0|3] ""  Gateway
 SG_ KL_SDA_AQS_VOZStatus : 34|4@1+ (1,0) [0|15] ""  Gateway
 SG_ KL_SDA_Klima_Automatik : 38|1@1+ (1,0) [0|1] ""  Gateway
 SG_ KL_SDA_Luft_Feinstaub : 10|8@1+ (5,0) [0|1200] ""  Gateway
 SG_ KL_SDA_Luft_Qualitaet : 6|4@1+ (1,0) [0|15] ""  Gateway
 SG_ KL_SDA_Luftverteilung_Person : 39|1@1+ (1,0) [0|1] ""  Gateway
 SG_ KL_SDA_Luftverteilung_Scheibe : 40|1@1+ (1,0) [0|1] ""  Gateway
 SG_ KL_SDA_Luftverteilung_Unten : 41|1@1+ (1,0) [0|1] ""  Gateway
 SG_ KL_SDA_Menutaste : 5|1@1+ (1,0) [0|1] ""  Gateway
 SG_ KL_SDA_Sitzheizung_VL : 42|2@1+ (1,0) [0|3] ""  Gateway
 SG_ KL_SDA_Sitzheizung_VR : 44|2@1+ (1,0) [0|3] ""  Gateway
 SG_ KL_SDA_Sitzlueftung_VL : 46|2@1+ (1,0) [0|3] ""  Gateway
 SG_ KL_SDA_Sitzlueftung_VR : 48|2@1+ (1,0) [0|3] ""  Gateway
 SG_ KL_SDA_Sonderfkt_AirCare : 50|1@1+ (1,0) [0|1] ""  Gateway
 SG_ KL_SDA_Sonderfkt_HSH : 51|1@1+ (1,0) [0|1] ""  Gateway
 SG_ KL_SDA_Sonderfkt_MaxAC : 52|1@1+ (1,0) [0|1] ""  Gateway
 SG_ KL_SDA_Sonderfkt_MaxDefrost : 53|1@1+ (1,0) [0|1] ""  Gateway
 SG_ KL_SDA_Sonderfunktionen_Sprache : 0|5@1+ (1,0) [0|31] ""  Gateway
 SG_ KL_SDA_Temp_Kundenwunsch_2 : 54|5@1+ (1,0) [0|31] ""  Gateway
 SG_ KL_SDA_Temp_Kundenwunsch_3 : 59|5@1+ (1,0) [0|31] ""  Gateway

BO_ 1717 Klima_Sensor_03: 8 Klima
 SG_ FSA_Err_Defekt_HumSens_TNCTOC : 61|1@1+ (1,0) [0|1] ""  Gateway
 SG_ FSA_Err_Defekt_HumSense_TF : 60|1@1+ (1,0) [0|1] ""  Gateway
 SG_ FSA_Err_Defekt_Tsens_TF : 10|1@1+ (1,0) [0|1] ""  Gateway
 SG_ FSA_Err_RAMROM_Check_TF : 14|1@1+ (1,0) [0|1] ""  Gateway
 SG_ FSA_Err_RAMROM_Check_TNCTOC : 26|1@1+ (1,0) [0|1] ""  Gateway
 SG_ FSA_Err_Ueberspannung_TF : 30|1@1+ (1,0) [0|1] ""  Gateway
 SG_ FSA_Err_Unterspannung_TF : 13|1@1+ (1,0) [0|1] ""  Gateway
 SG_ FSA_ErrMemState : 62|2@1+ (1,0) [0|3] ""  Gateway
 SG_ FSA_HW : 40|4@1+ (1,0) [0|15] ""  Gateway
 SG_ FSA_Luftfeuchte_rel : 32|8@1+ (0.5,0) [0|127.5] "Unit_PerCent"  Gateway
 SG_ FSA_Luftfeuchte_TF : 12|1@1+ (1,0) [0|1] ""  Gateway
 SG_ FSA_Luftfeuchte_TNCTOC : 11|1@1+ (1,0) [0|1] ""  Gateway
 SG_ FSA_ResponseError : 15|1@1+ (1,0) [0|1] ""  Gateway
 SG_ FSA_Sensorheizung_Status : 59|1@1+ (1,0) [0|1] ""  Gateway
 SG_ FSA_SW : 44|4@1+ (1,0) [0|15] ""  Gateway
 SG_ FSA_Taupunkt : 0|10@1+ (0.1,-40) [-40|62.3] "Unit_DegreCelsi"  Gateway
 SG_ FSA_Temp_Luft : 16|10@1+ (0.1,-40) [-40|62.3] "Unit_DegreCelsi"  Gateway
 SG_ FSA_Temp_Sensor : 48|11@1+ (0.1,-40) [-40|164.70] "Unit_DegreCelsi"  Gateway

BO_ 1513 Klima_Sensor_04: 8 Klima
 SG_ AAU_Geblaese : 24|7@1+ (1,0) [0|127] "Unit_PerCent"  Vector__XXX
 SG_ DS_Kaeltemittel_P : 8|11@1+ (0.0161,0) [0|32.9567] "Unit_Bar"  Gateway
 SG_ DS_Status : 19|2@1+ (1,0) [0|3] ""  Vector__XXX
 SG_ ION_Status : 21|2@1+ (1,0) [0|3] ""  Vector__XXX
 SG_ ION_Status_LED : 23|1@1+ (1,0) [0|1] ""  Vector__XXX
 SG_ ION_Status_Taster : 31|1@1+ (1,0) [0|1] ""  Vector__XXX

BO_ 2549088326 KN_Klima: 8 Klima
 SG_ KL_KD_Fehler : 63|1@1+ (1,0) [0|1] ""  Gateway
 SG_ Klima_Abschaltstufe : 1|1@1+ (1,0) [0|1] ""  Vector__XXX
 SG_ Klima_KompSchutz : 0|1@1+ (1,0) [0|1] ""  Vector__XXX
 SG_ Klima_Nachlauftyp : 4|4@1+ (1,0) [0|15] ""  Gateway
 SG_ Klima_Transport_Mode : 2|1@1+ (1,0) [0|1] ""  Vector__XXX
 SG_ KN_KL_DiagPfad : 60|1@1+ (1,0) [0|1] ""  Gateway
 SG_ KN_Klima_BusKnockOut : 38|2@1+ (1,0) [0|3] ""  Vector__XXX
 SG_ KN_Klima_BusKnockOutTimer : 40|8@1+ (1,0) [0|255] ""  Vector__XXX
 SG_ KN_Klima_ECUKnockOutTimer : 32|6@1+ (1,0) [0|63] "Unit_Minut"  Vector__XXX
 SG_ NM_Klima_Lokalaktiv : 61|1@1+ (1,0) [0|1] ""  Vector__XXX
 SG_ NM_Klima_Subsystemaktiv : 62|1@1+ (1,0) [0|1] ""  Vector__XXX
 SG_ NM_Klima_Wakeup : 48|8@1+ (1,0) [0|255] ""  Vector__XXX

BO_ 2600468550 NMH_Klima: 8 Klima
 SG_ NM_Klima_CAB_V09 : 40|24@1+ (1,0) [0|16777215] ""  Gateway
 SG_ NM_Klima_Car_Wakeup : 22|1@1+ (1,0) [0|1] ""  Gateway
 SG_ NM_Klima_CBV_AWB : 12|1@1+ (1,0) [0|1] ""  Gateway
 SG_ NM_Klima_CBV_CRI : 14|1@1+ (1,0) [0|1] ""  Gateway
 SG_ NM_Klima_NM_aktiv_Diagnose : 25|1@1+ (1,0) [0|1] ""  Vector__XXX
 SG_ NM_Klima_NM_aktiv_KL15 : 24|1@1+ (1,0) [0|1] ""  Vector__XXX
 SG_ NM_Klima_NM_aktiv_STH : 27|1@1+ (1,0) [0|1] ""  Vector__XXX
 SG_ NM_Klima_NM_aktiv_Tmin : 26|1@1+ (1,0) [0|1] ""  Vector__XXX
 SG_ NM_Klima_NM_State : 16|6@1+ (1,0) [0|63] ""  AAG,BCM,ELV,HDSG,HUD,KFG,Kombi,SAD,SitzMemo_BFS,SitzMemo_FS,STSG_HBFS,STSG_HFS,TSG_BFS,TSG_FS,TSG_HBFS,TSG_HFS,VSG
 SG_ NM_Klima_UDS_CC : 23|1@1+ (1,0) [0|1] ""  Vector__XXX

BO_ 1328 PTC_01: 8 Klima
 SG_ PTC_Aktiv : 12|1@1+ (1,0) [0|1] ""  Gateway
 SG_ PTC_Fehlerstatus : 13|3@1+ (1,0) [0|7] ""  Vector__XXX
 SG_ PTC_I_ist : 16|8@1+ (1,0) [0|253] "Unit_Amper"  Gateway
 SG_ PTC_Nenn_Strom : 32|5@1+ (10,0) [0|310] "Unit_Amper"  Vector__XXX
 SG_ PTC_P_ist : 24|8@1+ (10,0) [0|2530] "Unit_Watt"  Vector__XXX
 SG_ PTCs_01_alt : 39|1@1+ (1,0) [0|1] ""  Gateway

BO_ 2464153670 SOK_Zeit_Klima_Chal_01: 8 Klima
 SG_ SOK_Zeit_Klima_Challenge : 0|64@1+ (1,0) [0|0] ""  Gateway

BO_ 1001 Thermo_Verbrauch_01: 8 Klima
 SG_ Thermo_Pred_Innen_Kunde_Anf : 8|2@1+ (1,0) [0|3] ""  Gateway
 SG_ Thermo_Pred_Innen_System_Anf : 46|2@1+ (1,0) [0|3] ""  Gateway
 SG_ Thermo_Pred_P_dyn_Innen : 10|11@1+ (10,0) [0|20470] "Unit_Watt"  Gateway
 SG_ Thermo_Pred_P_stat_Innen : 21|11@1+ (10,0) [0|20470] "Unit_Watt"  Gateway
 SG_ Thermo_Pred_T_dyn_Innen : 0|8@1+ (1,0) [0|255] "Unit_Minut"  Gateway
 SG_ Thermo_Verbrauch_BTL : 32|13@1+ (1,0) [0|8191] "Unit_WattSecond"  Gateway,Kombi
 SG_ Thermo_Verbrauch_BTL_Ueberlauf : 45|1@1+ (1,0) [0|1] ""  Gateway,Kombi
 SG_ Thermo_Verbrauch_Innen : 50|13@1+ (1,0) [0|8191] "Unit_WattSecond"  Gateway,Kombi
 SG_ Thermo_Verbrauch_Innen_Ueberlauf : 63|1@1+ (1,0) [0|1] ""  Gateway,Kombi

*/

// #VAR_DEF_END#

    Timer t_DoorNMCancelTimer;
    Timer t_KeyInLockNMCancelTimer;
    Timer t_StWhlButtonNMCancelTimer;
    Timer t_WakeWarningNMCancelTimer;
    Timer t_CarClosureNMCancelTimer;
    Timer t_EPKBWarningNMCancelTimer;
    Timer t_IlluNMCancelTimer;
    Timer t_GearIndNMCancelTimer;
    const byte c_NMCancelTimer_05sec = 5;
    const byte c_NMCancelTimer_30sec = 30;

    char buffer[1024], stringbuffer[512];
    int bActiveHelper;    // Hilfsvariable für "Aktive Signale"

//--------------------------------------- AUTOSAR NM ------------------------------------------------

    const byte cAUTO   = 0;
    const byte cMANUAL = 1;

    msTimer t_NM_Transmit;
    long  NM_Transmit_Cycle;
    msTimer t_NM_Wait_Bus_Sleep_Time;
    const c_NM_Wait_Bus_Sleep_Time = 750;
//    msTimer t_NM_Remote_Sleep_Ind_Time;
    const c_NM_Remote_Sleep_Ind_Time = 5000;
    msTimer t_NM_Repeat_Message_Time;
    const c_NM_Repeat_Message_Time = 5000;
    msTimer t_NM_Timeout_Time;
    const c_NM_Timeout_Time = 1000;

    byte NM_Mode = 0;
    const byte cNM_Mode_Init = 0;
    const byte cNM_Mode_Sleep = 1;
    const byte cNM_Mode_Prepare_Bus_Sleep = 2;
    const byte cNM_Mode_Ready_Sleep = 3;
    const byte cNM_Mode_Normal_Operation_State = 4;
    const byte cNM_Mode_RepeatMsg = 5;

    const byte cCANNormalNetworkLoad = 0;
    const byte cCANHeavyNetworkLoad = 1;
    byte bCanLoad = 0;
    const byte cCANNormalNetworkLoad_SpontanCnt = 1;
    const byte cCANHeavyNetworkLoad_SpontanCnt = 2;
    byte bCanLoad_SpontanCnt = 1;

    // Values NM_Gateway_NM_State
    byte bNM_xxx_NM_State;
    const byte cNM_RM_aus_BSM  = 1; // State "Repeat Message" entered from "Bus-Sleep Mode"
    const byte cNM_RM_aus_PBSM = 2; // State "Repeat Message" entered from "Prepare Bus-Sleep Mode"
    const byte cNM_NO_aus_RM   = 4; // State "Normal Operation" entered from "Repeat Message"
    const byte cNM_NO_aus_RS   = 8; // State "Normal Operation" entered from "Ready to Sleep"

    byte boCanNM_Rx_Indication = 0;
    byte boCanNM_Tx_Confirmation = 0;
    byte boCanNM_WaitBusSleep_Timer_Expired = 0;
    byte boCanNM_RepeatMessage_Timer_Expired = 0;
    byte boCanNM_NM_Timeout_Timer_Expired = 0;
    byte boCanNM_RepeatMessage_Requested = 0;

    const word cFLDoorNMRequest       = 0x0001;
    const word cFRDoorNMRequest       = 0x0002;
    const word cRLDoorNMRequest       = 0x0004;
    const word cRRDoorNMRequest       = 0x0008;
    const word cAllDoorNMRequest      = 0x000F;
    const word cIgnitionNMRequest     = 0x0010; // KL_15
    const word cKeyInLockNMRequest    = 0x0020; // KL_S
    const word cWakeWarningNMRequest  = 0x0040;
    const word cEPKBWarningNMRequest  = 0x0080;
    const word cIlluNMRequest         = 0x0100;
    const word cCarClosureNMRequest   = 0x0200;
    const word cGearIndNMRequest      = 0x0400;
    const word cLowBeamNMRequest      = 0x0800;
    const word cStWhlButtonNMRequest  = 0x1000;

    const word cManualNMRequest       = 0x8000;
    const word cAllNMRequest          = 0xFFFF;

    const CanNmNodeId_Base   = 0x1B000000; //     = 0dec
    const CanNmNodeId_AAG          = 0x47; //    = 71dec
    const CanNmNodeId_BCM1         = 0x0E; //    = 14dec
    const CanNmNodeId_eCall        = 0x67; //   = 103dec
    const CanNmNodeId_ELV          = 0x31; //    = 49dec
    const CanNmNodeId_FCM          = 0xA9; //   = 169dec 
    const CanNmNodeId_Gateway      = 0x10; //    = 16dec
    const CanNmNodeId_HDSG         = 0x23; //    = 35dec
    const CanNmNodeId_HUD          = 0x1B; //    = 27dec
    const CanNmNodeId_Kessy        = 0x32; //    = 50dec
    const CanNmNodeId_Klima        = 0x46; //    = 70dec
    const CanNmNodeId_Kombi        = 0x14; //    = 20dec
    const CanNmNodeId_MFG          = 0x2C; //    = 44dec
    const CanNmNodeId_SAD          = 0x84; //   = 132dec
    const CanNmNodeId_Sitzmemo_BFS = 0x4D; //    = 77dec
    const CanNmNodeId_Sitzmemo_FS  = 0x4C; //    = 76dec
    const CanNmNodeId_SMLS         = 0x0C; //    = 12dec
    const CanNmNodeId_STS          = 0x2B; //    = 43dec
    const CanNmNodeId_STSG_HBFS    = 0x34; //    = 52dec
    const CanNmNodeId_STSG_HFS     = 0x33; //    = 51dec
    const CanNmNodeId_TSG_BFS      = 0x4B; //    = 75dec
    const CanNmNodeId_TSG_FS       = 0x4A; //    = 74dec
    const CanNmNodeId_TSG_HBFS     = 0x3F; //    = 63dec
    const CanNmNodeId_TSG_HFS      = 0x3E; //    = 62dec
    const CanNmNodeId_VSG          = 0x2D; //    = 45dec

    const CanNmNodeDetectionEnabled          = 0; //false
    const CanNmNodeIdEnabled                 = 1; //true
    const CanNmUserDataEnabled               = 1; //true;
    const CanNmUserDataLentgh                = 7;
    const CanNmRepeatMsgIndEnabled           = 1; //true;
    const CanNmDevErrorDetect                = 0; //false
//    const CanNmUserDataEnabled             = 1; //true
    const CanNmRemoteSleepIndEnabled         = 0; //false
    const CanNmMsgReducedtime                = 80; //ms
    const CanNmPduRxIndicationEnabled        = 0; //false
    const CanNmStateChangeIndEnabled         = 0; //false
    const CanNmImmediateTxconfEnabled        = 0;// false
    const CanNmMsgTimeoutTime                = 5000; //ms
    const CanNmPduNidPosition                = 0; //CANNM_PDU_BYTE_0;
    const CanNmPduCbvPosition                = 0xFF; //ANNM_PDU_OFF;
    const CanNmPduLength                     = 8;
    const cCanNmPassiveModeEnabled           = 0; //false
    const CanNmBusSynchronizationEnabled     = 0; //false
    const CanNmBusLoadReductionEnabled       = 0; //false
//    const CanNmRemoteSleepIndEnabled       = 0; //false
//    const CanNmNodeDetectionEnabled        = 0; //false
    const CanNmComControlEnabled             = 1; //true    

    const NmAsrCanMsgStandardCycle           = 200;
    const NmAsrCanMsgCycleOffset_AAG         =  30;
    const NmAsrCanMsgReducedTime_AAG         = 200;
    const NmAsrCanMsgCycleOffset_Klima       =  40;
    const NmAsrCanMsgReducedTime_Klima       = 200;
    const NmAsrCanMsgCycleOffset_DLM         =  30;
    const NmAsrCanMsgReducedTime_DLM         = 200;
    const NmAsrCanMsgCycleOffset_DRVU        =  50;
    const NmAsrCanMsgReducedTime_DRVU        = 200;
    const NmAsrCanMsgCycleOffset_EIS         =  70;
    const NmAsrCanMsgReducedTime_EIS         = 200;
    const NmAsrCanMsgCycleOffset_HGW         =  30;
    const NmAsrCanMsgReducedTime_HGW         = 200;
    const NmAsrCanMsgCycleOffset_HUD         =  20;
    const NmAsrCanMsgReducedTime_HUD         = 200;
    const NmAsrCanMsgCycleOffset_IC          =  10;
    const NmAsrCanMsgReducedTime_IC          = 200;
    const NmAsrCanMsgCycleOffset_NV          =  30;
    const NmAsrCanMsgReducedTime_NV          = 200;
    const NmAsrCanMsgCycleOffset_ORC         =  50;
    const NmAsrCanMsgReducedTime_ORC         = 200;
    const NmAsrCanMsgCycleOffset_RBTM_FL     =   0;
    const NmAsrCanMsgReducedTime_RBTM_FL     = 200;
    const NmAsrCanMsgCycleOffset_RBTM_FR     =  70;
    const NmAsrCanMsgReducedTime_RBTM_FR     = 200;
    const NmAsrCanMsgCycleOffset_RVC         =  40;
    const NmAsrCanMsgReducedTime_RVC         = 200;
    const NmAsrCanMsgCycleOffset_SVS         =  40;
    const NmAsrCanMsgReducedTime_SVS         = 200;
    const NmAsrCanMsgCycleOffset_TGW         =   0;
    const NmAsrCanMsgReducedTime_TGW         = 200;
    const NmAsrCanMsgCycleOffset_TPM         =  20;
    const NmAsrCanMsgReducedTime_TPM         = 200;

    char  gECU[12] = "KCAN_Klima";

    byte  CanNmNodeId            = CanNmNodeId_Klima;
    dword NmNodeIdentifier       = CanNmNodeId_Base + CanNmNodeId_Klima;
    word  NmAsrCanMsgCycleOffset = NmAsrCanMsgCycleOffset_Klima;
    word  NmAsrCanMsgReducedTime = NmAsrCanMsgReducedTime_Klima;
    word  NmAsrCanMsgCycleTime   = 200;
    byte  NM_Repeat_Message_State_Active = 0;
    byte  NM_AutomaticModeActive = 0;

//  message   NM_xxx_AR --- Sendeart cyclicX --- 
    message NMH_Klima _mNM_xxx_AR;
    byte _mNM_xxx_Transmit_Allowed = 1;

//--------------------------------------- AUTOSAR NM ------------------------------------------------

    byte  crctable[256] = {
        0x00, 0x2f, 0x5e, 0x71, 0xbc, 0x93, 0xe2, 0xcd, 0x57, 0x78, 0x09, 0x26, 0xeb, 0xc4, 0xb5, 0x9a,
        0xae, 0x81, 0xf0, 0xdf, 0x12, 0x3d, 0x4c, 0x63, 0xf9, 0xd6, 0xa7, 0x88, 0x45, 0x6a, 0x1b, 0x34,
        0x73, 0x5c, 0x2d, 0x02, 0xcf, 0xe0, 0x91, 0xbe, 0x24, 0x0b, 0x7a, 0x55, 0x98, 0xb7, 0xc6, 0xe9,
        0xdd, 0xf2, 0x83, 0xac, 0x61, 0x4e, 0x3f, 0x10, 0x8a, 0xa5, 0xd4, 0xfb, 0x36, 0x19, 0x68, 0x47,
        0xe6, 0xc9, 0xb8, 0x97, 0x5a, 0x75, 0x04, 0x2b, 0xb1, 0x9e, 0xef, 0xc0, 0x0d, 0x22, 0x53, 0x7c,
        0x48, 0x67, 0x16, 0x39, 0xf4, 0xdb, 0xaa, 0x85, 0x1f, 0x30, 0x41, 0x6e, 0xa3, 0x8c, 0xfd, 0xd2,
        0x95, 0xba, 0xcb, 0xe4, 0x29, 0x06, 0x77, 0x58, 0xc2, 0xed, 0x9c, 0xb3, 0x7e, 0x51, 0x20, 0x0f,
        0x3b, 0x14, 0x65, 0x4a, 0x87, 0xa8, 0xd9, 0xf6, 0x6c, 0x43, 0x32, 0x1d, 0xd0, 0xff, 0x8e, 0xa1,
        0xe3, 0xcc, 0xbd, 0x92, 0x5f, 0x70, 0x01, 0x2e, 0xb4, 0x9b, 0xea, 0xc5, 0x08, 0x27, 0x56, 0x79,
        0x4d, 0x62, 0x13, 0x3c, 0xf1, 0xde, 0xaf, 0x80, 0x1a, 0x35, 0x44, 0x6b, 0xa6, 0x89, 0xf8, 0xd7,
        0x90, 0xbf, 0xce, 0xe1, 0x2c, 0x03, 0x72, 0x5d, 0xc7, 0xe8, 0x99, 0xb6, 0x7b, 0x54, 0x25, 0x0a,
        0x3e, 0x11, 0x60, 0x4f, 0x82, 0xad, 0xdc, 0xf3, 0x69, 0x46, 0x37, 0x18, 0xd5, 0xfa, 0x8b, 0xa4,
        0x05, 0x2a, 0x5b, 0x74, 0xb9, 0x96, 0xe7, 0xc8, 0x52, 0x7d, 0x0c, 0x23, 0xee, 0xc1, 0xb0, 0x9f,
        0xab, 0x84, 0xf5, 0xda, 0x17, 0x38, 0x49, 0x66, 0xfc, 0xd3, 0xa2, 0x8d, 0x40, 0x6f, 0x1e, 0x31,
        0x76, 0x59, 0x28, 0x07, 0xca, 0xe5, 0x94, 0xbb, 0x21, 0x0e, 0x7f, 0x50, 0x9d, 0xb2, 0xc3, 0xec,
        0xd8, 0xf7, 0x86, 0xa9, 0x64, 0x4b, 0x3a, 0x15, 0x8f, 0xa0, 0xd1, 0xfe, 0x33, 0x1c, 0x6d, 0x42
    };
}

on start
{
    putValue( KCAN__NMH_Klima_NM_Request, 0 );  // reset all requests
    _NM_Switch_NM_Mode();
    
    __Init_Msg();
    __Startup_Delay();
    __Reset_E2E_SQC();

    putValue( KCAN__NMH_Klima_AutomaticModeActive, 0 );
    putValue( KCAN__NMH_Klima_AutomaticModeActive, 1 );
}

__Init_Msg()
{
// #START_INIT#
    Klima_03_init();
    Klima_06_init();
    Klima_12_init();
    Klima_16_init();
    
    Thermo_Verbrauch_01_init();
    /*
    _init();
    */
    
    
    
// #START_INIT_END#
//    APPL_ECU_APM_1_init();
//    APPL_ECU_APM_2_init();
//    APPL_ECU_DRVU_1_init();
//    APPL_ECU_DRVU_2_init();
//    APPL_ECU_HIL_TO_IC1_init();
//    APPL_ECU_ORC1_init();
//    APPL_ECU_RVC_SVS1_init();
//    APPL_ECU_TGW1_init();
//    NM_APPL_AR_init();
    NM_xxx_AR_init();
//    XCP_Rq_DRVU_1_init();
//    XCP_Rq_DRVU_2_init();
//    XCP_Rq_RBTM_FL_init();
//    XCP_Rq_RBTM_FR_init();
//    XCP_Rq_RVC_SVS_init();
//    XCP_Rq_TPM_init();
}

on envVar KCAN__STOP_All_MESSAGES_DEFAULT_STARTDELAY
{
    if( getValue( this ) )
    {
        __Init_Msg();
        __Startup_Delay();
    }
}

on envVar KCAN__STOP_All_MESSAGES_SET_STARTDELAY
{
    if( getValue( this ) )
    {
        __Startup_Delay();
    }
}

__Startup_Delay()
{
//    write(" Delay setzen :__BCM_Startup_Delay");
// #START_DELAY#
    _Klima_03_Cnt = getValue( KCAN__STMSGSD_Klima_03 ) / _Klima_03_Timebase;
    _Klima_06_Cnt = getValue( KCAN__STMSGSD_Klima_06 ) / _Klima_06_Timebase;
    _Klima_12_Cnt = getValue( KCAN__STMSGSD_Klima_12 ) / _Klima_12_Timebase;
    _Klima_16_Cnt = getValue( KCAN__STMSGSD_Klima_16 ) / _Klima_16_Timebase;
    
    _Thermo_Verbrauch_01_Cnt = getValue( KCAN__STMSGSD_Thermo_Verbrauch_01 ) / _Thermo_Verbrauch_01_Timebase;
    /*
    __Cnt = getValue( KCAN__STMSGSD_ ) / __Timebase;
    __Cnt = getValue( KCAN__STMSGSD_ ) / __Timebase;
    __Cnt = getValue( KCAN__STMSGSD_ ) / __Timebase;
    __Cnt = getValue( KCAN__STMSGSD_ ) / __Timebase;
    */
// #START_DELAY_END#
}

__Reset_E2E_SQC()
{
//    putValue( KCAN_Klemmen_Status_01_BZ, 15 );
//    putValue( KCAN_Licht_Anf_01_BZ, 15 );
//    putValue( KCAN_Licht_hinten_01_BZ, 15 );
//    write(" E2E-simu: Reset SQC to 15 ");
}

on Timer t_DBKomTimer_5ms
{
// *** DBKom-Sendefunktion ***
    // timer aufziehen für nächsten Zyklus
    if( getValue( KCAN__NMH_Klima_CommActive        ) |
        getValue( KCAN__NMH_Klima_RequestBusCom )   )
    {
        setTimer( t_DBKomTimer_5ms, c_tDBKomTimer_5ms );
    }
// #CYC_TIMER_5_MS_START#
    Klima_12_check_output();
    Thermo_Verbrauch_01_check_output();
    /*
    _check_output();
    */
    
    
    
// #CYC_TIMER_5_MS_END#
}

on Timer t_DBKomTimer_20ms
{
// *** DBKom-Transmit-function ***
    // rearm timer for the next cycle
    if( getValue( KCAN__NMH_Klima_CommActive ) )
    {
        setTimer( t_DBKomTimer_20ms, c_tDBKomTimer_20ms );
    }
// #CYC_TIMER_20_MS#
    Klima_03_check_output();
    Klima_06_check_output();
//5ms    Klima_12_check_output();
    Klima_16_check_output();
    
//5ms    Thermo_Verbrauch_01_check_output();
    /*
    _check_output();
    */
    
// #CYC_TIMER_20_MS_END#
//    NM_xxx_AR_check_output();
}

on EnvVar KCAN__SAVE_PANEL_CONFIG
{
    dword hFile;

    if( getValue(this) )
    {
        write("Saving HMI Panel Variables ...");

        hFile = openFileWrite( "CONFIG\\HMI_PRESETS.ASC", 0 );
        filePutString( "base hex timestamps absolute\n", 31, hFile );

// #MSG_SAVEENVVAR#
   //     Klima_03_saveEnvVars( hFile );
   //     Klima_06_saveEnvVars( hFile );
   //     Klima_12_saveEnvVars( hFile );
   //     Klima_16_saveEnvVars( hFile );
   
   //     Thermo_Verbrauch_01_saveEnvVars( hFile );
        /*
        _saveEnvVars( hFile );
        _saveEnvVars( hFile );
        _saveEnvVars( hFile );
        _saveEnvVars( hFile );
        _saveEnvVars( hFile );
        */
// #MSG_SAVEENVVAR_END#
        NM_xxx_AR_saveEnvVars( hFile );

        fileClose(hFile );
    }
}

on EnvVar KCAN__STOP_Klima_MESSAGES_OFF
{
    if( getValue(this) )
    {
// #MSG_OFF#
        putValue( KCAN__STMSGT_Klima_03_CTRL, 4 );
        putValue( KCAN__STMSGT_Klima_06_CTRL, 4 );
        putValue( KCAN__STMSGT_Klima_12_CTRL, 4 );
        putValue( KCAN__STMSGT_Klima_16_CTRL, 4 );
        
        putValue( KCAN__STMSGT_Thermo_Verbrauch_01_CTRL, 4 );
        
        /*
        putValue( KCAN__STMSG_, 1 );
        putValue( KCAN__STMSG_, 1 );
        putValue( KCAN__STMSG_, 1 );
        putValue( KCAN__STMSG_, 1 );
        putValue( KCAN__STMSG_, 1 );
        putValue( KCAN__STMSG_, 1 );
        */
// #MSG_OFF_END#
    }
}

on envVar KCAN__STOP_Klima_MESSAGES_ON
{
    if( getValue(this) )
    {
// #MSG_ON#
        putValue( KCAN__STMSGT_Klima_03_CTRL, 0 );
        putValue( KCAN__STMSGT_Klima_06_CTRL, 0 );
        putValue( KCAN__STMSGT_Klima_12_CTRL, 0 );
        putValue( KCAN__STMSGT_Klima_16_CTRL, 0 );

        putValue( KCAN__STMSGT_Thermo_Verbrauch_01_CTRL, 0 );
/*
        putValue( KCAN__STMSG_, 0 );
        putValue( KCAN__STMSG_, 0 );
        putValue( KCAN__STMSG_, 0 );
        putValue( KCAN__STMSG_, 0 );
        putValue( KCAN__STMSG_, 0 );
        putValue( KCAN__STMSG_, 0 );
        */
// #MSG_ON_END#

    }
}

on EnvVar KCAN__STOP_All_MESSAGES_OFF
{
    if( getValue(this) )
    {
        putValue( KCAN__STOP_Klima_MESSAGES_OFF, 1 );
    }
    else
    {
        putValue( KCAN__STOP_Klima_MESSAGES_OFF, 0 );
    }
}

on EnvVar KCAN__STOP_All_MESSAGES_ON
{
    if( getValue(this) )
    {
        putValue( KCAN__STOP_Klima_MESSAGES_ON, 1 );
    }
    else
    {
        putValue( KCAN__STOP_Klima_MESSAGES_ON, 0 );
    }
}

on busOff
{
    resetCan();
    write("CAN has been resetted due to BUSOFF    ( coded version )");
}

on message 0x1B000000x-0x1B00007Fx
{
    byte Identifier;

    Identifier = this.byte( 1 );

    if( this.ID == NmNodeIdentifier )    // check, wether the received NM-Frame is an own one
    {
        boCanNM_Tx_Confirmation = TRUE;    // so it is a TX-confirmation
    }
    else
    {
        boCanNM_Rx_Indication = TRUE;     // else it is a NM-Frame from another ECU
    }
    _NM_Switch_NM_Mode();     // inform the state-mashine
}

on timer t_DoorNMCancelTimer
{
    if( getValue( KCAN__NMH_Klima_AutomaticModeActive ) == 1 )
    {
        _ReleaseCommRequest( 15 );  // all doors reset their requests
    }
}

on timer t_KeyInLockNMCancelTimer
{
    if( getValue( KCAN__NMH_Klima_AutomaticModeActive ) == 1 )
    {
        _ReleaseCommRequest( cIgnitionNMRequest );
    }
}

on timer t_StWhlButtonNMCancelTimer
{
    if( getValue( KCAN__NMH_Klima_AutomaticModeActive ) == 1 )
    {
        _ReleaseCommRequest( cStWhlButtonNMRequest );  // all keys reset their requests
    }
}

on timer t_WakeWarningNMCancelTimer
{
    if( getValue( KCAN__NMH_Klima_AutomaticModeActive ) == 1 )
    {
        _ReleaseCommRequest( cWakeWarningNMRequest );  // all keys reset their requests
    }
}

on timer t_EPKBWarningNMCancelTimer
{
    if( getValue( KCAN__NMH_Klima_AutomaticModeActive ) == 1 )
    {
        _ReleaseCommRequest( cEPKBWarningNMRequest );  // all keys reset their requests
    }
}

on timer t_IlluNMCancelTimer
{
    if( getValue( KCAN__NMH_Klima_AutomaticModeActive ) == 1 )
    {
        _ReleaseCommRequest( cIlluNMRequest );  // all keys reset their requests
    }
}

on timer t_CarClosureNMCancelTimer
{
    if( getValue( KCAN__NMH_Klima_AutomaticModeActive ) == 1 )
    {
        _ReleaseCommRequest( cCarClosureNMRequest );  // all keys reset their requests
    }
}

on timer t_GearIndNMCancelTimer
{
    if( getValue( KCAN__NMH_Klima_AutomaticModeActive ) == 1 )
    {
        _ReleaseCommRequest( cGearIndNMRequest );  // all keys reset their requests
    }
}

on timer t_NM_Repeat_Message_Time
{
    boCanNM_RepeatMessage_Timer_Expired = TRUE;
    _NM_Switch_NM_Mode();     // inform the state-mashine
}

on timer t_NM_Timeout_Time
{
    boCanNM_NM_Timeout_Timer_Expired = TRUE;
    _NM_Switch_NM_Mode();     // inform the state-mashine
}

on timer t_NM_Transmit
{
    if( NM_Transmit_Cycle > 1 )
        setTimer( t_NM_Transmit, NM_Transmit_Cycle );
    NM_xxx_AR_output();
}

on timer t_NM_Wait_Bus_Sleep_Time
{
    boCanNM_WaitBusSleep_Timer_Expired = TRUE;
    _NM_Switch_NM_Mode();     // inform the state-mashine
}

NM_xxx_AR_init()
{
    _mNM_xxx_AR.NM_Klima_CAB_V09.phys = getValue( KCAN_NM_Klima_CAB_V09 );
    _mNM_xxx_AR.NM_Klima_Car_Wakeup.phys = getValue( KCAN_NM_Klima_Car_Wakeup );
    _mNM_xxx_AR.NM_Klima_CBV_AWB.phys = getValue( KCAN_NM_Klima_CBV_AWB );
    _mNM_xxx_AR.NM_Klima_CBV_CRI.phys = getValue( KCAN_NM_Klima_CBV_CRI );
    _mNM_xxx_AR.NM_Klima_NM_aktiv_Diagnose.phys = getValue( KCAN_NM_Klima_NM_aktiv_Diagnose );
    _mNM_xxx_AR.NM_Klima_NM_aktiv_KL15.phys = getValue( KCAN_NM_Klima_NM_aktiv_KL15 );
    _mNM_xxx_AR.NM_Klima_NM_aktiv_STH.phys = getValue( KCAN_NM_Klima_NM_aktiv_STH );
    _mNM_xxx_AR.NM_Klima_NM_aktiv_Tmin.phys = getValue( KCAN_NM_Klima_NM_aktiv_Tmin );
    _mNM_xxx_AR.NM_Klima_NM_State.phys = getValue( KCAN_NM_Klima_NM_State );
    _mNM_xxx_AR.NM_Klima_UDS_CC.phys = getValue( KCAN_NM_Klima_UDS_CC );
}

NM_xxx_AR_output()
{
    _mNM_xxx_AR.byte( 1 ) = CanNmNodeId;
    putValue( KCAN_NM_Klima_NM_State, bNM_xxx_NM_State );
    _mNM_xxx_AR.NM_Klima_NM_State = bNM_xxx_NM_State;

    if( _mNM_xxx_Transmit_Allowed )
        output( _mNM_xxx_AR );
}

NM_xxx_AR_saveEnvVars( dword hFile )
{
    filePutString("\n// Knoten NMH_Klima\n", 33, hFile );
    snprintf(buffer, elcount(buffer), "0.0000 KCAN__STMSG_NMH_Klima := %X\n", getValue( KCAN__STMSG_NMH_Klima ));        filePutString (buffer, elcount(buffer), hFile);
    snprintf(buffer, elcount(buffer), "0.0000 KCAN__STMSGT_NMH_Klima := %X\n", getValue( KCAN__STMSGT_NMH_Klima ));        filePutString (buffer, elcount(buffer), hFile);
    snprintf(buffer, elcount(buffer), "0.0000 KCAN_NM_Klima_CAB_V09 := %X\n", getValue( KCAN_NM_Klima_CAB_V09 ) );        filePutString (buffer, elcount(buffer), hFile);
    snprintf(buffer, elcount(buffer), "0.0000 KCAN_NM_Klima_Car_Wakeup := %X\n", getValue( KCAN_NM_Klima_Car_Wakeup ) );        filePutString (buffer, elcount(buffer), hFile);
    snprintf(buffer, elcount(buffer), "0.0000 KCAN_NM_Klima_CBV_AWB := %X\n", getValue( KCAN_NM_Klima_CBV_AWB ) );        filePutString (buffer, elcount(buffer), hFile);
    snprintf(buffer, elcount(buffer), "0.0000 KCAN_NM_Klima_CBV_CRI := %X\n", getValue( KCAN_NM_Klima_CBV_CRI ) );        filePutString (buffer, elcount(buffer), hFile);
    snprintf(buffer, elcount(buffer), "0.0000 KCAN_NM_Klima_NM_aktiv_Diagnose := %X\n", getValue( KCAN_NM_Klima_NM_aktiv_Diagnose ) );        filePutString (buffer, elcount(buffer), hFile);
    snprintf(buffer, elcount(buffer), "0.0000 KCAN_NM_Klima_NM_aktiv_KL15 := %X\n", getValue( KCAN_NM_Klima_NM_aktiv_KL15 ) );        filePutString (buffer, elcount(buffer), hFile);
    snprintf(buffer, elcount(buffer), "0.0000 KCAN_NM_Klima_NM_aktiv_STH := %X\n", getValue( KCAN_NM_Klima_NM_aktiv_STH ) );        filePutString (buffer, elcount(buffer), hFile);
    snprintf(buffer, elcount(buffer), "0.0000 KCAN_NM_Klima_NM_aktiv_Tmin := %X\n", getValue( KCAN_NM_Klima_NM_aktiv_Tmin ) );        filePutString (buffer, elcount(buffer), hFile);
    snprintf(buffer, elcount(buffer), "0.0000 KCAN_NM_Klima_NM_State := %X\n", getValue( KCAN_NM_Klima_NM_State ) );        filePutString (buffer, elcount(buffer), hFile);
    snprintf(buffer, elcount(buffer), "0.0000 KCAN_NM_Klima_UDS_CC := %X\n", getValue( KCAN_NM_Klima_UDS_CC ) );        filePutString (buffer, elcount(buffer), hFile);
}

on envVar KCAN__STMSG_NMH_Klima
{
    if( getValue( this ) == 0 )
        _mNM_xxx_Transmit_Allowed = 1;
    else
        _mNM_xxx_Transmit_Allowed = 0;    
}

on EnvVar KCAN_NM_Klima_CAB_V09
{
    _mNM_xxx_AR.NM_Klima_CAB_V09.phys = getValue(this);
}

on EnvVar KCAN_NM_Klima_Car_Wakeup
{
    _mNM_xxx_AR.NM_Klima_Car_Wakeup.phys = getValue(this);
}

on EnvVar KCAN_NM_Klima_CBV_AWB
{
    _mNM_xxx_AR.NM_Klima_CBV_AWB.phys = getValue(this);
}

on EnvVar KCAN_NM_Klima_CBV_CRI
{
    _mNM_xxx_AR.NM_Klima_CBV_CRI .phys = getValue(this);
}

on EnvVar KCAN_NM_Klima_NM_aktiv_Diagnose
{
    _mNM_xxx_AR.NM_Klima_NM_aktiv_Diagnose.phys = getValue(this);
}

on EnvVar KCAN_NM_Klima_NM_aktiv_KL15
{
    _mNM_xxx_AR.NM_Klima_NM_aktiv_KL15.phys = getValue(this);
}

on EnvVar KCAN_NM_Klima_NM_aktiv_STH
{
    _mNM_xxx_AR.NM_Klima_NM_aktiv_STH.phys = getValue(this);
}

on EnvVar KCAN_NM_Klima_NM_aktiv_Tmin
{
    _mNM_xxx_AR.NM_Klima_NM_aktiv_Tmin.phys = getValue(this);
}

on EnvVar KCAN_NM_Klima_NM_State
{
    _mNM_xxx_AR.NM_Klima_NM_State.phys = getValue(this);
}

on EnvVar KCAN_NM_Klima_UDS_CC
{
    _mNM_xxx_AR.NM_Klima_UDS_CC.phys = getValue(this);
}

/*on EnvVar KCAN_NM_Klima_Wakeup
{
    _mNM_xxx_AR.NM_Klima_Wakeup.phys = getValue(this);
}*/

on envVar KCAN__NMH_Klima_AutomaticModeActive
{
    byte temp; // actual NM request status

    if( getValue( this ) )
    {
        EnableControl( "Hauptpanel", "EnvVar:HMI__NM_BCM_Manually_Request_NM", 0 );

        temp = getValue( Env_Ignition_Status );
//        write( "HMI_ISw_Stat is %d", temp );
        if( temp > 1 ) // IGN not Lock
        {
            putValue( KCAN__NMH_Klima_Manually_Request_NM, 1 );
            putValue( KCAN__NMH_Klima_NM_Request, cIgnitionNMRequest );
            _NM_Switch_NM_Mode();
        }
        else
        {
            putValue( KCAN__NMH_Klima_Manually_Request_NM, 0 );
            _ReleaseCommRequest( cAllNMRequest );  // release all requests
            _NM_Switch_NM_Mode();
        }
    }
    else
    {
        EnableControl( "Hauptpanel", "EnvVar:HMI__NM_BCM_Manually_Request_NM", 1 );
        if( getValue( Env_Ignition_Status ) > 1 )
        {
            _SetCommRequest( cIgnitionNMRequest );
            _NM_Switch_NM_Mode();
            putValue( KCAN__NMH_Klima_Manually_Request_NM, 1 );
        }
    }
    NM_AutomaticModeActive = getValue( this );
}

on envVar KCAN__NMH_Klima_Manually_Request_NM
{
    if( getValue ( KCAN__NMH_Klima_AutomaticModeActive ) == 0 )
    {
        if( getValue( this ) )
        {
            _SetCommRequest( cManualNMRequest );
        }
        else
        {
            _ReleaseCommRequest( cAllNMRequest );// all
        }
    }
}

_NM_Switch_NM_Mode()
{
    byte bOld_NM_Mode;
    word NM_Request_State;

    bOld_NM_Mode = NM_Mode;
    NM_Request_State = getValue( KCAN__NMH_Klima_NM_Request );
    switch( NM_Mode )
    {
        case cNM_Mode_Init:                   _NM_Init();
                                              NM_Mode = cNM_Mode_Sleep;
                                              break;
        case cNM_Mode_Sleep:                  if( boCanNM_Rx_Indication == TRUE )
                                              {
                                                  // _NM_NetworkStartIndication();   nothing to do
                                                  // _NM_PassiveStartUp();    is content of _NM_NetworkMode();
                                                  setTimer( t_NM_Transmit, NmAsrCanMsgCycleOffset );    // send NM-Frame delayed
                                                  boCanNM_Rx_Indication = FALSE;
                                                  cancelTimer( t_NM_Timeout_Time );
                                                  setTimer( t_NM_Timeout_Time, c_NM_Timeout_Time );
                                                  setTimer( t_NM_Repeat_Message_Time, c_NM_Repeat_Message_Time );
                                                  NM_Transmit_Cycle = NmAsrCanMsgStandardCycle;
                                                  _NM_NetworkMode();
                                                  NM_Mode = cNM_Mode_RepeatMsg;
                                                  bNM_xxx_NM_State = cNM_RM_aus_BSM;
                                              }
                                              if( NM_Request_State )
                                              {
                                                  setTimer( t_NM_Transmit, 1 );    //send NM-Franme immediately
                                                  NM_Transmit_Cycle = NmAsrCanMsgStandardCycle;
                                                  cancelTimer( t_NM_Timeout_Time );
                                                  setTimer( t_NM_Timeout_Time, c_NM_Timeout_Time );
                                                  setTimer( t_NM_Repeat_Message_Time, c_NM_Repeat_Message_Time );
                                                  NM_Transmit_Cycle = NmAsrCanMsgStandardCycle;
                                                  _NM_NetworkMode();
                                                  NM_Mode = cNM_Mode_RepeatMsg;
                                                  bNM_xxx_NM_State = cNM_RM_aus_BSM;
                                              }
                                              break;
        case cNM_Mode_Prepare_Bus_Sleep:      if( boCanNM_WaitBusSleep_Timer_Expired == TRUE )
                                              {
                                                  _NM_BusSleepModeInd();   // set message startup delay
                                                  NM_Mode = cNM_Mode_Sleep;
                                                  boCanNM_WaitBusSleep_Timer_Expired = FALSE;
                                              }
                                              if( boCanNM_NM_Timeout_Timer_Expired == TRUE )
                                                  boCanNM_NM_Timeout_Timer_Expired = FALSE;
                                              if( ( boCanNM_Rx_Indication == TRUE ) ||  NM_Request_State )
                                              {
                                                  boCanNM_Rx_Indication = FALSE;
                                                  if( NM_Request_State )
                                                  {
                                                      setTimer( t_NM_Transmit, 1 );    //send NM-Franme immediately
                                                  }
                                                  cancelTimer( t_NM_Timeout_Time );
                                                  setTimer( t_NM_Timeout_Time, c_NM_Timeout_Time );
                                                  setTimer( t_NM_Repeat_Message_Time, c_NM_Repeat_Message_Time );
                                                  _NM_NetworkMode();
                                                  NM_Transmit_Cycle = NmAsrCanMsgStandardCycle;
                                                  NM_Mode = cNM_Mode_RepeatMsg;
                                                  bNM_xxx_NM_State = cNM_RM_aus_PBSM;
                                              }
                                              break;
        case cNM_Mode_Ready_Sleep:            if( boCanNM_Rx_Indication == TRUE )
                                              {
                                                  cancelTimer( t_NM_Timeout_Time );
                                                  setTimer( t_NM_Timeout_Time, c_NM_Timeout_Time );
                                                  boCanNM_Rx_Indication = FALSE;
                                              }
                                              if( boCanNM_Tx_Confirmation == TRUE )
                                              {
                                                  cancelTimer( t_NM_Timeout_Time );
                                                  setTimer( t_NM_Timeout_Time, c_NM_Timeout_Time );
                                                  boCanNM_Tx_Confirmation = FALSE;
                                              }
                                              if( NM_Request_State )
                                              {
                                                  setTimer( t_NM_Transmit, 1 );    //send NM-Franme immediately
                                                  cancelTimer( t_NM_Timeout_Time );
                                                  setTimer( t_NM_Timeout_Time, c_NM_Timeout_Time );
                                                  if( CanNmBusLoadReductionEnabled )
                                                      NM_Transmit_Cycle = NmAsrCanMsgReducedTime;
                                                  else
                                                      NM_Transmit_Cycle = NmAsrCanMsgStandardCycle;
                                                  NM_Mode = cNM_Mode_Normal_Operation_State;
                                                  bNM_xxx_NM_State = cNM_NO_aus_RS;
                                              }
                                              if( boCanNM_RepeatMessage_Requested == TRUE )
                                              {
                                                  setTimer( t_NM_Transmit, NmAsrCanMsgCycleOffset );    // send NM-Frame delayed
                                                  cancelTimer( t_NM_Timeout_Time );
                                                  setTimer( t_NM_Timeout_Time, c_NM_Timeout_Time );
                                                  setTimer( t_NM_Repeat_Message_Time, c_NM_Repeat_Message_Time );
                                                  NM_Transmit_Cycle = NmAsrCanMsgStandardCycle;
                                                  boCanNM_RepeatMessage_Requested = FALSE;
                                                  NM_Mode = cNM_Mode_RepeatMsg;
                                              }
                                              if( boCanNM_NM_Timeout_Timer_Expired == TRUE )
                                              {
                                                  setTimer( t_NM_Wait_Bus_Sleep_Time, c_NM_Wait_Bus_Sleep_Time );
                                                  _NM_PrepareBusSleepModeInd();    // here t_DBKonTimer is stopped
                                                  NM_Mode = cNM_Mode_Prepare_Bus_Sleep;
                                                  boCanNM_NM_Timeout_Timer_Expired = FALSE;
                                              }
                                              break;
        case cNM_Mode_Normal_Operation_State: if( boCanNM_NM_Timeout_Timer_Expired == TRUE )
                                              {
                                                  setTimer( t_NM_Timeout_Time, c_NM_Timeout_Time );
                                                  // _NM_TimeoutExeption();    // no action to be done
                                                  boCanNM_NM_Timeout_Timer_Expired = FALSE;
                                              }
                                              if( boCanNM_Rx_Indication == TRUE )
                                              {
                                                  cancelTimer( t_NM_Timeout_Time );
                                                  setTimer( t_NM_Timeout_Time, c_NM_Timeout_Time );
                                                  if( CanNmBusLoadReductionEnabled )
                                                  {
                                                      cancelTimer( t_NM_Transmit );
                                                      setTimer( t_NM_Transmit, NmAsrCanMsgReducedTime );
                                                  }
                                                  else
                                                  {
                                                  //    cancelTimer( t_NM_Transmit );
                                                  //    setTimer( t_NM_Transmit, NmAsrCanMsgStandardCycle );;
                                                  }
                                                  boCanNM_Rx_Indication = FALSE;
                                              }
                                              if( boCanNM_Tx_Confirmation == TRUE )
                                              {
                                                  cancelTimer( t_NM_Timeout_Time );
                                                  setTimer( t_NM_Timeout_Time, c_NM_Timeout_Time );
                                                  cancelTimer( t_NM_Transmit );
                                                  setTimer( t_NM_Transmit, NmAsrCanMsgStandardCycle );
                                                  boCanNM_Tx_Confirmation = FALSE;
                                              }
                                              if( NM_Request_State == 0 )    //no network requested
                                              {
                                                  cancelTimer( t_NM_Transmit );    // stop NM-Franme immediately
                                                  NM_Mode = cNM_Mode_Ready_Sleep;
                                              }
                                              if( boCanNM_RepeatMessage_Requested == TRUE )
                                              {
                                                  setTimer( t_NM_Transmit, NmAsrCanMsgCycleOffset );    // send NM-Frame delayed
                                                  cancelTimer( t_NM_Timeout_Time );
                                                  setTimer( t_NM_Timeout_Time, c_NM_Timeout_Time );
                                                  setTimer( t_NM_Repeat_Message_Time, c_NM_Repeat_Message_Time );
                                                  boCanNM_RepeatMessage_Requested = FALSE;
                                                  NM_Transmit_Cycle = NmAsrCanMsgStandardCycle;
                                                  NM_Mode = cNM_Mode_RepeatMsg;
                                              }
                                              break;
        case cNM_Mode_RepeatMsg:              if( boCanNM_NM_Timeout_Timer_Expired == TRUE )
                                              {
                                                  setTimer( t_NM_Timeout_Time, c_NM_Timeout_Time );
                                                  boCanNM_NM_Timeout_Timer_Expired = FALSE;
                                              }
                                              if( boCanNM_Rx_Indication == TRUE )
                                              {
                                                  cancelTimer( t_NM_Timeout_Time );
                                                  setTimer( t_NM_Timeout_Time, c_NM_Timeout_Time );
                                                  boCanNM_Rx_Indication = FALSE;
                                              }
                                              if( boCanNM_Tx_Confirmation == TRUE )
                                              {
                                                  cancelTimer( t_NM_Timeout_Time );
                                                  setTimer( t_NM_Timeout_Time, c_NM_Timeout_Time );
                                                  boCanNM_Tx_Confirmation = FALSE;
                                              }
                                              if( boCanNM_RepeatMessage_Timer_Expired == TRUE )
                                              {
                                                  boCanNM_RepeatMessage_Timer_Expired = FALSE;
                                                  if( NM_Request_State )
                                                  {
                                                      NM_Mode = cNM_Mode_Normal_Operation_State;
                                                  if( CanNmBusLoadReductionEnabled )
                                                      NM_Transmit_Cycle = NmAsrCanMsgReducedTime;
                                                  else
                                                      NM_Transmit_Cycle = NmAsrCanMsgStandardCycle;
                                                      bNM_xxx_NM_State = cNM_NO_aus_RM;
                                                  }
                                                  else
                                                  {
                                                      cancelTimer( t_NM_Transmit );    // stop NM-Franme immediately
                                                      NM_Mode = cNM_Mode_Ready_Sleep;
                                                  }
                                              }
                                              break;
    }
    if( bOld_NM_Mode != NM_Mode )
    {
        _Nm_StateChangeNotification( bOld_NM_Mode, NM_Mode );    // does the Trace
        putValue( KCAN__NMH_Klima_ActualState, NM_Mode );
    }
}

_NM_Init()
{
    NM_Transmit_Cycle = NmAsrCanMsgStandardCycle;
}

_NM_NetworkMode()
{
    setTimer( t_DBKomTimer_5ms, 1 ); //  ms     start CAN-communication immediately
    setTimer( t_DBKomTimer_20ms, 2 ); //  ms     start CAN-communication immediately
    putValue( KCAN__NMH_Klima_CommActive, 1 );
}

_Nm_BusSleepModeInd()
{
//    write( "_Nm_BusSleepModeInd: Sleep Mode active");
    __Startup_Delay();
    __Reset_E2E_SQC();
}

void _Nm_PrepareBusSleepModeInd()
{
//    _Trace( "Nm_PrepareBusSleepModeInd", "Prepare Sleep Mode active");
    putValue( KCAN__NMH_Klima_CommActive, 0 );
    cancelTimer( t_DBKomTimer_5ms );
    cancelTimer( t_DBKomTimer_20ms );
}

_Nm_StateChangeNotification( byte previousState, byte currentState )
{
/*
    char line[50];

    snprintf( line, elcount(line ), "Transition from %d to %d", previousState, currentState );
    _Trace( "Nm_StateChangeNotification", "", line );
*/
}

on EnvVar KCAN__HeavyBusload
{
    if( getValue( this ) )
    {
        bCanLoad            = cCANHeavyNetworkLoad;
        bCanLoad_SpontanCnt = cCANHeavyNetworkLoad_SpontanCnt;
        write("CANHeavyNetworkLoad");
    }
    else
    {
        bCanLoad            = cCANNormalNetworkLoad;
        bCanLoad_SpontanCnt = cCANNormalNetworkLoad_SpontanCnt;
        write("CANNormalNetworkLoad");
    }
}

_ReleaseCommRequest( word RequestID )
{
    word temp; // actual NM request status

    temp = getValue( KCAN__NMH_Klima_NM_Request );
    temp &= ~RequestID; // reset NM request 
    putValue( KCAN__NMH_Klima_NM_Request, temp );
    _NM_Switch_NM_Mode();
}

_SetCommRequest( word RequestID )
{
    word temp; // actual NM request status

    temp = getValue( KCAN__NMH_Klima_NM_Request );
    temp |= RequestID; // set NM request 
    putValue( KCAN__NMH_Klima_NM_Request, temp );
    _NM_Switch_NM_Mode();
}

on envVar KCAN__NMH_Klima_Remote_SetCommRequest
{
    word temp; // actual NM request status

if( getValue( this ) )
    {
        temp = getValue( KCAN__NMH_Klima_NM_Request );
        temp |= getValue( KCAN__NMH_Klima_RequestID ); // set NM request 
        putValue( KCAN__NMH_Klima_NM_Request, temp );
        _NM_Switch_NM_Mode();
        putValue( KCAN__NMH_Klima_Remote_SetCommRequest, 0 );
    }
}

on envVar KCAN__NMH_Klima_Remote_ReleaseCommRequest
{
    word temp, temp2; // actual NM request status

if( getValue( this ) )
    {
        temp = getValue( KCAN__NMH_Klima_NM_Request );
        temp2 = getValue( KCAN__NMH_Klima_RequestID );
        temp &= ~temp2; // reset NM request    
        putValue( KCAN__NMH_Klima_NM_Request, temp );
        _NM_Switch_NM_Mode();
        putValue( KCAN__NMH_Klima_Remote_ReleaseCommRequest, 0 );
    }
}

void _TraceCall( char functionName[], long callResult )
{
    char line[100];

    if( callResult == 1 )
        snprintf( line, elcount(line ), "calling %s", functionName );
    else
        snprintf( line, elcount(line ), "call to %s failed - wrong state?", functionName );
    _Trace( "", "", line );
}

void _Trace( char functionName[], char info[])
{
    _Trace( functionName, info, "");
}

void _Trace( char functionName[], char info[], char verbose[], long argument )
{
    char line[100];

    snprintf( line, elcount(line ), verbose, argument );
    _Trace( functionName, info, line );
}

void _Trace( char functionName[], char info[], char verbose[])
{
  char sep[2] = "/";
  sep[0] = functionName[0] ? '/' : 0;
  if( verbose[0])
  {
    write( "[%.3f]%s%s%s: %s", timeNow()/100000.0, gECU
           , sep
           , functionName
           , verbose
           );
  } else
  {
    write( "[%.3f]%s%s%s: %s", timeNow()/100000.0, gECU
           , sep
           , functionName
           , info
           );
  }
}

___Template_Header()
{
// #FUNCTIONS#
// #FUNCTIONS_END#
// #TIMERS#
// #TIMERS_END#
// #ENVVARS#
// #ENVVARS_END#
}

/*
Klemmen_Status_01_check_output()
{
    if( !getValue( KCAN__STMSG_Klemmen_Status_01 ) )
    {
    //  message   Klemmen_Status_01 ID: 780 --- Sendeart 0 cyclicX --- 
        if( _Klemmen_Status_01_DelayCnt > 0) _Klemmen_Status_01_DelayCnt--; // Mindestsendeabstand
        _Klemmen_Status_01_Cnt--;
        if( _Klemmen_Status_01_Cnt < 1 )
        {
                // send message due to ending cycle time
            if( _Klemmen_Status_01_DelayCnt < 1 )
            {
                Klemmen_Status_01_output();
                if( _Klemmen_Status_01_SpontanFlag > 0 )
                    _Klemmen_Status_01_SpontanFlag--; // reset Spontan-Flag
                _Klemmen_Status_01_DelayCnt = _Klemmen_Status_01_MinDelay;
            }
            else
            {
                // Spontanflag setzen damit nach Ablauf Mindestsendeabstand gesendet wird
                _Klemmen_Status_01_SpontanFlag = 1;
            }
            _Klemmen_Status_01_Cnt = _Klemmen_Status_01_CycleCount; // reset cycle timer to
        }
        else if( _Klemmen_Status_01_SpontanFlag)
        {
            if( _Klemmen_Status_01_DelayCnt < 1 )
            {
                Klemmen_Status_01_output(); // Nachricht wg. spontaner Änderung ausgeben (Mindestsendeabstand eingehalten)
                _Klemmen_Status_01_SpontanFlag--; // Spontan-Flag zurücksetzen
                _Klemmen_Status_01_DelayCnt = _Klemmen_Status_01_MinDelay;
            }
        }
    }
}

Klemmen_Status_01_init()
{ 
*/
/* Botschaft Klemmen_Status_01 ID: 960 --- Sendeart 0 cyclicX --- 
BA_ "VAGTP20_API" BO_ 960 0;
BA_ "VAGTP20_DynConnection" BO_ 960 0;
BA_ "VAGTP20_DynSetup" BO_ 960 0;
BA_ "VAGTP20_StatConnection" BO_ 960 0;
BA_ "DiagRequest" BO_ 960 0;
BA_ "DiagResponse" BO_ 960 0;
BA_ "DiagState" BO_ 960 0;
BA_ "MsgType" BO_ 960 0;
BA_ "NmhMessage" BO_ 960 0;
BA_ "NmMessage" BO_ 960 0;
BA_ "GenMsgChkConstant" BO_ 960 195;
BA_ "GenMsgILSupport" BO_ 960 1;
BA_ "GenMsgPDUConstants" BO_ 960 "0xc3,0xc3,0xc3,0xc3,0xc3,0xc3,0xc3,0xc3,0xc3,0xc3,0xc3,0xc3,0xc3,0xc3,0xc3,0xc3";
BA_ "GenMsgStartDelayTime" BO_ 960 0;
BA_ "GenMsgDelayTime" BO_ 960 10;
BA_ "GenMsgCycleTime" BO_ 960 100;
BA_ "GenMsgSendType" BO_ 960 0;
*/
/*
    _Klemmen_Status_01_Timebase             = c_tDBKomTimer_5ms;
    _Klemmen_Status_01_CycleCount          = 100 / _Klemmen_Status_01_Timebase;
    _Klemmen_Status_01_StartDelay            = 0 / _Klemmen_Status_01_Timebase;
    _Klemmen_Status_01_MinDelay             = 10 / _Klemmen_Status_01_Timebase;
    _Klemmen_Status_01_Cnt = _Klemmen_Status_01_StartDelay;
    _Klemmen_Status_01_SpontanFlag = 0;
    _Klemmen_Status_01_DelayCnt = 0;
    _Klemmen_Status_01_DLC = 4;

    putValue( KCAN__STMSGSD_Klemmen_Status_01, _Klemmen_Status_01_StartDelay * _Klemmen_Status_01_Timebase );
    putValue( KCAN__STMSGCT_Klemmen_Status_01, _Klemmen_Status_01_CycleCount * _Klemmen_Status_01_Timebase );
    putValue( KCAN__MSGDLC_Klemmen_Status_01,  _Klemmen_Status_01_DLC );
    
    _mKlemmen_Status_01.BCM_Ausparken_Betrieb.phys = getValue( KCAN_BCM_Ausparken_Betrieb );
    _mKlemmen_Status_01.BCM_Remotestart_Betrieb.phys = getValue( KCAN_BCM_Remotestart_Betrieb );
    _mKlemmen_Status_01.BCM_Remotestart_KL15_Anf.phys = getValue( KCAN_BCM_Remotestart_KL15_Anf );
    _mKlemmen_Status_01.BCM_Remotestart_MO_Start.phys = getValue( KCAN_BCM_Remotestart_MO_Start );
    _mKlemmen_Status_01.KST_Fahrerhinweis_1.phys = getValue( KCAN_KST_Fahrerhinweis_1 );
    _mKlemmen_Status_01.KST_Fahrerhinweis_2.phys = getValue( KCAN_KST_Fahrerhinweis_2 );
    _mKlemmen_Status_01.KST_Fahrerhinweis_4.phys = getValue( KCAN_KST_Fahrerhinweis_4 );
    _mKlemmen_Status_01.KST_Fahrerhinweis_5.phys = getValue( KCAN_KST_Fahrerhinweis_5 );
    _mKlemmen_Status_01.KST_Fahrerhinweis_6.phys = getValue( KCAN_KST_Fahrerhinweis_6 );
    _mKlemmen_Status_01.KST_Warn_P1_ZST_def.phys = getValue( KCAN_KST_Warn_P1_ZST_def );
    _mKlemmen_Status_01.KST_Warn_P2_ZST_def.phys = getValue( KCAN_KST_Warn_P2_ZST_def );
    _mKlemmen_Status_01.RSt_Fahrerhinweise.phys = getValue( KCAN_RSt_Fahrerhinweise );
    _mKlemmen_Status_01.ZAS_Kl_15.phys = getValue( KCAN_ZAS_Kl_15 );
    _mKlemmen_Status_01.ZAS_Kl_50_Startanforderung.phys = getValue( KCAN_ZAS_Kl_50_Startanforderung );
    _mKlemmen_Status_01.ZAS_Kl_Infotainment.phys = getValue( KCAN_ZAS_Kl_Infotainment );
    _mKlemmen_Status_01.ZAS_Kl_S.phys = getValue( KCAN_ZAS_Kl_S );
    _mKlemmen_Status_01.ZAS_Kl_X.phys = getValue( KCAN_ZAS_Kl_X );
}

void Klemmen_Status_01_output(void)
{
    byte crc;
    byte SQC_help;

    SQC_help = getValue( KCAN_Klemmen_Status_01_BZ ); //get copy of actual EnvVar
    if( !getValue( KCAN_Klemmen_Status_01_BZ_Auto ) ) // automatic SQC-calculation active ?
    {
        if( SQC_help == _Klemmen_Status_01_SQC_TriggPos ) // start injection of error when trigger reached
        {
            _Klemmen_Status_01_E2E_Armed = 1;   // run
            putValue( KCAN_Klemmen_Status_01_E2E_State, 1 );
        }
        // calculate new sequence counter
        
        if( ( _Klemmen_Status_01_SQC_WrongSeqJump != 0 ) &&
            ( _Klemmen_Status_01_E2E_Armed == 1        )    )
        {
            SQC_help = SQC_help + 16 + _Klemmen_Status_01_SQC_WrongSeqJump;
            if( SQC_help > 15 )
                SQC_help = SQC_help - 16;
            if( SQC_help > 15 )
                SQC_help = SQC_help - 16;
            _Klemmen_Status_01_SQC_WrongSeqJump = 0;
        }
        
        if( ( _Klemmen_Status_01_SQC_RepeatedCnt ) &&
            ( _Klemmen_Status_01_E2E_Armed == 1  )    )
        {
            _Klemmen_Status_01_SQC_RepeatedCnt--;
        }
        else
        {
            if( SQC_help >= 15 ) SQC_help = 0;
            else SQC_help++;
        }
            
        putValue( KCAN_Klemmen_Status_01_BZ, SQC_help );
    }
    _mKlemmen_Status_01.Klemmen_Status_01_BZ = SQC_help;

    if( !getValue( KCAN_Klemmen_Status_01_CRC_Auto ) )
    {   // CRC according Profile_02 ( W213 )
        // berechne crc
        crc = 0xFF;
//      crc = crctable[ crc ^ _mKlemmen_Status_01.byte( 0 ) ];  CRC
        crc = crctable[ crc ^ _mKlemmen_Status_01.byte( 1 ) ];
        crc = crctable[ crc ^ _mKlemmen_Status_01.byte( 2 ) ];
        crc = crctable[ crc ^ _mKlemmen_Status_01.byte( 3 ) ];
        crc = crctable[ crc ^ _mKlemmen_Status_01.byte( 4 ) ];
        crc = crctable[ crc ^ _mKlemmen_Status_01.byte( 5 ) ];
        crc = crctable[ crc ^ _mKlemmen_Status_01.byte( 6 ) ];
        crc = crctable[ crc ^ _mKlemmen_Status_01.byte( 7 ) ];
        crc = crctable[ crc ^ _Klemmen_Status_01_CRC_Offset[ _mKlemmen_Status_01.Klemmen_Status_01_BZ ] ]; // load offset
        crc = (crc ^ 0xFF);

        if( ( _Klemmen_Status_01_CRC_ErrorCnt   && ( _Klemmen_Status_01_E2E_Armed == 1   ) ) ||
            ( getValue( KCAN_Klemmen_Status_01_CRC_Invalid )                                         )    )
        {
            crc++;
            if( _Klemmen_Status_01_CRC_ErrorCnt > 0 )
                _Klemmen_Status_01_CRC_ErrorCnt--; 
        }
        _mKlemmen_Status_01.Klemmen_Status_01_CRC = crc;
        putValue( KCAN_Klemmen_Status_01_CRC, crc );
    }
    else
        _mKlemmen_Status_01.Klemmen_Status_01_CRC = getValue( KCAN_Klemmen_Status_01_CRC );

    if( ( _Klemmen_Status_01_MSG_DropCnt > 0 ) &&
        ( _Klemmen_Status_01_E2E_Armed == 1  )    )
    {
        _Klemmen_Status_01_MSG_DropCnt--;  // do not send message
    }
    else
    {
        _mKlemmen_Status_01.DLC = _Klemmen_Status_01_DLC;
        output( _mKlemmen_Status_01 );
    }
        
    if( _Klemmen_Status_01_E2E_Armed == 1 )
    {
        if ( ( _Klemmen_Status_01_MSG_DropCnt == 0      ) &&
             ( _Klemmen_Status_01_CRC_ErrorCnt == 0     ) &&
             ( _Klemmen_Status_01_SQC_RepeatedCnt == 0  ) &&
             ( _Klemmen_Status_01_SQC_WrongSeqJump == 0 )    )
        {
            _Klemmen_Status_01_E2E_Armed = 0; // no further influence, injetion completed
            putValue( KCAN_Klemmen_Status_01_E2E_State, 0 );
        }
    }
}

Klemmen_Status_01_saveEnvVars( dword hFile )
{
    filePutString("\n// Knoten BCM: Klemmen_Status_01\n", 28, hFile );
    snprintf( buffer, elcount( buffer ), "0.0000 KCAN__STMSG_Klemmen_Status_01 := %X\n", getValue( KCAN__STMSG_Klemmen_Status_01 ) );            filePutString ( buffer, elcount( buffer ), hFile );
    snprintf( buffer, elcount( buffer ), "0.0000 KCAN__STMSGT_Klemmen_Status_01 := %X\n", getValue( KCAN__STMSGT_Klemmen_Status_01 ) );        filePutString ( buffer, elcount( buffer ), hFile );
    snprintf( buffer, elcount( buffer ), "0.0000 KCAN_Klemmen_Status_01_BZ := %X\n", getValue( KCAN_Klemmen_Status_01_BZ ) );    filePutString ( buffer, elcount( buffer ), hFile );
    snprintf( buffer, elcount( buffer ), "0.0000 KCAN_Klemmen_Status_01_BZ_Auto := %X\n", getValue( KCAN_Klemmen_Status_01_BZ_Auto ) );    filePutString ( buffer, elcount( buffer ), hFile );
    snprintf( buffer, elcount( buffer ), "0.0000 KCAN_Klemmen_Status_01_CRC := %X\n", getValue( KCAN_Klemmen_Status_01_CRC ) );    filePutString ( buffer, elcount( buffer ), hFile );
    snprintf( buffer, elcount( buffer ), "0.0000 KCAN_Klemmen_Status_01_CRC_Auto := %X\n", getValue( KCAN_Klemmen_Status_01_CRC_Auto ) );    filePutString ( buffer, elcount( buffer ), hFile );
    snprintf( buffer, elcount( buffer ), "0.0000 KCAN_BCM_Ausparken_Betrieb := %X\n", getValue( KCAN_BCM_Ausparken_Betrieb ) );    filePutString ( buffer, elcount( buffer ), hFile );
    snprintf( buffer, elcount( buffer ), "0.0000 KCAN_BCM_Remotestart_Betrieb := %X\n", getValue( KCAN_BCM_Remotestart_Betrieb ) );    filePutString ( buffer, elcount( buffer ), hFile );
    snprintf( buffer, elcount( buffer ), "0.0000 KCAN_BCM_Remotestart_KL15_Anf := %X\n", getValue( KCAN_BCM_Remotestart_KL15_Anf ) );    filePutString ( buffer, elcount( buffer ), hFile );
    snprintf( buffer, elcount( buffer ), "0.0000 KCAN_BCM_Remotestart_MO_Start := %X\n", getValue( KCAN_BCM_Remotestart_MO_Start ) );    filePutString ( buffer, elcount( buffer ), hFile );
    snprintf( buffer, elcount( buffer ), "0.0000 KCAN_KST_Fahrerhinweis_1 := %X\n", getValue( KCAN_KST_Fahrerhinweis_1 ) );    filePutString ( buffer, elcount( buffer ), hFile );
    snprintf( buffer, elcount( buffer ), "0.0000 KCAN_KST_Fahrerhinweis_2 := %X\n", getValue( KCAN_KST_Fahrerhinweis_2 ) );    filePutString ( buffer, elcount( buffer ), hFile );
    snprintf( buffer, elcount( buffer ), "0.0000 KCAN_KST_Fahrerhinweis_4 := %X\n", getValue( KCAN_KST_Fahrerhinweis_4 ) );    filePutString ( buffer, elcount( buffer ), hFile );
    snprintf( buffer, elcount( buffer ), "0.0000 KCAN_KST_Fahrerhinweis_5 := %X\n", getValue( KCAN_KST_Fahrerhinweis_5 ) );    filePutString ( buffer, elcount( buffer ), hFile );
    snprintf( buffer, elcount( buffer ), "0.0000 KCAN_KST_Fahrerhinweis_6 := %X\n", getValue( KCAN_KST_Fahrerhinweis_6 ) );    filePutString ( buffer, elcount( buffer ), hFile );
    snprintf( buffer, elcount( buffer ), "0.0000 KCAN_KST_Warn_P1_ZST_def := %X\n", getValue( KCAN_KST_Warn_P1_ZST_def ) );    filePutString ( buffer, elcount( buffer ), hFile );
    snprintf( buffer, elcount( buffer ), "0.0000 KCAN_KST_Warn_P2_ZST_def := %X\n", getValue( KCAN_KST_Warn_P2_ZST_def ) );    filePutString ( buffer, elcount( buffer ), hFile );
    snprintf( buffer, elcount( buffer ), "0.0000 KCAN_RSt_Fahrerhinweise := %X\n", getValue( KCAN_RSt_Fahrerhinweise ) );    filePutString ( buffer, elcount( buffer ), hFile );
    snprintf( buffer, elcount( buffer ), "0.0000 KCAN_ZAS_Kl_15 := %X\n", getValue( KCAN_ZAS_Kl_15 ) );    filePutString ( buffer, elcount( buffer ), hFile );
    snprintf( buffer, elcount( buffer ), "0.0000 KCAN_ZAS_Kl_50_Startanforderung := %X\n", getValue( KCAN_ZAS_Kl_50_Startanforderung ) );    filePutString ( buffer, elcount( buffer ), hFile );
    snprintf( buffer, elcount( buffer ), "0.0000 KCAN_ZAS_Kl_Infotainment := %X\n", getValue( KCAN_ZAS_Kl_Infotainment ) );    filePutString ( buffer, elcount( buffer ), hFile );
    snprintf( buffer, elcount( buffer ), "0.0000 KCAN_ZAS_Kl_S := %X\n", getValue( KCAN_ZAS_Kl_S ) );    filePutString ( buffer, elcount( buffer ), hFile );
    snprintf( buffer, elcount( buffer ), "0.0000 KCAN_ZAS_Kl_X := %X\n", getValue( KCAN_ZAS_Kl_X ) );    filePutString ( buffer, elcount( buffer ), hFile );
}

on timer _tKlemmen_Status_01
{
    putValue( KCAN__STMSG_Klemmen_Status_01, 0 );
}

on EnvVar KCAN__STMSG_Klemmen_Status_01
{
    long tDelay;
    if( getValue( this ) == 2 )
    {
        tDelay = getValue( KCAN__STMSGT_Klemmen_Status_01 );
        if( tDelay > 0 )
            setTimer( _tKlemmen_Status_01, tDelay );
        else
            putValue( KCAN__STMSG_Klemmen_Status_01, 0 );
    }
}

on EnvVar KCAN__STMSGCT_Klemmen_Status_01
{
    if( getValue( this ) > 0 )
    {
        _Klemmen_Status_01_CycleCount = getValue( this ) / _Klemmen_Status_01_Timebase;     // set cycle counter to initial value
        _Klemmen_Status_01_SpontanFlag = 1;
    }
}

on envVar KCAN__MSGDLC_Klemmen_Status_01
{
    _Klemmen_Status_01_DLC = getValue( this );
}

on envVar KCAN__STMSG_PO_Klemmen_Status_01
{
    if( getValue( this ) )
        openPanel("Klemmen_Status_01");
}

on envVar KCAN_Klemmen_Status_01_E2E_Inject
{
    if( getValue( this ) )
    {
        _Klemmen_Status_01_CRC_ErrorCnt = getValue( KCAN_Klemmen_Status_01_CRC_ErrorCount );
        _Klemmen_Status_01_SQC_TriggPos = getValue( KCAN_Klemmen_Status_01_BZ_TriggerPosition );
        _Klemmen_Status_01_SQC_WrongSeqJump = getValue( KCAN_Klemmen_Status_01_BZ_WrongSeq );
        _Klemmen_Status_01_SQC_RepeatedCnt = getValue( KCAN_Klemmen_Status_01_BZ_Repeated );
        _Klemmen_Status_01_MSG_DropCnt = getValue( KCAN_Klemmen_Status_01_BZ_MSG_DropCnt );
        putValue( KCAN_Klemmen_Status_01_E2E_State, 2 );
        _Klemmen_Status_01_E2E_Armed = 2;  //armed
    }
}

on envVar KCAN__MSGDLoadDefault_Klemmen_Status_01
{
    Klemmen_Status_01_init();
}

on EnvVar KCAN_BCM_Ausparken_Betrieb
{
    _mKlemmen_Status_01.BCM_Ausparken_Betrieb.phys = getValue(this);
//    _Klemmen_Status_01_SpontanFlag = 1;
}

on EnvVar KCAN_BCM_Remotestart_Betrieb
{
    _mKlemmen_Status_01.BCM_Remotestart_Betrieb.phys = getValue(this);
//    _Klemmen_Status_01_SpontanFlag = 1;
}

on EnvVar KCAN_BCM_Remotestart_KL15_Anf
{
    _mKlemmen_Status_01.BCM_Remotestart_KL15_Anf.phys = getValue(this);
//    _Klemmen_Status_01_SpontanFlag = 1;
}

on EnvVar KCAN_BCM_Remotestart_MO_Start
{
    _mKlemmen_Status_01.BCM_Remotestart_MO_Start.phys = getValue(this);
//    _Klemmen_Status_01_SpontanFlag = 1;
}

on EnvVar KCAN_KST_Fahrerhinweis_1
{
    _mKlemmen_Status_01.KST_Fahrerhinweis_1.phys = getValue(this);
//    _Klemmen_Status_01_SpontanFlag = 1;
}

on EnvVar KCAN_KST_Fahrerhinweis_2
{
    _mKlemmen_Status_01.KST_Fahrerhinweis_2.phys = getValue(this);
//    _Klemmen_Status_01_SpontanFlag = 1;
} 

on EnvVar KCAN_KST_Fahrerhinweis_4
{
    _mKlemmen_Status_01.KST_Fahrerhinweis_4.phys = getValue(this);
//    _Klemmen_Status_01_SpontanFlag = 1;
}

on EnvVar KCAN_KST_Fahrerhinweis_5
{
    _mKlemmen_Status_01.KST_Fahrerhinweis_5.phys = getValue(this);
//    _Klemmen_Status_01_SpontanFlag = 1;
}

on EnvVar KCAN_KST_Fahrerhinweis_6
{
    _mKlemmen_Status_01.KST_Fahrerhinweis_6.phys = getValue(this);
//    _Klemmen_Status_01_SpontanFlag = 1;
}

on EnvVar KCAN_KST_Warn_P1_ZST_def
{
    _mKlemmen_Status_01.KST_Warn_P1_ZST_def.phys = getValue(this);
//    _Klemmen_Status_01_SpontanFlag = 1;
}

on EnvVar KCAN_KST_Warn_P2_ZST_def
{
    _mKlemmen_Status_01.KST_Warn_P2_ZST_def.phys = getValue(this);
//    _Klemmen_Status_01_SpontanFlag = 1;
}

on EnvVar KCAN_RSt_Fahrerhinweise
{
    _mKlemmen_Status_01.RSt_Fahrerhinweise.phys = getValue(this);
//    _Klemmen_Status_01_SpontanFlag = 1;
}

on EnvVar KCAN_ZAS_Kl_15
{
    if( getValue( this ) )
    {
        if( getValue( KCAN__NMH_Klima_AutomaticModeActive ) == 1 )
        {
        cancelTimer( t_KeyInLockNMCancelTimer );
//        write("HJH:_tKeyInLockNMCancelTimer : canceled, ISw_Stat = %d", temp );
        _SetCommRequest( cIgnitionNMRequest );
        }
    }
    _mKlemmen_Status_01.ZAS_Kl_15.phys = getValue(this);
    putValue( KCAN_NM_Klima_NM_aktiv_KL15, getValue(this) );
//    _Klemmen_Status_01_SpontanFlag = 1;
}

on EnvVar KCAN_ZAS_Kl_50_Startanforderung
{
    _mKlemmen_Status_01.ZAS_Kl_50_Startanforderung.phys = getValue(this);
//    _Klemmen_Status_01_SpontanFlag = 1;
}

on EnvVar KCAN_ZAS_Kl_Infotainment
{
    _mKlemmen_Status_01.ZAS_Kl_Infotainment.phys = getValue(this);
//    _Klemmen_Status_01_SpontanFlag = 1;
}

on EnvVar KCAN_ZAS_Kl_S
{
    if( getValue( this ) )
    {
        if( getValue( KCAN__NMH_Klima_AutomaticModeActive ) == 1 )
        {
        cancelTimer( t_KeyInLockNMCancelTimer );
        _SetCommRequest( cIgnitionNMRequest );
        setTimer( t_KeyInLockNMCancelTimer, c_NMCancelTimer_05sec );
//        write("HJH:_tKeyInLockNMCancelTimer : armed, ISw_Stat = %d", temp );
        }
    }
    _mKlemmen_Status_01.ZAS_Kl_S.phys = getValue(this);
//    _Klemmen_Status_01_SpontanFlag = 1;
}

on EnvVar KCAN_ZAS_Kl_X
{
    _mKlemmen_Status_01.ZAS_Kl_X.phys = getValue(this);
//    _Klemmen_Status_01_SpontanFlag = 1;
}
*/
/*
Klima_Sensor_01_check_output()
{
    if( !getValue( KCAN__STMSG_Klima_Sensor_01 ) )
    {
    //  message   Klima_Sensor_01 ID: 1712 --- Sendeart 0 cyclicX --- 
        if( _Klima_Sensor_01_DelayCnt > 0) _Klima_Sensor_01_DelayCnt--; // Mindestsendeabstand
        _Klima_Sensor_01_Cnt--;
        if( _Klima_Sensor_01_Cnt < 1 )
        {
            if( _Klima_Sensor_01_DelayCnt < 1 )
            {
                Klima_Sensor_01_output(); // Nachricht wg. abgelaufenem Zyklus ausgeben (Mindestsendeabstand eingehalten)
//                _Klima_Sensor_01_SpontanFlag = 0; // Spontan-Flag zurücksetzen
                _Klima_Sensor_01_DelayCnt = _Klima_Sensor_01_MinDelay;
            }
            else
            {
                // Spontanflag setzen damit nach Ablauf Mindestsendeabstand gesendet wird
//                _Klima_Sensor_01_SpontanFlag = 1;
            }
            _Klima_Sensor_01_Cnt = _Klima_Sensor_01_CycleCount; // Zyklus-Zähler zurücksetzen
        }*/
/*        else if( _Klima_Sensor_01_SpontanFlag)
        {
            if( _Klima_Sensor_01_DelayCnt < 1 )
            {
                Klima_Sensor_01_output(); // Nachricht wg. spontaner Änderung ausgeben (Mindestsendeabstand eingehalten)
                _Klima_Sensor_01_SpontanFlag = 0; // Spontan-Flag zurücksetzen
                _Klima_Sensor_01_DelayCnt = _Klima_Sensor_01_MinDelay;
            }
        }*//*
    }
}

Klima_Sensor_01_init()
{  
*/
/* Botschaft Klima_Sensor_01 ID: 1712 --- Sendeart 0 cyclicX --- 
BA_ "VAGTP20_API" BO_ 1712 0;
BA_ "VAGTP20_DynConnection" BO_ 1712 0;
BA_ "VAGTP20_DynSetup" BO_ 1712 0;
BA_ "VAGTP20_StatConnection" BO_ 1712 0;
BA_ "DiagRequest" BO_ 1712 0;
BA_ "DiagResponse" BO_ 1712 0;
BA_ "DiagState" BO_ 1712 0;
BA_ "NmMessage" BO_ 1712 0;
BA_ "NmhMessage" BO_ 1712 0;
BA_ "MsgType" BO_ 1712 0;
BA_ "GenMsgILSupport" BO_ 1712 1;
BA_ "GenMsgStartDelayTime" BO_ 1712 0;
BA_ "GenMsgCycleTime" BO_ 1712 500;
BA_ "GenMsgSendType" BO_ 1712 0;
*/
/*
    _Klima_Sensor_01_Timebase             = c_tDBKomTimer_20ms;
    _Klima_Sensor_01_CycleCount          = 100 / _Klima_Sensor_01_Timebase;
    _Klima_Sensor_01_StartDelay            = 0 / _Klima_Sensor_01_Timebase;
    _Klima_Sensor_01_MinDelay             = 10 / _Klima_Sensor_01_Timebase;
    _Klima_Sensor_01_Cnt = _Klima_Sensor_01_StartDelay;
    _Klima_Sensor_01_SpontanFlag = 0;
    _Klima_Sensor_01_DelayCnt = 0;
    _Klima_Sensor_01_DLC = 6;

    putValue( KCAN__STMSGSD_Klima_Sensor_01, _Klima_Sensor_01_StartDelay * _Klima_Sensor_01_Timebase );
    putValue( KCAN__STMSGCT_Klima_Sensor_01, _Klima_Sensor_01_CycleCount * _Klima_Sensor_01_Timebase );
    putValue( KCAN__MSGDLC_Klima_Sensor_01,  _Klima_Sensor_01_DLC );
    
    _mKlima_Sensor_01.FS_Luftfeuchte_rel.phys = getValue( KCAN_FS_Luftfeuchte_rel );
    _mKlima_Sensor_01.FS_ResponseError.phys = getValue( KCAN_FS_ResponseError );
    _mKlima_Sensor_01.FS_Taupunkt.phys = getValue( KCAN_FS_Taupunkt );
    _mKlima_Sensor_01.FS_Temp_Scheibe.phys = getValue( KCAN_FS_Temp_Scheibe );
    _mKlima_Sensor_01.FS_Temp_Sensor.phys = getValue( KCAN_FS_Temp_Sensor );
}

Klima_Sensor_01_output(void)
{
    _mKlima_Sensor_01.DLC = _Klima_Sensor_01_DLC;
    output( _mKlima_Sensor_01 );
}

Klima_Sensor_01_saveEnvVars( dword hFile )
{
    filePutString("\n// Knoten BCM: Klima_Sensor_01\n", 28, hFile );
    snprintf( buffer, elcount( buffer ), "0.0000 KCAN__STMSG_Klima_Sensor_01 := %X\n", getValue( KCAN__STMSG_Klima_Sensor_01 ) );            filePutString ( buffer, elcount( buffer ), hFile );
    snprintf( buffer, elcount( buffer ), "0.0000 KCAN__STMSGT_Klima_Sensor_01 := %X\n", getValue( KCAN__STMSGT_Klima_Sensor_01 ) );        filePutString ( buffer, elcount( buffer ), hFile );
    snprintf( buffer, elcount( buffer ), "0.0000 KCAN_FS_Luftfeuchte_rel := %X\n", getValue( KCAN_FS_Luftfeuchte_rel ) );    filePutString ( buffer, elcount( buffer ), hFile );
    snprintf( buffer, elcount( buffer ), "0.0000 KCAN_FS_ResponseError := %X\n", getValue( KCAN_FS_ResponseError ) );    filePutString ( buffer, elcount( buffer ), hFile );
    snprintf( buffer, elcount( buffer ), "0.0000 KCAN_FS_Taupunkt := %X\n", getValue( KCAN_FS_Taupunkt ) );    filePutString ( buffer, elcount( buffer ), hFile );
    snprintf( buffer, elcount( buffer ), "0.0000 KCAN_FS_Temp_Scheibe := %X\n", getValue( KCAN_FS_Temp_Scheibe ) );    filePutString ( buffer, elcount( buffer ), hFile );
    snprintf( buffer, elcount( buffer ), "0.0000 KCAN_FS_Temp_Sensor := %X\n", getValue( KCAN_FS_Temp_Sensor ) );    filePutString ( buffer, elcount( buffer ), hFile );
}

on timer _tKlima_Sensor_01
{
    putValue( KCAN__STMSG_Klima_Sensor_01, 0 );
}

on EnvVar KCAN__STMSG_Klima_Sensor_01
{
    long tDelay;
    if( getValue( this ) == 2 )
    {
        tDelay = getValue( KCAN__STMSGT_Klima_Sensor_01 );
        if( tDelay > 0 )
            setTimer( _tKlima_Sensor_01, tDelay );
        else
            putValue( KCAN__STMSG_Klima_Sensor_01, 0 );
    }
}

on EnvVar KCAN__STMSGCT_Klima_Sensor_01
{
    if( getValue( this ) > 0 )
    {
        _Klima_Sensor_01_CycleCount = getValue( this ) / _Klima_Sensor_01_Timebase;     // set cycle counter to initial value
        _Klima_Sensor_01_SpontanFlag = 1;
    }
}

on envVar KCAN__MSGDLC_Klima_Sensor_01
{
    _Klima_Sensor_01_DLC = getValue( this );
}

on envVar KCAN__STMSG_PO_Klima_Sensor_01
{
    if( getValue( this ) )
        openPanel( "Klima_Sensor_01" );
}

on envVar KCAN__MSGDLoadDefault_Klima_Sensor_01
{
    Klima_Sensor_01_init();
}

on EnvVar KCAN_FS_Luftfeuchte_rel
{
    _mKlima_Sensor_01.FS_Luftfeuchte_rel.phys = getValue(this);
    _Klima_Sensor_01_SpontanFlag = 1;
}

on EnvVar KCAN_FS_ResponseError
{
    _mKlima_Sensor_01.FS_ResponseError.phys = getValue(this);
    _Klima_Sensor_01_SpontanFlag = 1;
}

on EnvVar KCAN_FS_Taupunkt
{
    _mKlima_Sensor_01.FS_Taupunkt.phys = getValue(this);
    _Klima_Sensor_01_SpontanFlag = 1;
}

on EnvVar KCAN_FS_Temp_Scheibe
{
    _mKlima_Sensor_01.FS_Temp_Scheibe.phys = getValue(this);
    _Klima_Sensor_01_SpontanFlag = 1;
}

on EnvVar KCAN_FS_Temp_Sensor
{
    _mKlima_Sensor_01.FS_Temp_Sensor.phys = getValue(this);
    _Klima_Sensor_01_SpontanFlag = 1;
}
*/
/*
Klima_Sensor_02_check_output()
{
    if( !getValue( KCAN__STMSG_Klima_Sensor_02 ) )
    {
    //  message   Klima_Sensor_02 ID: 1505 --- Sendeart 0 cyclicX --- 
        if( _Klima_Sensor_02_DelayCnt > 0) _Klima_Sensor_02_DelayCnt--; // Mindestsendeabstand
        _Klima_Sensor_02_Cnt--;
        if( _Klima_Sensor_02_Cnt < 1 )
        {
            if( _Klima_Sensor_02_DelayCnt < 1 )
            {
                Klima_Sensor_02_output(); // Nachricht wg. abgelaufenem Zyklus ausgeben (Mindestsendeabstand eingehalten)
//                _Klima_Sensor_02_SpontanFlag = 0; // Spontan-Flag zurücksetzen
                _Klima_Sensor_02_DelayCnt = _Klima_Sensor_02_MinDelay;
            }
            else
            {
                // Spontanflag setzen damit nach Ablauf Mindestsendeabstand gesendet wird
//                _Klima_Sensor_02_SpontanFlag = 1;
            }
            _Klima_Sensor_02_Cnt = _Klima_Sensor_02_CycleCount; // Zyklus-Zähler zurücksetzen
        }*/
/*        else if( _Klima_Sensor_02_SpontanFlag)
        {
            if( _Klima_Sensor_02_DelayCnt < 1 )
            {
                Klima_Sensor_02_output(); // Nachricht wg. spontaner Änderung ausgeben (Mindestsendeabstand eingehalten)
                _Klima_Sensor_02_SpontanFlag = 0; // Spontan-Flag zurücksetzen
                _Klima_Sensor_02_DelayCnt = _Klima_Sensor_02_MinDelay;
            }
        }*//*
    }
}

Klima_Sensor_02_init()
{ 
*/
/* Botschaft Klima_Sensor_02 ID: 1712 --- Sendeart 0 cyclicX --- 
BA_ "VAGTP20_API" BO_ 1505 0;
BA_ "VAGTP20_DynConnection" BO_ 1505 0;
BA_ "VAGTP20_DynSetup" BO_ 1505 0;
BA_ "VAGTP20_StatConnection" BO_ 1505 0;
BA_ "DiagRequest" BO_ 1505 0;
BA_ "DiagResponse" BO_ 1505 0;
BA_ "DiagState" BO_ 1505 0;
BA_ "NmMessage" BO_ 1505 0;
BA_ "NmhMessage" BO_ 1505 0;
BA_ "MsgType" BO_ 1505 0;
BA_ "GenMsgILSupport" BO_ 1505 1;
BA_ "GenMsgStartDelayTime" BO_ 1505 0;
BA_ "GenMsgCycleTime" BO_ 1505 200;
BA_ "GenMsgSendType" BO_ 1505 0;
*/
/*
    _Klima_Sensor_02_Timebase             = c_tDBKomTimer_20ms;
    _Klima_Sensor_02_CycleCount          = 200 / _Klima_Sensor_02_Timebase;
    _Klima_Sensor_02_StartDelay            = 0 / _Klima_Sensor_02_Timebase;
    _Klima_Sensor_02_MinDelay              = 0 / _Klima_Sensor_02_Timebase;
    _Klima_Sensor_02_Cnt = _Klima_Sensor_02_StartDelay;
    _Klima_Sensor_02_SpontanFlag = 0;
    _Klima_Sensor_02_DelayCnt = 0;
    _Klima_Sensor_02_DLC = 6;

    putValue( KCAN__STMSGSD_Klima_Sensor_02, _Klima_Sensor_02_StartDelay * _Klima_Sensor_02_Timebase );
    putValue( KCAN__STMSGCT_Klima_Sensor_02, _Klima_Sensor_02_CycleCount * _Klima_Sensor_02_Timebase );
    putValue( KCAN__MSGDLC_Klima_Sensor_02,  _Klima_Sensor_02_DLC );
    
    _mKlima_Sensor_02.BCM_Heizungsabsperrventil_Status.phys = getValue( KCAN_BCM_Heizungsabsperrventil_Status );
    _mKlima_Sensor_02.BCM_Heizungspumpe_Status.phys = getValue( KCAN_BCM_Heizungspumpe_Status );
    _mKlima_Sensor_02.BCM_Kompressorkupplung_Status.phys = getValue( KCAN_BCM_Kompressorkupplung_Status );
    _mKlima_Sensor_02.Klima_Aussen_Temp_ungef.phys = getValue( KCAN_Klima_Aussen_Temp_ungef );
    _mKlima_Sensor_02.Klima_FStatus_Aussentemp_ungef.phys = getValue( KCAN_Klima_FStatus_Aussentemp_ungef );
    _mKlima_Sensor_02.Klima_Kompressorstrom_ist.phys = getValue( KCAN_Klima_Kompressorstrom_ist );
    _mKlima_Sensor_02.Klima_OBD_FStatus_ATemp.phys = getValue( KCAN_Klima_OBD_FStatus_ATemp );
    _mKlima_Sensor_02.Klima_PTC_stufig_Status.phys = getValue( KCAN_Klima_PTC_stufig_Status );
}

Klima_Sensor_02_output(void)
{
    _mKlima_Sensor_02.DLC = _Klima_Sensor_02_DLC;
    output( _mKlima_Sensor_02 );
}

Klima_Sensor_02_saveEnvVars( dword hFile )
{
    filePutString("\n// Knoten BCM: Klima_Sensor_02\n", 28, hFile );
    snprintf( buffer, elcount( buffer ), "0.0000 KCAN__STMSG_Klima_Sensor_02 := %X\n", getValue( KCAN__STMSG_Klima_Sensor_02 ) );            filePutString ( buffer, elcount( buffer ), hFile );
    snprintf( buffer, elcount( buffer ), "0.0000 KCAN__STMSGT_Klima_Sensor_02 := %X\n", getValue( KCAN__STMSGT_Klima_Sensor_02 ) );        filePutString ( buffer, elcount( buffer ), hFile );
    snprintf( buffer, elcount( buffer ), "0.0000 KCAN_BCM_Heizungsabsperrventil_Status := %X\n", getValue( KCAN_BCM_Heizungsabsperrventil_Status ) );    filePutString ( buffer, elcount( buffer ), hFile );
    snprintf( buffer, elcount( buffer ), "0.0000 KCAN_BCM_Heizungspumpe_Status := %X\n", getValue( KCAN_BCM_Heizungspumpe_Status ) );    filePutString ( buffer, elcount( buffer ), hFile );
    snprintf( buffer, elcount( buffer ), "0.0000 KCAN_BCM_Kompressorkupplung_Status := %X\n", getValue( KCAN_BCM_Kompressorkupplung_Status ) );    filePutString ( buffer, elcount( buffer ), hFile );
    snprintf( buffer, elcount( buffer ), "0.0000 KCAN_Klima_Aussen_Temp_ungef := %X\n", getValue( KCAN_Klima_Aussen_Temp_ungef ) );    filePutString ( buffer, elcount( buffer ), hFile );
    snprintf( buffer, elcount( buffer ), "0.0000 KCAN_Klima_FStatus_Aussentemp_ungef := %X\n", getValue( KCAN_Klima_FStatus_Aussentemp_ungef ) );    filePutString ( buffer, elcount( buffer ), hFile );
    snprintf( buffer, elcount( buffer ), "0.0000 KCAN_Klima_Kompressorstrom_ist := %X\n", getValue( KCAN_Klima_Kompressorstrom_ist ) );    filePutString ( buffer, elcount( buffer ), hFile );
    snprintf( buffer, elcount( buffer ), "0.0000 KCAN_Klima_OBD_FStatus_ATemp := %X\n", getValue( KCAN_Klima_OBD_FStatus_ATemp ) );    filePutString ( buffer, elcount( buffer ), hFile );
    snprintf( buffer, elcount( buffer ), "0.0000 KCAN_Klima_PTC_stufig_Status := %X\n", getValue( KCAN_Klima_PTC_stufig_Status ) );    filePutString ( buffer, elcount( buffer ), hFile );
}

on timer _tKlima_Sensor_02
{
    putValue( KCAN__STMSG_Klima_Sensor_02, 0 );
}

on EnvVar KCAN__STMSG_Klima_Sensor_02
{
    long tDelay;
    if( getValue( this ) == 2 )
    {
        tDelay = getValue( KCAN__STMSGT_Klima_Sensor_02 );
        if( tDelay > 0 )
            setTimer( _tKlima_Sensor_02, tDelay );
        else
            putValue( KCAN__STMSG_Klima_Sensor_02, 0 );
    }
}

on EnvVar KCAN__STMSGCT_Klima_Sensor_02
{
    if( getValue( this ) > 0 )
    {
        _Klima_Sensor_02_CycleCount = getValue( this ) / _Klima_Sensor_02_Timebase;     // set cycle counter to initial value
        _Klima_Sensor_02_SpontanFlag = 1;
    }
}

on envVar KCAN__MSGDLC_Klima_Sensor_02
{
    _Klima_Sensor_02_DLC = getValue( this );
}

on envVar KCAN__STMSG_PO_Klima_Sensor_02
{
    if( getValue( this ) )
        openPanel( "Klima_Sensor_02" );
}

on envVar KCAN__MSGDLoadDefault_Klima_Sensor_02
{
    Klima_Sensor_02_init();
}

on EnvVar KCAN_BCM_Heizungsabsperrventil_Status
{
    _mKlima_Sensor_02.BCM_Heizungsabsperrventil_Status.phys = getValue(this);
    _Klima_Sensor_02_SpontanFlag = 1;
}

on EnvVar KCAN_BCM_Heizungspumpe_Status
{
    _mKlima_Sensor_02.BCM_Heizungspumpe_Status.phys = getValue(this);
    _Klima_Sensor_02_SpontanFlag = 1;
}

on EnvVar KCAN_BCM_Kompressorkupplung_Status
{
    _mKlima_Sensor_02.BCM_Kompressorkupplung_Status.phys = getValue(this);
    _Klima_Sensor_02_SpontanFlag = 1;
}

on EnvVar KCAN_Klima_Aussen_Temp_ungef
{
    _mKlima_Sensor_02.Klima_Aussen_Temp_ungef.phys = getValue(this);
    _Klima_Sensor_02_SpontanFlag = 1;
}

on EnvVar KCAN_Klima_FStatus_Aussentemp_ungef
{
    _mKlima_Sensor_02.Klima_FStatus_Aussentemp_ungef.phys = getValue(this);
    _Klima_Sensor_02_SpontanFlag = 1;
}

on EnvVar KCAN_Klima_Kompressorstrom_ist
{
    _mKlima_Sensor_02.Klima_Kompressorstrom_ist.phys = getValue(this);
    _Klima_Sensor_02_SpontanFlag = 1;
}

on EnvVar KCAN_Klima_OBD_FStatus_ATemp
{
    _mKlima_Sensor_02.Klima_OBD_FStatus_ATemp.phys = getValue(this);
    _Klima_Sensor_02_SpontanFlag = 1;
}

on EnvVar KCAN_Klima_PTC_stufig_Status
{
    _mKlima_Sensor_02.Klima_PTC_stufig_Status.phys = getValue(this);
    _Klima_Sensor_02_SpontanFlag = 1;
}
*/
/*
Licht_Anf_01_check_output()
{
    if( !getValue( KCAN__STMSG_Licht_Anf_01 ) )
    {
    //  message   Licht_Anf_01 ID: 981 --- Sendeart 0 cyclicX --- 
        if( _Licht_Anf_01_DelayCnt > 0) _Licht_Anf_01_DelayCnt--; // Mindestsendeabstand
        _Licht_Anf_01_Cnt--;
        if( _Licht_Anf_01_Cnt < 1 )
        {
            if( _Licht_Anf_01_DelayCnt < 1 )
            {
                Licht_Anf_01_output(); // Nachricht wg. abgelaufenem Zyklus ausgeben (Mindestsendeabstand eingehalten)
                _Licht_Anf_01_SpontanFlag = 0; // Spontan-Flag zurücksetzen
                _Licht_Anf_01_DelayCnt = _Licht_Anf_01_MinDelay;
            }
            else
            {
                // Spontanflag setzen damit nach Ablauf Mindestsendeabstand gesendet wird
                _Licht_Anf_01_SpontanFlag = 1;
            }
            _Licht_Anf_01_Cnt = _Licht_Anf_01_CycleCount; // Zyklus-Zähler zurücksetzen
        }
        else if( _Licht_Anf_01_SpontanFlag)
        {
            if( _Licht_Anf_01_DelayCnt < 1 )
            {
                Licht_Anf_01_output(); // Nachricht wg. spontaner Änderung ausgeben (Mindestsendeabstand eingehalten)
                _Licht_Anf_01_SpontanFlag = 0; // Spontan-Flag zurücksetzen
                _Licht_Anf_01_DelayCnt = _Licht_Anf_01_MinDelay;
            }
        }
    }
}

Licht_Anf_01_init()
{  
*/
/* Botschaft Licht_Anf_01 ID: 981 --- Sendeart 0 cyclicX --- 
BA_ "VAGTP20_API" BO_ 981 0;
BA_ "VAGTP20_DynConnection" BO_ 981 0;
BA_ "VAGTP20_DynSetup" BO_ 981 0;
BA_ "VAGTP20_StatConnection" BO_ 981 0;
BA_ "DiagRequest" BO_ 981 0;
BA_ "DiagResponse" BO_ 981 0;
BA_ "DiagState" BO_ 981 0;
BA_ "MsgType" BO_ 981 0;
BA_ "NmhMessage" BO_ 981 0;
BA_ "NmMessage" BO_ 981 0;
BA_ "GenMsgILSupport" BO_ 981 1;
BA_ "GenMsgPDUConstants" BO_ 981 "0xc5,0x39,0xc7,0xf9,0x92,0xd8,0x24,0xce,0xf1,0xb5,0x7a,0xc4,0xbc,0x60,0xe3,0xd1";
BA_ "GenMsgStartDelayTime" BO_ 981 0;
BA_ "GenMsgDelayTime" BO_ 981 50;
BA_ "GenMsgCycleTime" BO_ 981 100;
BA_ "GenMsgSendType" BO_ 981 0;
*/
/*
    _Licht_Anf_01_Timebase             = c_tDBKomTimer_5ms;
    _Licht_Anf_01_CycleCount          = 100 / _Licht_Anf_01_Timebase;
    _Licht_Anf_01_StartDelay            = 0 / _Licht_Anf_01_Timebase;
    _Licht_Anf_01_MinDelay             = 50 / _Licht_Anf_01_Timebase;
    _Licht_Anf_01_Cnt = _Licht_Anf_01_StartDelay;
    _Licht_Anf_01_SpontanFlag = 0;
    _Licht_Anf_01_DelayCnt = 0;
    _Licht_Anf_01_DLC = 6;

    putValue( KCAN__STMSGSD_Licht_Anf_01, _Licht_Anf_01_StartDelay * _Licht_Anf_01_Timebase );
    putValue( KCAN__STMSGCT_Licht_Anf_01, _Licht_Anf_01_CycleCount * _Licht_Anf_01_Timebase );
    putValue( KCAN__MSGDLC_Licht_Anf_01,  _Licht_Anf_01_DLC );
    
    _mLicht_Anf_01.BCM_Rueckfahrlicht_Anf.phys = getValue( KCAN_BCM_Rueckfahrlicht_Anf );
    _mLicht_Anf_01.Klima_Abblendlicht_Anf.phys = getValue( KCAN_Klima_Abblendlicht_Anf );
    _mLicht_Anf_01.Klima_Adaptive_Lichtvert_Anf.phys = getValue( KCAN_Klima_Adaptive_Lichtvert_Anf );
    _mLicht_Anf_01.Klima_Allwetterlicht_Anf.phys = getValue( KCAN_Klima_Allwetterlicht_Anf );
    _mLicht_Anf_01.Klima_Autobahnlicht_Anf.phys = getValue( KCAN_Klima_Autobahnlicht_Anf );
    _mLicht_Anf_01.Klima_CH_aktiv.phys = getValue( KCAN_Klima_CH_aktiv );
    _mLicht_Anf_01.Klima_CH_LH_aktiv.phys = getValue( KCAN_Klima_CH_LH_aktiv );
    _mLicht_Anf_01.Klima_Fernlicht_Anf.phys = getValue( KCAN_Klima_Fernlicht_Anf );
    _mLicht_Anf_01.Klima_Gleitende_Leuchtw_Anf.phys = getValue( KCAN_Klima_Gleitende_Leuchtw_Anf );
    _mLicht_Anf_01.Klima_GLW_Fernlicht_Anf.phys = getValue( KCAN_Klima_GLW_Fernlicht_Anf );
    _mLicht_Anf_01.Klima_Kurvenlicht_links_Anf.phys = getValue( KCAN_Klima_Kurvenlicht_links_Anf );
    _mLicht_Anf_01.Klima_Kurvenlicht_rechts_Anf.phys = getValue( KCAN_Klima_Kurvenlicht_rechts_Anf );
    _mLicht_Anf_01.Klima_LH_aktiv.phys = getValue( KCAN_Klima_LH_aktiv );
    _mLicht_Anf_01.Klima_Nebellicht_Anf.phys = getValue( KCAN_Klima_Nebellicht_Anf );
    _mLicht_Anf_01.Klima_Nebelschluss_Ahg_Anf.phys = getValue( KCAN_Klima_Nebelschluss_Ahg_Anf );
    _mLicht_Anf_01.Klima_Nebelschluss_Fzg_Anf.phys = getValue( KCAN_Klima_Nebelschluss_Fzg_Anf );
    _mLicht_Anf_01.Klima_Parklicht_li_Anf.phys = getValue( KCAN_Klima_Parklicht_li_Anf );
    _mLicht_Anf_01.Klima_Parklicht_re_Anf.phys = getValue( KCAN_Klima_Parklicht_re_Anf );
    _mLicht_Anf_01.Klima_Regenlicht_Anf.phys = getValue( KCAN_Klima_Regenlicht_Anf );
    _mLicht_Anf_01.Klima_Schlusslicht_Anf.phys = getValue( KCAN_Klima_Schlusslicht_Anf );
    _mLicht_Anf_01.Klima_Signaturlicht_Anf.phys = getValue( KCAN_Klima_Signaturlicht_Anf );
    _mLicht_Anf_01.Klima_Standlicht_Anf.phys = getValue( KCAN_Klima_Standlicht_Anf );
    _mLicht_Anf_01.Klima_Tagfahrlicht_Anf.phys = getValue( KCAN_Klima_Tagfahrlicht_Anf );
    _mLicht_Anf_01.Klima_Touristen_Licht_Anf.phys = getValue( KCAN_Klima_Touristen_Licht_Anf );
    _mLicht_Anf_01.Klima_Umfeldleuchten_Anf.phys = getValue( KCAN_Klima_Umfeldleuchten_Anf );
}

Licht_Anf_01_output(void)
{
    byte crc;
    byte SQC_help;

    SQC_help = getValue( KCAN_Licht_Anf_01_BZ ); //get copy of actual EnvVar
    if( !getValue( KCAN_Licht_Anf_01_BZ_Auto ) ) // automatic SQC-calculation active ?
    {
        if( SQC_help == _Licht_Anf_01_SQC_TriggPos ) // start injection of error when trigger reached
        {
            _Licht_Anf_01_E2E_Armed = 1;   // run
            putValue( KCAN_Licht_Anf_01_E2E_State, 1 );
        }
        // calculate new sequence counter
        
        if( ( _Licht_Anf_01_SQC_WrongSeqJump != 0 ) &&
            ( _Licht_Anf_01_E2E_Armed == 1        )    )
        {
            SQC_help = SQC_help + 16 + _Licht_Anf_01_SQC_WrongSeqJump;
            if( SQC_help > 15 )
                SQC_help = SQC_help - 16;
            if( SQC_help > 15 )
                SQC_help = SQC_help - 16;
            _Licht_Anf_01_SQC_WrongSeqJump = 0;
        }
        
        if( ( _Licht_Anf_01_SQC_RepeatedCnt ) &&
            ( _Licht_Anf_01_E2E_Armed == 1  )    )
        {
            _Licht_Anf_01_SQC_RepeatedCnt--;
        }
        else
        {
            if( SQC_help >= 15 ) SQC_help = 0;
            else SQC_help++;
        }
            
        putValue( KCAN_Licht_Anf_01_BZ, SQC_help );
    }
    _mLicht_Anf_01.Licht_Anf_01_BZ = SQC_help;

    if( !getValue( KCAN_Licht_Anf_01_CRC_Auto ) )
    {   // CRC according Profile_02 ( W213 )
        // berechne crc
        crc = 0xFF;
//      crc = crctable[ crc ^ _mLicht_Anf_01.byte( 0 ) ];  CRC
        crc = crctable[ crc ^ _mLicht_Anf_01.byte( 1 ) ];
        crc = crctable[ crc ^ _mLicht_Anf_01.byte( 2 ) ];
        crc = crctable[ crc ^ _mLicht_Anf_01.byte( 3 ) ];
        crc = crctable[ crc ^ _mLicht_Anf_01.byte( 4 ) ];
        crc = crctable[ crc ^ _mLicht_Anf_01.byte( 5 ) ];
        crc = crctable[ crc ^ _mLicht_Anf_01.byte( 6 ) ];
        crc = crctable[ crc ^ _mLicht_Anf_01.byte( 7 ) ];
        crc = crctable[ crc ^ _Licht_Anf_01_CRC_Offset[ _mLicht_Anf_01.Licht_Anf_01_BZ ] ]; // load offset
        crc = (crc ^ 0xFF);

        if( ( _Licht_Anf_01_CRC_ErrorCnt   && ( _Licht_Anf_01_E2E_Armed == 1   ) ) ||
            ( getValue( KCAN_Licht_Anf_01_CRC_Invalid )                                         )    )
        {
            crc++;
            if( _Licht_Anf_01_CRC_ErrorCnt > 0 )
                _Licht_Anf_01_CRC_ErrorCnt--; 
        }
        _mLicht_Anf_01.Licht_Anf_01_CRC = crc;
        putValue( KCAN_Licht_Anf_01_CRC, crc );
    }
    else
        _mLicht_Anf_01.Licht_Anf_01_CRC = getValue( KCAN_Licht_Anf_01_CRC );

    if( ( _Licht_Anf_01_MSG_DropCnt > 0 ) &&
        ( _Licht_Anf_01_E2E_Armed == 1  )    )
    {
        _Licht_Anf_01_MSG_DropCnt--;  // do not send message
    }
    else
    {
        _mLicht_Anf_01.DLC = _Licht_Anf_01_DLC;
        output( _mLicht_Anf_01 );
    }
        
    if( _Licht_Anf_01_E2E_Armed == 1 )
    {
        if ( ( _Licht_Anf_01_MSG_DropCnt == 0      ) &&
             ( _Licht_Anf_01_CRC_ErrorCnt == 0     ) &&
             ( _Licht_Anf_01_SQC_RepeatedCnt == 0  ) &&
             ( _Licht_Anf_01_SQC_WrongSeqJump == 0 )    )
        {
            _Licht_Anf_01_E2E_Armed = 0; // no further influence, injetion completed
            putValue( KCAN_Licht_Anf_01_E2E_State, 0 );
        }
    }
}

Licht_Anf_01_saveEnvVars( dword hFile )
{
    filePutString("\n// Knoten BCM: Licht_Anf_01\n", 28, hFile );
    snprintf( buffer, elcount( buffer ), "0.0000 KCAN__STMSG_Licht_Anf_01 := %X\n", getValue( KCAN__STMSG_Licht_Anf_01 ) );            filePutString ( buffer, elcount( buffer ), hFile );
    snprintf( buffer, elcount( buffer ), "0.0000 KCAN__STMSGT_Licht_Anf_01 := %X\n", getValue( KCAN__STMSGT_Licht_Anf_01 ) );        filePutString ( buffer, elcount( buffer ), hFile );
    snprintf( buffer, elcount( buffer ), "0.0000 KCAN_Licht_Anf_01_BZ := %X\n", getValue( KCAN_Licht_Anf_01_BZ ) );    filePutString ( buffer, elcount( buffer ), hFile );
    snprintf( buffer, elcount( buffer ), "0.0000 KCAN_Licht_Anf_01_BZ_Auto := %X\n", getValue( KCAN_Licht_Anf_01_BZ_Auto ) );    filePutString ( buffer, elcount( buffer ), hFile );
    snprintf( buffer, elcount( buffer ), "0.0000 KCAN_Licht_Anf_01_CRC := %X\n", getValue( KCAN_Licht_Anf_01_CRC ) );    filePutString ( buffer, elcount( buffer ), hFile );
    snprintf( buffer, elcount( buffer ), "0.0000 KCAN_Licht_Anf_01_CRC_Auto := %X\n", getValue( KCAN_Licht_Anf_01_CRC_Auto ) );    filePutString ( buffer, elcount( buffer ), hFile );
    snprintf( buffer, elcount( buffer ), "0.0000 KCAN_BCM_Rueckfahrlicht_Anf := %X\n", getValue( KCAN_BCM_Rueckfahrlicht_Anf ) );    filePutString ( buffer, elcount( buffer ), hFile );
    snprintf( buffer, elcount( buffer ), "0.0000 KCAN_Klima_Abblendlicht_Anf := %X\n", getValue( KCAN_Klima_Abblendlicht_Anf ) );    filePutString ( buffer, elcount( buffer ), hFile );
    snprintf( buffer, elcount( buffer ), "0.0000 KCAN_Klima_Adaptive_Lichtvert_Anf := %X\n", getValue( KCAN_Klima_Adaptive_Lichtvert_Anf ) );    filePutString ( buffer, elcount( buffer ), hFile );
    snprintf( buffer, elcount( buffer ), "0.0000 KCAN_Klima_Allwetterlicht_Anf := %X\n", getValue( KCAN_Klima_Allwetterlicht_Anf ) );    filePutString ( buffer, elcount( buffer ), hFile );
    snprintf( buffer, elcount( buffer ), "0.0000 KCAN_Klima_Autobahnlicht_Anf := %X\n", getValue( KCAN_Klima_Autobahnlicht_Anf ) );    filePutString ( buffer, elcount( buffer ), hFile );
    snprintf( buffer, elcount( buffer ), "0.0000 KCAN_Klima_CH_aktiv := %X\n", getValue( KCAN_Klima_CH_aktiv ) );    filePutString ( buffer, elcount( buffer ), hFile );
    snprintf( buffer, elcount( buffer ), "0.0000 KCAN_Klima_CH_LH_aktiv := %X\n", getValue( KCAN_Klima_CH_LH_aktiv ) );    filePutString ( buffer, elcount( buffer ), hFile );
    snprintf( buffer, elcount( buffer ), "0.0000 KCAN_Klima_Fernlicht_Anf := %X\n", getValue( KCAN_Klima_Fernlicht_Anf ) );    filePutString ( buffer, elcount( buffer ), hFile );
    snprintf( buffer, elcount( buffer ), "0.0000 KCAN_Klima_Gleitende_Leuchtw_Anf := %X\n", getValue( KCAN_Klima_Gleitende_Leuchtw_Anf ) );    filePutString ( buffer, elcount( buffer ), hFile );
    snprintf( buffer, elcount( buffer ), "0.0000 KCAN_Klima_GLW_Fernlicht_Anf := %X\n", getValue( KCAN_Klima_GLW_Fernlicht_Anf ) );    filePutString ( buffer, elcount( buffer ), hFile );
    snprintf( buffer, elcount( buffer ), "0.0000 KCAN_Klima_Kurvenlicht_links_Anf := %X\n", getValue( KCAN_Klima_Kurvenlicht_links_Anf ) );    filePutString ( buffer, elcount( buffer ), hFile );
    snprintf( buffer, elcount( buffer ), "0.0000 KCAN_Klima_Kurvenlicht_rechts_Anf := %X\n", getValue( KCAN_Klima_Kurvenlicht_rechts_Anf ) );    filePutString ( buffer, elcount( buffer ), hFile );
    snprintf( buffer, elcount( buffer ), "0.0000 KCAN_Klima_LH_aktiv := %X\n", getValue( KCAN_Klima_LH_aktiv ) );    filePutString ( buffer, elcount( buffer ), hFile );
    snprintf( buffer, elcount( buffer ), "0.0000 KCAN_Klima_Nebellicht_Anf := %X\n", getValue( KCAN_Klima_Nebellicht_Anf ) );    filePutString ( buffer, elcount( buffer ), hFile );
    snprintf( buffer, elcount( buffer ), "0.0000 KCAN_Klima_Nebelschluss_Ahg_Anf := %X\n", getValue( KCAN_Klima_Nebelschluss_Ahg_Anf ) );    filePutString ( buffer, elcount( buffer ), hFile );
    snprintf( buffer, elcount( buffer ), "0.0000 KCAN_Klima_Nebelschluss_Fzg_Anf := %X\n", getValue( KCAN_Klima_Nebelschluss_Fzg_Anf ) );    filePutString ( buffer, elcount( buffer ), hFile );
    snprintf( buffer, elcount( buffer ), "0.0000 KCAN_Klima_Parklicht_li_Anf := %X\n", getValue( KCAN_Klima_Parklicht_li_Anf ) );    filePutString ( buffer, elcount( buffer ), hFile );
    snprintf( buffer, elcount( buffer ), "0.0000 KCAN_Klima_Parklicht_re_Anf := %X\n", getValue( KCAN_Klima_Parklicht_re_Anf ) );    filePutString ( buffer, elcount( buffer ), hFile );
    snprintf( buffer, elcount( buffer ), "0.0000 KCAN_Klima_Regenlicht_Anf := %X\n", getValue( KCAN_Klima_Regenlicht_Anf ) );    filePutString ( buffer, elcount( buffer ), hFile );
    snprintf( buffer, elcount( buffer ), "0.0000 KCAN_Klima_Schlusslicht_Anf := %X\n", getValue( KCAN_Klima_Schlusslicht_Anf ) );    filePutString ( buffer, elcount( buffer ), hFile );
    snprintf( buffer, elcount( buffer ), "0.0000 KCAN_Klima_Signaturlicht_Anf := %X\n", getValue( KCAN_Klima_Signaturlicht_Anf ) );    filePutString ( buffer, elcount( buffer ), hFile );
    snprintf( buffer, elcount( buffer ), "0.0000 KCAN_Klima_Standlicht_Anf := %X\n", getValue( KCAN_Klima_Standlicht_Anf ) );    filePutString ( buffer, elcount( buffer ), hFile );
    snprintf( buffer, elcount( buffer ), "0.0000 KCAN_Klima_Tagfahrlicht_Anf := %X\n", getValue( KCAN_Klima_Tagfahrlicht_Anf ) );    filePutString ( buffer, elcount( buffer ), hFile );
    snprintf( buffer, elcount( buffer ), "0.0000 KCAN_Klima_Touristen_Licht_Anf := %X\n", getValue( KCAN_Klima_Touristen_Licht_Anf ) );    filePutString ( buffer, elcount( buffer ), hFile );
    snprintf( buffer, elcount( buffer ), "0.0000 KCAN_Klima_Umfeldleuchten_Anf := %X\n", getValue( KCAN_Klima_Umfeldleuchten_Anf ) );    filePutString ( buffer, elcount( buffer ), hFile );
}

on timer _tLicht_Anf_01
{
    putValue( KCAN__STMSG_Licht_Anf_01, 0 );
}

on EnvVar KCAN__STMSG_Licht_Anf_01
{
    long tDelay;
    if( getValue( this ) == 2 )
    {
        tDelay = getValue( KCAN__STMSGT_Licht_Anf_01 );
        if( tDelay > 0 )
            setTimer( _tLicht_Anf_01, tDelay );
        else
            putValue( KCAN__STMSG_Licht_Anf_01, 0 );
    }
}

on EnvVar KCAN__STMSGCT_Licht_Anf_01
{
    if( getValue( this ) > 0 )
    {
        _Licht_Anf_01_CycleCount = getValue( this ) / _Licht_Anf_01_Timebase;     // set cycle counter to initial value
        _Licht_Anf_01_SpontanFlag = 1;
    }
}

on envVar KCAN__MSGDLC_Licht_Anf_01
{
    _Licht_Anf_01_DLC = getValue( this );
}

on envVar KCAN__STMSG_PO_Licht_Anf_01
{
    if( getValue( this ) )
        openPanel("Licht_Anf_01");
}

on envVar KCAN_Licht_Anf_01_E2E_Inject
{
    if( getValue( this ) )
    {
        _Licht_Anf_01_CRC_ErrorCnt = getValue( KCAN_Licht_Anf_01_CRC_ErrorCount );
        _Licht_Anf_01_SQC_TriggPos = getValue( KCAN_Licht_Anf_01_BZ_TriggerPosition );
        _Licht_Anf_01_SQC_WrongSeqJump = getValue( KCAN_Licht_Anf_01_BZ_WrongSeq );
        _Licht_Anf_01_SQC_RepeatedCnt = getValue( KCAN_Licht_Anf_01_BZ_Repeated );
        _Licht_Anf_01_MSG_DropCnt = getValue( KCAN_Licht_Anf_01_BZ_MSG_DropCnt );
        putValue( KCAN_Licht_Anf_01_E2E_State, 2 );
        _Licht_Anf_01_E2E_Armed = 2;  //armed
    }
}

on envVar KCAN__MSGDLoadDefault_Licht_Anf_01
{
    Licht_Anf_01_init();
}

on EnvVar KCAN_BCM_Rueckfahrlicht_Anf
{
    _mLicht_Anf_01.BCM_Rueckfahrlicht_Anf.phys = getValue(this);
    _Licht_Anf_01_SpontanFlag = 1;
}

on EnvVar KCAN_Klima_Abblendlicht_Anf
{
    _mLicht_Anf_01.Klima_Abblendlicht_Anf.phys = getValue(this);
    _Licht_Anf_01_SpontanFlag = 1;
}

on EnvVar KCAN_Klima_Adaptive_Lichtvert_Anf
{
    _mLicht_Anf_01.Klima_Adaptive_Lichtvert_Anf.phys = getValue(this);
    _Licht_Anf_01_SpontanFlag = 1;
}

on EnvVar KCAN_Klima_Allwetterlicht_Anf
{
    _mLicht_Anf_01.Klima_Allwetterlicht_Anf.phys = getValue(this);
    _Licht_Anf_01_SpontanFlag = 1;
}

on EnvVar KCAN_Klima_Autobahnlicht_Anf
{
    _mLicht_Anf_01.Klima_Autobahnlicht_Anf.phys = getValue(this);
    _Licht_Anf_01_SpontanFlag = 1;
}

on EnvVar KCAN_Klima_CH_aktiv
{
    _mLicht_Anf_01.Klima_CH_aktiv.phys = getValue(this);
    _Licht_Anf_01_SpontanFlag = 1;
}

on EnvVar KCAN_Klima_CH_LH_aktiv
{
    _mLicht_Anf_01.Klima_CH_LH_aktiv.phys = getValue(this);
    _Licht_Anf_01_SpontanFlag = 1;
}

on EnvVar KCAN_Klima_Fernlicht_Anf
{
    _mLicht_Anf_01.Klima_Fernlicht_Anf.phys = getValue(this);
    _Licht_Anf_01_SpontanFlag = 1;
}

on EnvVar KCAN_Klima_Gleitende_Leuchtw_Anf
{
    _mLicht_Anf_01.Klima_Gleitende_Leuchtw_Anf.phys = getValue(this);
    _Licht_Anf_01_SpontanFlag = 1;
}

on EnvVar KCAN_Klima_GLW_Fernlicht_Anf
{
    _mLicht_Anf_01.Klima_GLW_Fernlicht_Anf.phys = getValue(this);
    _Licht_Anf_01_SpontanFlag = 1;
}

on EnvVar KCAN_Klima_Kurvenlicht_links_Anf
{
    _mLicht_Anf_01.Klima_Kurvenlicht_links_Anf.phys = getValue(this);
    _Licht_Anf_01_SpontanFlag = 1;
}

on EnvVar KCAN_Klima_Kurvenlicht_rechts_Anf
{
    _mLicht_Anf_01.Klima_Kurvenlicht_rechts_Anf.phys = getValue(this);
    _Licht_Anf_01_SpontanFlag = 1;
}

on EnvVar KCAN_Klima_LH_aktiv
{
    _mLicht_Anf_01.Klima_LH_aktiv.phys = getValue(this);
    _Licht_Anf_01_SpontanFlag = 1;
}

on EnvVar KCAN_Klima_Nebellicht_Anf
{
    _mLicht_Anf_01.Klima_Nebellicht_Anf.phys = getValue(this);
    _Licht_Anf_01_SpontanFlag = 1;
}

on EnvVar KCAN_Klima_Nebelschluss_Ahg_Anf
{
    _mLicht_Anf_01.Klima_Nebelschluss_Ahg_Anf.phys = getValue(this);
    _Licht_Anf_01_SpontanFlag = 1;
}

on EnvVar KCAN_Klima_Nebelschluss_Fzg_Anf
{
    _mLicht_Anf_01.Klima_Nebelschluss_Fzg_Anf.phys = getValue(this);
    _Licht_Anf_01_SpontanFlag = 1;
}

on EnvVar KCAN_Klima_Parklicht_li_Anf
{
    _mLicht_Anf_01.Klima_Parklicht_li_Anf.phys = getValue(this);
    _Licht_Anf_01_SpontanFlag = 1;
}

on EnvVar KCAN_Klima_Parklicht_re_Anf
{
    _mLicht_Anf_01.Klima_Parklicht_re_Anf.phys = getValue(this);
    _Licht_Anf_01_SpontanFlag = 1;
}

on EnvVar KCAN_Klima_Regenlicht_Anf
{
    _mLicht_Anf_01.Klima_Regenlicht_Anf.phys = getValue(this);
    _Licht_Anf_01_SpontanFlag = 1;
}

on EnvVar KCAN_Klima_Schlusslicht_Anf
{
    _mLicht_Anf_01.Klima_Schlusslicht_Anf.phys = getValue(this);
    _Licht_Anf_01_SpontanFlag = 1;
}

on EnvVar KCAN_Klima_Signaturlicht_Anf
{
    _mLicht_Anf_01.Klima_Signaturlicht_Anf.phys = getValue(this);
    _Licht_Anf_01_SpontanFlag = 1;
}

on EnvVar KCAN_Klima_Standlicht_Anf
{
    _mLicht_Anf_01.Klima_Standlicht_Anf.phys = getValue(this);
    _Licht_Anf_01_SpontanFlag = 1;
}

on EnvVar KCAN_Klima_Tagfahrlicht_Anf
{
    _mLicht_Anf_01.Klima_Tagfahrlicht_Anf.phys = getValue(this);
    _Licht_Anf_01_SpontanFlag = 1;
}

on EnvVar KCAN_Klima_Touristen_Licht_Anf
{
    _mLicht_Anf_01.Klima_Touristen_Licht_Anf.phys = getValue(this);
    _Licht_Anf_01_SpontanFlag = 1;
}

on EnvVar KCAN_Klima_Umfeldleuchten_Anf
{
    _mLicht_Anf_01.Klima_Umfeldleuchten_Anf.phys = getValue(this);
    _Licht_Anf_01_SpontanFlag = 1;
}
*/
/*
Licht_hinten_01_check_output()
{
    if( !getValue( KCAN__STMSG_Licht_hinten_01 ) )
    {
    //  message   Licht_hinten_01 ID: 982 --- Sendeart 0 cyclicX --- 
        if( _Licht_hinten_01_DelayCnt > 0) _Licht_hinten_01_DelayCnt--; // Mindestsendeabstand
        _Licht_hinten_01_Cnt--;
        if( _Licht_hinten_01_Cnt < 1 )
        {
            if( _Licht_hinten_01_DelayCnt < 1 )
            {
                Licht_hinten_01_output(); // Nachricht wg. abgelaufenem Zyklus ausgeben (Mindestsendeabstand eingehalten)
//                _Licht_hinten_01_SpontanFlag = 0; // Spontan-Flag zurücksetzen
                _Licht_hinten_01_DelayCnt = _Licht_hinten_01_MinDelay;
            }
            else
            {
                // Spontanflag setzen damit nach Ablauf Mindestsendeabstand gesendet wird
//                _Licht_hinten_01_SpontanFlag = 1;
            }
            _Licht_hinten_01_Cnt = _Licht_hinten_01_CycleCount; // Zyklus-Zähler zurücksetzen
        }*/
/*        else if( _Licht_hinten_01_SpontanFlag)
        {
            if( _Licht_hinten_01_DelayCnt < 1 )
            {
                Licht_hinten_01_output(); // Nachricht wg. spontaner Änderung ausgeben (Mindestsendeabstand eingehalten)
                _Licht_hinten_01_SpontanFlag = 0; // Spontan-Flag zurücksetzen
                _Licht_hinten_01_DelayCnt = _Licht_hinten_01_MinDelay;
            }
        }*//*
    }
}

Licht_hinten_01_init()
{ 
*/
/* Botschaft Licht_hinten_01 ID: 982 --- Sendeart 0 cyclicX --- 
BA_ "VAGTP20_API" BO_ 982 0;
BA_ "VAGTP20_DynConnection" BO_ 982 0;
BA_ "VAGTP20_DynSetup" BO_ 982 0;
BA_ "VAGTP20_StatConnection" BO_ 982 0;
BA_ "MsgType" BO_ 982 0;
BA_ "NmhMessage" BO_ 982 0;
BA_ "NmMessage" BO_ 982 0;
BA_ "DiagRequest" BO_ 982 0;
BA_ "DiagResponse" BO_ 982 0;
BA_ "DiagState" BO_ 982 0;
BA_ "GenMsgILSupport" BO_ 982 1;
BA_ "GenMsgStartDelayTime" BO_ 982 0;
BA_ "GenMsgCycleTime" BO_ 982 100;
BA_ "GenMsgSendType" BO_ 982 0;
*/
/*
    
    _Licht_hinten_01_Timebase             = c_tDBKomTimer_5ms;
    _Licht_hinten_01_CycleCount          = 100 / _Licht_hinten_01_Timebase;
    _Licht_hinten_01_StartDelay            = 0 / _Licht_hinten_01_Timebase;
    _Licht_hinten_01_MinDelay              = 0 / _Licht_hinten_01_Timebase;
    _Licht_hinten_01_Cnt = _Licht_hinten_01_StartDelay;
    _Licht_hinten_01_SpontanFlag = 0;
    _Licht_hinten_01_DelayCnt = 0;
    _Licht_hinten_01_DLC = 6;

    putValue( KCAN__STMSGSD_Licht_hinten_01, _Licht_hinten_01_StartDelay * _Licht_hinten_01_Timebase );
    putValue( KCAN__STMSGCT_Licht_hinten_01, _Licht_hinten_01_CycleCount * _Licht_hinten_01_Timebase );
    putValue( KCAN__MSGDLC_Licht_hinten_01,  _Licht_hinten_01_DLC );
    
    _mLicht_hinten_01.BCM_Status_Ladeanzeige.phys = getValue( KCAN_BCM_Status_Ladeanzeige );
    _mLicht_hinten_01.BCM2_Bremsl_durch_ECD.phys = getValue( KCAN_BCM2_Bremsl_durch_ECD );
    _mLicht_hinten_01.LH_3_Bremsl_def.phys = getValue( KCAN_LH_3_Bremsl_def );
    _mLicht_hinten_01.LH_Aussenlicht_def.phys = getValue( KCAN_LH_Aussenlicht_def );
    _mLicht_hinten_01.LH_Blinker_HL_akt.phys = getValue( KCAN_LH_Blinker_HL_akt );
    _mLicht_hinten_01.LH_Blinker_HR_akt.phys = getValue( KCAN_LH_Blinker_HR_akt );
    _mLicht_hinten_01.LH_Blinker_li_def.phys = getValue( KCAN_LH_Blinker_li_def );
    _mLicht_hinten_01.LH_Blinker_re_def.phys = getValue( KCAN_LH_Blinker_re_def );
    _mLicht_hinten_01.LH_Brems_Blk_li_def.phys = getValue( KCAN_LH_Brems_Blk_li_def );
    _mLicht_hinten_01.LH_Brems_Blk_re_def.phys = getValue( KCAN_LH_Brems_Blk_re_def );
    _mLicht_hinten_01.LH_Bremsl_li_def.phys = getValue( KCAN_LH_Bremsl_li_def );
    _mLicht_hinten_01.LH_Bremsl_li_ges_def.phys = getValue( KCAN_LH_Bremsl_li_ges_def );
    _mLicht_hinten_01.LH_Bremsl_re_def.phys = getValue( KCAN_LH_Bremsl_re_def );
    _mLicht_hinten_01.LH_Bremsl_re_ges_def.phys = getValue( KCAN_LH_Bremsl_re_ges_def );
    _mLicht_hinten_01.LH_Bremslicht_H_aktiv.phys = getValue( KCAN_LH_Bremslicht_H_aktiv );
    _mLicht_hinten_01.LH_Kennzl_def.phys = getValue( KCAN_LH_Kennzl_def );
    _mLicht_hinten_01.LH_Nebel_li_def.phys = getValue( KCAN_LH_Nebel_li_def );
    _mLicht_hinten_01.LH_Nebel_mi_def.phys = getValue( KCAN_LH_Nebel_mi_def );
    _mLicht_hinten_01.LH_Nebel_re_def.phys = getValue( KCAN_LH_Nebel_re_def );
    _mLicht_hinten_01.LH_Nebelschluss_aktiv.phys = getValue( KCAN_LH_Nebelschluss_aktiv );
    _mLicht_hinten_01.LH_Parklicht_HL_aktiv.phys = getValue( KCAN_LH_Parklicht_HL_aktiv );
    _mLicht_hinten_01.LH_Parklicht_HR_aktiv.phys = getValue( KCAN_LH_Parklicht_HR_aktiv );
    _mLicht_hinten_01.LH_Rueckf_li_def.phys = getValue( KCAN_LH_Rueckf_li_def );
    _mLicht_hinten_01.LH_Rueckf_mi_def.phys = getValue( KCAN_LH_Rueckf_mi_def );
    _mLicht_hinten_01.LH_Rueckf_re_def .phys = getValue( KCAN_LH_Rueckf_re_def  );
    _mLicht_hinten_01.LH_Rueckfahrlicht_aktiv.phys = getValue( KCAN_LH_Rueckfahrlicht_aktiv );
    _mLicht_hinten_01.LH_Schluss_Brems_li_def.phys = getValue( KCAN_LH_Schluss_Brems_li_def );
    _mLicht_hinten_01.LH_Schluss_Brems_Nebel_li_def.phys = getValue( KCAN_LH_Schluss_Brems_Nebel_li_def );
    _mLicht_hinten_01.LH_Schluss_Brems_Nebel_re_def.phys = getValue( KCAN_LH_Schluss_Brems_Nebel_re_def );
    _mLicht_hinten_01.LH_Schluss_Brems_re_def.phys = getValue( KCAN_LH_Schluss_Brems_re_def );
    _mLicht_hinten_01.LH_Schluss_Nebel_li_def.phys = getValue( KCAN_LH_Schluss_Nebel_li_def );
    _mLicht_hinten_01.LH_Schluss_Nebel_re_def.phys = getValue( KCAN_LH_Schluss_Nebel_re_def );
    _mLicht_hinten_01.LH_Schlusslicht_li_def.phys = getValue( KCAN_LH_Schlusslicht_li_def );
    _mLicht_hinten_01.LH_Schlusslicht_re_def.phys = getValue( KCAN_LH_Schlusslicht_re_def );
    _mLicht_hinten_01.LH_SL_BRL_BLK_li_def.phys = getValue( KCAN_LH_SL_BRL_BLK_li_def );
    _mLicht_hinten_01.LH_SL_BRL_BLK_re_def.phys = getValue( KCAN_LH_SL_BRL_BLK_re_def );
    _mLicht_hinten_01.LH_Standlicht_H_aktiv.phys = getValue( KCAN_LH_Standlicht_H_aktiv );
}

Licht_hinten_01_output(void)
{
    byte crc;
    byte SQC_help;

    SQC_help = getValue( KCAN_Licht_Anf_01_BZ ); //get copy of actual EnvVar
    if( !getValue( KCAN_Licht_Anf_01_BZ_Auto ) ) // automatic SQC-calculation active ?
    {
        if( SQC_help == _Licht_Anf_01_SQC_TriggPos ) // start injection of error when trigger reached
        {
            _Licht_Anf_01_E2E_Armed = 1;   // run
            putValue( KCAN_Licht_Anf_01_E2E_State, 1 );
        }
        // calculate new sequence counter
        
        if( ( _Licht_Anf_01_SQC_WrongSeqJump != 0 ) &&
            ( _Licht_Anf_01_E2E_Armed == 1        )    )
        {
            SQC_help = SQC_help + 16 + _Licht_Anf_01_SQC_WrongSeqJump;
            if( SQC_help > 15 )
                SQC_help = SQC_help - 16;
            if( SQC_help > 15 )
                SQC_help = SQC_help - 16;
            _Licht_Anf_01_SQC_WrongSeqJump = 0;
        }
        
        if( ( _Licht_Anf_01_SQC_RepeatedCnt ) &&
            ( _Licht_Anf_01_E2E_Armed == 1  )    )
        {
            _Licht_Anf_01_SQC_RepeatedCnt--;
        }
        else
        {
            if( SQC_help >= 15 ) SQC_help = 0;
            else SQC_help++;
        }
            
        putValue( KCAN_Licht_Anf_01_BZ, SQC_help );
    }
    _mLicht_Anf_01.Licht_Anf_01_BZ = SQC_help;

    if( !getValue( KCAN_Licht_Anf_01_CRC_Auto ) )
    {   // CRC according Profile_02 ( W213 )
        // berechne crc
        crc = 0xFF;
//      crc = crctable[ crc ^ _mLicht_Anf_01.byte( 0 ) ];  CRC
        crc = crctable[ crc ^ _mLicht_Anf_01.byte( 1 ) ];
        crc = crctable[ crc ^ _mLicht_Anf_01.byte( 2 ) ];
        crc = crctable[ crc ^ _mLicht_Anf_01.byte( 3 ) ];
        crc = crctable[ crc ^ _mLicht_Anf_01.byte( 4 ) ];
        crc = crctable[ crc ^ _mLicht_Anf_01.byte( 5 ) ];
        crc = crctable[ crc ^ _mLicht_Anf_01.byte( 6 ) ];
        crc = crctable[ crc ^ _mLicht_Anf_01.byte( 7 ) ];
        crc = crctable[ crc ^ _Licht_Anf_01_CRC_Offset[ _mLicht_Anf_01.Licht_Anf_01_BZ ] ]; // load offset
        crc = (crc ^ 0xFF);

        if( ( _Licht_Anf_01_CRC_ErrorCnt   && ( _Licht_Anf_01_E2E_Armed == 1   ) ) ||
            ( getValue( KCAN_Licht_Anf_01_CRC_Invalid )                                         )    )
        {
            crc++;
            if( _Licht_Anf_01_CRC_ErrorCnt > 0 )
                _Licht_Anf_01_CRC_ErrorCnt--; 
        }
 //       _mLicht_Anf_01.Licht_Anf_01_CRC = crc; not excisting, only BZ
        putValue( KCAN_Licht_Anf_01_CRC, crc );
    }
    else
        _mLicht_Anf_01.Licht_Anf_01_CRC = getValue( KCAN_Licht_Anf_01_CRC );

    if( ( _Licht_Anf_01_MSG_DropCnt > 0 ) &&
        ( _Licht_Anf_01_E2E_Armed == 1  )    )
    {
        _Licht_Anf_01_MSG_DropCnt--;  // do not send message
    }
    else
    {
        _mLicht_Anf_01.DLC = _Licht_Anf_01_DLC;
        output( _mLicht_Anf_01 );
    }
        
    if( _Licht_Anf_01_E2E_Armed == 1 )
    {
        if ( ( _Licht_Anf_01_MSG_DropCnt == 0      ) &&
             ( _Licht_Anf_01_CRC_ErrorCnt == 0     ) &&
             ( _Licht_Anf_01_SQC_RepeatedCnt == 0  ) &&
             ( _Licht_Anf_01_SQC_WrongSeqJump == 0 )    )
        {
            _Licht_Anf_01_E2E_Armed = 0; // no further influence, injetion completed
            putValue( KCAN_Licht_Anf_01_E2E_State, 0 );
        }
    }
}

Licht_hinten_01_saveEnvVars( dword hFile )
{
    filePutString("\n// Knoten BCM: Licht_hinten_01\n", 28, hFile );
    snprintf( buffer, elcount( buffer ), "0.0000 KCAN__STMSG_Licht_hinten_01 := %X\n", getValue( KCAN__STMSG_Licht_hinten_01 ) );            filePutString ( buffer, elcount( buffer ), hFile );
    snprintf( buffer, elcount( buffer ), "0.0000 KCAN__STMSGT_Licht_hinten_01 := %X\n", getValue( KCAN__STMSGT_Licht_hinten_01 ) );        filePutString ( buffer, elcount( buffer ), hFile );
    snprintf( buffer, elcount( buffer ), "0.0000 KCAN_Licht_hinten_01_BZ := %X\n", getValue( KCAN_Licht_hinten_01_BZ ) );    filePutString ( buffer, elcount( buffer ), hFile );
    snprintf( buffer, elcount( buffer ), "0.0000 KCAN_Licht_hinten_01_BZ_Auto := %X\n", getValue( KCAN_Licht_hinten_01_BZ_Auto ) );    filePutString ( buffer, elcount( buffer ), hFile );
    snprintf( buffer, elcount( buffer ), "0.0000 KCAN_BCM_Status_Ladeanzeige := %X\n", getValue( KCAN_BCM_Status_Ladeanzeige ) );    filePutString ( buffer, elcount( buffer ), hFile );
    snprintf( buffer, elcount( buffer ), "0.0000 KCAN_BCM2_Bremsl_durch_ECD := %X\n", getValue( KCAN_BCM2_Bremsl_durch_ECD ) );    filePutString ( buffer, elcount( buffer ), hFile );
    snprintf( buffer, elcount( buffer ), "0.0000 KCAN_LH_3_Bremsl_def := %X\n", getValue( KCAN_LH_3_Bremsl_def ) );    filePutString ( buffer, elcount( buffer ), hFile );
    snprintf( buffer, elcount( buffer ), "0.0000 KCAN_LH_Aussenlicht_def := %X\n", getValue( KCAN_LH_Aussenlicht_def ) );    filePutString ( buffer, elcount( buffer ), hFile );
    snprintf( buffer, elcount( buffer ), "0.0000 KCAN_LH_Blinker_HL_akt := %X\n", getValue( KCAN_LH_Blinker_HL_akt ) );    filePutString ( buffer, elcount( buffer ), hFile );
    snprintf( buffer, elcount( buffer ), "0.0000 KCAN_LH_Blinker_HR_akt := %X\n", getValue( KCAN_LH_Blinker_HR_akt ) );    filePutString ( buffer, elcount( buffer ), hFile );
    snprintf( buffer, elcount( buffer ), "0.0000 KCAN_LH_Blinker_li_def := %X\n", getValue( KCAN_LH_Blinker_li_def ) );    filePutString ( buffer, elcount( buffer ), hFile );
    snprintf( buffer, elcount( buffer ), "0.0000 KCAN_LH_Blinker_re_def := %X\n", getValue( KCAN_LH_Blinker_re_def ) );    filePutString ( buffer, elcount( buffer ), hFile );
    snprintf( buffer, elcount( buffer ), "0.0000 KCAN_LH_Brems_Blk_li_def := %X\n", getValue( KCAN_LH_Brems_Blk_li_def ) );    filePutString ( buffer, elcount( buffer ), hFile );
    snprintf( buffer, elcount( buffer ), "0.0000 KCAN_LH_Brems_Blk_re_def := %X\n", getValue( KCAN_LH_Brems_Blk_re_def ) );    filePutString ( buffer, elcount( buffer ), hFile );
    snprintf( buffer, elcount( buffer ), "0.0000 KCAN_LH_Bremsl_li_def := %X\n", getValue( KCAN_LH_Bremsl_li_def ) );    filePutString ( buffer, elcount( buffer ), hFile );
    snprintf( buffer, elcount( buffer ), "0.0000 KCAN_LH_Bremsl_li_ges_def := %X\n", getValue( KCAN_LH_Bremsl_li_ges_def ) );    filePutString ( buffer, elcount( buffer ), hFile );
    snprintf( buffer, elcount( buffer ), "0.0000 KCAN_LH_Bremsl_re_def := %X\n", getValue( KCAN_LH_Bremsl_re_def ) );    filePutString ( buffer, elcount( buffer ), hFile );
    snprintf( buffer, elcount( buffer ), "0.0000 KCAN_LH_Bremsl_re_ges_def := %X\n", getValue( KCAN_LH_Bremsl_re_ges_def ) );    filePutString ( buffer, elcount( buffer ), hFile );
    snprintf( buffer, elcount( buffer ), "0.0000 KCAN_LH_Bremslicht_H_aktiv := %X\n", getValue( KCAN_LH_Bremslicht_H_aktiv ) );    filePutString ( buffer, elcount( buffer ), hFile );
    snprintf( buffer, elcount( buffer ), "0.0000 KCAN_LH_Kennzl_def := %X\n", getValue( KCAN_LH_Kennzl_def ) );    filePutString ( buffer, elcount( buffer ), hFile );
    snprintf( buffer, elcount( buffer ), "0.0000 KCAN_LH_Nebel_li_def := %X\n", getValue( KCAN_LH_Nebel_li_def ) );    filePutString ( buffer, elcount( buffer ), hFile );
    snprintf( buffer, elcount( buffer ), "0.0000 KCAN_LH_Nebel_mi_def := %X\n", getValue( KCAN_LH_Nebel_mi_def ) );    filePutString ( buffer, elcount( buffer ), hFile );
    snprintf( buffer, elcount( buffer ), "0.0000 KCAN_LH_Nebel_re_def := %X\n", getValue( KCAN_LH_Nebel_re_def ) );    filePutString ( buffer, elcount( buffer ), hFile );
    snprintf( buffer, elcount( buffer ), "0.0000 KCAN_LH_Nebelschluss_aktiv := %X\n", getValue( KCAN_LH_Nebelschluss_aktiv ) );    filePutString ( buffer, elcount( buffer ), hFile );
    snprintf( buffer, elcount( buffer ), "0.0000 KCAN_LH_Parklicht_HL_aktiv := %X\n", getValue( KCAN_LH_Parklicht_HL_aktiv ) );    filePutString ( buffer, elcount( buffer ), hFile );
    snprintf( buffer, elcount( buffer ), "0.0000 KCAN_LH_Parklicht_HR_aktiv := %X\n", getValue( KCAN_LH_Parklicht_HR_aktiv ) );    filePutString ( buffer, elcount( buffer ), hFile );
    snprintf( buffer, elcount( buffer ), "0.0000 KCAN_LH_Rueckf_li_def := %X\n", getValue( KCAN_LH_Rueckf_li_def ) );    filePutString ( buffer, elcount( buffer ), hFile );
    snprintf( buffer, elcount( buffer ), "0.0000 KCAN_LH_Rueckf_mi_def := %X\n", getValue( KCAN_LH_Rueckf_mi_def ) );    filePutString ( buffer, elcount( buffer ), hFile );
    snprintf( buffer, elcount( buffer ), "0.0000 KCAN_LH_Rueckf_re_def  := %X\n", getValue( KCAN_LH_Rueckf_re_def  ) );    filePutString ( buffer, elcount( buffer ), hFile );
    snprintf( buffer, elcount( buffer ), "0.0000 KCAN_LH_Rueckfahrlicht_aktiv := %X\n", getValue( KCAN_LH_Rueckfahrlicht_aktiv ) );    filePutString ( buffer, elcount( buffer ), hFile );
    snprintf( buffer, elcount( buffer ), "0.0000 KCAN_LH_Schluss_Brems_li_def := %X\n", getValue( KCAN_LH_Schluss_Brems_li_def ) );    filePutString ( buffer, elcount( buffer ), hFile );
    snprintf( buffer, elcount( buffer ), "0.0000 KCAN_LH_Schluss_Brems_Nebel_li_def := %X\n", getValue( KCAN_LH_Schluss_Brems_Nebel_li_def ) );    filePutString ( buffer, elcount( buffer ), hFile );
    snprintf( buffer, elcount( buffer ), "0.0000 KCAN_LH_Schluss_Brems_Nebel_re_def := %X\n", getValue( KCAN_LH_Schluss_Brems_Nebel_re_def ) );    filePutString ( buffer, elcount( buffer ), hFile );
    snprintf( buffer, elcount( buffer ), "0.0000 KCAN_LH_Schluss_Brems_re_def := %X\n", getValue( KCAN_LH_Schluss_Brems_re_def ) );    filePutString ( buffer, elcount( buffer ), hFile );
    snprintf( buffer, elcount( buffer ), "0.0000 KCAN_LH_Schluss_Nebel_li_def := %X\n", getValue( KCAN_LH_Schluss_Nebel_li_def ) );    filePutString ( buffer, elcount( buffer ), hFile );
    snprintf( buffer, elcount( buffer ), "0.0000 KCAN_LH_Schluss_Nebel_re_def := %X\n", getValue( KCAN_LH_Schluss_Nebel_re_def ) );    filePutString ( buffer, elcount( buffer ), hFile );
    snprintf( buffer, elcount( buffer ), "0.0000 KCAN_LH_Schlusslicht_li_def := %X\n", getValue( KCAN_LH_Schlusslicht_li_def ) );    filePutString ( buffer, elcount( buffer ), hFile );
    snprintf( buffer, elcount( buffer ), "0.0000 KCAN_LH_Schlusslicht_re_def := %X\n", getValue( KCAN_LH_Schlusslicht_re_def ) );    filePutString ( buffer, elcount( buffer ), hFile );
    snprintf( buffer, elcount( buffer ), "0.0000 KCAN_LH_SL_BRL_BLK_li_def := %X\n", getValue( KCAN_LH_SL_BRL_BLK_li_def ) );    filePutString ( buffer, elcount( buffer ), hFile );
    snprintf( buffer, elcount( buffer ), "0.0000 KCAN_LH_SL_BRL_BLK_re_def := %X\n", getValue( KCAN_LH_SL_BRL_BLK_re_def ) );    filePutString ( buffer, elcount( buffer ), hFile );
    snprintf( buffer, elcount( buffer ), "0.0000 KCAN_LH_Standlicht_H_aktiv := %X\n", getValue( KCAN_LH_Standlicht_H_aktiv ) );    filePutString ( buffer, elcount( buffer ), hFile );
}

on timer _tLicht_hinten_01
{
    putValue( KCAN__STMSG_Licht_hinten_01, 0 );
}

on EnvVar KCAN__STMSG_Licht_hinten_01
{
    long tDelay;
    if( getValue( this ) == 2 )
    {
        tDelay = getValue( KCAN__STMSGT_Licht_hinten_01 );
        if( tDelay > 0 )
            setTimer( _tLicht_hinten_01, tDelay );
        else
            putValue( KCAN__STMSG_Licht_hinten_01, 0 );
    }
}

on EnvVar KCAN__STMSGCT_Licht_hinten_01
{
    if( getValue( this ) > 0 )
    {
        _Licht_hinten_01_CycleCount = getValue( this ) / _Licht_hinten_01_Timebase;     // set cycle counter to initial value
        _Licht_hinten_01_SpontanFlag = 1;
    }
}

on envVar KCAN__MSGDLC_Licht_hinten_01
{
    _Licht_hinten_01_DLC = getValue( this );
}

on envVar KCAN__STMSG_PO_Licht_hinten_01
{
    if( getValue( this ) )
        openPanel( "Licht_hinten_01" );
}

on envVar KCAN__MSGDLoadDefault_Licht_hinten_01
{
    Licht_hinten_01_init();
}

on EnvVar KCAN_BCM_Status_Ladeanzeige
{
    _mLicht_hinten_01.BCM_Status_Ladeanzeige.phys = getValue(this);
    _Licht_hinten_01_SpontanFlag = 1;
}

on EnvVar KCAN_BCM2_Bremsl_durch_ECD
{
    _mLicht_hinten_01.BCM2_Bremsl_durch_ECD.phys = getValue(this);
    _Licht_hinten_01_SpontanFlag = 1;
}

on EnvVar KCAN_LH_3_Bremsl_def
{
    _mLicht_hinten_01.LH_3_Bremsl_def.phys = getValue(this);
    _Licht_hinten_01_SpontanFlag = 1;
}

on EnvVar KCAN_LH_Aussenlicht_def
{
    _mLicht_hinten_01.LH_Aussenlicht_def.phys = getValue(this);
    _Licht_hinten_01_SpontanFlag = 1;
}

on EnvVar KCAN_LH_Blinker_HL_akt
{
    _mLicht_hinten_01.LH_Blinker_HL_akt.phys = getValue(this);
    _Licht_hinten_01_SpontanFlag = 1;
}

on EnvVar KCAN_LH_Blinker_HR_akt
{
    _mLicht_hinten_01.LH_Blinker_HR_akt.phys = getValue(this);
    _Licht_hinten_01_SpontanFlag = 1;
}

on EnvVar KCAN_LH_Blinker_li_def
{
    _mLicht_hinten_01.LH_Blinker_li_def.phys = getValue(this);
    _Licht_hinten_01_SpontanFlag = 1;
}

on EnvVar KCAN_LH_Blinker_re_def
{
    _mLicht_hinten_01.LH_Blinker_re_def.phys = getValue(this);
    _Licht_hinten_01_SpontanFlag = 1;
}

on EnvVar KCAN_LH_Brems_Blk_li_def
{
    _mLicht_hinten_01.LH_Brems_Blk_li_def.phys = getValue(this);
    _Licht_hinten_01_SpontanFlag = 1;
}

on EnvVar KCAN_LH_Brems_Blk_re_def
{
    _mLicht_hinten_01.LH_Brems_Blk_re_def.phys = getValue(this);
    _Licht_hinten_01_SpontanFlag = 1;
}

on EnvVar KCAN_LH_Bremsl_li_def
{
    _mLicht_hinten_01.LH_Bremsl_li_def.phys = getValue(this);
    _Licht_hinten_01_SpontanFlag = 1;
}

on EnvVar KCAN_LH_Bremsl_li_ges_def
{
    _mLicht_hinten_01.LH_Bremsl_li_ges_def.phys = getValue(this);
    _Licht_hinten_01_SpontanFlag = 1;
}

on EnvVar KCAN_LH_Bremsl_re_def
{
    _mLicht_hinten_01.LH_Bremsl_re_def.phys = getValue(this);
    _Licht_hinten_01_SpontanFlag = 1;
}

on EnvVar KCAN_LH_Bremsl_re_ges_def
{
    _mLicht_hinten_01.LH_Bremsl_re_ges_def.phys = getValue(this);
    _Licht_hinten_01_SpontanFlag = 1;
}

on EnvVar KCAN_LH_Bremslicht_H_aktiv
{
    _mLicht_hinten_01.LH_Bremslicht_H_aktiv.phys = getValue(this);
    _Licht_hinten_01_SpontanFlag = 1;
}

on EnvVar KCAN_LH_Kennzl_def
{
    _mLicht_hinten_01.LH_Kennzl_def.phys = getValue(this);
    _Licht_hinten_01_SpontanFlag = 1;
}

on EnvVar KCAN_LH_Nebel_li_def
{
    _mLicht_hinten_01.LH_Nebel_li_def.phys = getValue(this);
    _Licht_hinten_01_SpontanFlag = 1;
}

on EnvVar KCAN_LH_Nebel_mi_def
{
    _mLicht_hinten_01.LH_Nebel_mi_def.phys = getValue(this);
    _Licht_hinten_01_SpontanFlag = 1;
}

on EnvVar KCAN_LH_Nebel_re_def
{
    _mLicht_hinten_01.LH_Nebel_re_def.phys = getValue(this);
    _Licht_hinten_01_SpontanFlag = 1;
}

on EnvVar KCAN_LH_Nebelschluss_aktiv
{
    _mLicht_hinten_01.LH_Nebelschluss_aktiv.phys = getValue(this);
    _Licht_hinten_01_SpontanFlag = 1;
}

on EnvVar KCAN_LH_Parklicht_HL_aktiv
{
    _mLicht_hinten_01.LH_Parklicht_HL_aktiv.phys = getValue(this);
    _Licht_hinten_01_SpontanFlag = 1;
}

on EnvVar KCAN_LH_Parklicht_HR_aktiv
{
    _mLicht_hinten_01.LH_Parklicht_HR_aktiv.phys = getValue(this);
    _Licht_hinten_01_SpontanFlag = 1;
}

on EnvVar KCAN_LH_Rueckf_li_def
{
    _mLicht_hinten_01.LH_Rueckf_li_def.phys = getValue(this);
    _Licht_hinten_01_SpontanFlag = 1;
}

on EnvVar KCAN_LH_Rueckf_mi_def
{
    _mLicht_hinten_01.LH_Rueckf_mi_def.phys = getValue(this);
    _Licht_hinten_01_SpontanFlag = 1;
}

on EnvVar KCAN_LH_Rueckf_re_def
{
    _mLicht_hinten_01.LH_Rueckf_re_def.phys = getValue(this);
    _Licht_hinten_01_SpontanFlag = 1;
}

on EnvVar KCAN_LH_Rueckfahrlicht_aktiv
{
    _mLicht_hinten_01.LH_Rueckfahrlicht_aktiv.phys = getValue(this);
    _Licht_hinten_01_SpontanFlag = 1;
}

on EnvVar KCAN_LH_Schluss_Brems_li_def
{
    _mLicht_hinten_01.LH_Schluss_Brems_li_def.phys = getValue(this);
    _Licht_hinten_01_SpontanFlag = 1;
}

on EnvVar KCAN_LH_Schluss_Brems_Nebel_li_def
{
    _mLicht_hinten_01.LH_Schluss_Brems_Nebel_li_def.phys = getValue(this);
    _Licht_hinten_01_SpontanFlag = 1;
}

on EnvVar KCAN_LH_Schluss_Brems_Nebel_re_def
{
    _mLicht_hinten_01.LH_Schluss_Brems_Nebel_re_def.phys = getValue(this);
    _Licht_hinten_01_SpontanFlag = 1;
}

on EnvVar KCAN_LH_Schluss_Brems_re_def
{
    _mLicht_hinten_01.LH_Schluss_Brems_re_def.phys = getValue(this);
    _Licht_hinten_01_SpontanFlag = 1;
}

on EnvVar KCAN_LH_Schluss_Nebel_li_def
{
    _mLicht_hinten_01.LH_Schluss_Nebel_li_def.phys = getValue(this);
    _Licht_hinten_01_SpontanFlag = 1;
}

on EnvVar KCAN_LH_Schluss_Nebel_re_def
{
    _mLicht_hinten_01.LH_Schluss_Nebel_re_def.phys = getValue(this);
    _Licht_hinten_01_SpontanFlag = 1;
}

on EnvVar KCAN_LH_Schlusslicht_li_def
{
    _mLicht_hinten_01.LH_Schlusslicht_li_def.phys = getValue(this);
    _Licht_hinten_01_SpontanFlag = 1;
}

on EnvVar KCAN_LH_Schlusslicht_re_def
{
    _mLicht_hinten_01.LH_Schlusslicht_re_def.phys = getValue(this);
    _Licht_hinten_01_SpontanFlag = 1;
}

on EnvVar KCAN_LH_SL_BRL_BLK_li_def
{
    _mLicht_hinten_01.LH_SL_BRL_BLK_li_def.phys = getValue(this);
    _Licht_hinten_01_SpontanFlag = 1;
}

on EnvVar KCAN_LH_SL_BRL_BLK_re_def
{
    _mLicht_hinten_01.LH_SL_BRL_BLK_re_def.phys = getValue(this);
    _Licht_hinten_01_SpontanFlag = 1;
}

on EnvVar KCAN_LH_Standlicht_H_aktiv
{
    _mLicht_hinten_01.LH_Standlicht_H_aktiv.phys = getValue(this);
    _Licht_hinten_01_SpontanFlag = 1;
}

*/

/*
Licht_vorne_01_check_output()
{
    if( !getValue( KCAN__STMSG_Licht_vorne_01 ) )
    {
    //  message   Licht_vorne_01 ID: 1624 --- Sendeart 0 cyclicX --- 
        if( _Licht_vorne_01_DelayCnt > 0) _Licht_vorne_01_DelayCnt--; // Mindestsendeabstand
        _Licht_vorne_01_Cnt--;
        if( _Licht_vorne_01_Cnt < 1 )
        {
            if( _Licht_vorne_01_DelayCnt < 1 )
            {
                Licht_vorne_01_output(); // Nachricht wg. abgelaufenem Zyklus ausgeben (Mindestsendeabstand eingehalten)
//                _Licht_vorne_01_SpontanFlag = 0; // Spontan-Flag zurücksetzen
                _Licht_vorne_01_DelayCnt = _Licht_vorne_01_MinDelay;
            }
            else
            {
                // Spontanflag setzen damit nach Ablauf Mindestsendeabstand gesendet wird
//                _Licht_vorne_01_SpontanFlag = 1;
            }
            _Licht_vorne_01_Cnt = _Licht_vorne_01_CycleCount; // Zyklus-Zähler zurücksetzen
        }*/
/*        else if( _Licht_vorne_01_SpontanFlag)
        {
            if( _Licht_vorne_01_DelayCnt < 1 )
            {
                Licht_vorne_01_output(); // Nachricht wg. spontaner Änderung ausgeben (Mindestsendeabstand eingehalten)
                _Licht_vorne_01_SpontanFlag = 0; // Spontan-Flag zurücksetzen
                _Licht_vorne_01_DelayCnt = _Licht_vorne_01_MinDelay;
            }
        }*//*
    }
}

Licht_vorne_01_init()
{  
*/
/* Botschaft Licht_vorne_01 ID: 1624 --- Sendeart 0 cyclicX --- 
BA_ "VAGTP20_API" BO_ 1624 0;
BA_ "VAGTP20_DynConnection" BO_ 1624 0;
BA_ "VAGTP20_DynSetup" BO_ 1624 0;
BA_ "VAGTP20_StatConnection" BO_ 1624 0;
BA_ "DiagRequest" BO_ 1624 0;
BA_ "DiagResponse" BO_ 1624 0;
BA_ "DiagState" BO_ 1624 0;
BA_ "MsgType" BO_ 1624 0;
BA_ "NmhMessage" BO_ 1624 0;  
BA_ "NmMessage" BO_ 1624 0;
BA_ "GenMsgILSupport" BO_ 1624 1;
BA_ "GenMsgPDUConstants" BO_ 1624 "0x46, 0x0F, 0xE0, 0xCC, 0xBE, 0xB1, 0xD7, 0xF1, 0x1F, 0x31, 0xC1, 0x25, 0xB4, 0x3E, 0xC8, 0xA3";
BA_ "GenMsgStartDelayTime" BO_ 1624 0;
BA_ "GenMsgDelayTime" BO_ 1624 50;
BA_ "GenMsgCycleTime" BO_ 1624 1000;
BA_ "GenMsgSendType" BO_ 1624 0;
*/
/*
    _Licht_vorne_01_Timebase             = c_tDBKomTimer_20ms;
    _Licht_vorne_01_CycleCount         = 1000 / _Licht_vorne_01_Timebase;
    _Licht_vorne_01_StartDelay            = 0 / _Licht_vorne_01_Timebase;
    _Licht_vorne_01_MinDelay             = 50 / _Licht_vorne_01_Timebase;
    _Licht_vorne_01_Cnt = _Licht_vorne_01_StartDelay;
    _Licht_vorne_01_SpontanFlag = 0;
    _Licht_vorne_01_DelayCnt = 0;
    _Licht_vorne_01_DLC = 6;

    putValue( KCAN__STMSGSD_Licht_vorne_01, _Licht_vorne_01_StartDelay * _Licht_vorne_01_Timebase );
    putValue( KCAN__STMSGCT_Licht_vorne_01, _Licht_vorne_01_CycleCount * _Licht_vorne_01_Timebase );
    putValue( KCAN__MSGDLC_Licht_vorne_01,  _Licht_vorne_01_DLC );
    
    _mLicht_vorne_01.Klima_Licht_Dunkelheit_aktiv.phys = getValue( KCAN_Klima_Licht_Dunkelheit_aktiv );
    _mLicht_vorne_01.Klima_Linksverkehr.phys = getValue( KCAN_Klima_Linksverkehr );
    _mLicht_vorne_01.LV_Abbiegelicht_li_def.phys = getValue( KCAN_LV_Abbiegelicht_li_def );
    _mLicht_vorne_01.LV_Abbiegelicht_re_def.phys = getValue( KCAN_LV_Abbiegelicht_re_def );
    _mLicht_vorne_01.LV_Abblend_Fernlicht_li_def.phys = getValue( KCAN_LV_Abblend_Fernlicht_li_def );
    _mLicht_vorne_01.LV_Abblend_Fernlicht_re_def.phys = getValue( KCAN_LV_Abblend_Fernlicht_re_def );
    _mLicht_vorne_01.LV_Abblendlicht_Anzeige.phys = getValue( KCAN_LV_Abblendlicht_Anzeige );
    _mLicht_vorne_01.LV_Abblendlicht_li_def.phys = getValue( KCAN_LV_Abblendlicht_li_def );
    _mLicht_vorne_01.LV_Abblendlicht_re_def.phys = getValue( KCAN_LV_Abblendlicht_re_def );
    _mLicht_vorne_01.LV_Abblendlicht_TFL_li_def.phys = getValue( KCAN_LV_Abblendlicht_TFL_li_def );
    _mLicht_vorne_01.LV_Abblendlicht_TFL_re_def.phys = getValue( KCAN_LV_Abblendlicht_TFL_re_def );
    _mLicht_vorne_01.LV_AFL_aktiv_Anzeige.phys = getValue( KCAN_LV_AFL_aktiv_Anzeige );
    _mLicht_vorne_01.LV_AFL_defekt.phys = getValue( KCAN_LV_AFL_defekt );
    _mLicht_vorne_01.LV_Aussenlicht_def.phys = getValue( KCAN_LV_Aussenlicht_def );
    _mLicht_vorne_01.LV_Blinker_li_def.phys = getValue( KCAN_LV_Blinker_li_def );
    _mLicht_vorne_01.LV_Blinker_re_def.phys = getValue( KCAN_LV_Blinker_re_def );
    _mLicht_vorne_01.LV_Blinker_VL_aktiv.phys = getValue( KCAN_LV_Blinker_VL_aktiv );
    _mLicht_vorne_01.LV_Blinker_VR_aktiv.phys = getValue( KCAN_LV_Blinker_VR_aktiv );
    _mLicht_vorne_01.LV_Blk_li_Seite_def.phys = getValue( KCAN_LV_Blk_li_Seite_def );
    _mLicht_vorne_01.LV_Blk_re_Seite_def.phys = getValue( KCAN_LV_Blk_re_Seite_def );
    _mLicht_vorne_01.LV_Fernlicht_Anzeige.phys = getValue( KCAN_LV_Fernlicht_Anzeige );
    _mLicht_vorne_01.LV_Fernlicht_li_def.phys = getValue( KCAN_LV_Fernlicht_li_def );
    _mLicht_vorne_01.LV_Fernlicht_re_def.phys = getValue( KCAN_LV_Fernlicht_re_def );
    _mLicht_vorne_01.LV_FLA_aktiv_Anzeige.phys = getValue( KCAN_LV_FLA_aktiv_Anzeige );
    _mLicht_vorne_01.LV_FLA_defekt.phys = getValue( KCAN_LV_FLA_defekt );
    _mLicht_vorne_01.LV_FLA_Sensor_blockiert.phys = getValue( KCAN_LV_FLA_Sensor_blockiert );
    _mLicht_vorne_01.LV_LED_Scheinwerfer_li_def.phys = getValue( KCAN_LV_LED_Scheinwerfer_li_def );
    _mLicht_vorne_01.LV_LED_Scheinwerfer_re_def.phys = getValue( KCAN_LV_LED_Scheinwerfer_re_def );
    _mLicht_vorne_01.LV_MXB_Status_Anzeige.phys = getValue( KCAN_LV_MXB_Status_Anzeige );
    _mLicht_vorne_01.LV_Nebellicht_Anzeige.phys = getValue( KCAN_LV_Nebellicht_Anzeige );
    _mLicht_vorne_01.LV_Nebellicht_li_def.phys = getValue( KCAN_LV_Nebellicht_li_def );
    _mLicht_vorne_01.LV_Nebellicht_re_def.phys = getValue( KCAN_LV_Nebellicht_re_def );
    _mLicht_vorne_01.LV_Nebellicht_TFL_li_def.phys = getValue( KCAN_LV_Nebellicht_TFL_li_def );
    _mLicht_vorne_01.LV_Nebellicht_TFL_re_def.phys = getValue( KCAN_LV_Nebellicht_TFL_re_def );
    _mLicht_vorne_01.LV_Nebelschlusslicht_Anzeige.phys = getValue( KCAN_LV_Nebelschlusslicht_Anzeige );
    _mLicht_vorne_01.LV_Standlicht_Anzeige.phys = getValue( KCAN_LV_Standlicht_Anzeige );
    _mLicht_vorne_01.LV_Standlicht_li_def.phys = getValue( KCAN_LV_Standlicht_li_def );
    _mLicht_vorne_01.LV_Standlicht_re_def.phys = getValue( KCAN_LV_Standlicht_re_def );
    _mLicht_vorne_01.LV_Standlicht_TFL_li_def.phys = getValue( KCAN_LV_Standlicht_TFL_li_def );
    _mLicht_vorne_01.LV_Standlicht_TFL_re_def.phys = getValue( KCAN_LV_Standlicht_TFL_re_def );
    _mLicht_vorne_01.LV_Tagfahrlicht_Anzeige.phys = getValue( KCAN_LV_Tagfahrlicht_Anzeige );
    _mLicht_vorne_01.LV_Tagfahrlicht_li_def.phys = getValue( KCAN_LV_Tagfahrlicht_li_def );
    _mLicht_vorne_01.LV_Tagfahrlicht_re_def.phys = getValue( KCAN_LV_Tagfahrlicht_re_def );
}

Licht_vorne_01_output(void)
{
    byte crc;
    byte SQC_help;

    SQC_help = getValue( KCAN_Licht_Anf_01_BZ ); //get copy of actual EnvVar
    if( !getValue( KCAN_Licht_Anf_01_BZ_Auto ) ) // automatic SQC-calculation active ?
    {
        if( SQC_help == _Licht_Anf_01_SQC_TriggPos ) // start injection of error when trigger reached
        {
            _Licht_Anf_01_E2E_Armed = 1;   // run
            putValue( KCAN_Licht_Anf_01_E2E_State, 1 );
        }
        // calculate new sequence counter
        
        if( ( _Licht_Anf_01_SQC_WrongSeqJump != 0 ) &&
            ( _Licht_Anf_01_E2E_Armed == 1        )    )
        {
            SQC_help = SQC_help + 16 + _Licht_Anf_01_SQC_WrongSeqJump;
            if( SQC_help > 15 )
                SQC_help = SQC_help - 16;
            if( SQC_help > 15 )
                SQC_help = SQC_help - 16;
            _Licht_Anf_01_SQC_WrongSeqJump = 0;
        }
        
        if( ( _Licht_Anf_01_SQC_RepeatedCnt ) &&
            ( _Licht_Anf_01_E2E_Armed == 1  )    )
        {
            _Licht_Anf_01_SQC_RepeatedCnt--;
        }
        else
        {
            if( SQC_help >= 15 ) SQC_help = 0;
            else SQC_help++;
        }
            
        putValue( KCAN_Licht_Anf_01_BZ, SQC_help );
    }
//    _mLicht_Anf_01.Licht_Anf_01_BZ = SQC_help; not excisting

    if( !getValue( KCAN_Licht_Anf_01_CRC_Auto ) )
    {   // CRC according Profile_02 ( W213 )
        // berechne crc
        crc = 0xFF;
//      crc = crctable[ crc ^ _mLicht_Anf_01.byte( 0 ) ];  CRC
        crc = crctable[ crc ^ _mLicht_Anf_01.byte( 1 ) ];
        crc = crctable[ crc ^ _mLicht_Anf_01.byte( 2 ) ];
        crc = crctable[ crc ^ _mLicht_Anf_01.byte( 3 ) ];
        crc = crctable[ crc ^ _mLicht_Anf_01.byte( 4 ) ];
        crc = crctable[ crc ^ _mLicht_Anf_01.byte( 5 ) ];
        crc = crctable[ crc ^ _mLicht_Anf_01.byte( 6 ) ];
        crc = crctable[ crc ^ _mLicht_Anf_01.byte( 7 ) ];
        crc = crctable[ crc ^ _Licht_Anf_01_CRC_Offset[ _mLicht_Anf_01.Licht_Anf_01_BZ ] ]; // load offset
        crc = (crc ^ 0xFF);

        if( ( _Licht_Anf_01_CRC_ErrorCnt   && ( _Licht_Anf_01_E2E_Armed == 1   ) ) ||
            ( getValue( KCAN_Licht_Anf_01_CRC_Invalid )                                         )    )
        {
            crc++;
            if( _Licht_Anf_01_CRC_ErrorCnt > 0 )
                _Licht_Anf_01_CRC_ErrorCnt--; 
        }
 //       _mLicht_Anf_01.Licht_Anf_01_CRC = crc; not excisting
        putValue( KCAN_Licht_Anf_01_CRC, crc );
    }
    else
        _mLicht_Anf_01.Licht_Anf_01_CRC = getValue( KCAN_Licht_Anf_01_CRC );

    if( ( _Licht_Anf_01_MSG_DropCnt > 0 ) &&
        ( _Licht_Anf_01_E2E_Armed == 1  )    )
    {
        _Licht_Anf_01_MSG_DropCnt--;  // do not send message
    }
    else
    {
        _mLicht_Anf_01.DLC = _Licht_Anf_01_DLC;
        output( _mLicht_Anf_01 );
    }
        
    if( _Licht_Anf_01_E2E_Armed == 1 )
    {
        if ( ( _Licht_Anf_01_MSG_DropCnt == 0      ) &&
             ( _Licht_Anf_01_CRC_ErrorCnt == 0     ) &&
             ( _Licht_Anf_01_SQC_RepeatedCnt == 0  ) &&
             ( _Licht_Anf_01_SQC_WrongSeqJump == 0 )    )
        {
            _Licht_Anf_01_E2E_Armed = 0; // no further influence, injetion completed
            putValue( KCAN_Licht_Anf_01_E2E_State, 0 );
        }
    }
}

Licht_vorne_01_saveEnvVars( dword hFile )
{
    filePutString("\n// Knoten BCM: Licht_vorne_01\n", 28, hFile );
    snprintf( buffer, elcount( buffer ), "0.0000 KCAN__STMSG_Licht_vorne_01 := %X\n", getValue( KCAN__STMSG_Licht_vorne_01 ) );            filePutString ( buffer, elcount( buffer ), hFile );
    snprintf( buffer, elcount( buffer ), "0.0000 KCAN__STMSGT_Licht_vorne_01 := %X\n", getValue( KCAN__STMSGT_Licht_vorne_01 ) );        filePutString ( buffer, elcount( buffer ), hFile );
    snprintf( buffer, elcount( buffer ), "0.0000 KCAN_Licht_Anf_01_BZ := %X\n", getValue( KCAN_Licht_Anf_01_BZ ) );    filePutString ( buffer, elcount( buffer ), hFile );
    snprintf( buffer, elcount( buffer ), "0.0000 KCAN_Licht_Anf_01_BZ_Auto := %X\n", getValue( KCAN_Licht_Anf_01_BZ_Auto ) );    filePutString ( buffer, elcount( buffer ), hFile );
    snprintf( buffer, elcount( buffer ), "0.0000 KCAN_Licht_Anf_01_CRC := %X\n", getValue( KCAN_Licht_Anf_01_CRC ) );    filePutString ( buffer, elcount( buffer ), hFile );
    snprintf( buffer, elcount( buffer ), "0.0000 KCAN_Licht_Anf_01_CRC_Auto := %X\n", getValue( KCAN_Licht_Anf_01_CRC_Auto ) );    filePutString ( buffer, elcount( buffer ), hFile );
    snprintf( buffer, elcount( buffer ), "0.0000 KCAN_Klima_Licht_Dunkelheit_aktiv := %X\n", getValue( KCAN_Klima_Licht_Dunkelheit_aktiv ) );    filePutString ( buffer, elcount( buffer ), hFile );
    snprintf( buffer, elcount( buffer ), "0.0000 KCAN_Klima_Linksverkehr := %X\n", getValue( KCAN_Klima_Linksverkehr ) );    filePutString ( buffer, elcount( buffer ), hFile );
    snprintf( buffer, elcount( buffer ), "0.0000 KCAN_LV_Abbiegelicht_li_def := %X\n", getValue( KCAN_LV_Abbiegelicht_li_def ) );    filePutString ( buffer, elcount( buffer ), hFile );
    snprintf( buffer, elcount( buffer ), "0.0000 KCAN_LV_Abbiegelicht_re_def := %X\n", getValue( KCAN_LV_Abbiegelicht_re_def ) );    filePutString ( buffer, elcount( buffer ), hFile );
    snprintf( buffer, elcount( buffer ), "0.0000 KCAN_LV_Abblend_Fernlicht_li_def := %X\n", getValue( KCAN_LV_Abblend_Fernlicht_li_def ) );    filePutString ( buffer, elcount( buffer ), hFile );
    snprintf( buffer, elcount( buffer ), "0.0000 KCAN_LV_Abblend_Fernlicht_re_def := %X\n", getValue( KCAN_LV_Abblend_Fernlicht_re_def ) );    filePutString ( buffer, elcount( buffer ), hFile );
    snprintf( buffer, elcount( buffer ), "0.0000 KCAN_LV_Abblendlicht_Anzeige := %X\n", getValue( KCAN_LV_Abblendlicht_Anzeige ) );    filePutString ( buffer, elcount( buffer ), hFile );
    snprintf( buffer, elcount( buffer ), "0.0000 KCAN_LV_Abblendlicht_li_def := %X\n", getValue( KCAN_LV_Abblendlicht_li_def ) );    filePutString ( buffer, elcount( buffer ), hFile );
    snprintf( buffer, elcount( buffer ), "0.0000 KCAN_LV_Abblendlicht_re_def := %X\n", getValue( KCAN_LV_Abblendlicht_re_def ) );    filePutString ( buffer, elcount( buffer ), hFile );
    snprintf( buffer, elcount( buffer ), "0.0000 KCAN_LV_Abblendlicht_TFL_li_def := %X\n", getValue( KCAN_LV_Abblendlicht_TFL_li_def ) );    filePutString ( buffer, elcount( buffer ), hFile );
    snprintf( buffer, elcount( buffer ), "0.0000 KCAN_LV_Abblendlicht_TFL_re_def := %X\n", getValue( KCAN_LV_Abblendlicht_TFL_re_def ) );    filePutString ( buffer, elcount( buffer ), hFile );
    snprintf( buffer, elcount( buffer ), "0.0000 KCAN_LV_AFL_aktiv_Anzeige := %X\n", getValue( KCAN_LV_AFL_aktiv_Anzeige ) );    filePutString ( buffer, elcount( buffer ), hFile );
    snprintf( buffer, elcount( buffer ), "0.0000 KCAN_LV_AFL_defekt := %X\n", getValue( KCAN_LV_AFL_defekt ) );    filePutString ( buffer, elcount( buffer ), hFile );
    snprintf( buffer, elcount( buffer ), "0.0000 KCAN_LV_Aussenlicht_def := %X\n", getValue( KCAN_LV_Aussenlicht_def ) );    filePutString ( buffer, elcount( buffer ), hFile );
    snprintf( buffer, elcount( buffer ), "0.0000 KCAN_LV_Blinker_li_def := %X\n", getValue( KCAN_LV_Blinker_li_def ) );    filePutString ( buffer, elcount( buffer ), hFile );
    snprintf( buffer, elcount( buffer ), "0.0000 KCAN_LV_Blinker_re_def := %X\n", getValue( KCAN_LV_Blinker_re_def ) );    filePutString ( buffer, elcount( buffer ), hFile );
    snprintf( buffer, elcount( buffer ), "0.0000 KCAN_LV_Blinker_VL_aktiv := %X\n", getValue( KCAN_LV_Blinker_VL_aktiv ) );    filePutString ( buffer, elcount( buffer ), hFile );
    snprintf( buffer, elcount( buffer ), "0.0000 KCAN_LV_Blinker_VR_aktiv := %X\n", getValue( KCAN_LV_Blinker_VR_aktiv ) );    filePutString ( buffer, elcount( buffer ), hFile );
    snprintf( buffer, elcount( buffer ), "0.0000 KCAN_LV_Blk_li_Seite_def := %X\n", getValue( KCAN_LV_Blk_li_Seite_def ) );    filePutString ( buffer, elcount( buffer ), hFile );
    snprintf( buffer, elcount( buffer ), "0.0000 KCAN_LV_Blk_re_Seite_def := %X\n", getValue( KCAN_LV_Blk_re_Seite_def ) );    filePutString ( buffer, elcount( buffer ), hFile );
    snprintf( buffer, elcount( buffer ), "0.0000 KCAN_LV_Fernlicht_Anzeige := %X\n", getValue( KCAN_LV_Fernlicht_Anzeige ) );    filePutString ( buffer, elcount( buffer ), hFile );
    snprintf( buffer, elcount( buffer ), "0.0000 KCAN_LV_Fernlicht_li_def := %X\n", getValue( KCAN_LV_Fernlicht_li_def ) );    filePutString ( buffer, elcount( buffer ), hFile );
    snprintf( buffer, elcount( buffer ), "0.0000 KCAN_LV_Fernlicht_re_def := %X\n", getValue( KCAN_LV_Fernlicht_re_def ) );    filePutString ( buffer, elcount( buffer ), hFile );
    snprintf( buffer, elcount( buffer ), "0.0000 KCAN_LV_FLA_aktiv_Anzeige := %X\n", getValue( KCAN_LV_FLA_aktiv_Anzeige ) );    filePutString ( buffer, elcount( buffer ), hFile );
    snprintf( buffer, elcount( buffer ), "0.0000 KCAN_LV_FLA_defekt := %X\n", getValue( KCAN_LV_FLA_defekt ) );    filePutString ( buffer, elcount( buffer ), hFile );
    snprintf( buffer, elcount( buffer ), "0.0000 KCAN_LV_FLA_Sensor_blockiert := %X\n", getValue( KCAN_LV_FLA_Sensor_blockiert ) );    filePutString ( buffer, elcount( buffer ), hFile );
    snprintf( buffer, elcount( buffer ), "0.0000 KCAN_LV_LED_Scheinwerfer_li_def := %X\n", getValue( KCAN_LV_LED_Scheinwerfer_li_def ) );    filePutString ( buffer, elcount( buffer ), hFile );
    snprintf( buffer, elcount( buffer ), "0.0000 KCAN_LV_LED_Scheinwerfer_re_def := %X\n", getValue( KCAN_LV_LED_Scheinwerfer_re_def ) );    filePutString ( buffer, elcount( buffer ), hFile );
    snprintf( buffer, elcount( buffer ), "0.0000 KCAN_LV_MXB_Status_Anzeige := %X\n", getValue( KCAN_LV_MXB_Status_Anzeige ) );    filePutString ( buffer, elcount( buffer ), hFile );
    snprintf( buffer, elcount( buffer ), "0.0000 KCAN_LV_Nebellicht_Anzeige := %X\n", getValue( KCAN_LV_Nebellicht_Anzeige ) );    filePutString ( buffer, elcount( buffer ), hFile );
    snprintf( buffer, elcount( buffer ), "0.0000 KCAN_LV_Nebellicht_li_def := %X\n", getValue( KCAN_LV_Nebellicht_li_def ) );    filePutString ( buffer, elcount( buffer ), hFile );
    snprintf( buffer, elcount( buffer ), "0.0000 KCAN_LV_Nebellicht_re_def := %X\n", getValue( KCAN_LV_Nebellicht_re_def ) );    filePutString ( buffer, elcount( buffer ), hFile );
    snprintf( buffer, elcount( buffer ), "0.0000 KCAN_LV_Nebellicht_TFL_li_def := %X\n", getValue( KCAN_LV_Nebellicht_TFL_li_def ) );    filePutString ( buffer, elcount( buffer ), hFile );
    snprintf( buffer, elcount( buffer ), "0.0000 KCAN_LV_Nebellicht_TFL_re_def := %X\n", getValue( KCAN_LV_Nebellicht_TFL_re_def ) );    filePutString ( buffer, elcount( buffer ), hFile );
    snprintf( buffer, elcount( buffer ), "0.0000 KCAN_LV_Nebelschlusslicht_Anzeige := %X\n", getValue( KCAN_LV_Nebelschlusslicht_Anzeige ) );    filePutString ( buffer, elcount( buffer ), hFile );
    snprintf( buffer, elcount( buffer ), "0.0000 KCAN_LV_Standlicht_Anzeige := %X\n", getValue( KCAN_LV_Standlicht_Anzeige ) );    filePutString ( buffer, elcount( buffer ), hFile );
    snprintf( buffer, elcount( buffer ), "0.0000 KCAN_LV_Standlicht_li_def := %X\n", getValue( KCAN_LV_Standlicht_li_def ) );    filePutString ( buffer, elcount( buffer ), hFile );
    snprintf( buffer, elcount( buffer ), "0.0000 KCAN_LV_Standlicht_re_def := %X\n", getValue( KCAN_LV_Standlicht_re_def ) );    filePutString ( buffer, elcount( buffer ), hFile );
    snprintf( buffer, elcount( buffer ), "0.0000 KCAN_LV_Standlicht_TFL_li_def := %X\n", getValue( KCAN_LV_Standlicht_TFL_li_def ) );    filePutString ( buffer, elcount( buffer ), hFile );
    snprintf( buffer, elcount( buffer ), "0.0000 KCAN_LV_Standlicht_TFL_re_def := %X\n", getValue( KCAN_LV_Standlicht_TFL_re_def ) );    filePutString ( buffer, elcount( buffer ), hFile );
    snprintf( buffer, elcount( buffer ), "0.0000 KCAN_LV_Tagfahrlicht_Anzeige := %X\n", getValue( KCAN_LV_Tagfahrlicht_Anzeige ) );    filePutString ( buffer, elcount( buffer ), hFile );
    snprintf( buffer, elcount( buffer ), "0.0000 KCAN_LV_Tagfahrlicht_li_def := %X\n", getValue( KCAN_LV_Tagfahrlicht_li_def ) );    filePutString ( buffer, elcount( buffer ), hFile );
    snprintf( buffer, elcount( buffer ), "0.0000 KCAN_LV_Tagfahrlicht_re_def := %X\n", getValue( KCAN_LV_Tagfahrlicht_re_def ) );    filePutString ( buffer, elcount( buffer ), hFile );
}

on timer _tLicht_vorne_01
{
    putValue( KCAN__STMSG_Licht_vorne_01, 0 );
}

on EnvVar KCAN__STMSG_Licht_vorne_01
{
    long tDelay;
    if( getValue( this ) == 2 )
    {
        tDelay = getValue( KCAN__STMSGT_Licht_vorne_01 );
        if( tDelay > 0 )
            setTimer( _tLicht_vorne_01, tDelay );
        else
            putValue( KCAN__STMSG_Licht_vorne_01, 0 );
    }
}

on EnvVar KCAN__STMSGCT_Licht_vorne_01
{
    if( getValue( this ) > 0 )
    {
        _Licht_vorne_01_CycleCount = getValue( this ) / _Licht_vorne_01_Timebase;     // set cycle counter to initial value
        _Licht_vorne_01_SpontanFlag = 1;
    }
}

on envVar KCAN__MSGDLC_Licht_vorne_01
{
    _Licht_vorne_01_DLC = getValue( this );
}

on envVar KCAN__STMSG_PO_Licht_vorne_01
{
    if( getValue( this ) )
        openPanel( "Licht_vorne_01" );
}

on envVar KCAN__MSGDLoadDefault_Licht_vorne_01
{
    Licht_vorne_01_init();
}

on EnvVar KCAN_Klima_Licht_Dunkelheit_aktiv
{
    _mLicht_vorne_01.Klima_Licht_Dunkelheit_aktiv.phys = getValue(this);
    _Licht_vorne_01_SpontanFlag = 1;
}

on EnvVar KCAN_Klima_Linksverkehr
{
    _mLicht_vorne_01.Klima_Linksverkehr.phys = getValue(this);
    _Licht_vorne_01_SpontanFlag = 1;
}

on EnvVar KCAN_LV_Abbiegelicht_li_def
{
    _mLicht_vorne_01.LV_Abbiegelicht_li_def.phys = getValue(this);
    _Licht_vorne_01_SpontanFlag = 1;
}

on EnvVar KCAN_LV_Abbiegelicht_re_def
{
    _mLicht_vorne_01.LV_Abbiegelicht_re_def.phys = getValue(this);
    _Licht_vorne_01_SpontanFlag = 1;
}

on EnvVar KCAN_LV_Abblend_Fernlicht_li_def
{
    _mLicht_vorne_01.LV_Abblend_Fernlicht_li_def.phys = getValue(this);
    _Licht_vorne_01_SpontanFlag = 1;
}

on EnvVar KCAN_LV_Abblend_Fernlicht_re_def
{
    _mLicht_vorne_01.LV_Abblend_Fernlicht_re_def.phys = getValue(this);
    _Licht_vorne_01_SpontanFlag = 1;
}

on EnvVar KCAN_LV_Abblendlicht_Anzeige
{
    _mLicht_vorne_01.LV_Abblendlicht_Anzeige.phys = getValue(this);
    _Licht_vorne_01_SpontanFlag = 1;
}

on EnvVar KCAN_LV_Abblendlicht_li_def
{
    _mLicht_vorne_01.LV_Abblendlicht_li_def.phys = getValue(this);
    _Licht_vorne_01_SpontanFlag = 1;
}

on EnvVar KCAN_LV_Abblendlicht_re_def
{
    _mLicht_vorne_01.LV_Abblendlicht_re_def.phys = getValue(this);
    _Licht_vorne_01_SpontanFlag = 1;
}

on EnvVar KCAN_LV_Abblendlicht_TFL_li_def
{
    _mLicht_vorne_01.LV_Abblendlicht_TFL_li_def.phys = getValue(this);
    _Licht_vorne_01_SpontanFlag = 1;
}

on EnvVar KCAN_LV_Abblendlicht_TFL_re_def
{
    _mLicht_vorne_01.LV_Abblendlicht_TFL_re_def.phys = getValue(this);
    _Licht_vorne_01_SpontanFlag = 1;
}

on EnvVar KCAN_LV_AFL_aktiv_Anzeige
{
    _mLicht_vorne_01.LV_AFL_aktiv_Anzeige.phys = getValue(this);
    _Licht_vorne_01_SpontanFlag = 1;
}

on EnvVar KCAN_LV_AFL_defekt
{
    _mLicht_vorne_01.LV_AFL_defekt.phys = getValue(this);
    _Licht_vorne_01_SpontanFlag = 1;
}

on EnvVar KCAN_LV_Aussenlicht_def
{
    _mLicht_vorne_01.LV_Aussenlicht_def.phys = getValue(this);
    _Licht_vorne_01_SpontanFlag = 1;
}

on EnvVar KCAN_LV_Blinker_li_def
{
    _mLicht_vorne_01.LV_Blinker_li_def.phys = getValue(this);
    _Licht_vorne_01_SpontanFlag = 1;
}

on EnvVar KCAN_LV_Blinker_re_def
{
    _mLicht_vorne_01.LV_Blinker_re_def.phys = getValue(this);
    _Licht_vorne_01_SpontanFlag = 1;
}

on EnvVar KCAN_LV_Blinker_VL_aktiv
{
    _mLicht_vorne_01.LV_Blinker_VL_aktiv.phys = getValue(this);
    _Licht_vorne_01_SpontanFlag = 1;
}

on EnvVar KCAN_LV_Blinker_VR_aktiv
{
    _mLicht_vorne_01.LV_Blinker_VR_aktiv.phys = getValue(this);
    _Licht_vorne_01_SpontanFlag = 1;
}

on EnvVar KCAN_LV_Blk_li_Seite_def
{
    _mLicht_vorne_01.LV_Blk_li_Seite_def.phys = getValue(this);
    _Licht_vorne_01_SpontanFlag = 1;
}

on EnvVar KCAN_LV_Blk_re_Seite_def
{
    _mLicht_vorne_01.LV_Blk_re_Seite_def.phys = getValue(this);
    _Licht_vorne_01_SpontanFlag = 1;
}

on EnvVar KCAN_LV_Fernlicht_Anzeige
{
    _mLicht_vorne_01.LV_Fernlicht_Anzeige.phys = getValue(this);
    _Licht_vorne_01_SpontanFlag = 1;
}

on EnvVar KCAN_LV_Fernlicht_li_def
{
    _mLicht_vorne_01.LV_Fernlicht_li_def.phys = getValue(this);
    _Licht_vorne_01_SpontanFlag = 1;
}

on EnvVar KCAN_LV_Fernlicht_re_def
{
    _mLicht_vorne_01.LV_Fernlicht_re_def.phys = getValue(this);
    _Licht_vorne_01_SpontanFlag = 1;
}

on EnvVar KCAN_LV_FLA_aktiv_Anzeige
{
    _mLicht_vorne_01.LV_FLA_aktiv_Anzeige.phys = getValue(this);
    _Licht_vorne_01_SpontanFlag = 1;
}

on EnvVar KCAN_LV_FLA_defekt
{
    _mLicht_vorne_01.LV_FLA_defekt.phys = getValue(this);
    _Licht_vorne_01_SpontanFlag = 1;
}

on EnvVar KCAN_LV_FLA_Sensor_blockiert
{
    _mLicht_vorne_01.LV_FLA_Sensor_blockiert.phys = getValue(this);
    _Licht_vorne_01_SpontanFlag = 1;
}

on EnvVar KCAN_LV_LED_Scheinwerfer_li_def
{
    _mLicht_vorne_01.LV_LED_Scheinwerfer_li_def.phys = getValue(this);
    _Licht_vorne_01_SpontanFlag = 1;
}

on EnvVar KCAN_LV_LED_Scheinwerfer_re_def
{
    _mLicht_vorne_01.LV_LED_Scheinwerfer_re_def.phys = getValue(this);
    _Licht_vorne_01_SpontanFlag = 1;
}

on EnvVar KCAN_LV_MXB_Status_Anzeige
{
    _mLicht_vorne_01.LV_MXB_Status_Anzeige.phys = getValue(this);
    _Licht_vorne_01_SpontanFlag = 1;
}

on EnvVar KCAN_LV_Nebellicht_Anzeige
{
    _mLicht_vorne_01.LV_Nebellicht_Anzeige.phys = getValue(this);
    _Licht_vorne_01_SpontanFlag = 1;
}

on EnvVar KCAN_LV_Nebellicht_li_def
{
    _mLicht_vorne_01.LV_Nebellicht_li_def.phys = getValue(this);
    _Licht_vorne_01_SpontanFlag = 1;
}

on EnvVar KCAN_LV_Nebellicht_re_def
{
    _mLicht_vorne_01.LV_Nebellicht_re_def.phys = getValue(this);
    _Licht_vorne_01_SpontanFlag = 1;
}

on EnvVar KCAN_LV_Nebellicht_TFL_li_def
{
    _mLicht_vorne_01.LV_Nebellicht_TFL_li_def.phys = getValue(this);
    _Licht_vorne_01_SpontanFlag = 1;
}

on EnvVar KCAN_LV_Nebellicht_TFL_re_def
{
    _mLicht_vorne_01.LV_Nebellicht_TFL_re_def.phys = getValue(this);
    _Licht_vorne_01_SpontanFlag = 1;
}

on EnvVar KCAN_LV_Nebelschlusslicht_Anzeige
{
    _mLicht_vorne_01.LV_Nebelschlusslicht_Anzeige.phys = getValue(this);
    _Licht_vorne_01_SpontanFlag = 1;
}

on EnvVar KCAN_LV_Standlicht_Anzeige
{
    _mLicht_vorne_01.LV_Standlicht_Anzeige.phys = getValue(this);
    _Licht_vorne_01_SpontanFlag = 1;
}

on EnvVar KCAN_LV_Standlicht_li_def
{
    _mLicht_vorne_01.LV_Standlicht_li_def.phys = getValue(this);
    _Licht_vorne_01_SpontanFlag = 1;
}

on EnvVar KCAN_LV_Standlicht_re_def
{
    _mLicht_vorne_01.LV_Standlicht_re_def.phys = getValue(this);
    _Licht_vorne_01_SpontanFlag = 1;
}

on EnvVar KCAN_LV_Standlicht_TFL_li_def
{
    _mLicht_vorne_01.LV_Standlicht_TFL_li_def.phys = getValue(this);
    _Licht_vorne_01_SpontanFlag = 1;
}

on EnvVar KCAN_LV_Standlicht_TFL_re_def
{
    _mLicht_vorne_01.LV_Standlicht_TFL_re_def.phys = getValue(this);
    _Licht_vorne_01_SpontanFlag = 1;
}

on EnvVar KCAN_LV_Tagfahrlicht_Anzeige
{
    _mLicht_vorne_01.LV_Tagfahrlicht_Anzeige.phys = getValue(this);
    _Licht_vorne_01_SpontanFlag = 1;
}

on EnvVar KCAN_LV_Tagfahrlicht_li_def
{
    _mLicht_vorne_01.LV_Tagfahrlicht_li_def.phys = getValue(this);
    _Licht_vorne_01_SpontanFlag = 1;
}

on EnvVar KCAN_LV_Tagfahrlicht_re_def
{
    _mLicht_vorne_01.LV_Tagfahrlicht_re_def.phys = getValue(this);
    _Licht_vorne_01_SpontanFlag = 1;
}

*/
/*


BO_ 1411 ZV_02: 8 BCM
 SG_ BCM_FH_Freigabe : 12|1@1+ (1,0) [0|1] ""  FCM,Kessy_MQB_Gen1,Kessy_MQB_Gen2,SAD,TSG_BFS,TSG_FS,VSG
 SG_ BCM_HSK_Freigabe : 14|1@1+ (1,0) [0|1] ""  FCM
 SG_ BCM_Komfortfkt_Freigabe : 13|1@1+ (1,0) [0|1] ""  FCM,Kessy_MQB_Gen1,Kessy_MQB_Gen2,SAD,TSG_BFS,TSG_FS
 SG_ BCM_Tankklappensteller_Fehler : 61|1@1+ (1,0) [0|1] ""  FCM,Gateway_MQB
 SG_ BCM_Verdeck_Freigabe : 15|1@1+ (1,0) [0|1] ""  FCM,Kessy_MQB_Gen1,Kessy_MQB_Gen2,TSG_BFS,TSG_FS,VSG
 SG_ DWA_aktiv : 31|1@1+ (1,0) [0|1] ""  FCM,KFG,Kombi_MQB,MFG,OCU
 SG_ FBS_IDG_in_Reichweite : 41|1@1+ (1,0) [0|1] ""  FCM,HDSG
 SG_ FBS_Warn_Schluessel_Batt : 47|1@1+ (1,0) [0|1] ""  FCM,Kessy_MQB_Gen1,Kessy_MQB_Gen2,Kombi_MQB,Kombi_TT3
 SG_ FFB_Auf_Taste : 36|1@1+ (1,0) [0|1] ""  FCM,Kessy_MQB_Gen1,Kessy_MQB_Gen2,OCU,SitzMemo_FS
 SG_ FFB_CarFinder : 38|1@1+ (1,0) [0|1] ""  FCM
 SG_ FFB_HDF_Taste : 34|1@1+ (1,0) [0|1] ""  AAG,FCM,HDSG,Kessy_MQB_Gen1,Kessy_MQB_Gen2
 SG_ FFB_Komfortoeffnen : 39|1@1+ (1,0) [0|1] ""  FCM
 SG_ FFB_Komfortschliessen : 40|1@1+ (1,0) [0|1] ""  FCM,HDSG
 SG_ FFB_Panik_Taste : 35|1@1+ (1,0) [0|1] ""  FCM,Kessy_MQB_Gen1,Kessy_MQB_Gen2,SitzMemo_BFS,SitzMemo_FS
 SG_ FFB_Zu_Taste : 37|1@1+ (1,0) [0|1] ""  FCM,Kessy_MQB_Gen1,Kessy_MQB_Gen2,SitzMemo_FS
 SG_ HBFS_gesafet : 53|1@1+ (1,0) [0|1] ""  FCM,Kessy_MQB_Gen1,Kessy_MQB_Gen2,KFG,OCU,TSG_BFS
 SG_ HBFS_verriegelt : 52|1@1+ (1,0) [0|1] ""  FCM,Kessy_MQB_Gen1,Kessy_MQB_Gen2,KFG,OCU,TSG_BFS
 SG_ HD_Hauptraste : 32|1@1+ (1,0) [0|1] ""  FCM,HDSG,Kessy_MQB_Gen1,Kessy_MQB_Gen2,KFG,MFG,OCU,VSG
 SG_ HD_Vorraste : 33|1@1+ (1,0) [0|1] ""  FCM,HDSG,Kessy_MQB_Gen1,Kessy_MQB_Gen2
 SG_ HFS_gesafet : 51|1@1+ (1,0) [0|1] ""  FCM,Kessy_MQB_Gen1,Kessy_MQB_Gen2,KFG,OCU,TSG_FS
 SG_ HFS_verriegelt : 50|1@1+ (1,0) [0|1] ""  FCM,Kessy_MQB_Gen1,Kessy_MQB_Gen2,KFG,OCU,TSG_FS
 SG_ IRUE_aktiv : 30|1@1+ (1,0) [0|1] ""  FCM,Klima,TSG_FS
 SG_ IRUE_Taster_Fkts_LED : 55|1@1+ (1,0) [0|1] ""  FCM,TSG_FS
 SG_ ZV_BT_offen : 25|1@1+ (1,0) [0|1] ""  FCM,Gateway_MQB,Kessy_MQB_Gen1,Kessy_MQB_Gen2,KFG,Klima,Kombi_MQB,Kombi_TT3,MFG,OCU
 SG_ ZV_Einzeltuerentriegelung : 22|1@1+ (1,0) [0|1] ""  FCM,Kessy_MQB_Gen1,Kessy_MQB_Gen2,KFG,MFG,TSG_BFS,TSG_FS
 SG_ ZV_FT_offen : 24|1@1+ (1,0) [0|1] ""  FCM,Gateway_MQB,Kessy_MQB_Gen1,Kessy_MQB_Gen2,KFG,Klima,Kombi_MQB,Kombi_TT3,MFG,OCU
 SG_ ZV_gesafet_extern_ist : 20|1@1+ (1,0) [0|1] ""  FCM,Kessy_MQB_Gen2,KFG,Klima,MFG,OCU,TSG_BFS,TSG_FS
 SG_ ZV_gesafet_extern_soll : 21|1@1+ (1,0) [0|1] ""  ELV_MQB_Gen1,ELV_MQB_Gen2,FCM,Kessy_MQB_Gen1,Kessy_MQB_Gen2,TSG_BFS,TSG_FS
 SG_ ZV_HBFS_offen : 27|1@1+ (1,0) [0|1] ""  FCM,Gateway_MQB,Kessy_MQB_Gen1,Kessy_MQB_Gen2,KFG,Klima,Kombi_MQB,Kombi_TT3,MFG,OCU,TSG_BFS
 SG_ ZV_HD_offen : 28|1@1+ (1,0) [0|1] ""  AAG,FCM,Gateway_MQB,HDSG,Kessy_MQB_Gen1,Kessy_MQB_Gen2,Kombi_MQB,Kombi_TT3,OCU,VSG
 SG_ ZV_Heckeinzelentriegelung : 23|1@1+ (1,0) [0|1] ""  FCM,Kessy_MQB_Gen1,Kessy_MQB_Gen2,KFG,MFG,OCU
 SG_ ZV_HFS_offen : 26|1@1+ (1,0) [0|1] ""  FCM,Gateway_MQB,Kessy_MQB_Gen1,Kessy_MQB_Gen2,KFG,Klima,Kombi_MQB,Kombi_TT3,MFG,OCU,TSG_FS
 SG_ ZV_HS_offen : 29|1@1+ (1,0) [0|1] ""  AAG,FCM,Kessy_MQB_Gen1,Kessy_MQB_Gen2,Kombi_MQB,Kombi_TT3
 SG_ ZV_ist_Zustand_verfuegbar : 54|1@1+ (1,0) [0|1] ""  FCM
 SG_ ZV_Oeffnungsmodus : 48|2@1+ (1,0) [0|3] ""  FCM,Kessy_MQB_Gen1,Kessy_MQB_Gen2
 SG_ ZV_Rollo_auf : 57|1@1+ (1,0) [0|1] ""  FCM,SAD
 SG_ ZV_Rollo_zu : 58|1@1+ (1,0) [0|1] ""  FCM,SAD
 SG_ ZV_SAD_auf : 59|1@1+ (1,0) [0|1] ""  FCM,SAD
 SG_ ZV_SAD_zu : 60|1@1+ (1,0) [0|1] ""  FCM,Kessy_MQB_Gen1,Kessy_MQB_Gen2,SAD
 SG_ ZV_SafeFunktion_aktiv : 46|1@1+ (1,0) [0|1] ""  FCM,Kombi_MQB,Kombi_TT3
 SG_ ZV_Schluessel_Zugang : 42|4@1+ (1,0) [0|15] ""  FCM,Gateway_MQB,Kessy_MQB_Gen1,Kessy_MQB_Gen2,KFG,Klima,SitzMemo_BFS,SitzMemo_FS,TSG_BFS,TSG_FS
 SG_ ZV_STSG_HBFS_Anf : 2|1@1+ (1,0) [0|1] ""  FCM,STSG_HBFS
 SG_ ZV_STSG_HFS_Anf : 1|1@1+ (1,0) [0|1] ""  FCM,STSG_HFS
 SG_ ZV_Tankklappe_offen : 56|1@1+ (1,0) [0|1] ""  FCM,Gateway_MQB,STSG_HBFS,STSG_HFS
 SG_ ZV_verriegeln_Anf : 0|1@1+ (1,0) [0|1] ""  FCM,Gateway_MQB
 SG_ ZV_verriegelt_extern_ist : 17|1@1+ (1,0) [0|1] ""  AAG,FCM,Kessy_MQB_Gen2,KFG,Klima,Kombi_MQB,Kombi_TT3,MFG,OCU,SitzMemo_FS,STSG_HBFS,STSG_HFS,TSG_BFS,TSG_FS,VSG
 SG_ ZV_verriegelt_extern_soll : 19|1@1+ (1,0) [0|1] ""  AAG,ELV_MQB_Gen1,ELV_MQB_Gen2,FCM,Gateway_MQB,Kessy_MQB_Gen1,Kessy_MQB_Gen2,Klima,Kombi_MQB,TSG_BFS,TSG_FS,VSG
 SG_ ZV_verriegelt_intern_ist : 16|1@1+ (1,0) [0|1] ""  FCM,Kessy_MQB_Gen2,KFG,Klima,MFG,OCU,TSG_BFS,TSG_FS
 SG_ ZV_verriegelt_intern_soll : 18|1@1+ (1,0) [0|1] ""  FCM,Kessy_MQB_Gen1,Kessy_MQB_Gen2,Klima,TSG_BFS,TSG_FS
 SG_ ZV_verriegelt_soll : 62|2@1+ (1,0) [0|3] ""  FCM,Gateway_MQB

BO_ 1411 ZV_02: 8 BCM
BA_ "VAGTP20_API" BO_ 1411 0;
BA_ "VAGTP20_DynConnection" BO_ 1411 0;
BA_ "VAGTP20_DynSetup" BO_ 1411 0;
BA_ "VAGTP20_StatConnection" BO_ 1411 0;
BA_ "DiagRequest" BO_ 1411 0;
BA_ "DiagResponse" BO_ 1411 0;
BA_ "DiagState" BO_ 1411 0;
BA_ "NmMessage" BO_ 1411 0;
BA_ "NmhMessage" BO_ 1411 0;
BA_ "GenMsgILSupport" BO_ 1411 1;
BA_ "GenMsgNrOfRepetition" BO_ 1411 3;
BA_ "MsgType" BO_ 1411 0;
BA_ "GenMsgStartDelayTime" BO_ 1411 0;
BA_ "GenMsgDelayTime" BO_ 1411 20;
BA_ "GenMsgCycleTimeFast" BO_ 1411 50;
BA_ "GenMsgCycleTime" BO_ 1411 200;
BA_ "GenMsgSendType" BO_ 1411 0;
*/

