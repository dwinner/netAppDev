/*@@var:*/
variables
{

	//@BAPSIMGEN_VAR_SECTION_BEGIN

	/***************************************************/
	/*            BapSimGen ASG template               */
	/***************************************************/

	/************** Ausgabe Konsolen (Traces) ***********/
	dword gBAP_Trace;
	dword gError_Trace;

	/************** Node Verwaltung ***************/
	//Power on/off
	byte gSG_PowerOnOff=0x01;     // wird mit Power_off/on gesetzt
	byte gBAP_Init=0;             // schon mal initialisiert?

	const Power_off = 0x00;
	const Power_on	= 0x01;

	mstimer TaskTimer;				//real communication timer

	/************** Request **************/
	const Requestbuffer_lines = 100;
	const BAP_buffer_size = 4096;

	/************ Speichern von Requests im "Ringbuffer" ***********/
	int   gBAP_Requestbuffer_status     [Requestbuffer_lines];		            // 0: kein Eintrag, 1:pending
	dword gBAP_Request_header			[Requestbuffer_lines] [6];				// beinhaltet auch skalare Daten
	dword gBAP_Request_data             [Requestbuffer_lines] [BAP_buffer_size];// ringbuffer Eintrag fuer BAP-Request


	/************** Indication **************/
	// enthaelt die derzeitige Indication
	dword gBAP_Indication_header[6];	
	byte  gBAP_Indication_data[BAP_buffer_size];		

	/************** Konstanten ****************/

	//BAP Data Type 
	const Bap_void				=0;
	const Bap_uint8				=1;
	const Bap_uint16			=2;
	const Bap_uint32			=3;
	const Bap_byteSequence		=4;
	const Bap_error				=5;
	const Bap_acknowledge		=6;

	char Datatype_Text[7][20] =
	{
		"void", "uint8", "uint16", "uint32", "byteSequence", "error", "acknowledge"
	};

	//BAP request types
	const DataSetGet_REQ  = 0x00;
	const DataSet_REQ	  = 0x01;
	const DataGet_REQ	  = 0x02;
	const Data_REQ		  = 0x03;
	const Changed_REQ	  = 0x04;
	const Start_REQ		  = 0x05;
	const StartResult_REQ = 0x06;
	const AbortResult_REQ = 0x07;
	const Processing_REQ  = 0x08;
	const Result_REQ      = 0x09;
	const DataAck_REQ     = 0x0A;
	const Ack_REQ         = 0x0B;
	const Invalid_REQ     = 0x1F;      // Interne Kennzeichnung fuer einen ungueltigen Request

	//eigene Error-Definition
	const Error_REQ=0x20;

	char Requesttype_Text[33][30] =
	{
		"DataSetGet_REQ", "DataSet_REQ", "DataGet_REQ", "Data_REQ",			/* 00 .. 03 */
		"Changed_REQ", "Start_REQ", "StartResult_REQ", "AbortResult_REQ",   /* 04 .. 07 */
		"Processing_REQ", "Result_REQ", "DataAck_REQ", "Ack_REQ", 			/* 08 .. 0b */
		"Invalid_REQ", "Invalid_REQ", "Invalid_REQ", "Invalid_REQ",  		/* 0c .. 0f */
		"Invalid_REQ", "Invalid_REQ", "Invalid_REQ", "Invalid_REQ",  		/* 10 .. 13 */
		"Invalid_REQ", "Invalid_REQ", "Invalid_REQ", "Invalid_REQ",  		/* 14 .. 17 */
		"Invalid_REQ", "Invalid_REQ", "Invalid_REQ", "Invalid_REQ", 		/* 18 .. 1b */
		"Invalid_REQ", "Invalid_REQ", "Invalid_REQ", "Invalid_REQ",  		/* 1c .. 1f */
		"Error_REQ"	  														/* 20 */
	};

	//BAP indication types
	const Data_IND			 = 0x00;
	const Reset_IND			 = 0x01;
	const DataAck_IND        = 0x02;
	const Result_IND		 = 0x03;
	const Processing_IND	 = 0x04;
  	const Changed_IND		 = 0x05;
  	const DataSetGet_IND	 = 0x06;
	const DataSet_IND		 = 0x07;
	const DataGet_IND		 = 0x08;
	const Ack_IND            = 0x09;
	const Processing_CNF_IND = 0x0A;
	const Start_IND			 = 0x0B;
	const StartResult_IND	 = 0x0C;
	const AbortResult_IND	 = 0x0D;
	const Invalid_IND		 = 0x1F; // Kennzeichnung fuer eine ungueltige Indication
	const Error_IND			 = 0x20;
	
	char Indicationtype_Text[33][30] =
	{
		"Data_IND", "Reset_IND", "DataAck_IND", "Result_IND",			 	/* 00 .. 03 */
		"Processing_IND", "Changed_IND", "DataSetGet_IND", "DataSet_IND", 	/* 04 .. 07 */
		"DataGet_IND", "Ack_IND", "Processing_CNF_IND", "Start_REQ",	 	/* 08 .. 0b */
		"StartResult_REQ", "AbortResult_REQ", "Invalid_REQ", "Invalid_REQ", /* 0c .. 0f */
		"Invalid_REQ", "Invalid_REQ", "Invalid_REQ", "Invalid_REQ",  		/* 10 .. 13 */
		"Invalid_REQ", "Invalid_REQ", "Invalid_REQ", "Invalid_REQ",  		/* 14 .. 17 */
		"Invalid_REQ", "Invalid_REQ", "Invalid_REQ", "Invalid_REQ", 		/* 18 .. 1b */
		"Invalid_REQ", "Invalid_REQ", "Invalid_REQ", "Invalid_REQ",  		/* 1c .. 1f */
		"Error_REQ"	  														/* 20 */
	};	
	
	char Acknowledgetype_Text[24][30] =
	{
		"Property_SetGet_ACK", "Array_SetGet_ACK", "Property_Set_ACK", "Array_Set_ACK",  			/* 00 .. 03 */
		"Method_Start_ACK", "Method_StartResult_ACK", "Method_AbortResult_ACK", "Property_Get_ACK",	/* 04 .. 07 */
		"Array_Get_ACK", "Cache_GetAll_ACK", "Property_Ack_ACK", "Property_Status_ACK",	   			/* 08 .. 0b */
		"Property_StatusAck_ACK", "Property_Error_ACK", "Array_Status_ACK", "Array_Changed_ACK",	/* 0c .. 0f */
		"Array_Error_ACK", "Method_Processing_ACK", "Method_Result_ACK", "Method_Error_ACK",  		/* 10 .. 13 */
		"Unknown_ACK", "Unknown_ACK", "Unknown_ACK", "Unknown_ACK"									/* 14 .. 17 */
	};

	/**************************** Global Function-ID's ******************************/
	/** TODO: already_pressed kann zwischen den Funktionen geshared werden          */

	byte already_pressed = 0;

	const FctID_GetAll									= 0x01;
	const FctID_BAP_Config								= 0x02;
	const FctID_FunctionList							= 0x03;
	const FctID_HeartBeat								= 0x04;
    
    char SGtype[4]="ASG";

	char  dbc_path[255]             = "asg10_1\\bapdb\\BAP_only_MQB_MLBevo_v1.18.dbc";
	char  xml_path[255]             = "asg10_1\\bapxml\\BAP_SW15_OPS_ASG1_OPS_MQB_MLBevo_v1.0.xml";
	dword NODE_INDEX                =  0;
	char  NODE_NAME[100]            = "PDC";
	const LSGID                     = 10;
	char  panel_name[100]           = "ASG10_1";
	char  bapconfig_panel_name[100]    = "panel1";
	char  common_panel_name[100]    = "panel2";
	const TaskTime                  = 10;
	const heartBeatFactor                               = 5;
	 const C_ASG_10_1_0_1_ID = 1;
	 byte C_ASG_10_1_0_1GetAll_BTN_already_pressed = 0;
	 char gCheckbox1[100] = "checkbox_C_ASG_10_1_0_1";
	 char gErrField1[100] = "errfield_C_ASG_10_1_0_1";
	 byte gC_ASG_10_1_0_1_ErrCode = 1;
	 const P_ASG_10_1_0_2_ID = 2;
	 byte P_ASG_10_1_0_2Get_BTN_already_pressed = 0;
	 char gCheckbox2[100] = "checkbox_P_ASG_10_1_0_2";
	 char gErrField2[100] = "errfield_P_ASG_10_1_0_2";
	 byte gP_ASG_10_1_0_2_ErrCode = 1;
	 const P_ASG_10_1_0_3_ID = 3;
	 byte P_ASG_10_1_0_3Get_BTN_already_pressed = 0;
	 char gCheckbox3[100] = "checkbox_P_ASG_10_1_0_3";
	 char gErrField3[100] = "errfield_P_ASG_10_1_0_3";
	 byte gP_ASG_10_1_0_3_ErrCode = 1;
	 const P_ASG_10_1_0_4_ID = 4;
	 byte P_ASG_10_1_0_4Get_BTN_already_pressed = 0;
	 char gCheckbox4[100] = "checkbox_P_ASG_10_1_0_4";
	 char gErrField4[100] = "errfield_P_ASG_10_1_0_4";
	 byte gP_ASG_10_1_0_4_ErrCode = 1;
	 const P_ASG_10_1_0_13_ID = 13;
	 byte P_ASG_10_1_0_13Get_BTN_already_pressed = 0;
	 byte P_ASG_10_1_0_13SetGet_BTN_already_pressed = 0;
	 char gCheckbox13[100] = "checkbox_P_ASG_10_1_0_13";
	 char gErrField13[100] = "errfield_P_ASG_10_1_0_13";
	 byte gP_ASG_10_1_0_13_ErrCode = 1;
	 char gPanel13[100] = "panel_P_ASG_10_1_0_13";
	 const P_ASG_10_1_0_14_ID = 14;
	 byte P_ASG_10_1_0_14Get_BTN_already_pressed = 0;
	 char gCheckbox14[100] = "checkbox_P_ASG_10_1_0_14";
	 char gErrField14[100] = "errfield_P_ASG_10_1_0_14";
	 byte gP_ASG_10_1_0_14_ErrCode = 1;
	 char gPanel14[100] = "panel_P_ASG_10_1_0_14";
	 const P_ASG_10_1_0_15_ID = 15;
	 byte P_ASG_10_1_0_15Get_BTN_already_pressed = 0;
	 char gCheckbox15[100] = "checkbox_P_ASG_10_1_0_15";
	 char gErrField15[100] = "errfield_P_ASG_10_1_0_15";
	 byte gP_ASG_10_1_0_15_ErrCode = 1;
	 char gPanel15[100] = "panel_P_ASG_10_1_0_15";
	 const P_ASG_10_1_0_16_ID = 16;
	 byte P_ASG_10_1_0_16Get_BTN_already_pressed = 0;
	 byte P_ASG_10_1_0_16SetGet_BTN_already_pressed = 0;
	 char gCheckbox16[100] = "checkbox_P_ASG_10_1_0_16";
	 char gErrField16[100] = "errfield_P_ASG_10_1_0_16";
	 byte gP_ASG_10_1_0_16_ErrCode = 1;
	 char gPanel16[100] = "panel_P_ASG_10_1_0_16";
	 const P_ASG_10_1_0_17_ID = 17;
	 byte P_ASG_10_1_0_17Get_BTN_already_pressed = 0;
	 byte P_ASG_10_1_0_17SetGet_BTN_already_pressed = 0;
	 char gCheckbox17[100] = "checkbox_P_ASG_10_1_0_17";
	 char gErrField17[100] = "errfield_P_ASG_10_1_0_17";
	 byte gP_ASG_10_1_0_17_ErrCode = 1;
	 char gPanel17[100] = "panel_P_ASG_10_1_0_17";
	 const P_ASG_10_1_0_18_ID = 18;
	 byte P_ASG_10_1_0_18Get_BTN_already_pressed = 0;
	 char gCheckbox18[100] = "checkbox_P_ASG_10_1_0_18";
	 char gErrField18[100] = "errfield_P_ASG_10_1_0_18";
	 byte gP_ASG_10_1_0_18_ErrCode = 1;
	 char gPanel18[100] = "panel_P_ASG_10_1_0_18";
	 const P_ASG_10_1_0_19_ID = 19;
	 byte P_ASG_10_1_0_19Get_BTN_already_pressed = 0;
	 char gCheckbox19[100] = "checkbox_P_ASG_10_1_0_19";
	 char gErrField19[100] = "errfield_P_ASG_10_1_0_19";
	 byte gP_ASG_10_1_0_19_ErrCode = 1;
	 char gPanel19[100] = "panel_P_ASG_10_1_0_19";
	 const P_ASG_10_1_0_20_ID = 20;
	 byte P_ASG_10_1_0_20Get_BTN_already_pressed = 0;
	 byte P_ASG_10_1_0_20SetGet_BTN_already_pressed = 0;
	 char gCheckbox20[100] = "checkbox_P_ASG_10_1_0_20";
	 char gErrField20[100] = "errfield_P_ASG_10_1_0_20";
	 byte gP_ASG_10_1_0_20_ErrCode = 1;
	 char gPanel20[100] = "panel_P_ASG_10_1_0_20";
	 const P_ASG_10_1_0_21_ID = 21;
	 byte P_ASG_10_1_0_21Get_BTN_already_pressed = 0;
	 byte P_ASG_10_1_0_21SetGet_BTN_already_pressed = 0;
	 char gCheckbox21[100] = "checkbox_P_ASG_10_1_0_21";
	 char gErrField21[100] = "errfield_P_ASG_10_1_0_21";
	 byte gP_ASG_10_1_0_21_ErrCode = 1;
	 char gPanel21[100] = "panel_P_ASG_10_1_0_21";
	 const P_ASG_10_1_0_22_ID = 22;
	 byte P_ASG_10_1_0_22Get_BTN_already_pressed = 0;
	 byte P_ASG_10_1_0_22SetGet_BTN_already_pressed = 0;
	 char gCheckbox22[100] = "checkbox_P_ASG_10_1_0_22";
	 char gErrField22[100] = "errfield_P_ASG_10_1_0_22";
	 byte gP_ASG_10_1_0_22_ErrCode = 1;
	 char gPanel22[100] = "panel_P_ASG_10_1_0_22";
	 const P_ASG_10_1_0_23_ID = 23;
	 byte P_ASG_10_1_0_23Get_BTN_already_pressed = 0;
	 char gCheckbox23[100] = "checkbox_P_ASG_10_1_0_23";
	 char gErrField23[100] = "errfield_P_ASG_10_1_0_23";
	 byte gP_ASG_10_1_0_23_ErrCode = 1;
	 char gPanel23[100] = "panel_P_ASG_10_1_0_23";
	 const P_ASG_10_1_0_24_ID = 24;
	 byte P_ASG_10_1_0_24Get_BTN_already_pressed = 0;
	 byte P_ASG_10_1_0_24SetGet_BTN_already_pressed = 0;
	 char gCheckbox24[100] = "checkbox_P_ASG_10_1_0_24";
	 char gErrField24[100] = "errfield_P_ASG_10_1_0_24";
	 byte gP_ASG_10_1_0_24_ErrCode = 1;
	 char gPanel24[100] = "panel_P_ASG_10_1_0_24";
	 const P_ASG_10_1_0_25_ID = 25;
	 byte P_ASG_10_1_0_25Get_BTN_already_pressed = 0;
	 char gCheckbox25[100] = "checkbox_P_ASG_10_1_0_25";
	 char gErrField25[100] = "errfield_P_ASG_10_1_0_25";
	 byte gP_ASG_10_1_0_25_ErrCode = 1;
	 char gPanel25[100] = "panel_P_ASG_10_1_0_25";
	 const P_ASG_10_1_0_26_ID = 26;
	 byte P_ASG_10_1_0_26Get_BTN_already_pressed = 0;
	 char gCheckbox26[100] = "checkbox_P_ASG_10_1_0_26";
	 char gErrField26[100] = "errfield_P_ASG_10_1_0_26";
	 byte gP_ASG_10_1_0_26_ErrCode = 1;
	 char gPanel26[100] = "panel_P_ASG_10_1_0_26";
	 const P_ASG_10_1_0_27_ID = 27;
	 byte P_ASG_10_1_0_27Get_BTN_already_pressed = 0;
	 byte P_ASG_10_1_0_27SetGet_BTN_already_pressed = 0;
	 char gCheckbox27[100] = "checkbox_P_ASG_10_1_0_27";
	 char gErrField27[100] = "errfield_P_ASG_10_1_0_27";
	 byte gP_ASG_10_1_0_27_ErrCode = 1;
	 char gPanel27[100] = "panel_P_ASG_10_1_0_27";
	 const P_ASG_10_1_0_28_ID = 28;
	 byte P_ASG_10_1_0_28Get_BTN_already_pressed = 0;
	 byte P_ASG_10_1_0_28SetGet_BTN_already_pressed = 0;
	 char gCheckbox28[100] = "checkbox_P_ASG_10_1_0_28";
	 char gErrField28[100] = "errfield_P_ASG_10_1_0_28";
	 byte gP_ASG_10_1_0_28_ErrCode = 1;
	 char gPanel28[100] = "panel_P_ASG_10_1_0_28";
	 const P_ASG_10_1_0_29_ID = 29;
	 byte P_ASG_10_1_0_29Get_BTN_already_pressed = 0;
	 byte P_ASG_10_1_0_29SetGet_BTN_already_pressed = 0;
	 char gCheckbox29[100] = "checkbox_P_ASG_10_1_0_29";
	 char gErrField29[100] = "errfield_P_ASG_10_1_0_29";
	 byte gP_ASG_10_1_0_29_ErrCode = 1;
	 char gPanel29[100] = "panel_P_ASG_10_1_0_29";
	 const P_ASG_10_1_0_30_ID = 30;
	 byte P_ASG_10_1_0_30Get_BTN_already_pressed = 0;
	 char gCheckbox30[100] = "checkbox_P_ASG_10_1_0_30";
	 char gErrField30[100] = "errfield_P_ASG_10_1_0_30";
	 byte gP_ASG_10_1_0_30_ErrCode = 1;
	 char gPanel30[100] = "panel_P_ASG_10_1_0_30";
	 const P_ASG_10_1_0_31_ID = 31;
	 byte P_ASG_10_1_0_31Get_BTN_already_pressed = 0;
	 char gCheckbox31[100] = "checkbox_P_ASG_10_1_0_31";
	 char gErrField31[100] = "errfield_P_ASG_10_1_0_31";
	 byte gP_ASG_10_1_0_31_ErrCode = 1;
	 char gPanel31[100] = "panel_P_ASG_10_1_0_31";
	 const P_ASG_10_1_0_32_ID = 32;
	 byte P_ASG_10_1_0_32Get_BTN_already_pressed = 0;
	 byte P_ASG_10_1_0_32SetGet_BTN_already_pressed = 0;
	 char gCheckbox32[100] = "checkbox_P_ASG_10_1_0_32";
	 char gErrField32[100] = "errfield_P_ASG_10_1_0_32";
	 byte gP_ASG_10_1_0_32_ErrCode = 1;
	 char gPanel32[100] = "panel_P_ASG_10_1_0_32";
	 const P_ASG_10_1_0_33_ID = 33;
	 byte P_ASG_10_1_0_33Get_BTN_already_pressed = 0;
	 char gCheckbox33[100] = "checkbox_P_ASG_10_1_0_33";
	 char gErrField33[100] = "errfield_P_ASG_10_1_0_33";
	 byte gP_ASG_10_1_0_33_ErrCode = 1;
	 char gPanel33[100] = "panel_P_ASG_10_1_0_33";
	 const P_ASG_10_1_0_34_ID = 34;
	 byte P_ASG_10_1_0_34Get_BTN_already_pressed = 0;
	 char gCheckbox34[100] = "checkbox_P_ASG_10_1_0_34";
	 char gErrField34[100] = "errfield_P_ASG_10_1_0_34";
	 byte gP_ASG_10_1_0_34_ErrCode = 1;
	 char gPanel34[100] = "panel_P_ASG_10_1_0_34";
	 const P_ASG_10_1_0_35_ID = 35;
	 byte P_ASG_10_1_0_35Get_BTN_already_pressed = 0;
	 char gCheckbox35[100] = "checkbox_P_ASG_10_1_0_35";
	 char gErrField35[100] = "errfield_P_ASG_10_1_0_35";
	 byte gP_ASG_10_1_0_35_ErrCode = 1;
	 char gPanel35[100] = "panel_P_ASG_10_1_0_35";
	 const P_ASG_10_1_0_36_ID = 36;
	 byte P_ASG_10_1_0_36Get_BTN_already_pressed = 0;
	 char gCheckbox36[100] = "checkbox_P_ASG_10_1_0_36";
	 char gErrField36[100] = "errfield_P_ASG_10_1_0_36";
	 byte gP_ASG_10_1_0_36_ErrCode = 1;
	 char gPanel36[100] = "panel_P_ASG_10_1_0_36";
	 const P_ASG_10_1_0_37_ID = 37;
	 byte P_ASG_10_1_0_37Get_BTN_already_pressed = 0;
	 byte P_ASG_10_1_0_37SetGet_BTN_already_pressed = 0;
	 char gCheckbox37[100] = "checkbox_P_ASG_10_1_0_37";
	 char gErrField37[100] = "errfield_P_ASG_10_1_0_37";
	 byte gP_ASG_10_1_0_37_ErrCode = 1;
	 char gPanel37[100] = "panel_P_ASG_10_1_0_37";
	 const P_ASG_10_1_0_38_ID = 38;
	 byte P_ASG_10_1_0_38Get_BTN_already_pressed = 0;
	 char gCheckbox38[100] = "checkbox_P_ASG_10_1_0_38";
	 char gErrField38[100] = "errfield_P_ASG_10_1_0_38";
	 byte gP_ASG_10_1_0_38_ErrCode = 1;
	 char gPanel38[100] = "panel_P_ASG_10_1_0_38";
	 const P_ASG_10_1_0_39_ID = 39;
	 byte P_ASG_10_1_0_39Get_BTN_already_pressed = 0;
	 char gCheckbox39[100] = "checkbox_P_ASG_10_1_0_39";
	 char gErrField39[100] = "errfield_P_ASG_10_1_0_39";
	 byte gP_ASG_10_1_0_39_ErrCode = 1;
	 char gPanel39[100] = "panel_P_ASG_10_1_0_39";
	 const P_ASG_10_1_0_40_ID = 40;
	 byte P_ASG_10_1_0_40Get_BTN_already_pressed = 0;
	 byte P_ASG_10_1_0_40SetGet_BTN_already_pressed = 0;
	 char gCheckbox40[100] = "checkbox_P_ASG_10_1_0_40";
	 char gErrField40[100] = "errfield_P_ASG_10_1_0_40";
	 byte gP_ASG_10_1_0_40_ErrCode = 1;
	 char gPanel40[100] = "panel_P_ASG_10_1_0_40";
	 const P_ASG_10_1_0_41_ID = 41;
	 byte P_ASG_10_1_0_41Get_BTN_already_pressed = 0;
	 byte P_ASG_10_1_0_41SetGet_BTN_already_pressed = 0;
	 char gCheckbox41[100] = "checkbox_P_ASG_10_1_0_41";
	 char gErrField41[100] = "errfield_P_ASG_10_1_0_41";
	 byte gP_ASG_10_1_0_41_ErrCode = 1;
	 char gPanel41[100] = "panel_P_ASG_10_1_0_41";
	 const P_ASG_10_1_0_42_ID = 42;
	 byte P_ASG_10_1_0_42Get_BTN_already_pressed = 0;
	 byte P_ASG_10_1_0_42SetGet_BTN_already_pressed = 0;
	 char gCheckbox42[100] = "checkbox_P_ASG_10_1_0_42";
	 char gErrField42[100] = "errfield_P_ASG_10_1_0_42";
	 byte gP_ASG_10_1_0_42_ErrCode = 1;
	 char gPanel42[100] = "panel_P_ASG_10_1_0_42";
	 const P_ASG_10_1_0_43_ID = 43;
	 byte P_ASG_10_1_0_43Get_BTN_already_pressed = 0;
	 byte P_ASG_10_1_0_43SetGet_BTN_already_pressed = 0;
	 char gCheckbox43[100] = "checkbox_P_ASG_10_1_0_43";
	 char gErrField43[100] = "errfield_P_ASG_10_1_0_43";
	 byte gP_ASG_10_1_0_43_ErrCode = 1;
	 char gPanel43[100] = "panel_P_ASG_10_1_0_43";
	 const P_ASG_10_1_0_44_ID = 44;
	 byte P_ASG_10_1_0_44Get_BTN_already_pressed = 0;
	 byte P_ASG_10_1_0_44SetGet_BTN_already_pressed = 0;
	 char gCheckbox44[100] = "checkbox_P_ASG_10_1_0_44";
	 char gErrField44[100] = "errfield_P_ASG_10_1_0_44";
	 byte gP_ASG_10_1_0_44_ErrCode = 1;
	 char gPanel44[100] = "panel_P_ASG_10_1_0_44";
	 const P_ASG_10_1_0_45_ID = 45;
	 byte P_ASG_10_1_0_45Get_BTN_already_pressed = 0;
	 byte P_ASG_10_1_0_45SetGet_BTN_already_pressed = 0;
	 char gCheckbox45[100] = "checkbox_P_ASG_10_1_0_45";
	 char gErrField45[100] = "errfield_P_ASG_10_1_0_45";
	 byte gP_ASG_10_1_0_45_ErrCode = 1;
	 char gPanel45[100] = "panel_P_ASG_10_1_0_45";
	 const P_ASG_10_1_0_46_ID = 46;
	 byte P_ASG_10_1_0_46Get_BTN_already_pressed = 0;
	 byte P_ASG_10_1_0_46SetGet_BTN_already_pressed = 0;
	 char gCheckbox46[100] = "checkbox_P_ASG_10_1_0_46";
	 char gErrField46[100] = "errfield_P_ASG_10_1_0_46";
	 byte gP_ASG_10_1_0_46_ErrCode = 1;
	 char gPanel46[100] = "panel_P_ASG_10_1_0_46";
	 const P_ASG_10_1_0_47_ID = 47;
	 byte P_ASG_10_1_0_47Get_BTN_already_pressed = 0;
	 char gCheckbox47[100] = "checkbox_P_ASG_10_1_0_47";
	 char gErrField47[100] = "errfield_P_ASG_10_1_0_47";
	 byte gP_ASG_10_1_0_47_ErrCode = 1;
	 char gPanel47[100] = "panel_P_ASG_10_1_0_47";
	 const P_ASG_10_1_0_48_ID = 48;
	 byte P_ASG_10_1_0_48Get_BTN_already_pressed = 0;
	 byte P_ASG_10_1_0_48SetGet_BTN_already_pressed = 0;
	 char gCheckbox48[100] = "checkbox_P_ASG_10_1_0_48";
	 char gErrField48[100] = "errfield_P_ASG_10_1_0_48";
	 byte gP_ASG_10_1_0_48_ErrCode = 1;
	 char gPanel48[100] = "panel_P_ASG_10_1_0_48";
	 const P_ASG_10_1_0_49_ID = 49;
	 byte P_ASG_10_1_0_49Get_BTN_already_pressed = 0;
	 byte P_ASG_10_1_0_49SetGet_BTN_already_pressed = 0;
	 char gCheckbox49[100] = "checkbox_P_ASG_10_1_0_49";
	 char gErrField49[100] = "errfield_P_ASG_10_1_0_49";
	 byte gP_ASG_10_1_0_49_ErrCode = 1;
	 char gPanel49[100] = "panel_P_ASG_10_1_0_49";
	 const P_ASG_10_1_0_50_ID = 50;
	 byte P_ASG_10_1_0_50Get_BTN_already_pressed = 0;
	 char gCheckbox50[100] = "checkbox_P_ASG_10_1_0_50";
	 char gErrField50[100] = "errfield_P_ASG_10_1_0_50";
	 byte gP_ASG_10_1_0_50_ErrCode = 1;
	 char gPanel50[100] = "panel_P_ASG_10_1_0_50";
	 const P_ASG_10_1_0_51_ID = 51;
	 byte P_ASG_10_1_0_51Get_BTN_already_pressed = 0;
	 byte P_ASG_10_1_0_51SetGet_BTN_already_pressed = 0;
	 char gCheckbox51[100] = "checkbox_P_ASG_10_1_0_51";
	 char gErrField51[100] = "errfield_P_ASG_10_1_0_51";
	 byte gP_ASG_10_1_0_51_ErrCode = 1;
	 char gPanel51[100] = "panel_P_ASG_10_1_0_51";
	 const P_ASG_10_1_0_52_ID = 52;
	 byte P_ASG_10_1_0_52Get_BTN_already_pressed = 0;
	 char gCheckbox52[100] = "checkbox_P_ASG_10_1_0_52";
	 char gErrField52[100] = "errfield_P_ASG_10_1_0_52";
	 byte gP_ASG_10_1_0_52_ErrCode = 1;
	 char gPanel52[100] = "panel_P_ASG_10_1_0_52";
	 const P_ASG_10_1_0_53_ID = 53;
	 byte P_ASG_10_1_0_53Get_BTN_already_pressed = 0;
	 byte P_ASG_10_1_0_53SetGet_BTN_already_pressed = 0;
	 char gCheckbox53[100] = "checkbox_P_ASG_10_1_0_53";
	 char gErrField53[100] = "errfield_P_ASG_10_1_0_53";
	 byte gP_ASG_10_1_0_53_ErrCode = 1;
	 char gPanel53[100] = "panel_P_ASG_10_1_0_53";


	/// Begin: Definition der BUS-Schnittstellen
	
	// FLEXRAY NOT ENABLED!
	
	// ETHERNET NOT ENABLED! 
	
	//// End Bus Schnittstellen
}
/*@@end*/

/*@@preStart:PreStart:*/
on preStart
{
	char Version[200];
	char Path[255];

	/***** Erzeugen der Ausgabeconsolen *****/	
	gBAP_Trace=writecreate("BAP-Trace");		//write-window for BAP-cummunication
	writeclear(gBAP_Trace);						//clear BAP-window in write-window
	
	gError_Trace=writecreate("Error");			//error-window for BAP-cummunication
	writeclear(gError_Trace);					//clear error-window in write-window
	
	writeclear(1);								//clear CAPL-window in write-window
	
	/**** Versionsstring von DLL holen und auf Bildschirm ausgeben ***/	
	BAP150_GetVersions(Version, 200);
	writelineEx(gBAP_Trace, 0, "Versionx:%s", Version);
											
    NODE_INDEX = BAP150_CreateNode();
    writelineEx(gBAP_Trace, 0, "ASG %d Nodeindex:%d", LSGID, Version);
    
	/**** Laden der CANoe Datenbank *****/
	getAbsFilePath(dbc_path, Path, 255);
	writelineEx(gBAP_Trace, 0, "Load BAP_DBC-File: %s", Path);
	if(BAP150_LoadDBC(NODE_INDEX, 1, Path)  != 0) {		writelineEx(gError_Trace, 0, "Fehler beim Laden: %s !", Path);
	}

	/**** Laden des BAP XML Files ****/
	getAbsFilePath(xml_path, Path, 255);
	writelineEx(gBAP_Trace, 0, "Load BAP-XML-File: %s", Path);
	if (BAP150_LoadConfig(NODE_INDEX, Path) != 0) {
	    writelineEx(gError_Trace, 0, "Fehler beim Laden: %s !", Path);
	}

	if (BAP150_AddCanMap(NODE_INDEX, 1, 1) != 0) {
		writelineEx(gError_Trace, 0, "Fehler beim Mappen!");
	}
	
	// FLEXRAY NOT ENABLED!
	
}
/*@@end*/

/*@@caplFunc:Name:*/
DisableFctCtrl ()
{
  	EnableControl(panel_name, common_panel_name, 0);
	EnableControl(panel_name,gErrField1,0);
	EnableControl(panel_name,gErrField2,0);
	EnableControl(panel_name,gErrField3,0);
	EnableControl(panel_name,gErrField4,0);
	EnableControl(panel_name,gErrField13,0);
	EnableControl(panel_name,gPanel13,0);
	EnableControl(panel_name,"panel_P_ASG_10_1_0_13",0);
	EnableControl(panel_name,gErrField14,0);
	EnableControl(panel_name,gPanel14,0);
	EnableControl(panel_name,"panel_P_ASG_10_1_0_14",0);
	EnableControl(panel_name,gErrField15,0);
	EnableControl(panel_name,gPanel15,0);
	EnableControl(panel_name,"panel_P_ASG_10_1_0_15",0);
	EnableControl(panel_name,gErrField16,0);
	EnableControl(panel_name,gPanel16,0);
	EnableControl(panel_name,"panel_P_ASG_10_1_0_16",0);
	EnableControl(panel_name,gErrField17,0);
	EnableControl(panel_name,gPanel17,0);
	EnableControl(panel_name,"panel_P_ASG_10_1_0_17",0);
	EnableControl(panel_name,gErrField18,0);
	EnableControl(panel_name,gPanel18,0);
	EnableControl(panel_name,"panel_P_ASG_10_1_0_18",0);
	EnableControl(panel_name,gErrField19,0);
	EnableControl(panel_name,gPanel19,0);
	EnableControl(panel_name,"panel_P_ASG_10_1_0_19",0);
	EnableControl(panel_name,gErrField20,0);
	EnableControl(panel_name,gPanel20,0);
	EnableControl(panel_name,"panel_P_ASG_10_1_0_20",0);
	EnableControl(panel_name,gErrField21,0);
	EnableControl(panel_name,gPanel21,0);
	EnableControl(panel_name,"panel_P_ASG_10_1_0_21",0);
	EnableControl(panel_name,gErrField22,0);
	EnableControl(panel_name,gPanel22,0);
	EnableControl(panel_name,"panel_P_ASG_10_1_0_22",0);
	EnableControl(panel_name,gErrField23,0);
	EnableControl(panel_name,gPanel23,0);
	EnableControl(panel_name,"panel_P_ASG_10_1_0_23",0);
	EnableControl(panel_name,gErrField24,0);
	EnableControl(panel_name,gPanel24,0);
	EnableControl(panel_name,"panel_P_ASG_10_1_0_24",0);
	EnableControl(panel_name,gErrField25,0);
	EnableControl(panel_name,gPanel25,0);
	EnableControl(panel_name,"panel_P_ASG_10_1_0_25",0);
	EnableControl(panel_name,gErrField26,0);
	EnableControl(panel_name,gPanel26,0);
	EnableControl(panel_name,"panel_P_ASG_10_1_0_26",0);
	EnableControl(panel_name,gErrField27,0);
	EnableControl(panel_name,gPanel27,0);
	EnableControl(panel_name,"panel_P_ASG_10_1_0_27",0);
	EnableControl(panel_name,gErrField28,0);
	EnableControl(panel_name,gPanel28,0);
	EnableControl(panel_name,"panel_P_ASG_10_1_0_28",0);
	EnableControl(panel_name,gErrField29,0);
	EnableControl(panel_name,gPanel29,0);
	EnableControl(panel_name,"panel_P_ASG_10_1_0_29",0);
	EnableControl(panel_name,gErrField30,0);
	EnableControl(panel_name,gPanel30,0);
	EnableControl(panel_name,"panel_P_ASG_10_1_0_30",0);
	EnableControl(panel_name,gErrField31,0);
	EnableControl(panel_name,gPanel31,0);
	EnableControl(panel_name,"panel_P_ASG_10_1_0_31",0);
	EnableControl(panel_name,gErrField32,0);
	EnableControl(panel_name,gPanel32,0);
	EnableControl(panel_name,"panel_P_ASG_10_1_0_32",0);
	EnableControl(panel_name,gErrField33,0);
	EnableControl(panel_name,gPanel33,0);
	EnableControl(panel_name,"panel_P_ASG_10_1_0_33",0);
	EnableControl(panel_name,gErrField34,0);
	EnableControl(panel_name,gPanel34,0);
	EnableControl(panel_name,"panel_P_ASG_10_1_0_34",0);
	EnableControl(panel_name,gErrField35,0);
	EnableControl(panel_name,gPanel35,0);
	EnableControl(panel_name,"panel_P_ASG_10_1_0_35",0);
	EnableControl(panel_name,gErrField36,0);
	EnableControl(panel_name,gPanel36,0);
	EnableControl(panel_name,"panel_P_ASG_10_1_0_36",0);
	EnableControl(panel_name,gErrField37,0);
	EnableControl(panel_name,gPanel37,0);
	EnableControl(panel_name,"panel_P_ASG_10_1_0_37",0);
	EnableControl(panel_name,gErrField38,0);
	EnableControl(panel_name,gPanel38,0);
	EnableControl(panel_name,"panel_P_ASG_10_1_0_38",0);
	EnableControl(panel_name,gErrField39,0);
	EnableControl(panel_name,gPanel39,0);
	EnableControl(panel_name,"panel_P_ASG_10_1_0_39",0);
	EnableControl(panel_name,gErrField40,0);
	EnableControl(panel_name,gPanel40,0);
	EnableControl(panel_name,"panel_P_ASG_10_1_0_40",0);
	EnableControl(panel_name,gErrField41,0);
	EnableControl(panel_name,gPanel41,0);
	EnableControl(panel_name,"panel_P_ASG_10_1_0_41",0);
	EnableControl(panel_name,gErrField42,0);
	EnableControl(panel_name,gPanel42,0);
	EnableControl(panel_name,"panel_P_ASG_10_1_0_42",0);
	EnableControl(panel_name,gErrField43,0);
	EnableControl(panel_name,gPanel43,0);
	EnableControl(panel_name,"panel_P_ASG_10_1_0_43",0);
	EnableControl(panel_name,gErrField44,0);
	EnableControl(panel_name,gPanel44,0);
	EnableControl(panel_name,"panel_P_ASG_10_1_0_44",0);
	EnableControl(panel_name,gErrField45,0);
	EnableControl(panel_name,gPanel45,0);
	EnableControl(panel_name,"panel_P_ASG_10_1_0_45",0);
	EnableControl(panel_name,gErrField46,0);
	EnableControl(panel_name,gPanel46,0);
	EnableControl(panel_name,"panel_P_ASG_10_1_0_46",0);
	EnableControl(panel_name,gErrField47,0);
	EnableControl(panel_name,gPanel47,0);
	EnableControl(panel_name,"panel_P_ASG_10_1_0_47",0);
	EnableControl(panel_name,gErrField48,0);
	EnableControl(panel_name,gPanel48,0);
	EnableControl(panel_name,"panel_P_ASG_10_1_0_48",0);
	EnableControl(panel_name,gErrField49,0);
	EnableControl(panel_name,gPanel49,0);
	EnableControl(panel_name,"panel_P_ASG_10_1_0_49",0);
	EnableControl(panel_name,gErrField50,0);
	EnableControl(panel_name,gPanel50,0);
	EnableControl(panel_name,"panel_P_ASG_10_1_0_50",0);
	EnableControl(panel_name,gErrField51,0);
	EnableControl(panel_name,gPanel51,0);
	EnableControl(panel_name,"panel_P_ASG_10_1_0_51",0);
	EnableControl(panel_name,gErrField52,0);
	EnableControl(panel_name,gPanel52,0);
	EnableControl(panel_name,"panel_P_ASG_10_1_0_52",0);
	EnableControl(panel_name,gErrField53,0);
	EnableControl(panel_name,gPanel53,0);
	EnableControl(panel_name,"panel_P_ASG_10_1_0_53",0);

}
/*@@end*/

/*@@caplFunc:Name:*/
EnableFctCtrl ()
{
  	EnableControl(panel_name, common_panel_name, 1);
		 EnableControl(panel_name,gPanel13,1);
		 EnableControl(panel_name,gErrField13,1);
		 EnableControl(panel_name,gPanel14,1);
		 EnableControl(panel_name,gErrField14,1);
		 EnableControl(panel_name,gPanel15,1);
		 EnableControl(panel_name,gErrField15,1);
		 EnableControl(panel_name,gPanel16,1);
		 EnableControl(panel_name,gErrField16,1);
		 EnableControl(panel_name,gPanel17,1);
		 EnableControl(panel_name,gErrField17,1);
		 EnableControl(panel_name,gPanel18,1);
		 EnableControl(panel_name,gErrField18,1);
		 EnableControl(panel_name,gPanel19,1);
		 EnableControl(panel_name,gErrField19,1);
		 EnableControl(panel_name,gPanel20,1);
		 EnableControl(panel_name,gErrField20,1);
		 EnableControl(panel_name,gPanel21,1);
		 EnableControl(panel_name,gErrField21,1);
		 EnableControl(panel_name,gPanel22,1);
		 EnableControl(panel_name,gErrField22,1);
		 EnableControl(panel_name,gPanel23,1);
		 EnableControl(panel_name,gErrField23,1);
		 EnableControl(panel_name,gPanel24,1);
		 EnableControl(panel_name,gErrField24,1);
		 EnableControl(panel_name,gPanel25,1);
		 EnableControl(panel_name,gErrField25,1);
		 EnableControl(panel_name,gPanel26,1);
		 EnableControl(panel_name,gErrField26,1);
		 EnableControl(panel_name,gPanel27,1);
		 EnableControl(panel_name,gErrField27,1);
		 EnableControl(panel_name,gPanel28,1);
		 EnableControl(panel_name,gErrField28,1);
		 EnableControl(panel_name,gPanel29,1);
		 EnableControl(panel_name,gErrField29,1);
		 EnableControl(panel_name,gPanel30,1);
		 EnableControl(panel_name,gErrField30,1);
		 EnableControl(panel_name,gPanel31,1);
		 EnableControl(panel_name,gErrField31,1);
		 EnableControl(panel_name,gPanel32,1);
		 EnableControl(panel_name,gErrField32,1);
		 EnableControl(panel_name,gPanel33,1);
		 EnableControl(panel_name,gErrField33,1);
		 EnableControl(panel_name,gPanel34,1);
		 EnableControl(panel_name,gErrField34,1);
		 EnableControl(panel_name,gPanel35,1);
		 EnableControl(panel_name,gErrField35,1);
		 EnableControl(panel_name,gPanel36,1);
		 EnableControl(panel_name,gErrField36,1);
		 EnableControl(panel_name,gPanel37,1);
		 EnableControl(panel_name,gErrField37,1);
		 EnableControl(panel_name,gPanel38,1);
		 EnableControl(panel_name,gErrField38,1);
		 EnableControl(panel_name,gPanel39,1);
		 EnableControl(panel_name,gErrField39,1);
		 EnableControl(panel_name,gPanel40,1);
		 EnableControl(panel_name,gErrField40,1);
		 EnableControl(panel_name,gPanel41,1);
		 EnableControl(panel_name,gErrField41,1);
		 EnableControl(panel_name,gPanel42,1);
		 EnableControl(panel_name,gErrField42,1);
		 EnableControl(panel_name,gPanel43,1);
		 EnableControl(panel_name,gErrField43,1);
		 EnableControl(panel_name,gPanel44,1);
		 EnableControl(panel_name,gErrField44,1);
		 EnableControl(panel_name,gPanel45,1);
		 EnableControl(panel_name,gErrField45,1);
		 EnableControl(panel_name,gPanel46,1);
		 EnableControl(panel_name,gErrField46,1);
		 EnableControl(panel_name,gPanel47,1);
		 EnableControl(panel_name,gErrField47,1);
		 EnableControl(panel_name,gPanel48,1);
		 EnableControl(panel_name,gErrField48,1);
		 EnableControl(panel_name,gPanel49,1);
		 EnableControl(panel_name,gErrField49,1);
		 EnableControl(panel_name,gPanel50,1);
		 EnableControl(panel_name,gErrField50,1);
		 EnableControl(panel_name,gPanel51,1);
		 EnableControl(panel_name,gErrField51,1);
		 EnableControl(panel_name,gPanel52,1);
		 EnableControl(panel_name,gErrField52,1);
		 EnableControl(panel_name,gPanel53,1);
		 EnableControl(panel_name,gErrField53,1);

}
/*@@end*/

/*@@caplFunc:Name:*/
EnableConfigCtrl ()
{
  	if(getValue(C_ASG_10_1_0_1_FctLstItemEn))
	{
		setControlForeColor(panel_name, gCheckbox1, MakeRGB(0,240,0));
	}
	else
	{
		setControlForeColor(panel_name, gCheckbox1, MakeRGB(250,0,0));
	}
	if(getValue(P_ASG_10_1_0_2_FctLstItemEn))
	{
		setControlForeColor(panel_name, gCheckbox2, MakeRGB(0,240,0));
	}
	else
	{
		setControlForeColor(panel_name, gCheckbox2, MakeRGB(250,0,0));
	}
	if(getValue(P_ASG_10_1_0_3_FctLstItemEn))
	{
		setControlForeColor(panel_name, gCheckbox3, MakeRGB(0,240,0));
	}
	else
	{
		setControlForeColor(panel_name, gCheckbox3, MakeRGB(250,0,0));
	}
	EnableControl(panel_name, "panel_P_ASG_10_1_0_4", 1);
	if(getValue(P_ASG_10_1_0_4_FctLstItemEn))
	{
		setControlForeColor(panel_name, gCheckbox4, MakeRGB(0,240,0));
	}
	else
	{
		setControlForeColor(panel_name, gCheckbox4, MakeRGB(250,0,0));
	}
	if(getValue(P_ASG_10_1_0_13_FctLstItemEn))
	{
		EnableControl(panel_name, "panel_P_ASG_10_1_0_13",1);
		EnableControl(panel_name,"errfield_P_ASG_10_1_0_13",1);
		setControlForeColor(panel_name, gCheckbox13, MakeRGB(0,240,0));
	}
	else
	{
		EnableControl(panel_name, "panel_P_ASG_10_1_0_13",0);
		EnableControl(panel_name,"errfield_P_ASG_10_1_0_13",0);
		setControlForeColor(panel_name, gCheckbox13, MakeRGB(250,0,0));
	}
	if(getValue(P_ASG_10_1_0_14_FctLstItemEn))
	{
		EnableControl(panel_name, "panel_P_ASG_10_1_0_14",1);
		EnableControl(panel_name,"errfield_P_ASG_10_1_0_14",1);
		setControlForeColor(panel_name, gCheckbox14, MakeRGB(0,240,0));
	}
	else
	{
		EnableControl(panel_name, "panel_P_ASG_10_1_0_14",0);
		EnableControl(panel_name,"errfield_P_ASG_10_1_0_14",0);
		setControlForeColor(panel_name, gCheckbox14, MakeRGB(250,0,0));
	}
	if(getValue(P_ASG_10_1_0_15_FctLstItemEn))
	{
		EnableControl(panel_name, "panel_P_ASG_10_1_0_15",1);
		EnableControl(panel_name,"errfield_P_ASG_10_1_0_15",1);
		setControlForeColor(panel_name, gCheckbox15, MakeRGB(0,240,0));
	}
	else
	{
		EnableControl(panel_name, "panel_P_ASG_10_1_0_15",0);
		EnableControl(panel_name,"errfield_P_ASG_10_1_0_15",0);
		setControlForeColor(panel_name, gCheckbox15, MakeRGB(250,0,0));
	}
	if(getValue(P_ASG_10_1_0_16_FctLstItemEn))
	{
		EnableControl(panel_name, "panel_P_ASG_10_1_0_16",1);
		EnableControl(panel_name,"errfield_P_ASG_10_1_0_16",1);
		setControlForeColor(panel_name, gCheckbox16, MakeRGB(0,240,0));
	}
	else
	{
		EnableControl(panel_name, "panel_P_ASG_10_1_0_16",0);
		EnableControl(panel_name,"errfield_P_ASG_10_1_0_16",0);
		setControlForeColor(panel_name, gCheckbox16, MakeRGB(250,0,0));
	}
	if(getValue(P_ASG_10_1_0_17_FctLstItemEn))
	{
		EnableControl(panel_name, "panel_P_ASG_10_1_0_17",1);
		EnableControl(panel_name,"errfield_P_ASG_10_1_0_17",1);
		setControlForeColor(panel_name, gCheckbox17, MakeRGB(0,240,0));
	}
	else
	{
		EnableControl(panel_name, "panel_P_ASG_10_1_0_17",0);
		EnableControl(panel_name,"errfield_P_ASG_10_1_0_17",0);
		setControlForeColor(panel_name, gCheckbox17, MakeRGB(250,0,0));
	}
	if(getValue(P_ASG_10_1_0_18_FctLstItemEn))
	{
		EnableControl(panel_name, "panel_P_ASG_10_1_0_18",1);
		EnableControl(panel_name,"errfield_P_ASG_10_1_0_18",1);
		setControlForeColor(panel_name, gCheckbox18, MakeRGB(0,240,0));
	}
	else
	{
		EnableControl(panel_name, "panel_P_ASG_10_1_0_18",0);
		EnableControl(panel_name,"errfield_P_ASG_10_1_0_18",0);
		setControlForeColor(panel_name, gCheckbox18, MakeRGB(250,0,0));
	}
	if(getValue(P_ASG_10_1_0_19_FctLstItemEn))
	{
		EnableControl(panel_name, "panel_P_ASG_10_1_0_19",1);
		EnableControl(panel_name,"errfield_P_ASG_10_1_0_19",1);
		setControlForeColor(panel_name, gCheckbox19, MakeRGB(0,240,0));
	}
	else
	{
		EnableControl(panel_name, "panel_P_ASG_10_1_0_19",0);
		EnableControl(panel_name,"errfield_P_ASG_10_1_0_19",0);
		setControlForeColor(panel_name, gCheckbox19, MakeRGB(250,0,0));
	}
	if(getValue(P_ASG_10_1_0_20_FctLstItemEn))
	{
		EnableControl(panel_name, "panel_P_ASG_10_1_0_20",1);
		EnableControl(panel_name,"errfield_P_ASG_10_1_0_20",1);
		setControlForeColor(panel_name, gCheckbox20, MakeRGB(0,240,0));
	}
	else
	{
		EnableControl(panel_name, "panel_P_ASG_10_1_0_20",0);
		EnableControl(panel_name,"errfield_P_ASG_10_1_0_20",0);
		setControlForeColor(panel_name, gCheckbox20, MakeRGB(250,0,0));
	}
	if(getValue(P_ASG_10_1_0_21_FctLstItemEn))
	{
		EnableControl(panel_name, "panel_P_ASG_10_1_0_21",1);
		EnableControl(panel_name,"errfield_P_ASG_10_1_0_21",1);
		setControlForeColor(panel_name, gCheckbox21, MakeRGB(0,240,0));
	}
	else
	{
		EnableControl(panel_name, "panel_P_ASG_10_1_0_21",0);
		EnableControl(panel_name,"errfield_P_ASG_10_1_0_21",0);
		setControlForeColor(panel_name, gCheckbox21, MakeRGB(250,0,0));
	}
	if(getValue(P_ASG_10_1_0_22_FctLstItemEn))
	{
		EnableControl(panel_name, "panel_P_ASG_10_1_0_22",1);
		EnableControl(panel_name,"errfield_P_ASG_10_1_0_22",1);
		setControlForeColor(panel_name, gCheckbox22, MakeRGB(0,240,0));
	}
	else
	{
		EnableControl(panel_name, "panel_P_ASG_10_1_0_22",0);
		EnableControl(panel_name,"errfield_P_ASG_10_1_0_22",0);
		setControlForeColor(panel_name, gCheckbox22, MakeRGB(250,0,0));
	}
	if(getValue(P_ASG_10_1_0_23_FctLstItemEn))
	{
		EnableControl(panel_name, "panel_P_ASG_10_1_0_23",1);
		EnableControl(panel_name,"errfield_P_ASG_10_1_0_23",1);
		setControlForeColor(panel_name, gCheckbox23, MakeRGB(0,240,0));
	}
	else
	{
		EnableControl(panel_name, "panel_P_ASG_10_1_0_23",0);
		EnableControl(panel_name,"errfield_P_ASG_10_1_0_23",0);
		setControlForeColor(panel_name, gCheckbox23, MakeRGB(250,0,0));
	}
	if(getValue(P_ASG_10_1_0_24_FctLstItemEn))
	{
		EnableControl(panel_name, "panel_P_ASG_10_1_0_24",1);
		EnableControl(panel_name,"errfield_P_ASG_10_1_0_24",1);
		setControlForeColor(panel_name, gCheckbox24, MakeRGB(0,240,0));
	}
	else
	{
		EnableControl(panel_name, "panel_P_ASG_10_1_0_24",0);
		EnableControl(panel_name,"errfield_P_ASG_10_1_0_24",0);
		setControlForeColor(panel_name, gCheckbox24, MakeRGB(250,0,0));
	}
	if(getValue(P_ASG_10_1_0_25_FctLstItemEn))
	{
		EnableControl(panel_name, "panel_P_ASG_10_1_0_25",1);
		EnableControl(panel_name,"errfield_P_ASG_10_1_0_25",1);
		setControlForeColor(panel_name, gCheckbox25, MakeRGB(0,240,0));
	}
	else
	{
		EnableControl(panel_name, "panel_P_ASG_10_1_0_25",0);
		EnableControl(panel_name,"errfield_P_ASG_10_1_0_25",0);
		setControlForeColor(panel_name, gCheckbox25, MakeRGB(250,0,0));
	}
	if(getValue(P_ASG_10_1_0_26_FctLstItemEn))
	{
		EnableControl(panel_name, "panel_P_ASG_10_1_0_26",1);
		EnableControl(panel_name,"errfield_P_ASG_10_1_0_26",1);
		setControlForeColor(panel_name, gCheckbox26, MakeRGB(0,240,0));
	}
	else
	{
		EnableControl(panel_name, "panel_P_ASG_10_1_0_26",0);
		EnableControl(panel_name,"errfield_P_ASG_10_1_0_26",0);
		setControlForeColor(panel_name, gCheckbox26, MakeRGB(250,0,0));
	}
	if(getValue(P_ASG_10_1_0_27_FctLstItemEn))
	{
		EnableControl(panel_name, "panel_P_ASG_10_1_0_27",1);
		EnableControl(panel_name,"errfield_P_ASG_10_1_0_27",1);
		setControlForeColor(panel_name, gCheckbox27, MakeRGB(0,240,0));
	}
	else
	{
		EnableControl(panel_name, "panel_P_ASG_10_1_0_27",0);
		EnableControl(panel_name,"errfield_P_ASG_10_1_0_27",0);
		setControlForeColor(panel_name, gCheckbox27, MakeRGB(250,0,0));
	}
	if(getValue(P_ASG_10_1_0_28_FctLstItemEn))
	{
		EnableControl(panel_name, "panel_P_ASG_10_1_0_28",1);
		EnableControl(panel_name,"errfield_P_ASG_10_1_0_28",1);
		setControlForeColor(panel_name, gCheckbox28, MakeRGB(0,240,0));
	}
	else
	{
		EnableControl(panel_name, "panel_P_ASG_10_1_0_28",0);
		EnableControl(panel_name,"errfield_P_ASG_10_1_0_28",0);
		setControlForeColor(panel_name, gCheckbox28, MakeRGB(250,0,0));
	}
	if(getValue(P_ASG_10_1_0_29_FctLstItemEn))
	{
		EnableControl(panel_name, "panel_P_ASG_10_1_0_29",1);
		EnableControl(panel_name,"errfield_P_ASG_10_1_0_29",1);
		setControlForeColor(panel_name, gCheckbox29, MakeRGB(0,240,0));
	}
	else
	{
		EnableControl(panel_name, "panel_P_ASG_10_1_0_29",0);
		EnableControl(panel_name,"errfield_P_ASG_10_1_0_29",0);
		setControlForeColor(panel_name, gCheckbox29, MakeRGB(250,0,0));
	}
	if(getValue(P_ASG_10_1_0_30_FctLstItemEn))
	{
		EnableControl(panel_name, "panel_P_ASG_10_1_0_30",1);
		EnableControl(panel_name,"errfield_P_ASG_10_1_0_30",1);
		setControlForeColor(panel_name, gCheckbox30, MakeRGB(0,240,0));
	}
	else
	{
		EnableControl(panel_name, "panel_P_ASG_10_1_0_30",0);
		EnableControl(panel_name,"errfield_P_ASG_10_1_0_30",0);
		setControlForeColor(panel_name, gCheckbox30, MakeRGB(250,0,0));
	}
	if(getValue(P_ASG_10_1_0_31_FctLstItemEn))
	{
		EnableControl(panel_name, "panel_P_ASG_10_1_0_31",1);
		EnableControl(panel_name,"errfield_P_ASG_10_1_0_31",1);
		setControlForeColor(panel_name, gCheckbox31, MakeRGB(0,240,0));
	}
	else
	{
		EnableControl(panel_name, "panel_P_ASG_10_1_0_31",0);
		EnableControl(panel_name,"errfield_P_ASG_10_1_0_31",0);
		setControlForeColor(panel_name, gCheckbox31, MakeRGB(250,0,0));
	}
	if(getValue(P_ASG_10_1_0_32_FctLstItemEn))
	{
		EnableControl(panel_name, "panel_P_ASG_10_1_0_32",1);
		EnableControl(panel_name,"errfield_P_ASG_10_1_0_32",1);
		setControlForeColor(panel_name, gCheckbox32, MakeRGB(0,240,0));
	}
	else
	{
		EnableControl(panel_name, "panel_P_ASG_10_1_0_32",0);
		EnableControl(panel_name,"errfield_P_ASG_10_1_0_32",0);
		setControlForeColor(panel_name, gCheckbox32, MakeRGB(250,0,0));
	}
	if(getValue(P_ASG_10_1_0_33_FctLstItemEn))
	{
		EnableControl(panel_name, "panel_P_ASG_10_1_0_33",1);
		EnableControl(panel_name,"errfield_P_ASG_10_1_0_33",1);
		setControlForeColor(panel_name, gCheckbox33, MakeRGB(0,240,0));
	}
	else
	{
		EnableControl(panel_name, "panel_P_ASG_10_1_0_33",0);
		EnableControl(panel_name,"errfield_P_ASG_10_1_0_33",0);
		setControlForeColor(panel_name, gCheckbox33, MakeRGB(250,0,0));
	}
	if(getValue(P_ASG_10_1_0_34_FctLstItemEn))
	{
		EnableControl(panel_name, "panel_P_ASG_10_1_0_34",1);
		EnableControl(panel_name,"errfield_P_ASG_10_1_0_34",1);
		setControlForeColor(panel_name, gCheckbox34, MakeRGB(0,240,0));
	}
	else
	{
		EnableControl(panel_name, "panel_P_ASG_10_1_0_34",0);
		EnableControl(panel_name,"errfield_P_ASG_10_1_0_34",0);
		setControlForeColor(panel_name, gCheckbox34, MakeRGB(250,0,0));
	}
	if(getValue(P_ASG_10_1_0_35_FctLstItemEn))
	{
		EnableControl(panel_name, "panel_P_ASG_10_1_0_35",1);
		EnableControl(panel_name,"errfield_P_ASG_10_1_0_35",1);
		setControlForeColor(panel_name, gCheckbox35, MakeRGB(0,240,0));
	}
	else
	{
		EnableControl(panel_name, "panel_P_ASG_10_1_0_35",0);
		EnableControl(panel_name,"errfield_P_ASG_10_1_0_35",0);
		setControlForeColor(panel_name, gCheckbox35, MakeRGB(250,0,0));
	}
	if(getValue(P_ASG_10_1_0_36_FctLstItemEn))
	{
		EnableControl(panel_name, "panel_P_ASG_10_1_0_36",1);
		EnableControl(panel_name,"errfield_P_ASG_10_1_0_36",1);
		setControlForeColor(panel_name, gCheckbox36, MakeRGB(0,240,0));
	}
	else
	{
		EnableControl(panel_name, "panel_P_ASG_10_1_0_36",0);
		EnableControl(panel_name,"errfield_P_ASG_10_1_0_36",0);
		setControlForeColor(panel_name, gCheckbox36, MakeRGB(250,0,0));
	}
	if(getValue(P_ASG_10_1_0_37_FctLstItemEn))
	{
		EnableControl(panel_name, "panel_P_ASG_10_1_0_37",1);
		EnableControl(panel_name,"errfield_P_ASG_10_1_0_37",1);
		setControlForeColor(panel_name, gCheckbox37, MakeRGB(0,240,0));
	}
	else
	{
		EnableControl(panel_name, "panel_P_ASG_10_1_0_37",0);
		EnableControl(panel_name,"errfield_P_ASG_10_1_0_37",0);
		setControlForeColor(panel_name, gCheckbox37, MakeRGB(250,0,0));
	}
	if(getValue(P_ASG_10_1_0_38_FctLstItemEn))
	{
		EnableControl(panel_name, "panel_P_ASG_10_1_0_38",1);
		EnableControl(panel_name,"errfield_P_ASG_10_1_0_38",1);
		setControlForeColor(panel_name, gCheckbox38, MakeRGB(0,240,0));
	}
	else
	{
		EnableControl(panel_name, "panel_P_ASG_10_1_0_38",0);
		EnableControl(panel_name,"errfield_P_ASG_10_1_0_38",0);
		setControlForeColor(panel_name, gCheckbox38, MakeRGB(250,0,0));
	}
	if(getValue(P_ASG_10_1_0_39_FctLstItemEn))
	{
		EnableControl(panel_name, "panel_P_ASG_10_1_0_39",1);
		EnableControl(panel_name,"errfield_P_ASG_10_1_0_39",1);
		setControlForeColor(panel_name, gCheckbox39, MakeRGB(0,240,0));
	}
	else
	{
		EnableControl(panel_name, "panel_P_ASG_10_1_0_39",0);
		EnableControl(panel_name,"errfield_P_ASG_10_1_0_39",0);
		setControlForeColor(panel_name, gCheckbox39, MakeRGB(250,0,0));
	}
	if(getValue(P_ASG_10_1_0_40_FctLstItemEn))
	{
		EnableControl(panel_name, "panel_P_ASG_10_1_0_40",1);
		EnableControl(panel_name,"errfield_P_ASG_10_1_0_40",1);
		setControlForeColor(panel_name, gCheckbox40, MakeRGB(0,240,0));
	}
	else
	{
		EnableControl(panel_name, "panel_P_ASG_10_1_0_40",0);
		EnableControl(panel_name,"errfield_P_ASG_10_1_0_40",0);
		setControlForeColor(panel_name, gCheckbox40, MakeRGB(250,0,0));
	}
	if(getValue(P_ASG_10_1_0_41_FctLstItemEn))
	{
		EnableControl(panel_name, "panel_P_ASG_10_1_0_41",1);
		EnableControl(panel_name,"errfield_P_ASG_10_1_0_41",1);
		setControlForeColor(panel_name, gCheckbox41, MakeRGB(0,240,0));
	}
	else
	{
		EnableControl(panel_name, "panel_P_ASG_10_1_0_41",0);
		EnableControl(panel_name,"errfield_P_ASG_10_1_0_41",0);
		setControlForeColor(panel_name, gCheckbox41, MakeRGB(250,0,0));
	}
	if(getValue(P_ASG_10_1_0_42_FctLstItemEn))
	{
		EnableControl(panel_name, "panel_P_ASG_10_1_0_42",1);
		EnableControl(panel_name,"errfield_P_ASG_10_1_0_42",1);
		setControlForeColor(panel_name, gCheckbox42, MakeRGB(0,240,0));
	}
	else
	{
		EnableControl(panel_name, "panel_P_ASG_10_1_0_42",0);
		EnableControl(panel_name,"errfield_P_ASG_10_1_0_42",0);
		setControlForeColor(panel_name, gCheckbox42, MakeRGB(250,0,0));
	}
	if(getValue(P_ASG_10_1_0_43_FctLstItemEn))
	{
		EnableControl(panel_name, "panel_P_ASG_10_1_0_43",1);
		EnableControl(panel_name,"errfield_P_ASG_10_1_0_43",1);
		setControlForeColor(panel_name, gCheckbox43, MakeRGB(0,240,0));
	}
	else
	{
		EnableControl(panel_name, "panel_P_ASG_10_1_0_43",0);
		EnableControl(panel_name,"errfield_P_ASG_10_1_0_43",0);
		setControlForeColor(panel_name, gCheckbox43, MakeRGB(250,0,0));
	}
	if(getValue(P_ASG_10_1_0_44_FctLstItemEn))
	{
		EnableControl(panel_name, "panel_P_ASG_10_1_0_44",1);
		EnableControl(panel_name,"errfield_P_ASG_10_1_0_44",1);
		setControlForeColor(panel_name, gCheckbox44, MakeRGB(0,240,0));
	}
	else
	{
		EnableControl(panel_name, "panel_P_ASG_10_1_0_44",0);
		EnableControl(panel_name,"errfield_P_ASG_10_1_0_44",0);
		setControlForeColor(panel_name, gCheckbox44, MakeRGB(250,0,0));
	}
	if(getValue(P_ASG_10_1_0_45_FctLstItemEn))
	{
		EnableControl(panel_name, "panel_P_ASG_10_1_0_45",1);
		EnableControl(panel_name,"errfield_P_ASG_10_1_0_45",1);
		setControlForeColor(panel_name, gCheckbox45, MakeRGB(0,240,0));
	}
	else
	{
		EnableControl(panel_name, "panel_P_ASG_10_1_0_45",0);
		EnableControl(panel_name,"errfield_P_ASG_10_1_0_45",0);
		setControlForeColor(panel_name, gCheckbox45, MakeRGB(250,0,0));
	}
	if(getValue(P_ASG_10_1_0_46_FctLstItemEn))
	{
		EnableControl(panel_name, "panel_P_ASG_10_1_0_46",1);
		EnableControl(panel_name,"errfield_P_ASG_10_1_0_46",1);
		setControlForeColor(panel_name, gCheckbox46, MakeRGB(0,240,0));
	}
	else
	{
		EnableControl(panel_name, "panel_P_ASG_10_1_0_46",0);
		EnableControl(panel_name,"errfield_P_ASG_10_1_0_46",0);
		setControlForeColor(panel_name, gCheckbox46, MakeRGB(250,0,0));
	}
	if(getValue(P_ASG_10_1_0_47_FctLstItemEn))
	{
		EnableControl(panel_name, "panel_P_ASG_10_1_0_47",1);
		EnableControl(panel_name,"errfield_P_ASG_10_1_0_47",1);
		setControlForeColor(panel_name, gCheckbox47, MakeRGB(0,240,0));
	}
	else
	{
		EnableControl(panel_name, "panel_P_ASG_10_1_0_47",0);
		EnableControl(panel_name,"errfield_P_ASG_10_1_0_47",0);
		setControlForeColor(panel_name, gCheckbox47, MakeRGB(250,0,0));
	}
	if(getValue(P_ASG_10_1_0_48_FctLstItemEn))
	{
		EnableControl(panel_name, "panel_P_ASG_10_1_0_48",1);
		EnableControl(panel_name,"errfield_P_ASG_10_1_0_48",1);
		setControlForeColor(panel_name, gCheckbox48, MakeRGB(0,240,0));
	}
	else
	{
		EnableControl(panel_name, "panel_P_ASG_10_1_0_48",0);
		EnableControl(panel_name,"errfield_P_ASG_10_1_0_48",0);
		setControlForeColor(panel_name, gCheckbox48, MakeRGB(250,0,0));
	}
	if(getValue(P_ASG_10_1_0_49_FctLstItemEn))
	{
		EnableControl(panel_name, "panel_P_ASG_10_1_0_49",1);
		EnableControl(panel_name,"errfield_P_ASG_10_1_0_49",1);
		setControlForeColor(panel_name, gCheckbox49, MakeRGB(0,240,0));
	}
	else
	{
		EnableControl(panel_name, "panel_P_ASG_10_1_0_49",0);
		EnableControl(panel_name,"errfield_P_ASG_10_1_0_49",0);
		setControlForeColor(panel_name, gCheckbox49, MakeRGB(250,0,0));
	}
	if(getValue(P_ASG_10_1_0_50_FctLstItemEn))
	{
		EnableControl(panel_name, "panel_P_ASG_10_1_0_50",1);
		EnableControl(panel_name,"errfield_P_ASG_10_1_0_50",1);
		setControlForeColor(panel_name, gCheckbox50, MakeRGB(0,240,0));
	}
	else
	{
		EnableControl(panel_name, "panel_P_ASG_10_1_0_50",0);
		EnableControl(panel_name,"errfield_P_ASG_10_1_0_50",0);
		setControlForeColor(panel_name, gCheckbox50, MakeRGB(250,0,0));
	}
	if(getValue(P_ASG_10_1_0_51_FctLstItemEn))
	{
		EnableControl(panel_name, "panel_P_ASG_10_1_0_51",1);
		EnableControl(panel_name,"errfield_P_ASG_10_1_0_51",1);
		setControlForeColor(panel_name, gCheckbox51, MakeRGB(0,240,0));
	}
	else
	{
		EnableControl(panel_name, "panel_P_ASG_10_1_0_51",0);
		EnableControl(panel_name,"errfield_P_ASG_10_1_0_51",0);
		setControlForeColor(panel_name, gCheckbox51, MakeRGB(250,0,0));
	}
	if(getValue(P_ASG_10_1_0_52_FctLstItemEn))
	{
		EnableControl(panel_name, "panel_P_ASG_10_1_0_52",1);
		EnableControl(panel_name,"errfield_P_ASG_10_1_0_52",1);
		setControlForeColor(panel_name, gCheckbox52, MakeRGB(0,240,0));
	}
	else
	{
		EnableControl(panel_name, "panel_P_ASG_10_1_0_52",0);
		EnableControl(panel_name,"errfield_P_ASG_10_1_0_52",0);
		setControlForeColor(panel_name, gCheckbox52, MakeRGB(250,0,0));
	}
	if(getValue(P_ASG_10_1_0_53_FctLstItemEn))
	{
		EnableControl(panel_name, "panel_P_ASG_10_1_0_53",1);
		EnableControl(panel_name,"errfield_P_ASG_10_1_0_53",1);
		setControlForeColor(panel_name, gCheckbox53, MakeRGB(0,240,0));
	}
	else
	{
		EnableControl(panel_name, "panel_P_ASG_10_1_0_53",0);
		EnableControl(panel_name,"errfield_P_ASG_10_1_0_53",0);
		setControlForeColor(panel_name, gCheckbox53, MakeRGB(250,0,0));
	}

}
/*@@end*/

/*@@caplFunc:Name:*/
DisableReservedFld ()
{
  	EnableControl(panel_name,"P_ASG_10_1_0_20_2_reserved",0);
	EnableControl(panel_name,"P_ASG_10_1_0_20_3_reserved",0);
	EnableControl(panel_name,"P_ASG_10_1_0_24_2_reserved",0);
	EnableControl(panel_name,"P_ASG_10_1_0_24_3_reserved",0);
	EnableControl(panel_name,"P_ASG_10_1_0_29_2_reserved",0);
	EnableControl(panel_name,"P_ASG_10_1_0_29_3_reserved",0);
	EnableControl(panel_name,"P_ASG_10_1_0_32_2_reserved",0);
	EnableControl(panel_name,"P_ASG_10_1_0_32_3_reserved",0);
	EnableControl(panel_name,"P_ASG_10_1_0_37_1_reserved",0);
	EnableControl(panel_name,"P_ASG_10_1_0_37_2_reserved",0);
	EnableControl(panel_name,"P_ASG_10_1_0_37_3_reserved",0);
	EnableControl(panel_name,"P_ASG_10_1_0_37_4_reserved",0);
	EnableControl(panel_name,"P_ASG_10_1_0_37_5_reserved",0);
	EnableControl(panel_name,"P_ASG_10_1_0_37_6_reserved",0);
	EnableControl(panel_name,"P_ASG_10_1_0_40_2_reserved",0);
	EnableControl(panel_name,"P_ASG_10_1_0_40_3_reserved",0);
	EnableControl(panel_name,"P_ASG_10_1_0_41_3_reserved",0);
	EnableControl(panel_name,"P_ASG_10_1_0_41_4_reserved",0);
	EnableControl(panel_name,"P_ASG_10_1_0_42_2_reserved",0);
	EnableControl(panel_name,"P_ASG_10_1_0_42_3_reserved",0);
	EnableControl(panel_name,"P_ASG_10_1_0_43_3_reserved",0);
	EnableControl(panel_name,"P_ASG_10_1_0_43_4_reserved",0);
	EnableControl(panel_name,"P_ASG_10_1_0_44_2_reserved",0);
	EnableControl(panel_name,"P_ASG_10_1_0_44_3_reserved",0);
	EnableControl(panel_name,"P_ASG_10_1_0_45_2_reserved",0);
	EnableControl(panel_name,"P_ASG_10_1_0_45_3_reserved",0);
	EnableControl(panel_name,"P_ASG_10_1_0_46_2_reserved",0);
	EnableControl(panel_name,"P_ASG_10_1_0_46_3_reserved",0);
	EnableControl(panel_name,"P_ASG_10_1_0_48_2_reserved",0);
	EnableControl(panel_name,"P_ASG_10_1_0_48_3_reserved",0);
	EnableControl(panel_name,"P_ASG_10_1_0_49_2_reserved",0);
	EnableControl(panel_name,"P_ASG_10_1_0_49_3_reserved",0);
	EnableControl(panel_name,"P_ASG_10_1_0_49_4_reserved",0);
	EnableControl(panel_name,"P_ASG_10_1_0_51_2_reserved",0);
	EnableControl(panel_name,"P_ASG_10_1_0_51_3_reserved",0);
	EnableControl(panel_name,"P_ASG_10_1_0_53_4_reserved",0);
	EnableControl(panel_name,"P_ASG_10_1_0_53_5_reserved",0);

}
/*@@end*/

/*@@caplFunc:Name:*/
resetErrfieldColor()
{
  	setControlBackColor(panel_name, "errfield_C_ASG_10_1_0_1", MakeRGB(255,255,255));
	setControlBackColor(panel_name, "errfield_P_ASG_10_1_0_2", MakeRGB(255,255,255));
	setControlBackColor(panel_name, "errfield_P_ASG_10_1_0_3", MakeRGB(255,255,255));
	setControlBackColor(panel_name, "errfield_P_ASG_10_1_0_4", MakeRGB(255,255,255));
	setControlBackColor(panel_name, "errfield_P_ASG_10_1_0_13", MakeRGB(255,255,255));
	setControlBackColor(panel_name, "errfield_P_ASG_10_1_0_14", MakeRGB(255,255,255));
	setControlBackColor(panel_name, "errfield_P_ASG_10_1_0_15", MakeRGB(255,255,255));
	setControlBackColor(panel_name, "errfield_P_ASG_10_1_0_16", MakeRGB(255,255,255));
	setControlBackColor(panel_name, "errfield_P_ASG_10_1_0_17", MakeRGB(255,255,255));
	setControlBackColor(panel_name, "errfield_P_ASG_10_1_0_18", MakeRGB(255,255,255));
	setControlBackColor(panel_name, "errfield_P_ASG_10_1_0_19", MakeRGB(255,255,255));
	setControlBackColor(panel_name, "errfield_P_ASG_10_1_0_20", MakeRGB(255,255,255));
	setControlBackColor(panel_name, "errfield_P_ASG_10_1_0_21", MakeRGB(255,255,255));
	setControlBackColor(panel_name, "errfield_P_ASG_10_1_0_22", MakeRGB(255,255,255));
	setControlBackColor(panel_name, "errfield_P_ASG_10_1_0_23", MakeRGB(255,255,255));
	setControlBackColor(panel_name, "errfield_P_ASG_10_1_0_24", MakeRGB(255,255,255));
	setControlBackColor(panel_name, "errfield_P_ASG_10_1_0_25", MakeRGB(255,255,255));
	setControlBackColor(panel_name, "errfield_P_ASG_10_1_0_26", MakeRGB(255,255,255));
	setControlBackColor(panel_name, "errfield_P_ASG_10_1_0_27", MakeRGB(255,255,255));
	setControlBackColor(panel_name, "errfield_P_ASG_10_1_0_28", MakeRGB(255,255,255));
	setControlBackColor(panel_name, "errfield_P_ASG_10_1_0_29", MakeRGB(255,255,255));
	setControlBackColor(panel_name, "errfield_P_ASG_10_1_0_30", MakeRGB(255,255,255));
	setControlBackColor(panel_name, "errfield_P_ASG_10_1_0_31", MakeRGB(255,255,255));
	setControlBackColor(panel_name, "errfield_P_ASG_10_1_0_32", MakeRGB(255,255,255));
	setControlBackColor(panel_name, "errfield_P_ASG_10_1_0_33", MakeRGB(255,255,255));
	setControlBackColor(panel_name, "errfield_P_ASG_10_1_0_34", MakeRGB(255,255,255));
	setControlBackColor(panel_name, "errfield_P_ASG_10_1_0_35", MakeRGB(255,255,255));
	setControlBackColor(panel_name, "errfield_P_ASG_10_1_0_36", MakeRGB(255,255,255));
	setControlBackColor(panel_name, "errfield_P_ASG_10_1_0_37", MakeRGB(255,255,255));
	setControlBackColor(panel_name, "errfield_P_ASG_10_1_0_38", MakeRGB(255,255,255));
	setControlBackColor(panel_name, "errfield_P_ASG_10_1_0_39", MakeRGB(255,255,255));
	setControlBackColor(panel_name, "errfield_P_ASG_10_1_0_40", MakeRGB(255,255,255));
	setControlBackColor(panel_name, "errfield_P_ASG_10_1_0_41", MakeRGB(255,255,255));
	setControlBackColor(panel_name, "errfield_P_ASG_10_1_0_42", MakeRGB(255,255,255));
	setControlBackColor(panel_name, "errfield_P_ASG_10_1_0_43", MakeRGB(255,255,255));
	setControlBackColor(panel_name, "errfield_P_ASG_10_1_0_44", MakeRGB(255,255,255));
	setControlBackColor(panel_name, "errfield_P_ASG_10_1_0_45", MakeRGB(255,255,255));
	setControlBackColor(panel_name, "errfield_P_ASG_10_1_0_46", MakeRGB(255,255,255));
	setControlBackColor(panel_name, "errfield_P_ASG_10_1_0_47", MakeRGB(255,255,255));
	setControlBackColor(panel_name, "errfield_P_ASG_10_1_0_48", MakeRGB(255,255,255));
	setControlBackColor(panel_name, "errfield_P_ASG_10_1_0_49", MakeRGB(255,255,255));
	setControlBackColor(panel_name, "errfield_P_ASG_10_1_0_50", MakeRGB(255,255,255));
	setControlBackColor(panel_name, "errfield_P_ASG_10_1_0_51", MakeRGB(255,255,255));
	setControlBackColor(panel_name, "errfield_P_ASG_10_1_0_52", MakeRGB(255,255,255));
	setControlBackColor(panel_name, "errfield_P_ASG_10_1_0_53", MakeRGB(255,255,255));

}
/*@@end*/

/*@@caplFunc:Name:*/
CANoe_Shutdown ()
{
	// Timer 
	canceltimer(TaskTimer);		//cancel real CAN-communication timer

	// Ruecksetzen der Hintergrundfarbe der Error-Felder
	resetErrfieldColor();
	// Deaktivierung aller Panel Elemente 
	DisableFctCtrl();
	EnableControl(panel_name, bapconfig_panel_name, 0); 
	EnableConfigCtrl();

}
/*@@end*/

/*@@timer:Name:*/
on timer TaskTimer
{

	/*** Aufruf des BAP Task in DLL fuer NODE_INDEX ***/
	BAP150_Task(NODE_INDEX);	

	/*** Pollen ueber die anstehenden Indications (Lesen aus DLL, Auslesen eines Puffers der DLL) ***/
	BAP_DLL_Indication();	
	
	/*** Pollen ueber die anstehenden Requests (Schreiben in DLL, dort werden evt. Sendeauftraege gesetzt) ***/
	BAP_DLL_Request();
	
	/*** Abarbeiten der ausstehenden Sendeauftraege innerhalb der BAP DLL und Versenden ueber CANoe ***/
	BAP_CAN_TX_Request();

	/*** Der Empfang von CAN Daten geschieht ueber on message CAN message Mechanismen ***/
	// keine Funktion hier

	/*** Retriggern des Timers mit 10 ms ***/
	setTimer(TaskTimer, TaskTime); // @TODO bei anderer Taskzeit muss hier modifiziert werden
}
/*@@end*/

/*@@caplFunc:Name:*/
BAP_DLL_Indication()	//function to get received BAP-data from DLL (at BAL-interface)
{
	int i, length, datalength, temp;
	byte Indication_data[BAP_buffer_size];		// indication data from DLL
	dword Indication_header[6];					// indication header from DLL
	byte BAP_data_type;

	//init local variables
	length=0;
	datalength=0;
	temp=0;
	BAP_data_type=0;

	for(i=0;i<6;i++)
		Indication_header[i]=0;

	for(i=0;i<BAP_buffer_size;i++)
		Indication_data[i]=0;

	// BAP-Stack needs this information for successful BAP150_GetIndication 
	Indication_header[4]=BAP_buffer_size;

	while (BAP150_GetInd(NODE_INDEX, Indication_header, Indication_data) == 0)
	{		
		//read header and write in global variable
		for (i = 0; i < 6; i++) {
			gBAP_Indication_header[i]=Indication_header[i];	
		}

		// nur Bytesequneces haben Datenanteil
		if (gBAP_Indication_header[3] == Bap_byteSequence)
		{
			for (i = 0; i < BAP_buffer_size; i++) {
				gBAP_Indication_data[i]=Indication_data[i];	
			}
		}	
		// Verarbeiten der Indication
		Process_Current_Indication();

		// Vorbereiten fuer naechsten Durchlauf 
		Indication_header[4]=BAP_buffer_size;
	} 
}
/*@@end*/

/*@@caplFunc:Name:*/
ChangeConfig(long paramIndex,long config[])
{

        byte temp ;
        temp = BAP150_ChangeConfig(NODE_INDEX, paramIndex, config);
        if(temp == 0)
            writelineEx(gBAP_Trace, 0, "BAP150_ChangeConfig for %s succesful (LSG %d, NODE_INDEX %d)", NODE_NAME, LSGID, NODE_INDEX);
        else
            writelineEx(gError_Trace, 0, "BAP150_ChangeConfig error 0x%X for %s (LSG %d, NODE_INDEX %d)", temp, NODE_NAME, LSGID, NODE_INDEX);        
}
/*@@end*/

/*@@caplFunc:Name:*/
PrintIndicationError(char reason[])
{
	writelineEx(gError_Trace, 0, "%s - %s lsgId:%d fctid:%d indType:%s dataType:%s",
		reason, SGtype, gBAP_Indication_header[0], gBAP_Indication_header[1], Indicationtype_Text[gBAP_Indication_header[2]], Datatype_Text[gBAP_Indication_header[3]]);
}
/*@@end*/

/*@@caplFunc:Name:*/
BapOnOff(byte _on)
{
    int length, temp;

    /***** Einschalten ******/
    if(_on==1){
        // soll der BAP Stack wieder initlialisiert werden?                                 
        if(gBAP_Init==0){
            gBAP_Init=1;
            temp=BAP150_Init(NODE_INDEX, LSGID);
            if(temp==0)
                writelineEx(gBAP_Trace, 0, "BAP_Init for %s succesful (LSG %d, NODE_INDEX %d)", NODE_NAME, LSGID, NODE_INDEX);
            else
                writelineEx(gError_Trace, 0, "BAP_Init error 0x%X for %s (LSG %d, NODE_INDEX %d)", temp, NODE_NAME, LSGID, NODE_INDEX);         
        }

        // Initialisierung aller Variablen
        Initialize_Variables();                     

        // Aktivierung aller Panelelemente
		//EnableFctCtrl();
		initInvalidFields();
		EnableControl(panel_name, common_panel_name, 1);
		EnableControl(panel_name, bapconfig_panel_name, 1); 
		DisableReservedFld();

        //BAP-Shutdown
        temp = BAP150_Shutdown(NODE_INDEX, LSGID);
        if(temp==0)
            writelineEx(gBAP_Trace, 0, "BAP_Shutdown for %s succesful (LSG %d, NODE_INDEX %d)", NODE_NAME, LSGID, NODE_INDEX);
        else
            writelineEx(gError_Trace, 0, "BAP_Shutdown error 0x%X for %s (LSG %d, NODE_INDEX %d)", temp, NODE_NAME, LSGID, NODE_INDEX); 

        //BAP-Start
        temp = BAP150_Start(NODE_INDEX, LSGID);             
        if(temp == 0)
            writelineEx(gBAP_Trace, 0, "BAP_Start for %s succesful (LSG %d, NODE_INDEX %d)", NODE_NAME, LSGID, NODE_INDEX);
        else
            writelineEx(gError_Trace, 0, "BAP_Start error 0x%X for %s (LSG %d, NODE_INDEX %d)", temp, NODE_NAME, LSGID, NODE_INDEX);        
    
        // setze den Timer fuer den zyklischen Aufruf des CANoe-"Tasks"
        setTimer(TaskTimer, 10);                
    
        //  BAPFsg_ProcessDebug(NODE_INDEX,DEBUG_CAN_CHANNEL, DEBUG_ID, LSGID, DEBUG_SWITCH_ON);    
    }
    else{ /***** Ausschalten ****/
        
        BAP150_Shutdown(NODE_INDEX,LSGID);
        
        CANoe_Shutdown();
        
        // ETHERNET NOT ENABLED! (CALL_FCT_CLOSE_UPD_SOCKET_TOKEN)
    }

}
/*@@end*/

/*@@caplFunc:Name:*/
Initialize_Variables()	//initialize/reset all global variables
{
	int i;
	byte  Init_data[BAP_buffer_size];	// InitSend data for DLL

	/**** Request Buffer Geschichten initialisieren ****/
	for (i = 0; i < Requestbuffer_lines; i++)
	{
		gBAP_Requestbuffer_status[i] = 0;
	}
	for (i = 0; i < BAP_buffer_size; i++)
	{
		Init_data[i] = 0;
	}
	
	/* Wert im Eingabefeld initialisieren*/
	putValue(P_ASG_10_1_0_13, 0);
	getValue(P_ASG_10_1_0_16,Init_data);
	putValue(P_ASG_10_1_0_16,Init_data, 2);
	getValue(P_ASG_10_1_0_17,Init_data);
	putValue(P_ASG_10_1_0_17,Init_data, 2);
	getValue(P_ASG_10_1_0_20,Init_data);
	putValue(P_ASG_10_1_0_20,Init_data, 2);
	getValue(P_ASG_10_1_0_21,Init_data);
	putValue(P_ASG_10_1_0_21,Init_data, 2);
	putValue(P_ASG_10_1_0_22, 0);
	getValue(P_ASG_10_1_0_24,Init_data);
	putValue(P_ASG_10_1_0_24,Init_data, 2);
	getValue(P_ASG_10_1_0_27,Init_data);
	putValue(P_ASG_10_1_0_27,Init_data, 2);
	getValue(P_ASG_10_1_0_28,Init_data);
	putValue(P_ASG_10_1_0_28,Init_data, 2);
	getValue(P_ASG_10_1_0_29,Init_data);
	putValue(P_ASG_10_1_0_29,Init_data, 2);
	getValue(P_ASG_10_1_0_32,Init_data);
	putValue(P_ASG_10_1_0_32,Init_data, 2);
	getValue(P_ASG_10_1_0_37,Init_data);
	putValue(P_ASG_10_1_0_37,Init_data, 5);
	getValue(P_ASG_10_1_0_40,Init_data);
	putValue(P_ASG_10_1_0_40,Init_data, 2);
	getValue(P_ASG_10_1_0_41,Init_data);
	putValue(P_ASG_10_1_0_41,Init_data, 2);
	getValue(P_ASG_10_1_0_42,Init_data);
	putValue(P_ASG_10_1_0_42,Init_data, 2);
	getValue(P_ASG_10_1_0_43,Init_data);
	putValue(P_ASG_10_1_0_43,Init_data, 3);
	getValue(P_ASG_10_1_0_44,Init_data);
	putValue(P_ASG_10_1_0_44,Init_data, 2);
	getValue(P_ASG_10_1_0_45,Init_data);
	putValue(P_ASG_10_1_0_45,Init_data, 2);
	getValue(P_ASG_10_1_0_46,Init_data);
	putValue(P_ASG_10_1_0_46,Init_data, 2);
	getValue(P_ASG_10_1_0_48,Init_data);
	putValue(P_ASG_10_1_0_48,Init_data, 2);
	getValue(P_ASG_10_1_0_49,Init_data);
	putValue(P_ASG_10_1_0_49,Init_data, 5);
	getValue(P_ASG_10_1_0_51,Init_data);
	putValue(P_ASG_10_1_0_51,Init_data, 2);
	getValue(P_ASG_10_1_0_53,Init_data);
	putValue(P_ASG_10_1_0_53,Init_data, 4);
	/* Farbe setzen*/
	putValue(C_ASG_10_1_0_1_State,"");
	setControlBackColor(panel_name, "errfield_C_ASG_10_1_0_1_State", MakeRGB(255,255,255));

}
/*@@end*/

/*@@caplFunc:Name:*/
initInvalidFields()	//initialize/reset all global variables
{
	    setControlBackColor(panel_name, "panel1_edit", MakeRGB(220,220,220));
    setControlBackColor(panel_name, "panel_P_ASG_10_1_0_4", MakeRGB(220,220,220));
    setControlBackColor(panel_name, "panel_P_ASG_10_1_0_13", MakeRGB(220,220,220));
    setControlBackColor(panel_name, "panel_P_ASG_10_1_0_14", MakeRGB(220,220,220));
    setControlBackColor(panel_name, "panel_P_ASG_10_1_0_15", MakeRGB(220,220,220));
    setControlBackColor(panel_name, "panel_P_ASG_10_1_0_16", MakeRGB(220,220,220));
    setControlBackColor(panel_name, "panel_P_ASG_10_1_0_17", MakeRGB(220,220,220));
    setControlBackColor(panel_name, "panel_P_ASG_10_1_0_18", MakeRGB(220,220,220));
    setControlBackColor(panel_name, "panel_P_ASG_10_1_0_19", MakeRGB(220,220,220));
    setControlBackColor(panel_name, "panel_P_ASG_10_1_0_20", MakeRGB(220,220,220));
    setControlBackColor(panel_name, "panel_P_ASG_10_1_0_21", MakeRGB(220,220,220));
    setControlBackColor(panel_name, "panel_P_ASG_10_1_0_22", MakeRGB(220,220,220));
    setControlBackColor(panel_name, "panel_P_ASG_10_1_0_23", MakeRGB(220,220,220));
    setControlBackColor(panel_name, "panel_P_ASG_10_1_0_24", MakeRGB(220,220,220));
    setControlBackColor(panel_name, "panel_P_ASG_10_1_0_25", MakeRGB(220,220,220));
    setControlBackColor(panel_name, "panel_P_ASG_10_1_0_26", MakeRGB(220,220,220));
    setControlBackColor(panel_name, "panel_P_ASG_10_1_0_27", MakeRGB(220,220,220));
    setControlBackColor(panel_name, "panel_P_ASG_10_1_0_28", MakeRGB(220,220,220));
    setControlBackColor(panel_name, "panel_P_ASG_10_1_0_29", MakeRGB(220,220,220));
    setControlBackColor(panel_name, "panel_P_ASG_10_1_0_30", MakeRGB(220,220,220));
    setControlBackColor(panel_name, "panel_P_ASG_10_1_0_31", MakeRGB(220,220,220));
    setControlBackColor(panel_name, "panel_P_ASG_10_1_0_32", MakeRGB(220,220,220));
    setControlBackColor(panel_name, "panel_P_ASG_10_1_0_33", MakeRGB(220,220,220));
    setControlBackColor(panel_name, "panel_P_ASG_10_1_0_34", MakeRGB(220,220,220));
    setControlBackColor(panel_name, "panel_P_ASG_10_1_0_35", MakeRGB(220,220,220));
    setControlBackColor(panel_name, "panel_P_ASG_10_1_0_36", MakeRGB(220,220,220));
    setControlBackColor(panel_name, "panel_P_ASG_10_1_0_37", MakeRGB(220,220,220));
    setControlBackColor(panel_name, "panel_P_ASG_10_1_0_38", MakeRGB(220,220,220));
    setControlBackColor(panel_name, "panel_P_ASG_10_1_0_39", MakeRGB(220,220,220));
    setControlBackColor(panel_name, "panel_P_ASG_10_1_0_40", MakeRGB(220,220,220));
    setControlBackColor(panel_name, "panel_P_ASG_10_1_0_41", MakeRGB(220,220,220));
    setControlBackColor(panel_name, "panel_P_ASG_10_1_0_42", MakeRGB(220,220,220));
    setControlBackColor(panel_name, "panel_P_ASG_10_1_0_43", MakeRGB(220,220,220));
    setControlBackColor(panel_name, "panel_P_ASG_10_1_0_44", MakeRGB(220,220,220));
    setControlBackColor(panel_name, "panel_P_ASG_10_1_0_45", MakeRGB(220,220,220));
    setControlBackColor(panel_name, "panel_P_ASG_10_1_0_46", MakeRGB(220,220,220));
    setControlBackColor(panel_name, "panel_P_ASG_10_1_0_47", MakeRGB(220,220,220));
    setControlBackColor(panel_name, "panel_P_ASG_10_1_0_48", MakeRGB(220,220,220));
    setControlBackColor(panel_name, "panel_P_ASG_10_1_0_49", MakeRGB(220,220,220));
    setControlBackColor(panel_name, "panel_P_ASG_10_1_0_50", MakeRGB(220,220,220));
    setControlBackColor(panel_name, "panel_P_ASG_10_1_0_51", MakeRGB(220,220,220));
    setControlBackColor(panel_name, "panel_P_ASG_10_1_0_52", MakeRGB(220,220,220));
    setControlBackColor(panel_name, "panel_P_ASG_10_1_0_53", MakeRGB(220,220,220));

}
/*@@end*/

/*@@startStart:Start:*/
on start
{
	// noch nicht eingeschaltet
	gSG_PowerOnOff=0;
	// noch nicht initialisiert
	gBAP_Init=0;
	// open the panel, nur fuer CANoe-Version >= 5.1 erlaubt
	//openPanel(panel_name);
	// deaktiviere alle aktiven Panel Elemente, ausser AN/AUSS
    CANoe_Shutdown();
    // ungueltige Felder initialisieren
    initInvalidFields();    
    
// ETHERNET AND FLEXRAY NOT ENABLED!
}
/*@@end*/

/*@@caplFunc:Name:*/
BAP_CAN_TX_Request()	//Function to send BAP-data over CAN
{
   int i;
   byte TX_Data[8];				// CAN-data
   byte TX_Data_FR[10];    		// FlexRay-Data
   dword TX_Header[3];			// CAN-header
   message 0x100 TX_Message;	// dummy-message, Adresse wird noch modifiziert
   
   byte send_result;
   
   // ONLY CAN IS ENABLED! 
   		TX_Header[2] = 8; // max-Length of TX_Data

		// Pollen ueber die Queue, die von der DLL zur Verfuegung gestellt wird
		// Diese Daten muessen ueber den CAN Bus gesendet werden
	   	while (BAP150_CAN_GetTxDat(NODE_INDEX,TX_Header,TX_Data) == 0) {	
			TX_Message.CAN = TX_Header[0]; 		//CAN channel
			TX_Message.ID =TX_Header[1]; 			//Can ID
			TX_Message.DLC = TX_Header[2]; 		// received length
			
			for (i=0; i<TX_Message.DLC; i++) {	//CAN data-bytes
		  		TX_Message.byte(i) = TX_Data[i];
		  	}
		  	
		  	output(TX_Message);					//send CAN message
		  	
		  	//Versions Output
		  	if(TX_Data[0] == 0x40 && TX_Data[1] == 0x00 && TX_Header[2] == 4)
		  	{
		    	writelineEx(gBAP_Trace, 0,"Major Version: %i, Minor Version: %i", TX_Data[2], TX_Data[3]);
		  	}       
		  	TX_Header[2] = 8; // max-Length of TX_Data
	   	} 
   // ONLY CAN IS ENABLED!
   // FLEXRAY NOT ENABLED! (TX_FR_TOKEN)
   // ETHERNET NOT ENABLED! (TX_IP_TOKEN)
}
/*@@end*/

/*@@caplFunc:Name:*/
ringbuffer_write (byte lsgID, byte fctID, byte request, byte dataType, word length, dword singleData, byte data[])
{
	int bufferline, i;

	bufferline = getNextWriteIndex();	//get next free position in ring-buffer

	if (bufferline == -1) 
	{
		writelineEx(gError_Trace, 0, "Crititcal Error: No free buffer found!");
		return;
	}
		
	gBAP_Request_header[bufferline][0] = lsgID;	// LSG
	gBAP_Request_header[bufferline][1] = fctID;	// FCT
	gBAP_Request_header[bufferline][3] = dataType; // dataType

    //writelineEx(gBAP_Trace, 0, "Write request in buffer ASG NODEINDEX:%d lsgid:%d fctid:%d requesttype:%d datatype:%d length:%d", 
    //        NODE_INDEX,lsgID,fctID,request,dataType,length);
	switch (dataType)
	{
		case Bap_void:
			gBAP_Request_header[bufferline][2] = request;	// request
			gBAP_Request_header[bufferline][4] = 0;	// length
				// Void
			// @TODO?		
			break;
		case Bap_uint8:
			gBAP_Request_header[bufferline][2] = request;		// request
			gBAP_Request_header[bufferline][5] = singleData;	// Daten		
			break;
		case Bap_uint16:
			gBAP_Request_header[bufferline][2] = request;		// request
			gBAP_Request_header[bufferline][5] = singleData;	// Daten
			break;			
		case Bap_uint32:
			gBAP_Request_header[bufferline][2] = request;		// request
			gBAP_Request_header[bufferline][5] = singleData;	// Daten		
			break;	
		case Bap_byteSequence:
			gBAP_Request_header[bufferline][2] = request;	// request
			gBAP_Request_header[bufferline][4] = length;	// length
			// Daten der ByteSequence kopieren
			for(i = 0; i < BAP_buffer_size; i++)									
				gBAP_Request_data[bufferline][i] = data[i];
		case Bap_error:
			gBAP_Request_header[bufferline][5] = singleData;	// Errorcode						
			break;
		default:
			break;
	}

			

}
/*@@end*/

/*@@caplFunc:Name:*/
float round (float value, float step)
{
	return _floor(value / step + 0.5) * step;
}
/*@@end*/

/*@@caplFunc:Name:*/
Request_Void (byte lsgID, byte fctID, byte request)
{
	int i;
	byte dataArray [BAP_buffer_size];

	// Initialisieren eines Arrays
	for(i=0;i<BAP_buffer_size;i++) dataArray [i]=0;

	ringbuffer_write (lsgID, fctID, request, Bap_void, 0, 0, dataArray);	
}
/*@@end*/

/*@@caplFunc:Name:*/
Request_Int8 (byte lsgID, byte fctID, byte request, dword data)
{
	int i;
	byte dataArray [BAP_buffer_size];

	// Initialisieren eines Arrays
	for(i=0;i<BAP_buffer_size;i++) dataArray [i]=0;

	ringbuffer_write (lsgID, fctID, request, Bap_uint8, 0, data, dataArray);

}
/*@@end*/

/*@@caplFunc:Name:*/
Request_Int16 (byte lsgID, byte fctID, byte request, dword data)
{
	int i;
	byte dataArray [BAP_buffer_size];

	// Initialisieren eines Arrays
	for(i=0;i<BAP_buffer_size;i++) dataArray [i]=0;

	ringbuffer_write (lsgID, fctID, request, Bap_uint16, 0, data, dataArray);

}
/*@@end*/

/*@@caplFunc:Name:*/
Request_Int32 (byte lsgID, byte fctID, byte request, dword data)
{
	int i;
	byte dataArray [BAP_buffer_size];

	// Initialisieren eines Arrays
	for(i=0;i<BAP_buffer_size;i++) dataArray [i]=0;

	ringbuffer_write (lsgID, fctID, request, Bap_uint32, 0, data, dataArray);
}
/*@@end*/

/*@@caplFunc:Name:*/
Request_ByteSequence (byte lsgID, byte fctID, byte request, byte data[], word length)
{
	int i;
	byte dataArray [BAP_buffer_size];

	// Initialisieren eines Arrays
	for(i=0;i<BAP_buffer_size;i++) dataArray [i]=0;

	// Fuellen des Arrays
	for(i=0;i<length;i++) dataArray [i]=data[i];

	ringbuffer_write (lsgID, fctID, request, Bap_byteSequence, length, 0, dataArray);
}
/*@@end*/

/*@@caplFunc:Name:*/
Request_Error (byte lsgID, byte fctID, byte errorCode)
{
	int i;
	byte dataArray [BAP_buffer_size];

	// Initialisieren eines Arrays
	for(i=0;i<BAP_buffer_size;i++) dataArray [i]=0;

	ringbuffer_write (lsgID, fctID, 0, Bap_error, 0, errorCode, dataArray);
}
/*@@end*/

/*@@caplFunc:Name:*/
DisplayRequestErrorCode(dword fctID, dword errCode)
{
       switch(fctID)
   {
       case C_ASG_10_1_0_1_ID:
           gC_ASG_10_1_0_1_ErrCode = 0;
           putValue(C_ASG_10_1_0_1_ErrCode,  errCode);
           setControlBackColor(panel_name,"errfield_C_ASG_10_1_0_1", MakeRGB(255,79,79));
       break;
       case P_ASG_10_1_0_2_ID:
           gP_ASG_10_1_0_2_ErrCode = 0;
           putValue(P_ASG_10_1_0_2_ErrCode,  errCode);
           setControlBackColor(panel_name,"errfield_P_ASG_10_1_0_2", MakeRGB(255,79,79));
       break;
       case P_ASG_10_1_0_3_ID:
           gP_ASG_10_1_0_3_ErrCode = 0;
           putValue(P_ASG_10_1_0_3_ErrCode,  errCode);
           setControlBackColor(panel_name,"errfield_P_ASG_10_1_0_3", MakeRGB(255,79,79));
       break;
       case P_ASG_10_1_0_4_ID:
           gP_ASG_10_1_0_4_ErrCode = 0;
           putValue(P_ASG_10_1_0_4_ErrCode,  errCode);
           setControlBackColor(panel_name,"errfield_P_ASG_10_1_0_4", MakeRGB(255,79,79));
       break;
       case P_ASG_10_1_0_13_ID:
           gP_ASG_10_1_0_13_ErrCode = 0;
           putValue(P_ASG_10_1_0_13_ErrCode,  errCode);
           setControlBackColor(panel_name,"errfield_P_ASG_10_1_0_13", MakeRGB(255,79,79));
       break;
       case P_ASG_10_1_0_14_ID:
           gP_ASG_10_1_0_14_ErrCode = 0;
           putValue(P_ASG_10_1_0_14_ErrCode,  errCode);
           setControlBackColor(panel_name,"errfield_P_ASG_10_1_0_14", MakeRGB(255,79,79));
       break;
       case P_ASG_10_1_0_15_ID:
           gP_ASG_10_1_0_15_ErrCode = 0;
           putValue(P_ASG_10_1_0_15_ErrCode,  errCode);
           setControlBackColor(panel_name,"errfield_P_ASG_10_1_0_15", MakeRGB(255,79,79));
       break;
       case P_ASG_10_1_0_16_ID:
           gP_ASG_10_1_0_16_ErrCode = 0;
           putValue(P_ASG_10_1_0_16_ErrCode,  errCode);
           setControlBackColor(panel_name,"errfield_P_ASG_10_1_0_16", MakeRGB(255,79,79));
       break;
       case P_ASG_10_1_0_17_ID:
           gP_ASG_10_1_0_17_ErrCode = 0;
           putValue(P_ASG_10_1_0_17_ErrCode,  errCode);
           setControlBackColor(panel_name,"errfield_P_ASG_10_1_0_17", MakeRGB(255,79,79));
       break;
       case P_ASG_10_1_0_18_ID:
           gP_ASG_10_1_0_18_ErrCode = 0;
           putValue(P_ASG_10_1_0_18_ErrCode,  errCode);
           setControlBackColor(panel_name,"errfield_P_ASG_10_1_0_18", MakeRGB(255,79,79));
       break;
       case P_ASG_10_1_0_19_ID:
           gP_ASG_10_1_0_19_ErrCode = 0;
           putValue(P_ASG_10_1_0_19_ErrCode,  errCode);
           setControlBackColor(panel_name,"errfield_P_ASG_10_1_0_19", MakeRGB(255,79,79));
       break;
       case P_ASG_10_1_0_20_ID:
           gP_ASG_10_1_0_20_ErrCode = 0;
           putValue(P_ASG_10_1_0_20_ErrCode,  errCode);
           setControlBackColor(panel_name,"errfield_P_ASG_10_1_0_20", MakeRGB(255,79,79));
       break;
       case P_ASG_10_1_0_21_ID:
           gP_ASG_10_1_0_21_ErrCode = 0;
           putValue(P_ASG_10_1_0_21_ErrCode,  errCode);
           setControlBackColor(panel_name,"errfield_P_ASG_10_1_0_21", MakeRGB(255,79,79));
       break;
       case P_ASG_10_1_0_22_ID:
           gP_ASG_10_1_0_22_ErrCode = 0;
           putValue(P_ASG_10_1_0_22_ErrCode,  errCode);
           setControlBackColor(panel_name,"errfield_P_ASG_10_1_0_22", MakeRGB(255,79,79));
       break;
       case P_ASG_10_1_0_23_ID:
           gP_ASG_10_1_0_23_ErrCode = 0;
           putValue(P_ASG_10_1_0_23_ErrCode,  errCode);
           setControlBackColor(panel_name,"errfield_P_ASG_10_1_0_23", MakeRGB(255,79,79));
       break;
       case P_ASG_10_1_0_24_ID:
           gP_ASG_10_1_0_24_ErrCode = 0;
           putValue(P_ASG_10_1_0_24_ErrCode,  errCode);
           setControlBackColor(panel_name,"errfield_P_ASG_10_1_0_24", MakeRGB(255,79,79));
       break;
       case P_ASG_10_1_0_25_ID:
           gP_ASG_10_1_0_25_ErrCode = 0;
           putValue(P_ASG_10_1_0_25_ErrCode,  errCode);
           setControlBackColor(panel_name,"errfield_P_ASG_10_1_0_25", MakeRGB(255,79,79));
       break;
       case P_ASG_10_1_0_26_ID:
           gP_ASG_10_1_0_26_ErrCode = 0;
           putValue(P_ASG_10_1_0_26_ErrCode,  errCode);
           setControlBackColor(panel_name,"errfield_P_ASG_10_1_0_26", MakeRGB(255,79,79));
       break;
       case P_ASG_10_1_0_27_ID:
           gP_ASG_10_1_0_27_ErrCode = 0;
           putValue(P_ASG_10_1_0_27_ErrCode,  errCode);
           setControlBackColor(panel_name,"errfield_P_ASG_10_1_0_27", MakeRGB(255,79,79));
       break;
       case P_ASG_10_1_0_28_ID:
           gP_ASG_10_1_0_28_ErrCode = 0;
           putValue(P_ASG_10_1_0_28_ErrCode,  errCode);
           setControlBackColor(panel_name,"errfield_P_ASG_10_1_0_28", MakeRGB(255,79,79));
       break;
       case P_ASG_10_1_0_29_ID:
           gP_ASG_10_1_0_29_ErrCode = 0;
           putValue(P_ASG_10_1_0_29_ErrCode,  errCode);
           setControlBackColor(panel_name,"errfield_P_ASG_10_1_0_29", MakeRGB(255,79,79));
       break;
       case P_ASG_10_1_0_30_ID:
           gP_ASG_10_1_0_30_ErrCode = 0;
           putValue(P_ASG_10_1_0_30_ErrCode,  errCode);
           setControlBackColor(panel_name,"errfield_P_ASG_10_1_0_30", MakeRGB(255,79,79));
       break;
       case P_ASG_10_1_0_31_ID:
           gP_ASG_10_1_0_31_ErrCode = 0;
           putValue(P_ASG_10_1_0_31_ErrCode,  errCode);
           setControlBackColor(panel_name,"errfield_P_ASG_10_1_0_31", MakeRGB(255,79,79));
       break;
       case P_ASG_10_1_0_32_ID:
           gP_ASG_10_1_0_32_ErrCode = 0;
           putValue(P_ASG_10_1_0_32_ErrCode,  errCode);
           setControlBackColor(panel_name,"errfield_P_ASG_10_1_0_32", MakeRGB(255,79,79));
       break;
       case P_ASG_10_1_0_33_ID:
           gP_ASG_10_1_0_33_ErrCode = 0;
           putValue(P_ASG_10_1_0_33_ErrCode,  errCode);
           setControlBackColor(panel_name,"errfield_P_ASG_10_1_0_33", MakeRGB(255,79,79));
       break;
       case P_ASG_10_1_0_34_ID:
           gP_ASG_10_1_0_34_ErrCode = 0;
           putValue(P_ASG_10_1_0_34_ErrCode,  errCode);
           setControlBackColor(panel_name,"errfield_P_ASG_10_1_0_34", MakeRGB(255,79,79));
       break;
       case P_ASG_10_1_0_35_ID:
           gP_ASG_10_1_0_35_ErrCode = 0;
           putValue(P_ASG_10_1_0_35_ErrCode,  errCode);
           setControlBackColor(panel_name,"errfield_P_ASG_10_1_0_35", MakeRGB(255,79,79));
       break;
       case P_ASG_10_1_0_36_ID:
           gP_ASG_10_1_0_36_ErrCode = 0;
           putValue(P_ASG_10_1_0_36_ErrCode,  errCode);
           setControlBackColor(panel_name,"errfield_P_ASG_10_1_0_36", MakeRGB(255,79,79));
       break;
       case P_ASG_10_1_0_37_ID:
           gP_ASG_10_1_0_37_ErrCode = 0;
           putValue(P_ASG_10_1_0_37_ErrCode,  errCode);
           setControlBackColor(panel_name,"errfield_P_ASG_10_1_0_37", MakeRGB(255,79,79));
       break;
       case P_ASG_10_1_0_38_ID:
           gP_ASG_10_1_0_38_ErrCode = 0;
           putValue(P_ASG_10_1_0_38_ErrCode,  errCode);
           setControlBackColor(panel_name,"errfield_P_ASG_10_1_0_38", MakeRGB(255,79,79));
       break;
       case P_ASG_10_1_0_39_ID:
           gP_ASG_10_1_0_39_ErrCode = 0;
           putValue(P_ASG_10_1_0_39_ErrCode,  errCode);
           setControlBackColor(panel_name,"errfield_P_ASG_10_1_0_39", MakeRGB(255,79,79));
       break;
       case P_ASG_10_1_0_40_ID:
           gP_ASG_10_1_0_40_ErrCode = 0;
           putValue(P_ASG_10_1_0_40_ErrCode,  errCode);
           setControlBackColor(panel_name,"errfield_P_ASG_10_1_0_40", MakeRGB(255,79,79));
       break;
       case P_ASG_10_1_0_41_ID:
           gP_ASG_10_1_0_41_ErrCode = 0;
           putValue(P_ASG_10_1_0_41_ErrCode,  errCode);
           setControlBackColor(panel_name,"errfield_P_ASG_10_1_0_41", MakeRGB(255,79,79));
       break;
       case P_ASG_10_1_0_42_ID:
           gP_ASG_10_1_0_42_ErrCode = 0;
           putValue(P_ASG_10_1_0_42_ErrCode,  errCode);
           setControlBackColor(panel_name,"errfield_P_ASG_10_1_0_42", MakeRGB(255,79,79));
       break;
       case P_ASG_10_1_0_43_ID:
           gP_ASG_10_1_0_43_ErrCode = 0;
           putValue(P_ASG_10_1_0_43_ErrCode,  errCode);
           setControlBackColor(panel_name,"errfield_P_ASG_10_1_0_43", MakeRGB(255,79,79));
       break;
       case P_ASG_10_1_0_44_ID:
           gP_ASG_10_1_0_44_ErrCode = 0;
           putValue(P_ASG_10_1_0_44_ErrCode,  errCode);
           setControlBackColor(panel_name,"errfield_P_ASG_10_1_0_44", MakeRGB(255,79,79));
       break;
       case P_ASG_10_1_0_45_ID:
           gP_ASG_10_1_0_45_ErrCode = 0;
           putValue(P_ASG_10_1_0_45_ErrCode,  errCode);
           setControlBackColor(panel_name,"errfield_P_ASG_10_1_0_45", MakeRGB(255,79,79));
       break;
       case P_ASG_10_1_0_46_ID:
           gP_ASG_10_1_0_46_ErrCode = 0;
           putValue(P_ASG_10_1_0_46_ErrCode,  errCode);
           setControlBackColor(panel_name,"errfield_P_ASG_10_1_0_46", MakeRGB(255,79,79));
       break;
       case P_ASG_10_1_0_47_ID:
           gP_ASG_10_1_0_47_ErrCode = 0;
           putValue(P_ASG_10_1_0_47_ErrCode,  errCode);
           setControlBackColor(panel_name,"errfield_P_ASG_10_1_0_47", MakeRGB(255,79,79));
       break;
       case P_ASG_10_1_0_48_ID:
           gP_ASG_10_1_0_48_ErrCode = 0;
           putValue(P_ASG_10_1_0_48_ErrCode,  errCode);
           setControlBackColor(panel_name,"errfield_P_ASG_10_1_0_48", MakeRGB(255,79,79));
       break;
       case P_ASG_10_1_0_49_ID:
           gP_ASG_10_1_0_49_ErrCode = 0;
           putValue(P_ASG_10_1_0_49_ErrCode,  errCode);
           setControlBackColor(panel_name,"errfield_P_ASG_10_1_0_49", MakeRGB(255,79,79));
       break;
       case P_ASG_10_1_0_50_ID:
           gP_ASG_10_1_0_50_ErrCode = 0;
           putValue(P_ASG_10_1_0_50_ErrCode,  errCode);
           setControlBackColor(panel_name,"errfield_P_ASG_10_1_0_50", MakeRGB(255,79,79));
       break;
       case P_ASG_10_1_0_51_ID:
           gP_ASG_10_1_0_51_ErrCode = 0;
           putValue(P_ASG_10_1_0_51_ErrCode,  errCode);
           setControlBackColor(panel_name,"errfield_P_ASG_10_1_0_51", MakeRGB(255,79,79));
       break;
       case P_ASG_10_1_0_52_ID:
           gP_ASG_10_1_0_52_ErrCode = 0;
           putValue(P_ASG_10_1_0_52_ErrCode,  errCode);
           setControlBackColor(panel_name,"errfield_P_ASG_10_1_0_52", MakeRGB(255,79,79));
       break;
       case P_ASG_10_1_0_53_ID:
           gP_ASG_10_1_0_53_ErrCode = 0;
           putValue(P_ASG_10_1_0_53_ErrCode,  errCode);
           setControlBackColor(panel_name,"errfield_P_ASG_10_1_0_53", MakeRGB(255,79,79));
       break;
       default:
           writelineEx(gError_Trace, 0, "%s%d/%d Unknown Functionid in  displayErrorCode", SGtype, LSGID,fctID);
   }

}
/*@@end*/

/*@@caplFunc:Name:*/
BAP_DLL_Request ()
{
	int i;
    int l=0;
	byte temp;
	byte Request_data[4096];	//Request data for DLL
	dword Request_header[6];	//Request header for DLL
	byte dataValid;
	int nextElementToRead;
	
	// defaultmaessig ist senden OK
	dataValid = 1;

	// loeschen der Daten "Container"
	for(i=0;i<6;i++)
		Request_header[i]=0;
	for(i=0;i<BAP_buffer_size;i++)
		Request_data[i]=0;

    
	// Verarbeiten aller noch offenen Requests	
	while ((nextElementToRead = getNextReadIndex()) != -1) 
	{
		// Fuer alle Datentypen gleich
		Request_header[0]=gBAP_Request_header [nextElementToRead][0];		//LSG-ID
		Request_header[1]=gBAP_Request_header [nextElementToRead][1];		//Function-ID
		Request_header[2]=gBAP_Request_header [nextElementToRead][2];		//request type
		Request_header[3]=gBAP_Request_header [nextElementToRead][3];		//BAP data type

		switch(gBAP_Request_header[nextElementToRead][3]){
			case Bap_uint32:
                l=2;
            case Bap_uint16:
                l++;
            case Bap_uint8:
			case Bap_error: // Request (2) wird dabei ignoriert
                l++;
			case Bap_void:  // Datenfeld (5) wird dabei ignoriert
				Request_header[4]=l;												//	not used
				Request_header[5]=gBAP_Request_header [nextElementToRead][5];		// Daten
			break;
			case Bap_byteSequence:									
				Request_header[4]=gBAP_Request_header [nextElementToRead][4];		// length
				Request_header[5]=0;												// not used

				// data-array for BAP-DLL funcion 'BAP_Request'
				for(i=0;i<BAP_buffer_size;i++)
					Request_data[i]=gBAP_Request_data [nextElementToRead][i];
				break;			
			default:
				writelineEx(gError_Trace, 0, "BAP_DLL_Request: invalid BAP-Data-Type: %d", gBAP_Request_header[nextElementToRead][3]);
				dataValid = 0;
			break;			
		}
		
		if(dataValid){
            // wie heisst der Request?
            writelineEx(gBAP_Trace, 0, "%s%d/%d BAP_Request %s datatype:%s length:%d", SGtype, Request_header[0],Request_header[1],Requesttype_Text[Request_header[2]],Datatype_Text[Request_header[3]],Request_header[4]);
			temp = BAP150_Request(NODE_INDEX, Request_header, Request_data);	//send data to BAP-DLL	
			// BAP-Request failed
            if(temp != 0){
                // Fehlercode: Request failed
                writelineEx(gError_Trace, 0, "%s%d/%d Error during BAP_Request errorcode: 0x%X", SGtype, Request_header[0],Request_header[1],temp);
                DisplayRequestErrorCode(Request_header[1],temp);
            } 
		}

	}
} 
/*@@end*/

/*@@caplFunc:Name:*/
int getNextReadIndex ()
{
	int i, ret;
	// der Puffer wird nach dem naechsten zu lesenden Eintrag durchsucht
	// Existiert keiner wird -1 zurueckgegeben
	ret = -1;

	for (i = 0; i < Requestbuffer_lines; i++)
	{
		if (gBAP_Requestbuffer_status[i] == 1)
		{
			// zum verschicken
			ret = i;
			// und wieder freigeben
			gBAP_Requestbuffer_status[i] = 0;
			break;
		}
	}

	return (ret);
}
/*@@end*/

/*@@caplFunc:Name:*/
int getNextWriteIndex ()
{
	int i, ret;
	// der Puffer wird nach dem naechsten freien Eintrag durchsucht
	// Existiert keiner wird -1 zurueckgegeben
	ret = -1;

	for (i = 0; i < Requestbuffer_lines; i++)
	{
		if (gBAP_Requestbuffer_status[i] == 0)
		{
			// zum schreiben
			ret = i;
			// belegen
			gBAP_Requestbuffer_status[i] = 1;
			break;
		}
	}

	return (ret);
}
/*@@end*/

/*@@caplFunc:Name:*/
byte  isBitForFctSetted(word fctid, byte fctList[])
{
    byte byteNo ;
    byte bitno ;
    byte fctValue ;

    byteNo = fctid / 8;
    bitno = fctid % 8;

    fctValue = 0x80 >> bitno;

    return (fctList[byteNo] & fctValue)?1:0;
}
/*@@end*/

/*@@caplFunc:Name:*/
UpdateAllProperties()
{
	Request_Void(LSGID,P_ASG_10_1_0_2_ID,DataGet_REQ);
	Request_Void(LSGID,P_ASG_10_1_0_3_ID,DataGet_REQ);
	Request_Void(LSGID,P_ASG_10_1_0_4_ID,DataGet_REQ);
	Request_Void(LSGID,P_ASG_10_1_0_13_ID,DataGet_REQ);
	Request_Void(LSGID,P_ASG_10_1_0_14_ID,DataGet_REQ);
	Request_Void(LSGID,P_ASG_10_1_0_15_ID,DataGet_REQ);
	Request_Void(LSGID,P_ASG_10_1_0_16_ID,DataGet_REQ);
	Request_Void(LSGID,P_ASG_10_1_0_17_ID,DataGet_REQ);
	Request_Void(LSGID,P_ASG_10_1_0_18_ID,DataGet_REQ);
	Request_Void(LSGID,P_ASG_10_1_0_19_ID,DataGet_REQ);
	Request_Void(LSGID,P_ASG_10_1_0_20_ID,DataGet_REQ);
	Request_Void(LSGID,P_ASG_10_1_0_21_ID,DataGet_REQ);
	Request_Void(LSGID,P_ASG_10_1_0_22_ID,DataGet_REQ);
	Request_Void(LSGID,P_ASG_10_1_0_23_ID,DataGet_REQ);
	Request_Void(LSGID,P_ASG_10_1_0_24_ID,DataGet_REQ);
	Request_Void(LSGID,P_ASG_10_1_0_25_ID,DataGet_REQ);
	Request_Void(LSGID,P_ASG_10_1_0_26_ID,DataGet_REQ);
	Request_Void(LSGID,P_ASG_10_1_0_27_ID,DataGet_REQ);
	Request_Void(LSGID,P_ASG_10_1_0_28_ID,DataGet_REQ);
	Request_Void(LSGID,P_ASG_10_1_0_29_ID,DataGet_REQ);
	Request_Void(LSGID,P_ASG_10_1_0_30_ID,DataGet_REQ);
	Request_Void(LSGID,P_ASG_10_1_0_31_ID,DataGet_REQ);
	Request_Void(LSGID,P_ASG_10_1_0_32_ID,DataGet_REQ);
	Request_Void(LSGID,P_ASG_10_1_0_33_ID,DataGet_REQ);
	Request_Void(LSGID,P_ASG_10_1_0_34_ID,DataGet_REQ);
	Request_Void(LSGID,P_ASG_10_1_0_35_ID,DataGet_REQ);
	Request_Void(LSGID,P_ASG_10_1_0_36_ID,DataGet_REQ);
	Request_Void(LSGID,P_ASG_10_1_0_37_ID,DataGet_REQ);
	Request_Void(LSGID,P_ASG_10_1_0_38_ID,DataGet_REQ);
	Request_Void(LSGID,P_ASG_10_1_0_39_ID,DataGet_REQ);
	Request_Void(LSGID,P_ASG_10_1_0_40_ID,DataGet_REQ);
	Request_Void(LSGID,P_ASG_10_1_0_41_ID,DataGet_REQ);
	Request_Void(LSGID,P_ASG_10_1_0_42_ID,DataGet_REQ);
	Request_Void(LSGID,P_ASG_10_1_0_43_ID,DataGet_REQ);
	Request_Void(LSGID,P_ASG_10_1_0_44_ID,DataGet_REQ);
	Request_Void(LSGID,P_ASG_10_1_0_45_ID,DataGet_REQ);
	Request_Void(LSGID,P_ASG_10_1_0_46_ID,DataGet_REQ);
	Request_Void(LSGID,P_ASG_10_1_0_47_ID,DataGet_REQ);
	Request_Void(LSGID,P_ASG_10_1_0_48_ID,DataGet_REQ);
	Request_Void(LSGID,P_ASG_10_1_0_49_ID,DataGet_REQ);
	Request_Void(LSGID,P_ASG_10_1_0_50_ID,DataGet_REQ);
	Request_Void(LSGID,P_ASG_10_1_0_51_ID,DataGet_REQ);
	Request_Void(LSGID,P_ASG_10_1_0_52_ID,DataGet_REQ);
	Request_Void(LSGID,P_ASG_10_1_0_53_ID,DataGet_REQ);

}
/*@@end*/

/*@@caplFunc:Name:*/
/*@@caplFunc:Process_Current_Indication():*/
Process_Current_Indication ()
{
   int rxsize;
   int txsize;
   byte temp[BAP_buffer_size];
   char buffer[BAP_buffer_size];
   if(strncmp(Datatype_Text[gBAP_Indication_header[3]], "acknowledge", 4)!=0) 
       writelineEx(gBAP_Trace, 0, "NodeIndex: %d: CurrentIndication %s lsgid:%d fctid:%d indType:%s dataType=%s length=%d",
               NODE_INDEX, SGtype, gBAP_Indication_header[0], gBAP_Indication_header[1], Indicationtype_Text[gBAP_Indication_header[2]], Datatype_Text[gBAP_Indication_header[3]], gBAP_Indication_header[4]);
   else 
       writelineEx(gBAP_Trace, 0, "Internal acknowledge %s-%d fctid:%d indType:%s dataType=%s length=%d",
               SGtype, gBAP_Indication_header[0], gBAP_Indication_header[1], Acknowledgetype_Text[gBAP_Indication_header[5]], Datatype_Text[gBAP_Indication_header[3]], gBAP_Indication_header[4]);
   switch(gBAP_Indication_header[0])  // LSGID
   {
   case LSGID:
       switch(gBAP_Indication_header[1]) // FCTID
       {
    case C_ASG_10_1_0_1_ID: 
        switch(gBAP_Indication_header[3]) // Datentyp 
        {
        case Bap_void:
            switch (gBAP_Indication_header[2]) // IndType
            {
                case Data_IND: // Indicationtyp pruefen
                    //Now every Property with Cache is updated
                    UpdateAllProperties();
                    putValue(C_ASG_10_1_0_1_State, "StatusAll");
                    setControlBackColor(panel_name, "errfield_C_ASG_10_1_0_1_State", MakeRGB(255,255,255));
                    break;
                default:
                    PrintIndicationError("Illegal IndType");
                    break;
            }
            break;
            case Bap_error:
               snprintf(buffer,BAP_buffer_size-1,"Error %02x", gBAP_Indication_header[5]);
               putValue(C_ASG_10_1_0_1_State, buffer);
               setControlBackColor(panel_name, "errfield_C_ASG_10_1_0_1_State", MakeRGB(255,79,79));
               break;
            case Bap_acknowledge:
                break;
            default:
                PrintIndicationError("Illegal DataType");
                break;
        }
    break;
    case P_ASG_10_1_0_2_ID: 
        switch(gBAP_Indication_header[3]) // Datentyp 
        {
        case Bap_byteSequence:
            switch (gBAP_Indication_header[2]) // IndType
            {
                case Reset_IND: // Nur fuer FctId 2 (BAPConfig) relevant
                   putValue(C_ASG_10_1_0_1_State, "");
                   setControlBackColor(panel_name, "errfield_C_ASG_10_1_0_1_State", MakeRGB(255,255,255));
                   initInvalidFields();
                   // Fall through
                case Data_IND: // Indicationtyp pruefen
                    // Daten setzen
                    putValue(BAPCFG_ASG_10_1_0_ProtocolMajor, gBAP_Indication_data[0]);
                    putValue(BAPCFG_ASG_10_1_0_ProtocolMinor, gBAP_Indication_data[1]);
                    putValue(BAPCFG_ASG_10_1_0_LsgClassMajor, gBAP_Indication_data[2]);
                    putValue(BAPCFG_ASG_10_1_0_LsgClassMinor, gBAP_Indication_data[3]);
                    putValue(BAPCFG_ASG_10_1_0_DFMajor, gBAP_Indication_data[4]);
                    putValue(BAPCFG_ASG_10_1_0_DFMinor, gBAP_Indication_data[5]);
                    setControlBackColor(panel_name, "errfield_P_ASG_10_1_0_2", MakeRGB(255,255,255));  
                    setControlBackColor(panel_name, "panel1_edit", MakeRGB(255,255,255));  
                    break;
                default:
                    PrintIndicationError("Illegal IndType");
                    break;
            }
            break;
            case Bap_error:
                putValue(P_ASG_10_1_0_2_ErrCode,  gBAP_Indication_header[5]);
                setControlBackColor(panel_name, "errfield_P_ASG_10_1_0_2", MakeRGB(255,79,79));  
                setControlBackColor(panel_name, "panel1_edit", MakeRGB(220,220,220));  
                break;
            case Bap_acknowledge:
                break;
            default:
                PrintIndicationError("Illegal DataType");
                break;
        }
    break;
    case P_ASG_10_1_0_3_ID: 
       switch(gBAP_Indication_header[3]) // Datentyp
       {
            case Bap_byteSequence:
                switch (gBAP_Indication_header[2]) // IndType
                {
                    case Data_IND: // Indicationtyp pruefen
                    case Reset_IND: // Nur fuer FctId 2 (BAPConfig) relevant
                    {
                        setControlBackColor(panel_name, "errfield_P_ASG_10_1_0_3", MakeRGB(255,255,255));
                        if(isBitForFctSetted(P_ASG_10_1_0_29_ID,gBAP_Indication_data))
                        {
                            putValue(P_ASG_10_1_0_29_FctLstItemEn, 1);
                            setControlForeColor(panel_name, gCheckbox29,MakeRGB(0,240,0));
                            EnableControl(panel_name, gPanel29, 1);
                            EnableControl(panel_name, "panel_P_ASG_10_1_0_29",1);
                        }
                        else
                        {
                            putValue(P_ASG_10_1_0_29_FctLstItemEn, 0);
                            setControlForeColor(panel_name, gCheckbox29,MakeRGB(250,0,0));
                            EnableControl(panel_name, gPanel29, 0);
                            EnableControl(panel_name, "panel_P_ASG_10_1_0_29",0);
                        }

                        if(isBitForFctSetted(P_ASG_10_1_0_28_ID,gBAP_Indication_data))
                        {
                            putValue(P_ASG_10_1_0_28_FctLstItemEn, 1);
                            setControlForeColor(panel_name, gCheckbox28,MakeRGB(0,240,0));
                            EnableControl(panel_name, gPanel28, 1);
                            EnableControl(panel_name, "panel_P_ASG_10_1_0_28",1);
                        }
                        else
                        {
                            putValue(P_ASG_10_1_0_28_FctLstItemEn, 0);
                            setControlForeColor(panel_name, gCheckbox28,MakeRGB(250,0,0));
                            EnableControl(panel_name, gPanel28, 0);
                            EnableControl(panel_name, "panel_P_ASG_10_1_0_28",0);
                        }

                        if(isBitForFctSetted(P_ASG_10_1_0_27_ID,gBAP_Indication_data))
                        {
                            putValue(P_ASG_10_1_0_27_FctLstItemEn, 1);
                            setControlForeColor(panel_name, gCheckbox27,MakeRGB(0,240,0));
                            EnableControl(panel_name, gPanel27, 1);
                            EnableControl(panel_name, "panel_P_ASG_10_1_0_27",1);
                        }
                        else
                        {
                            putValue(P_ASG_10_1_0_27_FctLstItemEn, 0);
                            setControlForeColor(panel_name, gCheckbox27,MakeRGB(250,0,0));
                            EnableControl(panel_name, gPanel27, 0);
                            EnableControl(panel_name, "panel_P_ASG_10_1_0_27",0);
                        }

                        if(isBitForFctSetted(P_ASG_10_1_0_26_ID,gBAP_Indication_data))
                        {
                            putValue(P_ASG_10_1_0_26_FctLstItemEn, 1);
                            setControlForeColor(panel_name, gCheckbox26,MakeRGB(0,240,0));
                            EnableControl(panel_name, gPanel26, 1);
                            EnableControl(panel_name, "panel_P_ASG_10_1_0_26",1);
                        }
                        else
                        {
                            putValue(P_ASG_10_1_0_26_FctLstItemEn, 0);
                            setControlForeColor(panel_name, gCheckbox26,MakeRGB(250,0,0));
                            EnableControl(panel_name, gPanel26, 0);
                            EnableControl(panel_name, "panel_P_ASG_10_1_0_26",0);
                        }

                        if(isBitForFctSetted(P_ASG_10_1_0_25_ID,gBAP_Indication_data))
                        {
                            putValue(P_ASG_10_1_0_25_FctLstItemEn, 1);
                            setControlForeColor(panel_name, gCheckbox25,MakeRGB(0,240,0));
                            EnableControl(panel_name, gPanel25, 1);
                            EnableControl(panel_name, "panel_P_ASG_10_1_0_25",1);
                        }
                        else
                        {
                            putValue(P_ASG_10_1_0_25_FctLstItemEn, 0);
                            setControlForeColor(panel_name, gCheckbox25,MakeRGB(250,0,0));
                            EnableControl(panel_name, gPanel25, 0);
                            EnableControl(panel_name, "panel_P_ASG_10_1_0_25",0);
                        }

                        if(isBitForFctSetted(P_ASG_10_1_0_24_ID,gBAP_Indication_data))
                        {
                            putValue(P_ASG_10_1_0_24_FctLstItemEn, 1);
                            setControlForeColor(panel_name, gCheckbox24,MakeRGB(0,240,0));
                            EnableControl(panel_name, gPanel24, 1);
                            EnableControl(panel_name, "panel_P_ASG_10_1_0_24",1);
                        }
                        else
                        {
                            putValue(P_ASG_10_1_0_24_FctLstItemEn, 0);
                            setControlForeColor(panel_name, gCheckbox24,MakeRGB(250,0,0));
                            EnableControl(panel_name, gPanel24, 0);
                            EnableControl(panel_name, "panel_P_ASG_10_1_0_24",0);
                        }

                        if(isBitForFctSetted(P_ASG_10_1_0_23_ID,gBAP_Indication_data))
                        {
                            putValue(P_ASG_10_1_0_23_FctLstItemEn, 1);
                            setControlForeColor(panel_name, gCheckbox23,MakeRGB(0,240,0));
                            EnableControl(panel_name, gPanel23, 1);
                            EnableControl(panel_name, "panel_P_ASG_10_1_0_23",1);
                        }
                        else
                        {
                            putValue(P_ASG_10_1_0_23_FctLstItemEn, 0);
                            setControlForeColor(panel_name, gCheckbox23,MakeRGB(250,0,0));
                            EnableControl(panel_name, gPanel23, 0);
                            EnableControl(panel_name, "panel_P_ASG_10_1_0_23",0);
                        }

                        if(isBitForFctSetted(P_ASG_10_1_0_22_ID,gBAP_Indication_data))
                        {
                            putValue(P_ASG_10_1_0_22_FctLstItemEn, 1);
                            setControlForeColor(panel_name, gCheckbox22,MakeRGB(0,240,0));
                            EnableControl(panel_name, gPanel22, 1);
                            EnableControl(panel_name, "panel_P_ASG_10_1_0_22",1);
                        }
                        else
                        {
                            putValue(P_ASG_10_1_0_22_FctLstItemEn, 0);
                            setControlForeColor(panel_name, gCheckbox22,MakeRGB(250,0,0));
                            EnableControl(panel_name, gPanel22, 0);
                            EnableControl(panel_name, "panel_P_ASG_10_1_0_22",0);
                        }

                        if(isBitForFctSetted(P_ASG_10_1_0_53_ID,gBAP_Indication_data))
                        {
                            putValue(P_ASG_10_1_0_53_FctLstItemEn, 1);
                            setControlForeColor(panel_name, gCheckbox53,MakeRGB(0,240,0));
                            EnableControl(panel_name, gPanel53, 1);
                            EnableControl(panel_name, "panel_P_ASG_10_1_0_53",1);
                        }
                        else
                        {
                            putValue(P_ASG_10_1_0_53_FctLstItemEn, 0);
                            setControlForeColor(panel_name, gCheckbox53,MakeRGB(250,0,0));
                            EnableControl(panel_name, gPanel53, 0);
                            EnableControl(panel_name, "panel_P_ASG_10_1_0_53",0);
                        }

                        if(isBitForFctSetted(P_ASG_10_1_0_21_ID,gBAP_Indication_data))
                        {
                            putValue(P_ASG_10_1_0_21_FctLstItemEn, 1);
                            setControlForeColor(panel_name, gCheckbox21,MakeRGB(0,240,0));
                            EnableControl(panel_name, gPanel21, 1);
                            EnableControl(panel_name, "panel_P_ASG_10_1_0_21",1);
                        }
                        else
                        {
                            putValue(P_ASG_10_1_0_21_FctLstItemEn, 0);
                            setControlForeColor(panel_name, gCheckbox21,MakeRGB(250,0,0));
                            EnableControl(panel_name, gPanel21, 0);
                            EnableControl(panel_name, "panel_P_ASG_10_1_0_21",0);
                        }

                        if(isBitForFctSetted(P_ASG_10_1_0_52_ID,gBAP_Indication_data))
                        {
                            putValue(P_ASG_10_1_0_52_FctLstItemEn, 1);
                            setControlForeColor(panel_name, gCheckbox52,MakeRGB(0,240,0));
                            EnableControl(panel_name, gPanel52, 1);
                            EnableControl(panel_name, "panel_P_ASG_10_1_0_52",1);
                        }
                        else
                        {
                            putValue(P_ASG_10_1_0_52_FctLstItemEn, 0);
                            setControlForeColor(panel_name, gCheckbox52,MakeRGB(250,0,0));
                            EnableControl(panel_name, gPanel52, 0);
                            EnableControl(panel_name, "panel_P_ASG_10_1_0_52",0);
                        }

                        if(isBitForFctSetted(P_ASG_10_1_0_20_ID,gBAP_Indication_data))
                        {
                            putValue(P_ASG_10_1_0_20_FctLstItemEn, 1);
                            setControlForeColor(panel_name, gCheckbox20,MakeRGB(0,240,0));
                            EnableControl(panel_name, gPanel20, 1);
                            EnableControl(panel_name, "panel_P_ASG_10_1_0_20",1);
                        }
                        else
                        {
                            putValue(P_ASG_10_1_0_20_FctLstItemEn, 0);
                            setControlForeColor(panel_name, gCheckbox20,MakeRGB(250,0,0));
                            EnableControl(panel_name, gPanel20, 0);
                            EnableControl(panel_name, "panel_P_ASG_10_1_0_20",0);
                        }

                        if(isBitForFctSetted(P_ASG_10_1_0_51_ID,gBAP_Indication_data))
                        {
                            putValue(P_ASG_10_1_0_51_FctLstItemEn, 1);
                            setControlForeColor(panel_name, gCheckbox51,MakeRGB(0,240,0));
                            EnableControl(panel_name, gPanel51, 1);
                            EnableControl(panel_name, "panel_P_ASG_10_1_0_51",1);
                        }
                        else
                        {
                            putValue(P_ASG_10_1_0_51_FctLstItemEn, 0);
                            setControlForeColor(panel_name, gCheckbox51,MakeRGB(250,0,0));
                            EnableControl(panel_name, gPanel51, 0);
                            EnableControl(panel_name, "panel_P_ASG_10_1_0_51",0);
                        }

                        if(isBitForFctSetted(P_ASG_10_1_0_50_ID,gBAP_Indication_data))
                        {
                            putValue(P_ASG_10_1_0_50_FctLstItemEn, 1);
                            setControlForeColor(panel_name, gCheckbox50,MakeRGB(0,240,0));
                            EnableControl(panel_name, gPanel50, 1);
                            EnableControl(panel_name, "panel_P_ASG_10_1_0_50",1);
                        }
                        else
                        {
                            putValue(P_ASG_10_1_0_50_FctLstItemEn, 0);
                            setControlForeColor(panel_name, gCheckbox50,MakeRGB(250,0,0));
                            EnableControl(panel_name, gPanel50, 0);
                            EnableControl(panel_name, "panel_P_ASG_10_1_0_50",0);
                        }

                        if(isBitForFctSetted(P_ASG_10_1_0_19_ID,gBAP_Indication_data))
                        {
                            putValue(P_ASG_10_1_0_19_FctLstItemEn, 1);
                            setControlForeColor(panel_name, gCheckbox19,MakeRGB(0,240,0));
                            EnableControl(panel_name, gPanel19, 1);
                            EnableControl(panel_name, "panel_P_ASG_10_1_0_19",1);
                        }
                        else
                        {
                            putValue(P_ASG_10_1_0_19_FctLstItemEn, 0);
                            setControlForeColor(panel_name, gCheckbox19,MakeRGB(250,0,0));
                            EnableControl(panel_name, gPanel19, 0);
                            EnableControl(panel_name, "panel_P_ASG_10_1_0_19",0);
                        }

                        if(isBitForFctSetted(P_ASG_10_1_0_18_ID,gBAP_Indication_data))
                        {
                            putValue(P_ASG_10_1_0_18_FctLstItemEn, 1);
                            setControlForeColor(panel_name, gCheckbox18,MakeRGB(0,240,0));
                            EnableControl(panel_name, gPanel18, 1);
                            EnableControl(panel_name, "panel_P_ASG_10_1_0_18",1);
                        }
                        else
                        {
                            putValue(P_ASG_10_1_0_18_FctLstItemEn, 0);
                            setControlForeColor(panel_name, gCheckbox18,MakeRGB(250,0,0));
                            EnableControl(panel_name, gPanel18, 0);
                            EnableControl(panel_name, "panel_P_ASG_10_1_0_18",0);
                        }

                        if(isBitForFctSetted(P_ASG_10_1_0_49_ID,gBAP_Indication_data))
                        {
                            putValue(P_ASG_10_1_0_49_FctLstItemEn, 1);
                            setControlForeColor(panel_name, gCheckbox49,MakeRGB(0,240,0));
                            EnableControl(panel_name, gPanel49, 1);
                            EnableControl(panel_name, "panel_P_ASG_10_1_0_49",1);
                        }
                        else
                        {
                            putValue(P_ASG_10_1_0_49_FctLstItemEn, 0);
                            setControlForeColor(panel_name, gCheckbox49,MakeRGB(250,0,0));
                            EnableControl(panel_name, gPanel49, 0);
                            EnableControl(panel_name, "panel_P_ASG_10_1_0_49",0);
                        }

                        if(isBitForFctSetted(P_ASG_10_1_0_17_ID,gBAP_Indication_data))
                        {
                            putValue(P_ASG_10_1_0_17_FctLstItemEn, 1);
                            setControlForeColor(panel_name, gCheckbox17,MakeRGB(0,240,0));
                            EnableControl(panel_name, gPanel17, 1);
                            EnableControl(panel_name, "panel_P_ASG_10_1_0_17",1);
                        }
                        else
                        {
                            putValue(P_ASG_10_1_0_17_FctLstItemEn, 0);
                            setControlForeColor(panel_name, gCheckbox17,MakeRGB(250,0,0));
                            EnableControl(panel_name, gPanel17, 0);
                            EnableControl(panel_name, "panel_P_ASG_10_1_0_17",0);
                        }

                        if(isBitForFctSetted(P_ASG_10_1_0_48_ID,gBAP_Indication_data))
                        {
                            putValue(P_ASG_10_1_0_48_FctLstItemEn, 1);
                            setControlForeColor(panel_name, gCheckbox48,MakeRGB(0,240,0));
                            EnableControl(panel_name, gPanel48, 1);
                            EnableControl(panel_name, "panel_P_ASG_10_1_0_48",1);
                        }
                        else
                        {
                            putValue(P_ASG_10_1_0_48_FctLstItemEn, 0);
                            setControlForeColor(panel_name, gCheckbox48,MakeRGB(250,0,0));
                            EnableControl(panel_name, gPanel48, 0);
                            EnableControl(panel_name, "panel_P_ASG_10_1_0_48",0);
                        }

                        if(isBitForFctSetted(P_ASG_10_1_0_16_ID,gBAP_Indication_data))
                        {
                            putValue(P_ASG_10_1_0_16_FctLstItemEn, 1);
                            setControlForeColor(panel_name, gCheckbox16,MakeRGB(0,240,0));
                            EnableControl(panel_name, gPanel16, 1);
                            EnableControl(panel_name, "panel_P_ASG_10_1_0_16",1);
                        }
                        else
                        {
                            putValue(P_ASG_10_1_0_16_FctLstItemEn, 0);
                            setControlForeColor(panel_name, gCheckbox16,MakeRGB(250,0,0));
                            EnableControl(panel_name, gPanel16, 0);
                            EnableControl(panel_name, "panel_P_ASG_10_1_0_16",0);
                        }

                        if(isBitForFctSetted(P_ASG_10_1_0_47_ID,gBAP_Indication_data))
                        {
                            putValue(P_ASG_10_1_0_47_FctLstItemEn, 1);
                            setControlForeColor(panel_name, gCheckbox47,MakeRGB(0,240,0));
                            EnableControl(panel_name, gPanel47, 1);
                            EnableControl(panel_name, "panel_P_ASG_10_1_0_47",1);
                        }
                        else
                        {
                            putValue(P_ASG_10_1_0_47_FctLstItemEn, 0);
                            setControlForeColor(panel_name, gCheckbox47,MakeRGB(250,0,0));
                            EnableControl(panel_name, gPanel47, 0);
                            EnableControl(panel_name, "panel_P_ASG_10_1_0_47",0);
                        }

                        if(isBitForFctSetted(P_ASG_10_1_0_4_ID,gBAP_Indication_data))
                        {
                            putValue(P_ASG_10_1_0_4_FctLstItemEn, 1);
                            setControlForeColor(panel_name, gCheckbox4,MakeRGB(0,240,0));
                        }
                        else
                        {
                            putValue(P_ASG_10_1_0_4_FctLstItemEn, 0);
                            setControlForeColor(panel_name, gCheckbox4,MakeRGB(250,0,0));
                        }

                        if(isBitForFctSetted(P_ASG_10_1_0_15_ID,gBAP_Indication_data))
                        {
                            putValue(P_ASG_10_1_0_15_FctLstItemEn, 1);
                            setControlForeColor(panel_name, gCheckbox15,MakeRGB(0,240,0));
                            EnableControl(panel_name, gPanel15, 1);
                            EnableControl(panel_name, "panel_P_ASG_10_1_0_15",1);
                        }
                        else
                        {
                            putValue(P_ASG_10_1_0_15_FctLstItemEn, 0);
                            setControlForeColor(panel_name, gCheckbox15,MakeRGB(250,0,0));
                            EnableControl(panel_name, gPanel15, 0);
                            EnableControl(panel_name, "panel_P_ASG_10_1_0_15",0);
                        }

                        if(isBitForFctSetted(P_ASG_10_1_0_46_ID,gBAP_Indication_data))
                        {
                            putValue(P_ASG_10_1_0_46_FctLstItemEn, 1);
                            setControlForeColor(panel_name, gCheckbox46,MakeRGB(0,240,0));
                            EnableControl(panel_name, gPanel46, 1);
                            EnableControl(panel_name, "panel_P_ASG_10_1_0_46",1);
                        }
                        else
                        {
                            putValue(P_ASG_10_1_0_46_FctLstItemEn, 0);
                            setControlForeColor(panel_name, gCheckbox46,MakeRGB(250,0,0));
                            EnableControl(panel_name, gPanel46, 0);
                            EnableControl(panel_name, "panel_P_ASG_10_1_0_46",0);
                        }

                        if(isBitForFctSetted(P_ASG_10_1_0_3_ID,gBAP_Indication_data))
                        {
                            putValue(P_ASG_10_1_0_3_FctLstItemEn, 1);
                            setControlForeColor(panel_name, gCheckbox3,MakeRGB(0,240,0));
                        }
                        else
                        {
                            putValue(P_ASG_10_1_0_3_FctLstItemEn, 0);
                            setControlForeColor(panel_name, gCheckbox3,MakeRGB(250,0,0));
                        }

                        if(isBitForFctSetted(P_ASG_10_1_0_14_ID,gBAP_Indication_data))
                        {
                            putValue(P_ASG_10_1_0_14_FctLstItemEn, 1);
                            setControlForeColor(panel_name, gCheckbox14,MakeRGB(0,240,0));
                            EnableControl(panel_name, gPanel14, 1);
                            EnableControl(panel_name, "panel_P_ASG_10_1_0_14",1);
                        }
                        else
                        {
                            putValue(P_ASG_10_1_0_14_FctLstItemEn, 0);
                            setControlForeColor(panel_name, gCheckbox14,MakeRGB(250,0,0));
                            EnableControl(panel_name, gPanel14, 0);
                            EnableControl(panel_name, "panel_P_ASG_10_1_0_14",0);
                        }

                        if(isBitForFctSetted(P_ASG_10_1_0_45_ID,gBAP_Indication_data))
                        {
                            putValue(P_ASG_10_1_0_45_FctLstItemEn, 1);
                            setControlForeColor(panel_name, gCheckbox45,MakeRGB(0,240,0));
                            EnableControl(panel_name, gPanel45, 1);
                            EnableControl(panel_name, "panel_P_ASG_10_1_0_45",1);
                        }
                        else
                        {
                            putValue(P_ASG_10_1_0_45_FctLstItemEn, 0);
                            setControlForeColor(panel_name, gCheckbox45,MakeRGB(250,0,0));
                            EnableControl(panel_name, gPanel45, 0);
                            EnableControl(panel_name, "panel_P_ASG_10_1_0_45",0);
                        }

                        if(isBitForFctSetted(P_ASG_10_1_0_2_ID,gBAP_Indication_data))
                        {
                            putValue(P_ASG_10_1_0_2_FctLstItemEn, 1);
                            setControlForeColor(panel_name, gCheckbox2,MakeRGB(0,240,0));
                        }
                        else
                        {
                            putValue(P_ASG_10_1_0_2_FctLstItemEn, 0);
                            setControlForeColor(panel_name, gCheckbox2,MakeRGB(250,0,0));
                        }

                        if(isBitForFctSetted(P_ASG_10_1_0_13_ID,gBAP_Indication_data))
                        {
                            putValue(P_ASG_10_1_0_13_FctLstItemEn, 1);
                            setControlForeColor(panel_name, gCheckbox13,MakeRGB(0,240,0));
                            EnableControl(panel_name, gPanel13, 1);
                            EnableControl(panel_name, "panel_P_ASG_10_1_0_13",1);
                        }
                        else
                        {
                            putValue(P_ASG_10_1_0_13_FctLstItemEn, 0);
                            setControlForeColor(panel_name, gCheckbox13,MakeRGB(250,0,0));
                            EnableControl(panel_name, gPanel13, 0);
                            EnableControl(panel_name, "panel_P_ASG_10_1_0_13",0);
                        }

                        if(isBitForFctSetted(P_ASG_10_1_0_44_ID,gBAP_Indication_data))
                        {
                            putValue(P_ASG_10_1_0_44_FctLstItemEn, 1);
                            setControlForeColor(panel_name, gCheckbox44,MakeRGB(0,240,0));
                            EnableControl(panel_name, gPanel44, 1);
                            EnableControl(panel_name, "panel_P_ASG_10_1_0_44",1);
                        }
                        else
                        {
                            putValue(P_ASG_10_1_0_44_FctLstItemEn, 0);
                            setControlForeColor(panel_name, gCheckbox44,MakeRGB(250,0,0));
                            EnableControl(panel_name, gPanel44, 0);
                            EnableControl(panel_name, "panel_P_ASG_10_1_0_44",0);
                        }

                        if(isBitForFctSetted(C_ASG_10_1_0_1_ID,gBAP_Indication_data))
                        {
                            putValue(C_ASG_10_1_0_1_FctLstItemEn, 1);
                            setControlForeColor(panel_name, gCheckbox1,MakeRGB(0,240,0));
                        }
                        else
                        {
                            putValue(C_ASG_10_1_0_1_FctLstItemEn, 0);
                            setControlForeColor(panel_name, gCheckbox1,MakeRGB(250,0,0));
                        }

                        if(isBitForFctSetted(P_ASG_10_1_0_43_ID,gBAP_Indication_data))
                        {
                            putValue(P_ASG_10_1_0_43_FctLstItemEn, 1);
                            setControlForeColor(panel_name, gCheckbox43,MakeRGB(0,240,0));
                            EnableControl(panel_name, gPanel43, 1);
                            EnableControl(panel_name, "panel_P_ASG_10_1_0_43",1);
                        }
                        else
                        {
                            putValue(P_ASG_10_1_0_43_FctLstItemEn, 0);
                            setControlForeColor(panel_name, gCheckbox43,MakeRGB(250,0,0));
                            EnableControl(panel_name, gPanel43, 0);
                            EnableControl(panel_name, "panel_P_ASG_10_1_0_43",0);
                        }

                        if(isBitForFctSetted(P_ASG_10_1_0_42_ID,gBAP_Indication_data))
                        {
                            putValue(P_ASG_10_1_0_42_FctLstItemEn, 1);
                            setControlForeColor(panel_name, gCheckbox42,MakeRGB(0,240,0));
                            EnableControl(panel_name, gPanel42, 1);
                            EnableControl(panel_name, "panel_P_ASG_10_1_0_42",1);
                        }
                        else
                        {
                            putValue(P_ASG_10_1_0_42_FctLstItemEn, 0);
                            setControlForeColor(panel_name, gCheckbox42,MakeRGB(250,0,0));
                            EnableControl(panel_name, gPanel42, 0);
                            EnableControl(panel_name, "panel_P_ASG_10_1_0_42",0);
                        }

                        if(isBitForFctSetted(P_ASG_10_1_0_41_ID,gBAP_Indication_data))
                        {
                            putValue(P_ASG_10_1_0_41_FctLstItemEn, 1);
                            setControlForeColor(panel_name, gCheckbox41,MakeRGB(0,240,0));
                            EnableControl(panel_name, gPanel41, 1);
                            EnableControl(panel_name, "panel_P_ASG_10_1_0_41",1);
                        }
                        else
                        {
                            putValue(P_ASG_10_1_0_41_FctLstItemEn, 0);
                            setControlForeColor(panel_name, gCheckbox41,MakeRGB(250,0,0));
                            EnableControl(panel_name, gPanel41, 0);
                            EnableControl(panel_name, "panel_P_ASG_10_1_0_41",0);
                        }

                        if(isBitForFctSetted(P_ASG_10_1_0_40_ID,gBAP_Indication_data))
                        {
                            putValue(P_ASG_10_1_0_40_FctLstItemEn, 1);
                            setControlForeColor(panel_name, gCheckbox40,MakeRGB(0,240,0));
                            EnableControl(panel_name, gPanel40, 1);
                            EnableControl(panel_name, "panel_P_ASG_10_1_0_40",1);
                        }
                        else
                        {
                            putValue(P_ASG_10_1_0_40_FctLstItemEn, 0);
                            setControlForeColor(panel_name, gCheckbox40,MakeRGB(250,0,0));
                            EnableControl(panel_name, gPanel40, 0);
                            EnableControl(panel_name, "panel_P_ASG_10_1_0_40",0);
                        }

                        if(isBitForFctSetted(P_ASG_10_1_0_39_ID,gBAP_Indication_data))
                        {
                            putValue(P_ASG_10_1_0_39_FctLstItemEn, 1);
                            setControlForeColor(panel_name, gCheckbox39,MakeRGB(0,240,0));
                            EnableControl(panel_name, gPanel39, 1);
                            EnableControl(panel_name, "panel_P_ASG_10_1_0_39",1);
                        }
                        else
                        {
                            putValue(P_ASG_10_1_0_39_FctLstItemEn, 0);
                            setControlForeColor(panel_name, gCheckbox39,MakeRGB(250,0,0));
                            EnableControl(panel_name, gPanel39, 0);
                            EnableControl(panel_name, "panel_P_ASG_10_1_0_39",0);
                        }

                        if(isBitForFctSetted(P_ASG_10_1_0_38_ID,gBAP_Indication_data))
                        {
                            putValue(P_ASG_10_1_0_38_FctLstItemEn, 1);
                            setControlForeColor(panel_name, gCheckbox38,MakeRGB(0,240,0));
                            EnableControl(panel_name, gPanel38, 1);
                            EnableControl(panel_name, "panel_P_ASG_10_1_0_38",1);
                        }
                        else
                        {
                            putValue(P_ASG_10_1_0_38_FctLstItemEn, 0);
                            setControlForeColor(panel_name, gCheckbox38,MakeRGB(250,0,0));
                            EnableControl(panel_name, gPanel38, 0);
                            EnableControl(panel_name, "panel_P_ASG_10_1_0_38",0);
                        }

                        if(isBitForFctSetted(P_ASG_10_1_0_37_ID,gBAP_Indication_data))
                        {
                            putValue(P_ASG_10_1_0_37_FctLstItemEn, 1);
                            setControlForeColor(panel_name, gCheckbox37,MakeRGB(0,240,0));
                            EnableControl(panel_name, gPanel37, 1);
                            EnableControl(panel_name, "panel_P_ASG_10_1_0_37",1);
                        }
                        else
                        {
                            putValue(P_ASG_10_1_0_37_FctLstItemEn, 0);
                            setControlForeColor(panel_name, gCheckbox37,MakeRGB(250,0,0));
                            EnableControl(panel_name, gPanel37, 0);
                            EnableControl(panel_name, "panel_P_ASG_10_1_0_37",0);
                        }

                        if(isBitForFctSetted(P_ASG_10_1_0_36_ID,gBAP_Indication_data))
                        {
                            putValue(P_ASG_10_1_0_36_FctLstItemEn, 1);
                            setControlForeColor(panel_name, gCheckbox36,MakeRGB(0,240,0));
                            EnableControl(panel_name, gPanel36, 1);
                            EnableControl(panel_name, "panel_P_ASG_10_1_0_36",1);
                        }
                        else
                        {
                            putValue(P_ASG_10_1_0_36_FctLstItemEn, 0);
                            setControlForeColor(panel_name, gCheckbox36,MakeRGB(250,0,0));
                            EnableControl(panel_name, gPanel36, 0);
                            EnableControl(panel_name, "panel_P_ASG_10_1_0_36",0);
                        }

                        if(isBitForFctSetted(P_ASG_10_1_0_35_ID,gBAP_Indication_data))
                        {
                            putValue(P_ASG_10_1_0_35_FctLstItemEn, 1);
                            setControlForeColor(panel_name, gCheckbox35,MakeRGB(0,240,0));
                            EnableControl(panel_name, gPanel35, 1);
                            EnableControl(panel_name, "panel_P_ASG_10_1_0_35",1);
                        }
                        else
                        {
                            putValue(P_ASG_10_1_0_35_FctLstItemEn, 0);
                            setControlForeColor(panel_name, gCheckbox35,MakeRGB(250,0,0));
                            EnableControl(panel_name, gPanel35, 0);
                            EnableControl(panel_name, "panel_P_ASG_10_1_0_35",0);
                        }

                        if(isBitForFctSetted(P_ASG_10_1_0_34_ID,gBAP_Indication_data))
                        {
                            putValue(P_ASG_10_1_0_34_FctLstItemEn, 1);
                            setControlForeColor(panel_name, gCheckbox34,MakeRGB(0,240,0));
                            EnableControl(panel_name, gPanel34, 1);
                            EnableControl(panel_name, "panel_P_ASG_10_1_0_34",1);
                        }
                        else
                        {
                            putValue(P_ASG_10_1_0_34_FctLstItemEn, 0);
                            setControlForeColor(panel_name, gCheckbox34,MakeRGB(250,0,0));
                            EnableControl(panel_name, gPanel34, 0);
                            EnableControl(panel_name, "panel_P_ASG_10_1_0_34",0);
                        }

                        if(isBitForFctSetted(P_ASG_10_1_0_33_ID,gBAP_Indication_data))
                        {
                            putValue(P_ASG_10_1_0_33_FctLstItemEn, 1);
                            setControlForeColor(panel_name, gCheckbox33,MakeRGB(0,240,0));
                            EnableControl(panel_name, gPanel33, 1);
                            EnableControl(panel_name, "panel_P_ASG_10_1_0_33",1);
                        }
                        else
                        {
                            putValue(P_ASG_10_1_0_33_FctLstItemEn, 0);
                            setControlForeColor(panel_name, gCheckbox33,MakeRGB(250,0,0));
                            EnableControl(panel_name, gPanel33, 0);
                            EnableControl(panel_name, "panel_P_ASG_10_1_0_33",0);
                        }

                        if(isBitForFctSetted(P_ASG_10_1_0_32_ID,gBAP_Indication_data))
                        {
                            putValue(P_ASG_10_1_0_32_FctLstItemEn, 1);
                            setControlForeColor(panel_name, gCheckbox32,MakeRGB(0,240,0));
                            EnableControl(panel_name, gPanel32, 1);
                            EnableControl(panel_name, "panel_P_ASG_10_1_0_32",1);
                        }
                        else
                        {
                            putValue(P_ASG_10_1_0_32_FctLstItemEn, 0);
                            setControlForeColor(panel_name, gCheckbox32,MakeRGB(250,0,0));
                            EnableControl(panel_name, gPanel32, 0);
                            EnableControl(panel_name, "panel_P_ASG_10_1_0_32",0);
                        }

                        if(isBitForFctSetted(P_ASG_10_1_0_31_ID,gBAP_Indication_data))
                        {
                            putValue(P_ASG_10_1_0_31_FctLstItemEn, 1);
                            setControlForeColor(panel_name, gCheckbox31,MakeRGB(0,240,0));
                            EnableControl(panel_name, gPanel31, 1);
                            EnableControl(panel_name, "panel_P_ASG_10_1_0_31",1);
                        }
                        else
                        {
                            putValue(P_ASG_10_1_0_31_FctLstItemEn, 0);
                            setControlForeColor(panel_name, gCheckbox31,MakeRGB(250,0,0));
                            EnableControl(panel_name, gPanel31, 0);
                            EnableControl(panel_name, "panel_P_ASG_10_1_0_31",0);
                        }

                        if(isBitForFctSetted(P_ASG_10_1_0_30_ID,gBAP_Indication_data))
                        {
                            putValue(P_ASG_10_1_0_30_FctLstItemEn, 1);
                            setControlForeColor(panel_name, gCheckbox30,MakeRGB(0,240,0));
                            EnableControl(panel_name, gPanel30, 1);
                            EnableControl(panel_name, "panel_P_ASG_10_1_0_30",1);
                        }
                        else
                        {
                            putValue(P_ASG_10_1_0_30_FctLstItemEn, 0);
                            setControlForeColor(panel_name, gCheckbox30,MakeRGB(250,0,0));
                            EnableControl(panel_name, gPanel30, 0);
                            EnableControl(panel_name, "panel_P_ASG_10_1_0_30",0);
                        }

                     }
                        break;
                    default:
                      writelineEx(gError_Trace, 0, "NodeIndex: %d: Illegal IndType : lsgid:%d fctid:%d indType:%d",
                           NODE_INDEX, gBAP_Indication_header[0], gBAP_Indication_header[1], gBAP_Indication_header[2]);
                       break;
                  }
                  break;
            case Bap_error:
                putValue(P_ASG_10_1_0_3_ErrCode,  gBAP_Indication_header[5]);
                setControlBackColor(panel_name, "errfield_P_ASG_10_1_0_3", MakeRGB(255,79,79));
                break;
            case Bap_acknowledge:
            	 break;
            default:
                PrintIndicationError("Illegal DataType");
                break;
       }
       break;
    case P_ASG_10_1_0_4_ID: 
        switch(gBAP_Indication_header[3]) // Datentyp 
        {
           case Bap_uint8:
                   switch(gBAP_Indication_header[2]) // IndType
                   {
                       case Data_IND: // Indicationtyp pruefen
                           // Daten setzen
                           putValue(P_ASG_10_1_0_4, gBAP_Indication_header[5]);
                           setControlBackColor(panel_name, "errfield_P_ASG_10_1_0_4", MakeRGB(255,255,255));  
                           setControlBackColor(panel_name, "panel_P_ASG_10_1_0_4", MakeRGB(255,255,255));  
                           break;                              
                       default:
                           PrintIndicationError("Illegal IndType");
                           break;
                   }
                   break;
            case Bap_error:
                putValue(P_ASG_10_1_0_4_ErrCode,  gBAP_Indication_header[5]);
                setControlBackColor(panel_name, "errfield_P_ASG_10_1_0_4", MakeRGB(255,79,79));  
                setControlBackColor(panel_name, "panel_P_ASG_10_1_0_4", MakeRGB(220,220,220));  
                if(gBAP_Indication_header[5]==0x21)
                {
                   putValue(C_ASG_10_1_0_1_State, "");
                   setControlBackColor(panel_name, "errfield_C_ASG_10_1_0_1_State", MakeRGB(255,255,255));
                }
                break;
            case Bap_acknowledge:
                break;
            default:
                PrintIndicationError("Illegal DataType");
                break;
        }
    break;
    case P_ASG_10_1_0_13_ID: 
        switch(gBAP_Indication_header[3]) // Datentyp 
        {
            case Bap_uint8:
                    switch(gBAP_Indication_header[2]) // IndType
                    {
                        case Data_IND: // Indicationtyp pruefen
                            // Daten setzen
                            putValue(P_ASG_10_1_0_13, gBAP_Indication_header[5]);
                            setControlBackColor(panel_name, "errfield_P_ASG_10_1_0_13", MakeRGB(255,255,255));  
                            setControlBackColor(panel_name, "panel_P_ASG_10_1_0_13", MakeRGB(255,255,255));  
                            break;                              
                        default:
                            PrintIndicationError("Illegal IndType");
                            break;
                    }
                    break;
            case Bap_error:
                gP_ASG_10_1_0_13_ErrCode = 0;
                putValue(P_ASG_10_1_0_13_ErrCode,  gBAP_Indication_header[5]);
                setControlBackColor(panel_name, "errfield_P_ASG_10_1_0_13", MakeRGB(255,79,79));  
                setControlBackColor(panel_name, "panel_P_ASG_10_1_0_13", MakeRGB(220,220,220));  
                break;
            case Bap_acknowledge:
                break;
            default:
                    PrintIndicationError("Illegal DataType");
                    break;
        }
    break;
    case P_ASG_10_1_0_14_ID: 
        switch(gBAP_Indication_header[3]) // Datentyp 
        {
            case Bap_byteSequence:
                switch (gBAP_Indication_header[2]) // IndType
                {
                    case Data_IND: // Indicationtyp pruefen
                        // Daten setzen
                        putValue(P_ASG_10_1_0_14, gBAP_Indication_data, gBAP_Indication_header[4]);
                        setControlBackColor(panel_name, "errfield_P_ASG_10_1_0_14", MakeRGB(255,255,255));  
                        setControlBackColor(panel_name, "panel_P_ASG_10_1_0_14", MakeRGB(255,255,255));  
                        break;
                    default:
                        PrintIndicationError("Illegal IndType");
                        break;
                }
                break;
            case Bap_error:
                gP_ASG_10_1_0_14_ErrCode = 0;
                putValue(P_ASG_10_1_0_14_ErrCode,  gBAP_Indication_header[5]);
                setControlBackColor(panel_name, "errfield_P_ASG_10_1_0_14", MakeRGB(255,79,79));  
                setControlBackColor(panel_name, "panel_P_ASG_10_1_0_14", MakeRGB(220,220,220));  
                break;
            case Bap_acknowledge:
                break;
            default:
                PrintIndicationError("Illegal DataType");
                break;
        }
    break;
    case P_ASG_10_1_0_15_ID: 
        switch(gBAP_Indication_header[3]) // Datentyp 
        {
            case Bap_uint8:
                    switch(gBAP_Indication_header[2]) // IndType
                    {
                        case Data_IND: // Indicationtyp pruefen
                            // Daten setzen
                            putValue(P_ASG_10_1_0_15, gBAP_Indication_header[5]);
                            setControlBackColor(panel_name, "errfield_P_ASG_10_1_0_15", MakeRGB(255,255,255));  
                            setControlBackColor(panel_name, "panel_P_ASG_10_1_0_15", MakeRGB(255,255,255));  
                            break;                              
                        default:
                            PrintIndicationError("Illegal IndType");
                            break;
                    }
                    break;
            case Bap_error:
                gP_ASG_10_1_0_15_ErrCode = 0;
                putValue(P_ASG_10_1_0_15_ErrCode,  gBAP_Indication_header[5]);
                setControlBackColor(panel_name, "errfield_P_ASG_10_1_0_15", MakeRGB(255,79,79));  
                setControlBackColor(panel_name, "panel_P_ASG_10_1_0_15", MakeRGB(220,220,220));  
                break;
            case Bap_acknowledge:
                break;
            default:
                    PrintIndicationError("Illegal DataType");
                    break;
        }
    break;
    case P_ASG_10_1_0_16_ID: 
        switch(gBAP_Indication_header[3]) // Datentyp 
        {
            case Bap_byteSequence:
                switch (gBAP_Indication_header[2]) // IndType
                {
                    case Data_IND: // Indicationtyp pruefen
                        // Daten setzen
                        putValue(P_ASG_10_1_0_16, gBAP_Indication_data, gBAP_Indication_header[4]);
                        setControlBackColor(panel_name, "errfield_P_ASG_10_1_0_16", MakeRGB(255,255,255));  
                        setControlBackColor(panel_name, "panel_P_ASG_10_1_0_16", MakeRGB(255,255,255));  
                        break;
                    default:
                        PrintIndicationError("Illegal IndType");
                        break;
                }
                break;
            case Bap_error:
                gP_ASG_10_1_0_16_ErrCode = 0;
                putValue(P_ASG_10_1_0_16_ErrCode,  gBAP_Indication_header[5]);
                setControlBackColor(panel_name, "errfield_P_ASG_10_1_0_16", MakeRGB(255,79,79));  
                setControlBackColor(panel_name, "panel_P_ASG_10_1_0_16", MakeRGB(220,220,220));  
                break;
            case Bap_acknowledge:
                break;
            default:
                PrintIndicationError("Illegal DataType");
                break;
        }
    break;
    case P_ASG_10_1_0_17_ID: 
        switch(gBAP_Indication_header[3]) // Datentyp 
        {
            case Bap_byteSequence:
                switch (gBAP_Indication_header[2]) // IndType
                {
                    case Data_IND: // Indicationtyp pruefen
                        // Daten setzen
                        putValue(P_ASG_10_1_0_17, gBAP_Indication_data, gBAP_Indication_header[4]);
                        setControlBackColor(panel_name, "errfield_P_ASG_10_1_0_17", MakeRGB(255,255,255));  
                        setControlBackColor(panel_name, "panel_P_ASG_10_1_0_17", MakeRGB(255,255,255));  
                        break;
                    default:
                        PrintIndicationError("Illegal IndType");
                        break;
                }
                break;
            case Bap_error:
                gP_ASG_10_1_0_17_ErrCode = 0;
                putValue(P_ASG_10_1_0_17_ErrCode,  gBAP_Indication_header[5]);
                setControlBackColor(panel_name, "errfield_P_ASG_10_1_0_17", MakeRGB(255,79,79));  
                setControlBackColor(panel_name, "panel_P_ASG_10_1_0_17", MakeRGB(220,220,220));  
                break;
            case Bap_acknowledge:
                break;
            default:
                PrintIndicationError("Illegal DataType");
                break;
        }
    break;
    case P_ASG_10_1_0_18_ID: 
        switch(gBAP_Indication_header[3]) // Datentyp 
        {
            case Bap_byteSequence:
                switch (gBAP_Indication_header[2]) // IndType
                {
                    case Data_IND: // Indicationtyp pruefen
                        // Daten setzen
                        putValue(P_ASG_10_1_0_18, gBAP_Indication_data, gBAP_Indication_header[4]);
                        setControlBackColor(panel_name, "errfield_P_ASG_10_1_0_18", MakeRGB(255,255,255));  
                        setControlBackColor(panel_name, "panel_P_ASG_10_1_0_18", MakeRGB(255,255,255));  
                        break;
                    default:
                        PrintIndicationError("Illegal IndType");
                        break;
                }
                break;
            case Bap_error:
                gP_ASG_10_1_0_18_ErrCode = 0;
                putValue(P_ASG_10_1_0_18_ErrCode,  gBAP_Indication_header[5]);
                setControlBackColor(panel_name, "errfield_P_ASG_10_1_0_18", MakeRGB(255,79,79));  
                setControlBackColor(panel_name, "panel_P_ASG_10_1_0_18", MakeRGB(220,220,220));  
                break;
            case Bap_acknowledge:
                break;
            default:
                PrintIndicationError("Illegal DataType");
                break;
        }
    break;
    case P_ASG_10_1_0_19_ID: 
        switch(gBAP_Indication_header[3]) // Datentyp 
        {
            case Bap_byteSequence:
                switch (gBAP_Indication_header[2]) // IndType
                {
                    case Data_IND: // Indicationtyp pruefen
                        // Daten setzen
                        putValue(P_ASG_10_1_0_19, gBAP_Indication_data, gBAP_Indication_header[4]);
                        setControlBackColor(panel_name, "errfield_P_ASG_10_1_0_19", MakeRGB(255,255,255));  
                        setControlBackColor(panel_name, "panel_P_ASG_10_1_0_19", MakeRGB(255,255,255));  
                        break;
                    default:
                        PrintIndicationError("Illegal IndType");
                        break;
                }
                break;
            case Bap_error:
                gP_ASG_10_1_0_19_ErrCode = 0;
                putValue(P_ASG_10_1_0_19_ErrCode,  gBAP_Indication_header[5]);
                setControlBackColor(panel_name, "errfield_P_ASG_10_1_0_19", MakeRGB(255,79,79));  
                setControlBackColor(panel_name, "panel_P_ASG_10_1_0_19", MakeRGB(220,220,220));  
                break;
            case Bap_acknowledge:
                break;
            default:
                PrintIndicationError("Illegal DataType");
                break;
        }
    break;
    case P_ASG_10_1_0_20_ID: 
        switch(gBAP_Indication_header[3]) // Datentyp 
        {
            case Bap_byteSequence:
                switch (gBAP_Indication_header[2]) // IndType
                {
                    case Data_IND: // Indicationtyp pruefen
                        // Daten setzen
                        putValue(P_ASG_10_1_0_20, gBAP_Indication_data, gBAP_Indication_header[4]);
                        setControlBackColor(panel_name, "errfield_P_ASG_10_1_0_20", MakeRGB(255,255,255));  
                        setControlBackColor(panel_name, "panel_P_ASG_10_1_0_20", MakeRGB(255,255,255));  
                        break;
                    default:
                        PrintIndicationError("Illegal IndType");
                        break;
                }
                break;
            case Bap_error:
                gP_ASG_10_1_0_20_ErrCode = 0;
                putValue(P_ASG_10_1_0_20_ErrCode,  gBAP_Indication_header[5]);
                setControlBackColor(panel_name, "errfield_P_ASG_10_1_0_20", MakeRGB(255,79,79));  
                setControlBackColor(panel_name, "panel_P_ASG_10_1_0_20", MakeRGB(220,220,220));  
                break;
            case Bap_acknowledge:
                break;
            default:
                PrintIndicationError("Illegal DataType");
                break;
        }
    break;
    case P_ASG_10_1_0_21_ID: 
        switch(gBAP_Indication_header[3]) // Datentyp 
        {
            case Bap_byteSequence:
                switch (gBAP_Indication_header[2]) // IndType
                {
                    case Data_IND: // Indicationtyp pruefen
                        // Daten setzen
                        putValue(P_ASG_10_1_0_21, gBAP_Indication_data, gBAP_Indication_header[4]);
                        setControlBackColor(panel_name, "errfield_P_ASG_10_1_0_21", MakeRGB(255,255,255));  
                        setControlBackColor(panel_name, "panel_P_ASG_10_1_0_21", MakeRGB(255,255,255));  
                        break;
                    case DataAck_IND: //Indicationtyp pruefen
                            //write("FSG hat StatusAck geschickt (BYTESEQUENCE)");
                            //Daten setzen
                            putValue(P_ASG_10_1_0_21, gBAP_Indication_data, gBAP_Indication_header[4]);
                            setControlBackColor(panel_name, "errfield_P_ASG_10_1_0_21", MakeRGB(255,255,255));  
                            setControlBackColor(panel_name, "panel_P_ASG_10_1_0_21", MakeRGB(255,255,255));  
                            if(getValue(P_ASG_10_1_0_21_AckEn))
                            {
                                if(0 == getValueSize(P_ASG_10_1_0_21_Ack))
                                {
                                    putValue(P_ASG_10_1_0_21_Ack, gBAP_Indication_data, gBAP_Indication_header[4]);
                                }
                                getValue(P_ASG_10_1_0_21_Ack, temp);
                                Request_byteSequence(LSGID, P_ASG_10_1_0_21_ID, Ack_REQ, temp, getValueSize(P_ASG_10_1_0_21_Ack));
                            }
                            break;                              
                    default:
                        PrintIndicationError("Illegal IndType");
                        break;
                }
                break;
            case Bap_error:
                gP_ASG_10_1_0_21_ErrCode = 0;
                putValue(P_ASG_10_1_0_21_ErrCode,  gBAP_Indication_header[5]);
                setControlBackColor(panel_name, "errfield_P_ASG_10_1_0_21", MakeRGB(255,79,79));  
                setControlBackColor(panel_name, "panel_P_ASG_10_1_0_21", MakeRGB(220,220,220));  
                break;
            case Bap_acknowledge:
                break;
            default:
                PrintIndicationError("Illegal DataType");
                break;
        }
    break;
    case P_ASG_10_1_0_22_ID: 
        switch(gBAP_Indication_header[3]) // Datentyp 
        {
            case Bap_uint8:
                    switch(gBAP_Indication_header[2]) // IndType
                    {
                        case Data_IND: // Indicationtyp pruefen
                            // Daten setzen
                            putValue(P_ASG_10_1_0_22, gBAP_Indication_header[5]);
                            setControlBackColor(panel_name, "errfield_P_ASG_10_1_0_22", MakeRGB(255,255,255));  
                            setControlBackColor(panel_name, "panel_P_ASG_10_1_0_22", MakeRGB(255,255,255));  
                            break;                              
                        default:
                            PrintIndicationError("Illegal IndType");
                            break;
                    }
                    break;
            case Bap_error:
                gP_ASG_10_1_0_22_ErrCode = 0;
                putValue(P_ASG_10_1_0_22_ErrCode,  gBAP_Indication_header[5]);
                setControlBackColor(panel_name, "errfield_P_ASG_10_1_0_22", MakeRGB(255,79,79));  
                setControlBackColor(panel_name, "panel_P_ASG_10_1_0_22", MakeRGB(220,220,220));  
                break;
            case Bap_acknowledge:
                break;
            default:
                    PrintIndicationError("Illegal DataType");
                    break;
        }
    break;
    case P_ASG_10_1_0_23_ID: 
        switch(gBAP_Indication_header[3]) // Datentyp 
        {
            case Bap_uint8:
                    switch(gBAP_Indication_header[2]) // IndType
                    {
                        case Data_IND: // Indicationtyp pruefen
                            // Daten setzen
                            putValue(P_ASG_10_1_0_23, gBAP_Indication_header[5]);
                            setControlBackColor(panel_name, "errfield_P_ASG_10_1_0_23", MakeRGB(255,255,255));  
                            setControlBackColor(panel_name, "panel_P_ASG_10_1_0_23", MakeRGB(255,255,255));  
                            break;                              
                        default:
                            PrintIndicationError("Illegal IndType");
                            break;
                    }
                    break;
            case Bap_error:
                gP_ASG_10_1_0_23_ErrCode = 0;
                putValue(P_ASG_10_1_0_23_ErrCode,  gBAP_Indication_header[5]);
                setControlBackColor(panel_name, "errfield_P_ASG_10_1_0_23", MakeRGB(255,79,79));  
                setControlBackColor(panel_name, "panel_P_ASG_10_1_0_23", MakeRGB(220,220,220));  
                break;
            case Bap_acknowledge:
                break;
            default:
                    PrintIndicationError("Illegal DataType");
                    break;
        }
    break;
    case P_ASG_10_1_0_24_ID: 
        switch(gBAP_Indication_header[3]) // Datentyp 
        {
            case Bap_byteSequence:
                switch (gBAP_Indication_header[2]) // IndType
                {
                    case Data_IND: // Indicationtyp pruefen
                        // Daten setzen
                        putValue(P_ASG_10_1_0_24, gBAP_Indication_data, gBAP_Indication_header[4]);
                        setControlBackColor(panel_name, "errfield_P_ASG_10_1_0_24", MakeRGB(255,255,255));  
                        setControlBackColor(panel_name, "panel_P_ASG_10_1_0_24", MakeRGB(255,255,255));  
                        break;
                    default:
                        PrintIndicationError("Illegal IndType");
                        break;
                }
                break;
            case Bap_error:
                gP_ASG_10_1_0_24_ErrCode = 0;
                putValue(P_ASG_10_1_0_24_ErrCode,  gBAP_Indication_header[5]);
                setControlBackColor(panel_name, "errfield_P_ASG_10_1_0_24", MakeRGB(255,79,79));  
                setControlBackColor(panel_name, "panel_P_ASG_10_1_0_24", MakeRGB(220,220,220));  
                break;
            case Bap_acknowledge:
                break;
            default:
                PrintIndicationError("Illegal DataType");
                break;
        }
    break;
    case P_ASG_10_1_0_25_ID: 
        switch(gBAP_Indication_header[3]) // Datentyp 
        {
            case Bap_byteSequence:
                switch (gBAP_Indication_header[2]) // IndType
                {
                    case Data_IND: // Indicationtyp pruefen
                        // Daten setzen
                        putValue(P_ASG_10_1_0_25, gBAP_Indication_data, gBAP_Indication_header[4]);
                        setControlBackColor(panel_name, "errfield_P_ASG_10_1_0_25", MakeRGB(255,255,255));  
                        setControlBackColor(panel_name, "panel_P_ASG_10_1_0_25", MakeRGB(255,255,255));  
                        break;
                    default:
                        PrintIndicationError("Illegal IndType");
                        break;
                }
                break;
            case Bap_error:
                gP_ASG_10_1_0_25_ErrCode = 0;
                putValue(P_ASG_10_1_0_25_ErrCode,  gBAP_Indication_header[5]);
                setControlBackColor(panel_name, "errfield_P_ASG_10_1_0_25", MakeRGB(255,79,79));  
                setControlBackColor(panel_name, "panel_P_ASG_10_1_0_25", MakeRGB(220,220,220));  
                break;
            case Bap_acknowledge:
                break;
            default:
                PrintIndicationError("Illegal DataType");
                break;
        }
    break;
    case P_ASG_10_1_0_26_ID: 
        switch(gBAP_Indication_header[3]) // Datentyp 
        {
            case Bap_byteSequence:
                switch (gBAP_Indication_header[2]) // IndType
                {
                    case Data_IND: // Indicationtyp pruefen
                        // Daten setzen
                        putValue(P_ASG_10_1_0_26, gBAP_Indication_data, gBAP_Indication_header[4]);
                        setControlBackColor(panel_name, "errfield_P_ASG_10_1_0_26", MakeRGB(255,255,255));  
                        setControlBackColor(panel_name, "panel_P_ASG_10_1_0_26", MakeRGB(255,255,255));  
                        break;
                    default:
                        PrintIndicationError("Illegal IndType");
                        break;
                }
                break;
            case Bap_error:
                gP_ASG_10_1_0_26_ErrCode = 0;
                putValue(P_ASG_10_1_0_26_ErrCode,  gBAP_Indication_header[5]);
                setControlBackColor(panel_name, "errfield_P_ASG_10_1_0_26", MakeRGB(255,79,79));  
                setControlBackColor(panel_name, "panel_P_ASG_10_1_0_26", MakeRGB(220,220,220));  
                break;
            case Bap_acknowledge:
                break;
            default:
                PrintIndicationError("Illegal DataType");
                break;
        }
    break;
    case P_ASG_10_1_0_27_ID: 
        switch(gBAP_Indication_header[3]) // Datentyp 
        {
            case Bap_byteSequence:
                switch (gBAP_Indication_header[2]) // IndType
                {
                    case Data_IND: // Indicationtyp pruefen
                        // Daten setzen
                        putValue(P_ASG_10_1_0_27, gBAP_Indication_data, gBAP_Indication_header[4]);
                        setControlBackColor(panel_name, "errfield_P_ASG_10_1_0_27", MakeRGB(255,255,255));  
                        setControlBackColor(panel_name, "panel_P_ASG_10_1_0_27", MakeRGB(255,255,255));  
                        break;
                    default:
                        PrintIndicationError("Illegal IndType");
                        break;
                }
                break;
            case Bap_error:
                gP_ASG_10_1_0_27_ErrCode = 0;
                putValue(P_ASG_10_1_0_27_ErrCode,  gBAP_Indication_header[5]);
                setControlBackColor(panel_name, "errfield_P_ASG_10_1_0_27", MakeRGB(255,79,79));  
                setControlBackColor(panel_name, "panel_P_ASG_10_1_0_27", MakeRGB(220,220,220));  
                break;
            case Bap_acknowledge:
                break;
            default:
                PrintIndicationError("Illegal DataType");
                break;
        }
    break;
    case P_ASG_10_1_0_28_ID: 
        switch(gBAP_Indication_header[3]) // Datentyp 
        {
            case Bap_byteSequence:
                switch (gBAP_Indication_header[2]) // IndType
                {
                    case Data_IND: // Indicationtyp pruefen
                        // Daten setzen
                        putValue(P_ASG_10_1_0_28, gBAP_Indication_data, gBAP_Indication_header[4]);
                        setControlBackColor(panel_name, "errfield_P_ASG_10_1_0_28", MakeRGB(255,255,255));  
                        setControlBackColor(panel_name, "panel_P_ASG_10_1_0_28", MakeRGB(255,255,255));  
                        break;
                    default:
                        PrintIndicationError("Illegal IndType");
                        break;
                }
                break;
            case Bap_error:
                gP_ASG_10_1_0_28_ErrCode = 0;
                putValue(P_ASG_10_1_0_28_ErrCode,  gBAP_Indication_header[5]);
                setControlBackColor(panel_name, "errfield_P_ASG_10_1_0_28", MakeRGB(255,79,79));  
                setControlBackColor(panel_name, "panel_P_ASG_10_1_0_28", MakeRGB(220,220,220));  
                break;
            case Bap_acknowledge:
                break;
            default:
                PrintIndicationError("Illegal DataType");
                break;
        }
    break;
    case P_ASG_10_1_0_29_ID: 
        switch(gBAP_Indication_header[3]) // Datentyp 
        {
            case Bap_byteSequence:
                switch (gBAP_Indication_header[2]) // IndType
                {
                    case Data_IND: // Indicationtyp pruefen
                        // Daten setzen
                        putValue(P_ASG_10_1_0_29, gBAP_Indication_data, gBAP_Indication_header[4]);
                        setControlBackColor(panel_name, "errfield_P_ASG_10_1_0_29", MakeRGB(255,255,255));  
                        setControlBackColor(panel_name, "panel_P_ASG_10_1_0_29", MakeRGB(255,255,255));  
                        break;
                    default:
                        PrintIndicationError("Illegal IndType");
                        break;
                }
                break;
            case Bap_error:
                gP_ASG_10_1_0_29_ErrCode = 0;
                putValue(P_ASG_10_1_0_29_ErrCode,  gBAP_Indication_header[5]);
                setControlBackColor(panel_name, "errfield_P_ASG_10_1_0_29", MakeRGB(255,79,79));  
                setControlBackColor(panel_name, "panel_P_ASG_10_1_0_29", MakeRGB(220,220,220));  
                break;
            case Bap_acknowledge:
                break;
            default:
                PrintIndicationError("Illegal DataType");
                break;
        }
    break;
    case P_ASG_10_1_0_30_ID: 
        switch(gBAP_Indication_header[3]) // Datentyp 
        {
            case Bap_byteSequence:
                switch (gBAP_Indication_header[2]) // IndType
                {
                    case Data_IND: // Indicationtyp pruefen
                        // Daten setzen
                        putValue(P_ASG_10_1_0_30, gBAP_Indication_data, gBAP_Indication_header[4]);
                        setControlBackColor(panel_name, "errfield_P_ASG_10_1_0_30", MakeRGB(255,255,255));  
                        setControlBackColor(panel_name, "panel_P_ASG_10_1_0_30", MakeRGB(255,255,255));  
                        break;
                    default:
                        PrintIndicationError("Illegal IndType");
                        break;
                }
                break;
            case Bap_error:
                gP_ASG_10_1_0_30_ErrCode = 0;
                putValue(P_ASG_10_1_0_30_ErrCode,  gBAP_Indication_header[5]);
                setControlBackColor(panel_name, "errfield_P_ASG_10_1_0_30", MakeRGB(255,79,79));  
                setControlBackColor(panel_name, "panel_P_ASG_10_1_0_30", MakeRGB(220,220,220));  
                break;
            case Bap_acknowledge:
                break;
            default:
                PrintIndicationError("Illegal DataType");
                break;
        }
    break;
    case P_ASG_10_1_0_31_ID: 
        switch(gBAP_Indication_header[3]) // Datentyp 
        {
            case Bap_byteSequence:
                switch (gBAP_Indication_header[2]) // IndType
                {
                    case Data_IND: // Indicationtyp pruefen
                        // Daten setzen
                        putValue(P_ASG_10_1_0_31, gBAP_Indication_data, gBAP_Indication_header[4]);
                        setControlBackColor(panel_name, "errfield_P_ASG_10_1_0_31", MakeRGB(255,255,255));  
                        setControlBackColor(panel_name, "panel_P_ASG_10_1_0_31", MakeRGB(255,255,255));  
                        break;
                    default:
                        PrintIndicationError("Illegal IndType");
                        break;
                }
                break;
            case Bap_error:
                gP_ASG_10_1_0_31_ErrCode = 0;
                putValue(P_ASG_10_1_0_31_ErrCode,  gBAP_Indication_header[5]);
                setControlBackColor(panel_name, "errfield_P_ASG_10_1_0_31", MakeRGB(255,79,79));  
                setControlBackColor(panel_name, "panel_P_ASG_10_1_0_31", MakeRGB(220,220,220));  
                break;
            case Bap_acknowledge:
                break;
            default:
                PrintIndicationError("Illegal DataType");
                break;
        }
    break;
    case P_ASG_10_1_0_32_ID: 
        switch(gBAP_Indication_header[3]) // Datentyp 
        {
            case Bap_byteSequence:
                switch (gBAP_Indication_header[2]) // IndType
                {
                    case Data_IND: // Indicationtyp pruefen
                        // Daten setzen
                        putValue(P_ASG_10_1_0_32, gBAP_Indication_data, gBAP_Indication_header[4]);
                        setControlBackColor(panel_name, "errfield_P_ASG_10_1_0_32", MakeRGB(255,255,255));  
                        setControlBackColor(panel_name, "panel_P_ASG_10_1_0_32", MakeRGB(255,255,255));  
                        break;
                    default:
                        PrintIndicationError("Illegal IndType");
                        break;
                }
                break;
            case Bap_error:
                gP_ASG_10_1_0_32_ErrCode = 0;
                putValue(P_ASG_10_1_0_32_ErrCode,  gBAP_Indication_header[5]);
                setControlBackColor(panel_name, "errfield_P_ASG_10_1_0_32", MakeRGB(255,79,79));  
                setControlBackColor(panel_name, "panel_P_ASG_10_1_0_32", MakeRGB(220,220,220));  
                break;
            case Bap_acknowledge:
                break;
            default:
                PrintIndicationError("Illegal DataType");
                break;
        }
    break;
    case P_ASG_10_1_0_33_ID: 
        switch(gBAP_Indication_header[3]) // Datentyp 
        {
            case Bap_uint16:
                    switch(gBAP_Indication_header[2]) // IndType
                    {
                        case Data_IND: // Indicationtyp pruefen
                            // Daten setzen
                            putValue(P_ASG_10_1_0_33, gBAP_Indication_header[5]);
                            setControlBackColor(panel_name, "errfield_P_ASG_10_1_0_33", MakeRGB(255,255,255));  
                            setControlBackColor(panel_name, "panel_P_ASG_10_1_0_33", MakeRGB(255,255,255));  
                            break;                              
                        default:
                            PrintIndicationError("Illegal IndType");
                            break;
                    }
                    break;
            case Bap_error:
                gP_ASG_10_1_0_33_ErrCode = 0;
                putValue(P_ASG_10_1_0_33_ErrCode,  gBAP_Indication_header[5]);
                setControlBackColor(panel_name, "errfield_P_ASG_10_1_0_33", MakeRGB(255,79,79));  
                setControlBackColor(panel_name, "panel_P_ASG_10_1_0_33", MakeRGB(220,220,220));  
                break;
            case Bap_acknowledge:
                break;
            default:
                    PrintIndicationError("Illegal DataType");
                    break;
        }
    break;
    case P_ASG_10_1_0_34_ID: 
        switch(gBAP_Indication_header[3]) // Datentyp 
        {
            case Bap_byteSequence:
                switch (gBAP_Indication_header[2]) // IndType
                {
                    case Data_IND: // Indicationtyp pruefen
                        // Daten setzen
                        putValue(P_ASG_10_1_0_34, gBAP_Indication_data, gBAP_Indication_header[4]);
                        setControlBackColor(panel_name, "errfield_P_ASG_10_1_0_34", MakeRGB(255,255,255));  
                        setControlBackColor(panel_name, "panel_P_ASG_10_1_0_34", MakeRGB(255,255,255));  
                        break;
                    default:
                        PrintIndicationError("Illegal IndType");
                        break;
                }
                break;
            case Bap_error:
                gP_ASG_10_1_0_34_ErrCode = 0;
                putValue(P_ASG_10_1_0_34_ErrCode,  gBAP_Indication_header[5]);
                setControlBackColor(panel_name, "errfield_P_ASG_10_1_0_34", MakeRGB(255,79,79));  
                setControlBackColor(panel_name, "panel_P_ASG_10_1_0_34", MakeRGB(220,220,220));  
                break;
            case Bap_acknowledge:
                break;
            default:
                PrintIndicationError("Illegal DataType");
                break;
        }
    break;
    case P_ASG_10_1_0_35_ID: 
        switch(gBAP_Indication_header[3]) // Datentyp 
        {
            case Bap_byteSequence:
                switch (gBAP_Indication_header[2]) // IndType
                {
                    case Data_IND: // Indicationtyp pruefen
                        // Daten setzen
                        putValue(P_ASG_10_1_0_35, gBAP_Indication_data, gBAP_Indication_header[4]);
                        setControlBackColor(panel_name, "errfield_P_ASG_10_1_0_35", MakeRGB(255,255,255));  
                        setControlBackColor(panel_name, "panel_P_ASG_10_1_0_35", MakeRGB(255,255,255));  
                        break;
                    default:
                        PrintIndicationError("Illegal IndType");
                        break;
                }
                break;
            case Bap_error:
                gP_ASG_10_1_0_35_ErrCode = 0;
                putValue(P_ASG_10_1_0_35_ErrCode,  gBAP_Indication_header[5]);
                setControlBackColor(panel_name, "errfield_P_ASG_10_1_0_35", MakeRGB(255,79,79));  
                setControlBackColor(panel_name, "panel_P_ASG_10_1_0_35", MakeRGB(220,220,220));  
                break;
            case Bap_acknowledge:
                break;
            default:
                PrintIndicationError("Illegal DataType");
                break;
        }
    break;
    case P_ASG_10_1_0_36_ID: 
        switch(gBAP_Indication_header[3]) // Datentyp 
        {
            case Bap_byteSequence:
                switch (gBAP_Indication_header[2]) // IndType
                {
                    case Data_IND: // Indicationtyp pruefen
                        // Daten setzen
                        putValue(P_ASG_10_1_0_36, gBAP_Indication_data, gBAP_Indication_header[4]);
                        setControlBackColor(panel_name, "errfield_P_ASG_10_1_0_36", MakeRGB(255,255,255));  
                        setControlBackColor(panel_name, "panel_P_ASG_10_1_0_36", MakeRGB(255,255,255));  
                        break;
                    default:
                        PrintIndicationError("Illegal IndType");
                        break;
                }
                break;
            case Bap_error:
                gP_ASG_10_1_0_36_ErrCode = 0;
                putValue(P_ASG_10_1_0_36_ErrCode,  gBAP_Indication_header[5]);
                setControlBackColor(panel_name, "errfield_P_ASG_10_1_0_36", MakeRGB(255,79,79));  
                setControlBackColor(panel_name, "panel_P_ASG_10_1_0_36", MakeRGB(220,220,220));  
                break;
            case Bap_acknowledge:
                break;
            default:
                PrintIndicationError("Illegal DataType");
                break;
        }
    break;
    case P_ASG_10_1_0_37_ID: 
        switch(gBAP_Indication_header[3]) // Datentyp 
        {
            case Bap_byteSequence:
                switch (gBAP_Indication_header[2]) // IndType
                {
                    case Data_IND: // Indicationtyp pruefen
                        // Daten setzen
                        putValue(P_ASG_10_1_0_37, gBAP_Indication_data, gBAP_Indication_header[4]);
                        setControlBackColor(panel_name, "errfield_P_ASG_10_1_0_37", MakeRGB(255,255,255));  
                        setControlBackColor(panel_name, "panel_P_ASG_10_1_0_37", MakeRGB(255,255,255));  
                        break;
                    default:
                        PrintIndicationError("Illegal IndType");
                        break;
                }
                break;
            case Bap_error:
                gP_ASG_10_1_0_37_ErrCode = 0;
                putValue(P_ASG_10_1_0_37_ErrCode,  gBAP_Indication_header[5]);
                setControlBackColor(panel_name, "errfield_P_ASG_10_1_0_37", MakeRGB(255,79,79));  
                setControlBackColor(panel_name, "panel_P_ASG_10_1_0_37", MakeRGB(220,220,220));  
                break;
            case Bap_acknowledge:
                break;
            default:
                PrintIndicationError("Illegal DataType");
                break;
        }
    break;
    case P_ASG_10_1_0_38_ID: 
        switch(gBAP_Indication_header[3]) // Datentyp 
        {
            case Bap_byteSequence:
                switch (gBAP_Indication_header[2]) // IndType
                {
                    case Data_IND: // Indicationtyp pruefen
                        // Daten setzen
                        putValue(P_ASG_10_1_0_38, gBAP_Indication_data, gBAP_Indication_header[4]);
                        setControlBackColor(panel_name, "errfield_P_ASG_10_1_0_38", MakeRGB(255,255,255));  
                        setControlBackColor(panel_name, "panel_P_ASG_10_1_0_38", MakeRGB(255,255,255));  
                        break;
                    default:
                        PrintIndicationError("Illegal IndType");
                        break;
                }
                break;
            case Bap_error:
                gP_ASG_10_1_0_38_ErrCode = 0;
                putValue(P_ASG_10_1_0_38_ErrCode,  gBAP_Indication_header[5]);
                setControlBackColor(panel_name, "errfield_P_ASG_10_1_0_38", MakeRGB(255,79,79));  
                setControlBackColor(panel_name, "panel_P_ASG_10_1_0_38", MakeRGB(220,220,220));  
                break;
            case Bap_acknowledge:
                break;
            default:
                PrintIndicationError("Illegal DataType");
                break;
        }
    break;
    case P_ASG_10_1_0_39_ID: 
        switch(gBAP_Indication_header[3]) // Datentyp 
        {
            case Bap_uint8:
                    switch(gBAP_Indication_header[2]) // IndType
                    {
                        case Data_IND: // Indicationtyp pruefen
                            // Daten setzen
                            putValue(P_ASG_10_1_0_39, gBAP_Indication_header[5]);
                            setControlBackColor(panel_name, "errfield_P_ASG_10_1_0_39", MakeRGB(255,255,255));  
                            setControlBackColor(panel_name, "panel_P_ASG_10_1_0_39", MakeRGB(255,255,255));  
                            break;                              
                        default:
                            PrintIndicationError("Illegal IndType");
                            break;
                    }
                    break;
            case Bap_error:
                gP_ASG_10_1_0_39_ErrCode = 0;
                putValue(P_ASG_10_1_0_39_ErrCode,  gBAP_Indication_header[5]);
                setControlBackColor(panel_name, "errfield_P_ASG_10_1_0_39", MakeRGB(255,79,79));  
                setControlBackColor(panel_name, "panel_P_ASG_10_1_0_39", MakeRGB(220,220,220));  
                break;
            case Bap_acknowledge:
                break;
            default:
                    PrintIndicationError("Illegal DataType");
                    break;
        }
    break;
    case P_ASG_10_1_0_40_ID: 
        switch(gBAP_Indication_header[3]) // Datentyp 
        {
            case Bap_byteSequence:
                switch (gBAP_Indication_header[2]) // IndType
                {
                    case Data_IND: // Indicationtyp pruefen
                        // Daten setzen
                        putValue(P_ASG_10_1_0_40, gBAP_Indication_data, gBAP_Indication_header[4]);
                        setControlBackColor(panel_name, "errfield_P_ASG_10_1_0_40", MakeRGB(255,255,255));  
                        setControlBackColor(panel_name, "panel_P_ASG_10_1_0_40", MakeRGB(255,255,255));  
                        break;
                    default:
                        PrintIndicationError("Illegal IndType");
                        break;
                }
                break;
            case Bap_error:
                gP_ASG_10_1_0_40_ErrCode = 0;
                putValue(P_ASG_10_1_0_40_ErrCode,  gBAP_Indication_header[5]);
                setControlBackColor(panel_name, "errfield_P_ASG_10_1_0_40", MakeRGB(255,79,79));  
                setControlBackColor(panel_name, "panel_P_ASG_10_1_0_40", MakeRGB(220,220,220));  
                break;
            case Bap_acknowledge:
                break;
            default:
                PrintIndicationError("Illegal DataType");
                break;
        }
    break;
    case P_ASG_10_1_0_41_ID: 
        switch(gBAP_Indication_header[3]) // Datentyp 
        {
            case Bap_byteSequence:
                switch (gBAP_Indication_header[2]) // IndType
                {
                    case Data_IND: // Indicationtyp pruefen
                        // Daten setzen
                        putValue(P_ASG_10_1_0_41, gBAP_Indication_data, gBAP_Indication_header[4]);
                        setControlBackColor(panel_name, "errfield_P_ASG_10_1_0_41", MakeRGB(255,255,255));  
                        setControlBackColor(panel_name, "panel_P_ASG_10_1_0_41", MakeRGB(255,255,255));  
                        break;
                    default:
                        PrintIndicationError("Illegal IndType");
                        break;
                }
                break;
            case Bap_error:
                gP_ASG_10_1_0_41_ErrCode = 0;
                putValue(P_ASG_10_1_0_41_ErrCode,  gBAP_Indication_header[5]);
                setControlBackColor(panel_name, "errfield_P_ASG_10_1_0_41", MakeRGB(255,79,79));  
                setControlBackColor(panel_name, "panel_P_ASG_10_1_0_41", MakeRGB(220,220,220));  
                break;
            case Bap_acknowledge:
                break;
            default:
                PrintIndicationError("Illegal DataType");
                break;
        }
    break;
    case P_ASG_10_1_0_42_ID: 
        switch(gBAP_Indication_header[3]) // Datentyp 
        {
            case Bap_byteSequence:
                switch (gBAP_Indication_header[2]) // IndType
                {
                    case Data_IND: // Indicationtyp pruefen
                        // Daten setzen
                        putValue(P_ASG_10_1_0_42, gBAP_Indication_data, gBAP_Indication_header[4]);
                        setControlBackColor(panel_name, "errfield_P_ASG_10_1_0_42", MakeRGB(255,255,255));  
                        setControlBackColor(panel_name, "panel_P_ASG_10_1_0_42", MakeRGB(255,255,255));  
                        break;
                    default:
                        PrintIndicationError("Illegal IndType");
                        break;
                }
                break;
            case Bap_error:
                gP_ASG_10_1_0_42_ErrCode = 0;
                putValue(P_ASG_10_1_0_42_ErrCode,  gBAP_Indication_header[5]);
                setControlBackColor(panel_name, "errfield_P_ASG_10_1_0_42", MakeRGB(255,79,79));  
                setControlBackColor(panel_name, "panel_P_ASG_10_1_0_42", MakeRGB(220,220,220));  
                break;
            case Bap_acknowledge:
                break;
            default:
                PrintIndicationError("Illegal DataType");
                break;
        }
    break;
    case P_ASG_10_1_0_43_ID: 
        switch(gBAP_Indication_header[3]) // Datentyp 
        {
            case Bap_byteSequence:
                switch (gBAP_Indication_header[2]) // IndType
                {
                    case Data_IND: // Indicationtyp pruefen
                        // Daten setzen
                        putValue(P_ASG_10_1_0_43, gBAP_Indication_data, gBAP_Indication_header[4]);
                        setControlBackColor(panel_name, "errfield_P_ASG_10_1_0_43", MakeRGB(255,255,255));  
                        setControlBackColor(panel_name, "panel_P_ASG_10_1_0_43", MakeRGB(255,255,255));  
                        break;
                    default:
                        PrintIndicationError("Illegal IndType");
                        break;
                }
                break;
            case Bap_error:
                gP_ASG_10_1_0_43_ErrCode = 0;
                putValue(P_ASG_10_1_0_43_ErrCode,  gBAP_Indication_header[5]);
                setControlBackColor(panel_name, "errfield_P_ASG_10_1_0_43", MakeRGB(255,79,79));  
                setControlBackColor(panel_name, "panel_P_ASG_10_1_0_43", MakeRGB(220,220,220));  
                break;
            case Bap_acknowledge:
                break;
            default:
                PrintIndicationError("Illegal DataType");
                break;
        }
    break;
    case P_ASG_10_1_0_44_ID: 
        switch(gBAP_Indication_header[3]) // Datentyp 
        {
            case Bap_byteSequence:
                switch (gBAP_Indication_header[2]) // IndType
                {
                    case Data_IND: // Indicationtyp pruefen
                        // Daten setzen
                        putValue(P_ASG_10_1_0_44, gBAP_Indication_data, gBAP_Indication_header[4]);
                        setControlBackColor(panel_name, "errfield_P_ASG_10_1_0_44", MakeRGB(255,255,255));  
                        setControlBackColor(panel_name, "panel_P_ASG_10_1_0_44", MakeRGB(255,255,255));  
                        break;
                    default:
                        PrintIndicationError("Illegal IndType");
                        break;
                }
                break;
            case Bap_error:
                gP_ASG_10_1_0_44_ErrCode = 0;
                putValue(P_ASG_10_1_0_44_ErrCode,  gBAP_Indication_header[5]);
                setControlBackColor(panel_name, "errfield_P_ASG_10_1_0_44", MakeRGB(255,79,79));  
                setControlBackColor(panel_name, "panel_P_ASG_10_1_0_44", MakeRGB(220,220,220));  
                break;
            case Bap_acknowledge:
                break;
            default:
                PrintIndicationError("Illegal DataType");
                break;
        }
    break;
    case P_ASG_10_1_0_45_ID: 
        switch(gBAP_Indication_header[3]) // Datentyp 
        {
            case Bap_byteSequence:
                switch (gBAP_Indication_header[2]) // IndType
                {
                    case Data_IND: // Indicationtyp pruefen
                        // Daten setzen
                        putValue(P_ASG_10_1_0_45, gBAP_Indication_data, gBAP_Indication_header[4]);
                        setControlBackColor(panel_name, "errfield_P_ASG_10_1_0_45", MakeRGB(255,255,255));  
                        setControlBackColor(panel_name, "panel_P_ASG_10_1_0_45", MakeRGB(255,255,255));  
                        break;
                    default:
                        PrintIndicationError("Illegal IndType");
                        break;
                }
                break;
            case Bap_error:
                gP_ASG_10_1_0_45_ErrCode = 0;
                putValue(P_ASG_10_1_0_45_ErrCode,  gBAP_Indication_header[5]);
                setControlBackColor(panel_name, "errfield_P_ASG_10_1_0_45", MakeRGB(255,79,79));  
                setControlBackColor(panel_name, "panel_P_ASG_10_1_0_45", MakeRGB(220,220,220));  
                break;
            case Bap_acknowledge:
                break;
            default:
                PrintIndicationError("Illegal DataType");
                break;
        }
    break;
    case P_ASG_10_1_0_46_ID: 
        switch(gBAP_Indication_header[3]) // Datentyp 
        {
            case Bap_byteSequence:
                switch (gBAP_Indication_header[2]) // IndType
                {
                    case Data_IND: // Indicationtyp pruefen
                        // Daten setzen
                        putValue(P_ASG_10_1_0_46, gBAP_Indication_data, gBAP_Indication_header[4]);
                        setControlBackColor(panel_name, "errfield_P_ASG_10_1_0_46", MakeRGB(255,255,255));  
                        setControlBackColor(panel_name, "panel_P_ASG_10_1_0_46", MakeRGB(255,255,255));  
                        break;
                    default:
                        PrintIndicationError("Illegal IndType");
                        break;
                }
                break;
            case Bap_error:
                gP_ASG_10_1_0_46_ErrCode = 0;
                putValue(P_ASG_10_1_0_46_ErrCode,  gBAP_Indication_header[5]);
                setControlBackColor(panel_name, "errfield_P_ASG_10_1_0_46", MakeRGB(255,79,79));  
                setControlBackColor(panel_name, "panel_P_ASG_10_1_0_46", MakeRGB(220,220,220));  
                break;
            case Bap_acknowledge:
                break;
            default:
                PrintIndicationError("Illegal DataType");
                break;
        }
    break;
    case P_ASG_10_1_0_47_ID: 
        switch(gBAP_Indication_header[3]) // Datentyp 
        {
            case Bap_byteSequence:
                switch (gBAP_Indication_header[2]) // IndType
                {
                    case Data_IND: // Indicationtyp pruefen
                        // Daten setzen
                        putValue(P_ASG_10_1_0_47, gBAP_Indication_data, gBAP_Indication_header[4]);
                        setControlBackColor(panel_name, "errfield_P_ASG_10_1_0_47", MakeRGB(255,255,255));  
                        setControlBackColor(panel_name, "panel_P_ASG_10_1_0_47", MakeRGB(255,255,255));  
                        break;
                    default:
                        PrintIndicationError("Illegal IndType");
                        break;
                }
                break;
            case Bap_error:
                gP_ASG_10_1_0_47_ErrCode = 0;
                putValue(P_ASG_10_1_0_47_ErrCode,  gBAP_Indication_header[5]);
                setControlBackColor(panel_name, "errfield_P_ASG_10_1_0_47", MakeRGB(255,79,79));  
                setControlBackColor(panel_name, "panel_P_ASG_10_1_0_47", MakeRGB(220,220,220));  
                break;
            case Bap_acknowledge:
                break;
            default:
                PrintIndicationError("Illegal DataType");
                break;
        }
    break;
    case P_ASG_10_1_0_48_ID: 
        switch(gBAP_Indication_header[3]) // Datentyp 
        {
            case Bap_byteSequence:
                switch (gBAP_Indication_header[2]) // IndType
                {
                    case Data_IND: // Indicationtyp pruefen
                        // Daten setzen
                        putValue(P_ASG_10_1_0_48, gBAP_Indication_data, gBAP_Indication_header[4]);
                        setControlBackColor(panel_name, "errfield_P_ASG_10_1_0_48", MakeRGB(255,255,255));  
                        setControlBackColor(panel_name, "panel_P_ASG_10_1_0_48", MakeRGB(255,255,255));  
                        break;
                    default:
                        PrintIndicationError("Illegal IndType");
                        break;
                }
                break;
            case Bap_error:
                gP_ASG_10_1_0_48_ErrCode = 0;
                putValue(P_ASG_10_1_0_48_ErrCode,  gBAP_Indication_header[5]);
                setControlBackColor(panel_name, "errfield_P_ASG_10_1_0_48", MakeRGB(255,79,79));  
                setControlBackColor(panel_name, "panel_P_ASG_10_1_0_48", MakeRGB(220,220,220));  
                break;
            case Bap_acknowledge:
                break;
            default:
                PrintIndicationError("Illegal DataType");
                break;
        }
    break;
    case P_ASG_10_1_0_49_ID: 
        switch(gBAP_Indication_header[3]) // Datentyp 
        {
            case Bap_byteSequence:
                switch (gBAP_Indication_header[2]) // IndType
                {
                    case Data_IND: // Indicationtyp pruefen
                        // Daten setzen
                        putValue(P_ASG_10_1_0_49, gBAP_Indication_data, gBAP_Indication_header[4]);
                        setControlBackColor(panel_name, "errfield_P_ASG_10_1_0_49", MakeRGB(255,255,255));  
                        setControlBackColor(panel_name, "panel_P_ASG_10_1_0_49", MakeRGB(255,255,255));  
                        break;
                    default:
                        PrintIndicationError("Illegal IndType");
                        break;
                }
                break;
            case Bap_error:
                gP_ASG_10_1_0_49_ErrCode = 0;
                putValue(P_ASG_10_1_0_49_ErrCode,  gBAP_Indication_header[5]);
                setControlBackColor(panel_name, "errfield_P_ASG_10_1_0_49", MakeRGB(255,79,79));  
                setControlBackColor(panel_name, "panel_P_ASG_10_1_0_49", MakeRGB(220,220,220));  
                break;
            case Bap_acknowledge:
                break;
            default:
                PrintIndicationError("Illegal DataType");
                break;
        }
    break;
    case P_ASG_10_1_0_50_ID: 
        switch(gBAP_Indication_header[3]) // Datentyp 
        {
            case Bap_byteSequence:
                switch (gBAP_Indication_header[2]) // IndType
                {
                    case Data_IND: // Indicationtyp pruefen
                        // Daten setzen
                        putValue(P_ASG_10_1_0_50, gBAP_Indication_data, gBAP_Indication_header[4]);
                        setControlBackColor(panel_name, "errfield_P_ASG_10_1_0_50", MakeRGB(255,255,255));  
                        setControlBackColor(panel_name, "panel_P_ASG_10_1_0_50", MakeRGB(255,255,255));  
                        break;
                    default:
                        PrintIndicationError("Illegal IndType");
                        break;
                }
                break;
            case Bap_error:
                gP_ASG_10_1_0_50_ErrCode = 0;
                putValue(P_ASG_10_1_0_50_ErrCode,  gBAP_Indication_header[5]);
                setControlBackColor(panel_name, "errfield_P_ASG_10_1_0_50", MakeRGB(255,79,79));  
                setControlBackColor(panel_name, "panel_P_ASG_10_1_0_50", MakeRGB(220,220,220));  
                break;
            case Bap_acknowledge:
                break;
            default:
                PrintIndicationError("Illegal DataType");
                break;
        }
    break;
    case P_ASG_10_1_0_51_ID: 
        switch(gBAP_Indication_header[3]) // Datentyp 
        {
            case Bap_byteSequence:
                switch (gBAP_Indication_header[2]) // IndType
                {
                    case Data_IND: // Indicationtyp pruefen
                        // Daten setzen
                        putValue(P_ASG_10_1_0_51, gBAP_Indication_data, gBAP_Indication_header[4]);
                        setControlBackColor(panel_name, "errfield_P_ASG_10_1_0_51", MakeRGB(255,255,255));  
                        setControlBackColor(panel_name, "panel_P_ASG_10_1_0_51", MakeRGB(255,255,255));  
                        break;
                    default:
                        PrintIndicationError("Illegal IndType");
                        break;
                }
                break;
            case Bap_error:
                gP_ASG_10_1_0_51_ErrCode = 0;
                putValue(P_ASG_10_1_0_51_ErrCode,  gBAP_Indication_header[5]);
                setControlBackColor(panel_name, "errfield_P_ASG_10_1_0_51", MakeRGB(255,79,79));  
                setControlBackColor(panel_name, "panel_P_ASG_10_1_0_51", MakeRGB(220,220,220));  
                break;
            case Bap_acknowledge:
                break;
            default:
                PrintIndicationError("Illegal DataType");
                break;
        }
    break;
    case P_ASG_10_1_0_52_ID: 
        switch(gBAP_Indication_header[3]) // Datentyp 
        {
            case Bap_byteSequence:
                switch (gBAP_Indication_header[2]) // IndType
                {
                    case Data_IND: // Indicationtyp pruefen
                        // Daten setzen
                        putValue(P_ASG_10_1_0_52, gBAP_Indication_data, gBAP_Indication_header[4]);
                        setControlBackColor(panel_name, "errfield_P_ASG_10_1_0_52", MakeRGB(255,255,255));  
                        setControlBackColor(panel_name, "panel_P_ASG_10_1_0_52", MakeRGB(255,255,255));  
                        break;
                    default:
                        PrintIndicationError("Illegal IndType");
                        break;
                }
                break;
            case Bap_error:
                gP_ASG_10_1_0_52_ErrCode = 0;
                putValue(P_ASG_10_1_0_52_ErrCode,  gBAP_Indication_header[5]);
                setControlBackColor(panel_name, "errfield_P_ASG_10_1_0_52", MakeRGB(255,79,79));  
                setControlBackColor(panel_name, "panel_P_ASG_10_1_0_52", MakeRGB(220,220,220));  
                break;
            case Bap_acknowledge:
                break;
            default:
                PrintIndicationError("Illegal DataType");
                break;
        }
    break;
    case P_ASG_10_1_0_53_ID: 
        switch(gBAP_Indication_header[3]) // Datentyp 
        {
            case Bap_byteSequence:
                switch (gBAP_Indication_header[2]) // IndType
                {
                    case Data_IND: // Indicationtyp pruefen
                        // Daten setzen
                        putValue(P_ASG_10_1_0_53, gBAP_Indication_data, gBAP_Indication_header[4]);
                        setControlBackColor(panel_name, "errfield_P_ASG_10_1_0_53", MakeRGB(255,255,255));  
                        setControlBackColor(panel_name, "panel_P_ASG_10_1_0_53", MakeRGB(255,255,255));  
                        break;
                    default:
                        PrintIndicationError("Illegal IndType");
                        break;
                }
                break;
            case Bap_error:
                gP_ASG_10_1_0_53_ErrCode = 0;
                putValue(P_ASG_10_1_0_53_ErrCode,  gBAP_Indication_header[5]);
                setControlBackColor(panel_name, "errfield_P_ASG_10_1_0_53", MakeRGB(255,79,79));  
                setControlBackColor(panel_name, "panel_P_ASG_10_1_0_53", MakeRGB(220,220,220));  
                break;
            case Bap_acknowledge:
                break;
            default:
                PrintIndicationError("Illegal DataType");
                break;
        }
    break;
       default:
           writelineEx(gError_Trace, 0, "NodeIndex: %d: Illegal Fct: lsgid:%d fctid:%d indType:%d",
           NODE_INDEX, gBAP_Indication_header[0], gBAP_Indication_header[1], gBAP_Indication_header[2]);
           break;
       }
       break;
   default:
       writelineEx(gError_Trace, 0, "NodeIndex: %d: Illegal LSGID: lsgid:%d fctid:%d indType:%s", NODE_INDEX, gBAP_Indication_header[0], gBAP_Indication_header[1], Indicationtype_Text[gBAP_Indication_header[2]]);
       break;
   }
}
/*@@end*/

/*@@end*/

/*@@caplFunc:Name:*/
/*@@msg:Bap_11::BAP_OPS_FSG_02:*/
on message BAP_OPS_FSG_02
{
   int i, temp;
   byte RX_Data[8];            // received CAN-DATA
   dword RX_Header[3];         // received CAN-Header
   if(gSG_PowerOnOff==Power_on){
       RX_Header[0]=this.CAN;
       RX_Header[1]=this.ID;
       RX_Header[2]=this.DLC; // received length
       for (i=0; i<this.DLC; i++) {
           RX_Data[i]=this.byte(i);
       }
       temp=BAP150_CAN_SetRxDat(NODE_INDEX, RX_Header, RX_Data);
   }
}
/*@@end*/

/*@@msg:Bap_11::BAP_OPS_FSG_01:*/
on message BAP_OPS_FSG_01
{
   int i, temp;
   byte RX_Data[8];            // received CAN-DATA
   dword RX_Header[3];         // received CAN-Header
   if(gSG_PowerOnOff==Power_on){
       RX_Header[0]=this.CAN;
       RX_Header[1]=this.ID;
       RX_Header[2]=this.DLC; // received length
       for (i=0; i<this.DLC; i++) {
           RX_Data[i]=this.byte(i);
       }
       temp=BAP150_CAN_SetRxDat(NODE_INDEX, RX_Header, RX_Data);
   }
}
/*@@end*/


/*@@end*/

/*@@caplFunc:Name:*/
intertelegram_err(long fctId)
{
    long data[4];
    data[0]=LSGID;
    data[1]=fctId;
    data[2]=1;
    data[3]=940;
    ChangeConfig(0x0020,data);
}
/*@@end*/

/*@@caplFunc:Name:*/
sequence_err(long fctId, long size)
{
    long data[5];
    long lastSeg;

    lastSeg = size-5;

    data[0]=LSGID;
    data[1]=fctId;
    data[2]=lastSeg/7+1;
    data[3]=1;
    data[4]=(lastSeg/7+4) & 15;
    ChangeConfig(0x0021,data);
}
/*@@end*/

/*@@caplFunc:Name:*/
intertelegram_err_off(long fctId)
{
    long data[4];
    data[0]=LSGID;
    data[1]=fctId;
    data[2]=5000;
    data[3]=0;
    ChangeConfig(0x0020,data);
}
/*@@end*/

/*@@caplFunc:Name:*/
sequence_err_off(long fctId)
{
    long data[5];

    data[0]=LSGID;
    data[1]=fctId;
    data[2]=5000;
    data[3]=0;
    data[4]=0;
    ChangeConfig(0x0021,data);
}
/*@@end*/

// START OF BUS CONFIG PANEL CAPL

// ETHERNET AND FLEXRAY NOT ENABLED! (ENABLE_BUS_SELECTOR_PANEL_TOKEN)

// ETHERNET AND FLEXRAY NOT ENABLED! (ENABLE_CAN_FRAME_TOKEN)

// ETHERNET AND FLEXRAY NOT ENABLED! (ENABLE_FR_FRAME_TOKEN)

// ETHERNET AND FLEXRAY NOT ENABLED! (ENABLE_ETHERNET_FRAME_TOKEN)

// ETHERNET AND FLEXRAY NOT ENABLED! (ENABLE_IP_FORMAT_TOKEN)

// ETHERNET AND FLEXRAY NOT ENABLED! (ON_ENVVAR_BUSTYPE_TOKEN)

// ETHERNET NOT ENABLED! (ON_ENVVAR_ETHERNET_APPLY_BTN_TOKEN)

// ETHERNET NOT ENABLED! (ON_ENVVAR_ETHERNET_RESET_BTN_TOKEN)

// ETHERNET NOT ENABLED! (ON_ENVVAR_IP_INTERFACE_LIST_TOKEN)

// ETHERNET NOT ENABLED! (ON_ENVVAR_IP_FORMAT_TOKEN)

// ETHERNET NOT ENABLED! (ON_UDP_RECEIVE_FROM_TOKEN)

// ETHERNET NOT ENABLED!

/*@@caplFunc:Name:*/
on envVar ON_OFF_ASG10_1
{
   BapOnOff(getvalue(this));
   gSG_PowerOnOff=getvalue(ON_OFF_ASG10_1);
}
on envVar C_ASG_10_1_0_1GetAll_BTN
{
 if (C_ASG_10_1_0_1GetAll_BTN_already_pressed == 0)
  {
     C_ASG_10_1_0_1GetAll_BTN_already_pressed = 1;
     Request_Void(LSGID, C_ASG_10_1_0_1_ID, DataGet_REQ); 
     putValue(C_ASG_10_1_0_1_State, "GetAll");
     setControlBackColor(panel_name, "errfield_C_ASG_10_1_0_1_State", MakeRGB(255,255,255));
 }
 else
 {
     C_ASG_10_1_0_1GetAll_BTN_already_pressed = 0;
 }
}
on envVar P_ASG_10_1_0_2Get_BTN
{
 if (P_ASG_10_1_0_2Get_BTN_already_pressed == 0)
  {
       putValue(P_ASG_10_1_0_2_ErrCode,0);
       SetControlBackColor(panel_name,"errField_P_ASG_10_1_0_2",MakeRGB(255,255,255));
       P_ASG_10_1_0_2Get_BTN_already_pressed = 1;
 }
 else
 {
       Request_Void(LSGID, P_ASG_10_1_0_2_ID, DataGet_REQ); 
       P_ASG_10_1_0_2Get_BTN_already_pressed = 0;
 }
}
on envVar P_ASG_10_1_0_3Get_BTN
{
 if (P_ASG_10_1_0_3Get_BTN_already_pressed == 0)
  {
       putValue(P_ASG_10_1_0_3_ErrCode,0);
       SetControlBackColor(panel_name,"errField_P_ASG_10_1_0_3",MakeRGB(255,255,255));
       P_ASG_10_1_0_3Get_BTN_already_pressed = 1;
 }
 else
 {
       Request_Void(LSGID, P_ASG_10_1_0_3_ID, DataGet_REQ); 
       P_ASG_10_1_0_3Get_BTN_already_pressed = 0;
 }
}
on envVar P_ASG_10_1_0_4Get_BTN
{
 if (P_ASG_10_1_0_4Get_BTN_already_pressed == 0)
  {
       putValue(P_ASG_10_1_0_4_ErrCode,0);
       SetControlBackColor(panel_name,"errField_P_ASG_10_1_0_4",MakeRGB(255,255,255));
       P_ASG_10_1_0_4Get_BTN_already_pressed = 1;
 }
 else
 {
       Request_Void(LSGID, P_ASG_10_1_0_4_ID, DataGet_REQ); 
       P_ASG_10_1_0_4Get_BTN_already_pressed = 0;
 }
}
on envVar P_ASG_10_1_0_13Get_BTN
{
 if (P_ASG_10_1_0_13Get_BTN_already_pressed == 0)
  {
       putValue(P_ASG_10_1_0_13_ErrCode,0);
       SetControlBackColor(panel_name,"errField_P_ASG_10_1_0_13",MakeRGB(255,255,255));
       P_ASG_10_1_0_13Get_BTN_already_pressed = 1;
 }
 else
 {
       Request_Void(LSGID, P_ASG_10_1_0_13_ID, DataGet_REQ); 
       P_ASG_10_1_0_13Get_BTN_already_pressed = 0;
 }
}
on envVar P_ASG_10_1_0_13SetGet_BTN
{
    if (P_ASG_10_1_0_13SetGet_BTN_already_pressed == 0)
    {
       putValue(P_ASG_10_1_0_13_ErrCode,0);
       SetControlBackColor(panel_name,"errField_P_ASG_10_1_0_13",MakeRGB(255,255,255));
       P_ASG_10_1_0_13SetGet_BTN_already_pressed = 1;
    }
    else
    {
       Request_Int8(LSGID, P_ASG_10_1_0_13_ID, DataSetGet_REQ, getValue(P_ASG_10_1_0_13));
       P_ASG_10_1_0_13SetGet_BTN_already_pressed = 0;
    }
}
on envVar P_ASG_10_1_0_13 // bus value of FSG_Control (13).
{
	// opcodes: Error-Status
	byte param1; // Controlcode
	// DATATYPE_UINTXX
	param1 = getValue(P_ASG_10_1_0_13);
	putValue(P_ASG_10_1_0_13_1, param1);
}

on envVar P_ASG_10_1_0_13_1_0
{
	byte bitval;
	//thisval steht hier fuer den bitfield-wert, 
	//aus Generierungsgruenden hier keine einheitliche Bezeichnung moeglich.
	byte thisval; // Controlcode
	bitval= getValue(this);
	thisval = getValue(P_ASG_10_1_0_13_1);
	thisval = thisval&~(1<<0)|(bitval<<0);
	putValue(P_ASG_10_1_0_13_1,thisval);
}

on envVar P_ASG_10_1_0_13_1_4
{
	byte bitval;
	//thisval steht hier fuer den bitfield-wert, 
	//aus Generierungsgruenden hier keine einheitliche Bezeichnung moeglich.
	byte thisval; // Controlcode
	bitval= getValue(this);
	thisval = getValue(P_ASG_10_1_0_13_1);
	thisval = thisval&~(1<<4)|(bitval<<4);
	putValue(P_ASG_10_1_0_13_1,thisval);
}

on envVar P_ASG_10_1_0_13_1 // FSG_Control.Controlcode
{
	byte superval;

	//Update Childvalue (BitField)
	byte mask=0x01;
	int i = 0;
	byte thisval; // Controlcode
	thisval = getValue(this);
	if(thisval&(mask<<0))
		putValue(P_ASG_10_1_0_13_1_0, 1);
	else
		putValue(P_ASG_10_1_0_13_1_0, 0);
	if(thisval&(mask<<4))
		putValue(P_ASG_10_1_0_13_1_4, 1);
	else
		putValue(P_ASG_10_1_0_13_1_4, 0);

    // Update superval
	superval = getValue(P_ASG_10_1_0_13);
	superval = thisval;
	putValue(P_ASG_10_1_0_13,superval);
}

on envVar P_ASG_10_1_0_14Get_BTN
{
 if (P_ASG_10_1_0_14Get_BTN_already_pressed == 0)
  {
       putValue(P_ASG_10_1_0_14_ErrCode,0);
       SetControlBackColor(panel_name,"errField_P_ASG_10_1_0_14",MakeRGB(255,255,255));
       P_ASG_10_1_0_14Get_BTN_already_pressed = 1;
 }
 else
 {
       Request_Void(LSGID, P_ASG_10_1_0_14_ID, DataGet_REQ); 
       P_ASG_10_1_0_14Get_BTN_already_pressed = 0;
 }
}
on envVar P_ASG_10_1_0_14 // bus value of FSG_Setup (14).
{
	// opcodes: Error-Status
	byte param1; // NumberFrontSectors
	byte param2; // NumberRearSectors
	byte param3; // NumberRightSectors
	byte param4; // NumberLeftSectors
	word param5; // Wheelbase
	// DATATYPE_BYTESEQUENCE / DATATYPE_FIXEDBYTESEQUENCE
	int i;
	byte superval[6];
	int currentPos;
	currentPos = 0;
	for( i = 0; i < 6; i++ ) {
		superval[i] = 0;
	}
	getValue(P_ASG_10_1_0_14, superval);
	///////// Start param1 - UINT8 /////////
	param1 = superval[currentPos++];
	putValue(P_ASG_10_1_0_14_1, param1);
	///////// Start param2 - UINT8 /////////
	param2 = superval[currentPos++];
	putValue(P_ASG_10_1_0_14_2, param2);
	///////// Start param3 - UINT8 /////////
	param3 = superval[currentPos++];
	putValue(P_ASG_10_1_0_14_3, param3);
	///////// Start param4 - UINT8 /////////
	param4 = superval[currentPos++];
	putValue(P_ASG_10_1_0_14_4, param4);
	///////// Start param5 - UINT16 /////////
	param5 = superval[currentPos++]|(superval[currentPos++]<<8);
	putValue(P_ASG_10_1_0_14_5, round((param5 * 1.0) - (0) + (0), 1.0));
}

on envVar P_ASG_10_1_0_14_1 // FSG_Setup.NumberFrontSectors
{
	byte superval[6];

	//Update Childvalue (Enum)
	byte thisval; // NumberFrontSectors
	thisval = getValue(this);

    // Update superval
	getValue(P_ASG_10_1_0_14, superval);
	superval[0]=thisval;
	putValue(P_ASG_10_1_0_14,superval);
}

on envVar P_ASG_10_1_0_14_2 // FSG_Setup.NumberRearSectors
{
	byte superval[6];

	//Update Childvalue (Enum)
	byte thisval; // NumberRearSectors
	thisval = getValue(this);

    // Update superval
	getValue(P_ASG_10_1_0_14, superval);
	superval[1]=thisval;
	putValue(P_ASG_10_1_0_14,superval);
}

on envVar P_ASG_10_1_0_14_3 // FSG_Setup.NumberRightSectors
{
	byte superval[6];

	//Update Childvalue (Enum)
	byte thisval; // NumberRightSectors
	thisval = getValue(this);

    // Update superval
	getValue(P_ASG_10_1_0_14, superval);
	superval[2]=thisval;
	putValue(P_ASG_10_1_0_14,superval);
}

on envVar P_ASG_10_1_0_14_4 // FSG_Setup.NumberLeftSectors
{
	byte superval[6];

	//Update Childvalue (Enum)
	byte thisval; // NumberLeftSectors
	thisval = getValue(this);

    // Update superval
	getValue(P_ASG_10_1_0_14, superval);
	superval[3]=thisval;
	putValue(P_ASG_10_1_0_14,superval);
}

// Ueberwachung der Darstellungsvariable der Range.
on envVar P_ASG_10_1_0_14_5_range // FSG_Setup.Wheelbase 
{
	@P_ASG_10_1_0_14_5 = @P_ASG_10_1_0_14_5_range - (0); // slider = range - min
}

on envVar P_ASG_10_1_0_14_5 // FSG_Setup.Wheelbase
{
	byte superval[6];

	//Update Childvalue (Number)
	word thisval; // Wheelbase
	float slider_value;

	slider_value = round(@P_ASG_10_1_0_14_5, 1.0);
	@P_ASG_10_1_0_14_5_range = slider_value + (0); // real value := slider value + range min.
	thisval = (word)round((slider_value + (0) - (0)) / (1.0), 1); // bus value := (slider value + min - offset) / step.

    // Update superval
	getValue(P_ASG_10_1_0_14, superval);
	superval[4]=thisval&0x00ff;
	superval[5]=(thisval&0xff00)>>8;
	putValue(P_ASG_10_1_0_14,superval);
}

on envVar P_ASG_10_1_0_15Get_BTN
{
 if (P_ASG_10_1_0_15Get_BTN_already_pressed == 0)
  {
       putValue(P_ASG_10_1_0_15_ErrCode,0);
       SetControlBackColor(panel_name,"errField_P_ASG_10_1_0_15",MakeRGB(255,255,255));
       P_ASG_10_1_0_15Get_BTN_already_pressed = 1;
 }
 else
 {
       Request_Void(LSGID, P_ASG_10_1_0_15_ID, DataGet_REQ); 
       P_ASG_10_1_0_15Get_BTN_already_pressed = 0;
 }
}
on envVar P_ASG_10_1_0_15 // bus value of FSG_OperationState (15).
{
	// opcodes: Error-Status
	byte param1; // OP_State
	// DATATYPE_UINTXX
	param1 = getValue(P_ASG_10_1_0_15);
	putValue(P_ASG_10_1_0_15_1, param1);
}

on envVar P_ASG_10_1_0_15_1 // FSG_OperationState.OP_State
{
	byte superval;

	//Update Childvalue (Enum)
	byte thisval; // OP_State
	thisval = getValue(this);

    // Update superval
	superval = getValue(P_ASG_10_1_0_15);
	superval = thisval;
	putValue(P_ASG_10_1_0_15,superval);
}

on envVar P_ASG_10_1_0_16Get_BTN
{
 if (P_ASG_10_1_0_16Get_BTN_already_pressed == 0)
  {
       putValue(P_ASG_10_1_0_16_ErrCode,0);
       SetControlBackColor(panel_name,"errField_P_ASG_10_1_0_16",MakeRGB(255,255,255));
       P_ASG_10_1_0_16Get_BTN_already_pressed = 1;
 }
 else
 {
       Request_Void(LSGID, P_ASG_10_1_0_16_ID, DataGet_REQ); 
       P_ASG_10_1_0_16Get_BTN_already_pressed = 0;
 }
}
on envVar P_ASG_10_1_0_16SetGet_BTN
{
	byte BAPTemp[2];
    if (P_ASG_10_1_0_16SetGet_BTN_already_pressed == 0)
    {
       putValue(P_ASG_10_1_0_16_ErrCode,0);
       SetControlBackColor(panel_name,"errField_P_ASG_10_1_0_16",MakeRGB(255,255,255));
       P_ASG_10_1_0_16SetGet_BTN_already_pressed = 1;
    }
    else
    {
       getValue(P_ASG_10_1_0_16, BAPTemp);
       Request_ByteSequence(LSGID, P_ASG_10_1_0_16_ID, DataSetGet_REQ, BAPTemp, getValueSize(P_ASG_10_1_0_16));
       P_ASG_10_1_0_16SetGet_BTN_already_pressed = 0;
    }
}
on envVar P_ASG_10_1_0_16 // bus value of Sound_Front (16).
{
	// opcodes: Error-Status
	byte param1; // FrequencyFront
	byte param2; // VolumeFront
	// DATATYPE_BYTESEQUENCE / DATATYPE_FIXEDBYTESEQUENCE
	int i;
	byte superval[2];
	int currentPos;
	currentPos = 0;
	for( i = 0; i < 2; i++ ) {
		superval[i] = 0;
	}
	getValue(P_ASG_10_1_0_16, superval);
	///////// Start param1 - UINT8 /////////
	param1 = superval[currentPos++];
	putValue(P_ASG_10_1_0_16_1, round((param1 * 1.0) - (1) + (1), 1.0));
	///////// Start param2 - UINT8 /////////
	param2 = superval[currentPos++];
	putValue(P_ASG_10_1_0_16_2, round((param2 * 1.0) - (1) + (1), 1.0));
}

// Ueberwachung der Darstellungsvariable der Range.
on envVar P_ASG_10_1_0_16_1_range // Sound_Front.FrequencyFront 
{
	@P_ASG_10_1_0_16_1 = @P_ASG_10_1_0_16_1_range - (1); // slider = range - min
}

on envVar P_ASG_10_1_0_16_1 // Sound_Front.FrequencyFront
{
	byte superval[2];

	//Update Childvalue (Number)
	byte thisval; // FrequencyFront
	float slider_value;

	slider_value = round(@P_ASG_10_1_0_16_1, 1.0);
	@P_ASG_10_1_0_16_1_range = slider_value + (1); // real value := slider value + range min.
	thisval = (byte)round((slider_value + (1) - (1)) / (1.0), 1); // bus value := (slider value + min - offset) / step.

    // Update superval
	getValue(P_ASG_10_1_0_16, superval);
	superval[0]=thisval;
	putValue(P_ASG_10_1_0_16,superval);
}

// Ueberwachung der Darstellungsvariable der Range.
on envVar P_ASG_10_1_0_16_2_range // Sound_Front.VolumeFront 
{
	@P_ASG_10_1_0_16_2 = @P_ASG_10_1_0_16_2_range - (1); // slider = range - min
}

on envVar P_ASG_10_1_0_16_2 // Sound_Front.VolumeFront
{
	byte superval[2];

	//Update Childvalue (Number)
	byte thisval; // VolumeFront
	float slider_value;

	slider_value = round(@P_ASG_10_1_0_16_2, 1.0);
	@P_ASG_10_1_0_16_2_range = slider_value + (1); // real value := slider value + range min.
	thisval = (byte)round((slider_value + (1) - (1)) / (1.0), 1); // bus value := (slider value + min - offset) / step.

    // Update superval
	getValue(P_ASG_10_1_0_16, superval);
	superval[1]=thisval;
	putValue(P_ASG_10_1_0_16,superval);
}

on envVar P_ASG_10_1_0_17Get_BTN
{
 if (P_ASG_10_1_0_17Get_BTN_already_pressed == 0)
  {
       putValue(P_ASG_10_1_0_17_ErrCode,0);
       SetControlBackColor(panel_name,"errField_P_ASG_10_1_0_17",MakeRGB(255,255,255));
       P_ASG_10_1_0_17Get_BTN_already_pressed = 1;
 }
 else
 {
       Request_Void(LSGID, P_ASG_10_1_0_17_ID, DataGet_REQ); 
       P_ASG_10_1_0_17Get_BTN_already_pressed = 0;
 }
}
on envVar P_ASG_10_1_0_17SetGet_BTN
{
	byte BAPTemp[2];
    if (P_ASG_10_1_0_17SetGet_BTN_already_pressed == 0)
    {
       putValue(P_ASG_10_1_0_17_ErrCode,0);
       SetControlBackColor(panel_name,"errField_P_ASG_10_1_0_17",MakeRGB(255,255,255));
       P_ASG_10_1_0_17SetGet_BTN_already_pressed = 1;
    }
    else
    {
       getValue(P_ASG_10_1_0_17, BAPTemp);
       Request_ByteSequence(LSGID, P_ASG_10_1_0_17_ID, DataSetGet_REQ, BAPTemp, getValueSize(P_ASG_10_1_0_17));
       P_ASG_10_1_0_17SetGet_BTN_already_pressed = 0;
    }
}
on envVar P_ASG_10_1_0_17 // bus value of Sound_Rear (17).
{
	// opcodes: Error-Status
	byte param1; // FrequencyRear
	byte param2; // VolumeRear
	// DATATYPE_BYTESEQUENCE / DATATYPE_FIXEDBYTESEQUENCE
	int i;
	byte superval[2];
	int currentPos;
	currentPos = 0;
	for( i = 0; i < 2; i++ ) {
		superval[i] = 0;
	}
	getValue(P_ASG_10_1_0_17, superval);
	///////// Start param1 - UINT8 /////////
	param1 = superval[currentPos++];
	putValue(P_ASG_10_1_0_17_1, round((param1 * 1.0) - (1) + (1), 1.0));
	///////// Start param2 - UINT8 /////////
	param2 = superval[currentPos++];
	putValue(P_ASG_10_1_0_17_2, round((param2 * 1.0) - (1) + (1), 1.0));
}

// Ueberwachung der Darstellungsvariable der Range.
on envVar P_ASG_10_1_0_17_1_range // Sound_Rear.FrequencyRear 
{
	@P_ASG_10_1_0_17_1 = @P_ASG_10_1_0_17_1_range - (1); // slider = range - min
}

on envVar P_ASG_10_1_0_17_1 // Sound_Rear.FrequencyRear
{
	byte superval[2];

	//Update Childvalue (Number)
	byte thisval; // FrequencyRear
	float slider_value;

	slider_value = round(@P_ASG_10_1_0_17_1, 1.0);
	@P_ASG_10_1_0_17_1_range = slider_value + (1); // real value := slider value + range min.
	thisval = (byte)round((slider_value + (1) - (1)) / (1.0), 1); // bus value := (slider value + min - offset) / step.

    // Update superval
	getValue(P_ASG_10_1_0_17, superval);
	superval[0]=thisval;
	putValue(P_ASG_10_1_0_17,superval);
}

// Ueberwachung der Darstellungsvariable der Range.
on envVar P_ASG_10_1_0_17_2_range // Sound_Rear.VolumeRear 
{
	@P_ASG_10_1_0_17_2 = @P_ASG_10_1_0_17_2_range - (1); // slider = range - min
}

on envVar P_ASG_10_1_0_17_2 // Sound_Rear.VolumeRear
{
	byte superval[2];

	//Update Childvalue (Number)
	byte thisval; // VolumeRear
	float slider_value;

	slider_value = round(@P_ASG_10_1_0_17_2, 1.0);
	@P_ASG_10_1_0_17_2_range = slider_value + (1); // real value := slider value + range min.
	thisval = (byte)round((slider_value + (1) - (1)) / (1.0), 1); // bus value := (slider value + min - offset) / step.

    // Update superval
	getValue(P_ASG_10_1_0_17, superval);
	superval[1]=thisval;
	putValue(P_ASG_10_1_0_17,superval);
}

on envVar P_ASG_10_1_0_18Get_BTN
{
 if (P_ASG_10_1_0_18Get_BTN_already_pressed == 0)
  {
       putValue(P_ASG_10_1_0_18_ErrCode,0);
       SetControlBackColor(panel_name,"errField_P_ASG_10_1_0_18",MakeRGB(255,255,255));
       P_ASG_10_1_0_18Get_BTN_already_pressed = 1;
 }
 else
 {
       Request_Void(LSGID, P_ASG_10_1_0_18_ID, DataGet_REQ); 
       P_ASG_10_1_0_18Get_BTN_already_pressed = 0;
 }
}
on envVar P_ASG_10_1_0_18 // bus value of Spacing_Front (18).
{
	// opcodes: Error-Status
	byte param1; // Spacing1
	byte param2; // Spacing2
	byte param3; // Spacing3
	byte param4; // Spacing4
	byte param5; // StatusLevel1
	byte param6; // StatusLevel2
	byte param7; // StatusLevel3
	byte param8; // StatusLevel4
	// DATATYPE_BYTESEQUENCE / DATATYPE_FIXEDBYTESEQUENCE
	int i;
	byte superval[6];
	int currentPos;
	currentPos = 0;
	for( i = 0; i < 6; i++ ) {
		superval[i] = 0;
	}
	getValue(P_ASG_10_1_0_18, superval);
	///////// Start param1 - UINT8 /////////
	param1 = superval[currentPos++];
	putValue(P_ASG_10_1_0_18_1, round((param1 * 1.0) - (0) + (0), 1.0));
	///////// Start param2 - UINT8 /////////
	param2 = superval[currentPos++];
	putValue(P_ASG_10_1_0_18_2, round((param2 * 1.0) - (0) + (0), 1.0));
	///////// Start param3 - UINT8 /////////
	param3 = superval[currentPos++];
	putValue(P_ASG_10_1_0_18_3, round((param3 * 1.0) - (0) + (0), 1.0));
	///////// Start param4 - UINT8 /////////
	param4 = superval[currentPos++];
	putValue(P_ASG_10_1_0_18_4, round((param4 * 1.0) - (0) + (0), 1.0));
	///////// Start param5 - NIBBLE /////////
	param5 = (superval[currentPos] & 0xf0)>>4;
	putValue(P_ASG_10_1_0_18_5, param5);
	///////// Start param6 - NIBBLE /////////
	param6 = superval[currentPos++] & 0x0f;
	putValue(P_ASG_10_1_0_18_6, param6);
	///////// Start param7 - NIBBLE /////////
	param7 = (superval[currentPos] & 0xf0)>>4;
	putValue(P_ASG_10_1_0_18_7, param7);
	///////// Start param8 - NIBBLE /////////
	param8 = superval[currentPos++] & 0x0f;
	putValue(P_ASG_10_1_0_18_8, param8);
}

// Ueberwachung der Darstellungsvariable der Range.
on envVar P_ASG_10_1_0_18_1_range // Spacing_Front.Spacing1 
{
	@P_ASG_10_1_0_18_1 = @P_ASG_10_1_0_18_1_range - (0); // slider = range - min
}

on envVar P_ASG_10_1_0_18_1 // Spacing_Front.Spacing1
{
	byte superval[6];

	//Update Childvalue (Number)
	byte thisval; // Spacing1
	float slider_value;

	slider_value = round(@P_ASG_10_1_0_18_1, 1.0);
	@P_ASG_10_1_0_18_1_range = slider_value + (0); // real value := slider value + range min.
	thisval = (byte)round((slider_value + (0) - (0)) / (1.0), 1); // bus value := (slider value + min - offset) / step.

    // Update superval
	getValue(P_ASG_10_1_0_18, superval);
	superval[0]=thisval;
	putValue(P_ASG_10_1_0_18,superval);
}

// Ueberwachung der Darstellungsvariable der Range.
on envVar P_ASG_10_1_0_18_2_range // Spacing_Front.Spacing2 
{
	@P_ASG_10_1_0_18_2 = @P_ASG_10_1_0_18_2_range - (0); // slider = range - min
}

on envVar P_ASG_10_1_0_18_2 // Spacing_Front.Spacing2
{
	byte superval[6];

	//Update Childvalue (Number)
	byte thisval; // Spacing2
	float slider_value;

	slider_value = round(@P_ASG_10_1_0_18_2, 1.0);
	@P_ASG_10_1_0_18_2_range = slider_value + (0); // real value := slider value + range min.
	thisval = (byte)round((slider_value + (0) - (0)) / (1.0), 1); // bus value := (slider value + min - offset) / step.

    // Update superval
	getValue(P_ASG_10_1_0_18, superval);
	superval[1]=thisval;
	putValue(P_ASG_10_1_0_18,superval);
}

// Ueberwachung der Darstellungsvariable der Range.
on envVar P_ASG_10_1_0_18_3_range // Spacing_Front.Spacing3 
{
	@P_ASG_10_1_0_18_3 = @P_ASG_10_1_0_18_3_range - (0); // slider = range - min
}

on envVar P_ASG_10_1_0_18_3 // Spacing_Front.Spacing3
{
	byte superval[6];

	//Update Childvalue (Number)
	byte thisval; // Spacing3
	float slider_value;

	slider_value = round(@P_ASG_10_1_0_18_3, 1.0);
	@P_ASG_10_1_0_18_3_range = slider_value + (0); // real value := slider value + range min.
	thisval = (byte)round((slider_value + (0) - (0)) / (1.0), 1); // bus value := (slider value + min - offset) / step.

    // Update superval
	getValue(P_ASG_10_1_0_18, superval);
	superval[2]=thisval;
	putValue(P_ASG_10_1_0_18,superval);
}

// Ueberwachung der Darstellungsvariable der Range.
on envVar P_ASG_10_1_0_18_4_range // Spacing_Front.Spacing4 
{
	@P_ASG_10_1_0_18_4 = @P_ASG_10_1_0_18_4_range - (0); // slider = range - min
}

on envVar P_ASG_10_1_0_18_4 // Spacing_Front.Spacing4
{
	byte superval[6];

	//Update Childvalue (Number)
	byte thisval; // Spacing4
	float slider_value;

	slider_value = round(@P_ASG_10_1_0_18_4, 1.0);
	@P_ASG_10_1_0_18_4_range = slider_value + (0); // real value := slider value + range min.
	thisval = (byte)round((slider_value + (0) - (0)) / (1.0), 1); // bus value := (slider value + min - offset) / step.

    // Update superval
	getValue(P_ASG_10_1_0_18, superval);
	superval[3]=thisval;
	putValue(P_ASG_10_1_0_18,superval);
}

on envVar P_ASG_10_1_0_18_5 // Spacing_Front.StatusLevel1
{
	byte superval[6];

	//Update Childvalue (Enum)
	byte thisval; // StatusLevel1
	thisval = 0x0f & getValue(this);

    // Update superval
	getValue(P_ASG_10_1_0_18, superval);
	superval[4]= superval[4]&0x0f;
	superval[4]= superval[4]|(thisval<<4);
	putValue(P_ASG_10_1_0_18,superval);
}

on envVar P_ASG_10_1_0_18_6 // Spacing_Front.StatusLevel2
{
	byte superval[6];

	//Update Childvalue (Enum)
	byte thisval; // StatusLevel2
	thisval = 0x0f & getValue(this);

    // Update superval
	getValue(P_ASG_10_1_0_18, superval);
	superval[4]= superval[4]&0xf0;
	superval[4]= superval[4]|thisval;
	putValue(P_ASG_10_1_0_18,superval);
}

on envVar P_ASG_10_1_0_18_7 // Spacing_Front.StatusLevel3
{
	byte superval[6];

	//Update Childvalue (Enum)
	byte thisval; // StatusLevel3
	thisval = 0x0f & getValue(this);

    // Update superval
	getValue(P_ASG_10_1_0_18, superval);
	superval[5]= superval[5]&0x0f;
	superval[5]= superval[5]|(thisval<<4);
	putValue(P_ASG_10_1_0_18,superval);
}

on envVar P_ASG_10_1_0_18_8 // Spacing_Front.StatusLevel4
{
	byte superval[6];

	//Update Childvalue (Enum)
	byte thisval; // StatusLevel4
	thisval = 0x0f & getValue(this);

    // Update superval
	getValue(P_ASG_10_1_0_18, superval);
	superval[5]= superval[5]&0xf0;
	superval[5]= superval[5]|thisval;
	putValue(P_ASG_10_1_0_18,superval);
}

on envVar P_ASG_10_1_0_19Get_BTN
{
 if (P_ASG_10_1_0_19Get_BTN_already_pressed == 0)
  {
       putValue(P_ASG_10_1_0_19_ErrCode,0);
       SetControlBackColor(panel_name,"errField_P_ASG_10_1_0_19",MakeRGB(255,255,255));
       P_ASG_10_1_0_19Get_BTN_already_pressed = 1;
 }
 else
 {
       Request_Void(LSGID, P_ASG_10_1_0_19_ID, DataGet_REQ); 
       P_ASG_10_1_0_19Get_BTN_already_pressed = 0;
 }
}
on envVar P_ASG_10_1_0_19 // bus value of Spacing_Rear (19).
{
	// opcodes: Error-Status
	byte param1; // Spacing1
	byte param2; // Spacing2
	byte param3; // Spacing3
	byte param4; // Spacing4
	byte param5; // StatusLevel1
	byte param6; // StatusLevel2
	byte param7; // StatusLevel3
	byte param8; // StatusLevel4
	// DATATYPE_BYTESEQUENCE / DATATYPE_FIXEDBYTESEQUENCE
	int i;
	byte superval[6];
	int currentPos;
	currentPos = 0;
	for( i = 0; i < 6; i++ ) {
		superval[i] = 0;
	}
	getValue(P_ASG_10_1_0_19, superval);
	///////// Start param1 - UINT8 /////////
	param1 = superval[currentPos++];
	putValue(P_ASG_10_1_0_19_1, round((param1 * 1.0) - (0) + (0), 1.0));
	///////// Start param2 - UINT8 /////////
	param2 = superval[currentPos++];
	putValue(P_ASG_10_1_0_19_2, round((param2 * 1.0) - (0) + (0), 1.0));
	///////// Start param3 - UINT8 /////////
	param3 = superval[currentPos++];
	putValue(P_ASG_10_1_0_19_3, round((param3 * 1.0) - (0) + (0), 1.0));
	///////// Start param4 - UINT8 /////////
	param4 = superval[currentPos++];
	putValue(P_ASG_10_1_0_19_4, round((param4 * 1.0) - (0) + (0), 1.0));
	///////// Start param5 - NIBBLE /////////
	param5 = (superval[currentPos] & 0xf0)>>4;
	putValue(P_ASG_10_1_0_19_5, param5);
	///////// Start param6 - NIBBLE /////////
	param6 = superval[currentPos++] & 0x0f;
	putValue(P_ASG_10_1_0_19_6, param6);
	///////// Start param7 - NIBBLE /////////
	param7 = (superval[currentPos] & 0xf0)>>4;
	putValue(P_ASG_10_1_0_19_7, param7);
	///////// Start param8 - NIBBLE /////////
	param8 = superval[currentPos++] & 0x0f;
	putValue(P_ASG_10_1_0_19_8, param8);
}

// Ueberwachung der Darstellungsvariable der Range.
on envVar P_ASG_10_1_0_19_1_range // Spacing_Rear.Spacing1 
{
	@P_ASG_10_1_0_19_1 = @P_ASG_10_1_0_19_1_range - (0); // slider = range - min
}

on envVar P_ASG_10_1_0_19_1 // Spacing_Rear.Spacing1
{
	byte superval[6];

	//Update Childvalue (Number)
	byte thisval; // Spacing1
	float slider_value;

	slider_value = round(@P_ASG_10_1_0_19_1, 1.0);
	@P_ASG_10_1_0_19_1_range = slider_value + (0); // real value := slider value + range min.
	thisval = (byte)round((slider_value + (0) - (0)) / (1.0), 1); // bus value := (slider value + min - offset) / step.

    // Update superval
	getValue(P_ASG_10_1_0_19, superval);
	superval[0]=thisval;
	putValue(P_ASG_10_1_0_19,superval);
}

// Ueberwachung der Darstellungsvariable der Range.
on envVar P_ASG_10_1_0_19_2_range // Spacing_Rear.Spacing2 
{
	@P_ASG_10_1_0_19_2 = @P_ASG_10_1_0_19_2_range - (0); // slider = range - min
}

on envVar P_ASG_10_1_0_19_2 // Spacing_Rear.Spacing2
{
	byte superval[6];

	//Update Childvalue (Number)
	byte thisval; // Spacing2
	float slider_value;

	slider_value = round(@P_ASG_10_1_0_19_2, 1.0);
	@P_ASG_10_1_0_19_2_range = slider_value + (0); // real value := slider value + range min.
	thisval = (byte)round((slider_value + (0) - (0)) / (1.0), 1); // bus value := (slider value + min - offset) / step.

    // Update superval
	getValue(P_ASG_10_1_0_19, superval);
	superval[1]=thisval;
	putValue(P_ASG_10_1_0_19,superval);
}

// Ueberwachung der Darstellungsvariable der Range.
on envVar P_ASG_10_1_0_19_3_range // Spacing_Rear.Spacing3 
{
	@P_ASG_10_1_0_19_3 = @P_ASG_10_1_0_19_3_range - (0); // slider = range - min
}

on envVar P_ASG_10_1_0_19_3 // Spacing_Rear.Spacing3
{
	byte superval[6];

	//Update Childvalue (Number)
	byte thisval; // Spacing3
	float slider_value;

	slider_value = round(@P_ASG_10_1_0_19_3, 1.0);
	@P_ASG_10_1_0_19_3_range = slider_value + (0); // real value := slider value + range min.
	thisval = (byte)round((slider_value + (0) - (0)) / (1.0), 1); // bus value := (slider value + min - offset) / step.

    // Update superval
	getValue(P_ASG_10_1_0_19, superval);
	superval[2]=thisval;
	putValue(P_ASG_10_1_0_19,superval);
}

// Ueberwachung der Darstellungsvariable der Range.
on envVar P_ASG_10_1_0_19_4_range // Spacing_Rear.Spacing4 
{
	@P_ASG_10_1_0_19_4 = @P_ASG_10_1_0_19_4_range - (0); // slider = range - min
}

on envVar P_ASG_10_1_0_19_4 // Spacing_Rear.Spacing4
{
	byte superval[6];

	//Update Childvalue (Number)
	byte thisval; // Spacing4
	float slider_value;

	slider_value = round(@P_ASG_10_1_0_19_4, 1.0);
	@P_ASG_10_1_0_19_4_range = slider_value + (0); // real value := slider value + range min.
	thisval = (byte)round((slider_value + (0) - (0)) / (1.0), 1); // bus value := (slider value + min - offset) / step.

    // Update superval
	getValue(P_ASG_10_1_0_19, superval);
	superval[3]=thisval;
	putValue(P_ASG_10_1_0_19,superval);
}

on envVar P_ASG_10_1_0_19_5 // Spacing_Rear.StatusLevel1
{
	byte superval[6];

	//Update Childvalue (Enum)
	byte thisval; // StatusLevel1
	thisval = 0x0f & getValue(this);

    // Update superval
	getValue(P_ASG_10_1_0_19, superval);
	superval[4]= superval[4]&0x0f;
	superval[4]= superval[4]|(thisval<<4);
	putValue(P_ASG_10_1_0_19,superval);
}

on envVar P_ASG_10_1_0_19_6 // Spacing_Rear.StatusLevel2
{
	byte superval[6];

	//Update Childvalue (Enum)
	byte thisval; // StatusLevel2
	thisval = 0x0f & getValue(this);

    // Update superval
	getValue(P_ASG_10_1_0_19, superval);
	superval[4]= superval[4]&0xf0;
	superval[4]= superval[4]|thisval;
	putValue(P_ASG_10_1_0_19,superval);
}

on envVar P_ASG_10_1_0_19_7 // Spacing_Rear.StatusLevel3
{
	byte superval[6];

	//Update Childvalue (Enum)
	byte thisval; // StatusLevel3
	thisval = 0x0f & getValue(this);

    // Update superval
	getValue(P_ASG_10_1_0_19, superval);
	superval[5]= superval[5]&0x0f;
	superval[5]= superval[5]|(thisval<<4);
	putValue(P_ASG_10_1_0_19,superval);
}

on envVar P_ASG_10_1_0_19_8 // Spacing_Rear.StatusLevel4
{
	byte superval[6];

	//Update Childvalue (Enum)
	byte thisval; // StatusLevel4
	thisval = 0x0f & getValue(this);

    // Update superval
	getValue(P_ASG_10_1_0_19, superval);
	superval[5]= superval[5]&0xf0;
	superval[5]= superval[5]|thisval;
	putValue(P_ASG_10_1_0_19,superval);
}

on envVar P_ASG_10_1_0_20Get_BTN
{
 if (P_ASG_10_1_0_20Get_BTN_already_pressed == 0)
  {
       putValue(P_ASG_10_1_0_20_ErrCode,0);
       SetControlBackColor(panel_name,"errField_P_ASG_10_1_0_20",MakeRGB(255,255,255));
       P_ASG_10_1_0_20Get_BTN_already_pressed = 1;
 }
 else
 {
       Request_Void(LSGID, P_ASG_10_1_0_20_ID, DataGet_REQ); 
       P_ASG_10_1_0_20Get_BTN_already_pressed = 0;
 }
}
on envVar P_ASG_10_1_0_20SetGet_BTN
{
	byte BAPTemp[2];
    if (P_ASG_10_1_0_20SetGet_BTN_already_pressed == 0)
    {
       putValue(P_ASG_10_1_0_20_ErrCode,0);
       SetControlBackColor(panel_name,"errField_P_ASG_10_1_0_20",MakeRGB(255,255,255));
       P_ASG_10_1_0_20SetGet_BTN_already_pressed = 1;
    }
    else
    {
       getValue(P_ASG_10_1_0_20, BAPTemp);
       Request_ByteSequence(LSGID, P_ASG_10_1_0_20_ID, DataSetGet_REQ, BAPTemp, getValueSize(P_ASG_10_1_0_20));
       P_ASG_10_1_0_20SetGet_BTN_already_pressed = 0;
    }
}
on envVar P_ASG_10_1_0_20 // bus value of APS_Mute (20).
{
	// opcodes: Error-Status
	byte param1; // APSMuteState
	byte param2; // ModificationReason
	byte param3; // ModificationState
	// DATATYPE_BYTESEQUENCE / DATATYPE_FIXEDBYTESEQUENCE
	int i;
	byte superval[2];
	int currentPos;
	currentPos = 0;
	for( i = 0; i < 2; i++ ) {
		superval[i] = 0;
	}
	getValue(P_ASG_10_1_0_20, superval);
	///////// Start param1 - UINT8 /////////
	param1 = superval[currentPos++];
	putValue(P_ASG_10_1_0_20_1, param1);
	///////// Start param2 - NIBBLE /////////
	param2 = (superval[currentPos] & 0xf0)>>4;
	putValue(P_ASG_10_1_0_20_2, param2);
	///////// Start param3 - NIBBLE /////////
	param3 = superval[currentPos++] & 0x0f;
	putValue(P_ASG_10_1_0_20_3, param3);
}

on envVar P_ASG_10_1_0_20_1_0
{
	byte bitval;
	//thisval steht hier fuer den bitfield-wert, 
	//aus Generierungsgruenden hier keine einheitliche Bezeichnung moeglich.
	byte thisval; // APSMuteState
	bitval= getValue(this);
	thisval = getValue(P_ASG_10_1_0_20_1);
	thisval = thisval&~(1<<0)|(bitval<<0);
	putValue(P_ASG_10_1_0_20_1,thisval);
}

on envVar P_ASG_10_1_0_20_1 // APS_Mute.APSMuteState
{
	byte superval[2];

	//Update Childvalue (BitField)
	byte mask=0x01;
	int i = 0;
	byte thisval; // APSMuteState
	thisval = getValue(this);
	if(thisval&(mask<<0))
		putValue(P_ASG_10_1_0_20_1_0, 1);
	else
		putValue(P_ASG_10_1_0_20_1_0, 0);

    // Update superval
	getValue(P_ASG_10_1_0_20, superval);
	superval[0]=thisval;
	putValue(P_ASG_10_1_0_20,superval);
}

on envVar P_ASG_10_1_0_20_2 // APS_Mute.ModificationReason
{
	byte superval[2];

	//Update Childvalue (Enum)
	byte thisval; // ModificationReason
	thisval = 0x0f & getValue(this);

    // Update superval
	getValue(P_ASG_10_1_0_20, superval);
	superval[1]= superval[1]&0x0f;
	superval[1]= superval[1]|(thisval<<4);
	putValue(P_ASG_10_1_0_20,superval);
}

on envVar P_ASG_10_1_0_20_3_0
{
	byte bitval;
	//thisval steht hier fuer den bitfield-wert, 
	//aus Generierungsgruenden hier keine einheitliche Bezeichnung moeglich.
	byte thisval; // ModificationState
	bitval= getValue(this);
	thisval = getValue(P_ASG_10_1_0_20_3);
	thisval = thisval&~(1<<0)|(bitval<<0);
	putValue(P_ASG_10_1_0_20_3,thisval);
}

on envVar P_ASG_10_1_0_20_3 // APS_Mute.ModificationState
{
	byte superval[2];

	//Update Childvalue (BitField)
	byte mask=0x01;
	int i = 0;
	byte thisval; // ModificationState
	thisval = getValue(this);
	if(thisval&(mask<<0))
		putValue(P_ASG_10_1_0_20_3_0, 1);
	else
		putValue(P_ASG_10_1_0_20_3_0, 0);

    // Update superval
	getValue(P_ASG_10_1_0_20, superval);
	superval[1]= superval[1]&0xf0;
	superval[1]= superval[1]|thisval;
	putValue(P_ASG_10_1_0_20,superval);
}

on envVar P_ASG_10_1_0_21Get_BTN
{
 if (P_ASG_10_1_0_21Get_BTN_already_pressed == 0)
  {
       putValue(P_ASG_10_1_0_21_ErrCode,0);
       SetControlBackColor(panel_name,"errField_P_ASG_10_1_0_21",MakeRGB(255,255,255));
       P_ASG_10_1_0_21Get_BTN_already_pressed = 1;
 }
 else
 {
       Request_Void(LSGID, P_ASG_10_1_0_21_ID, DataGet_REQ); 
       P_ASG_10_1_0_21Get_BTN_already_pressed = 0;
 }
}
on envVar P_ASG_10_1_0_21SetGet_BTN
{
	byte BAPTemp[2];
    if (P_ASG_10_1_0_21SetGet_BTN_already_pressed == 0)
    {
       putValue(P_ASG_10_1_0_21_ErrCode,0);
       SetControlBackColor(panel_name,"errField_P_ASG_10_1_0_21",MakeRGB(255,255,255));
       P_ASG_10_1_0_21SetGet_BTN_already_pressed = 1;
    }
    else
    {
       getValue(P_ASG_10_1_0_21, BAPTemp);
       Request_ByteSequence(LSGID, P_ASG_10_1_0_21_ID, DataSetGet_REQ, BAPTemp, getValueSize(P_ASG_10_1_0_21));
       P_ASG_10_1_0_21SetGet_BTN_already_pressed = 0;
    }
}
on envVar P_ASG_10_1_0_21 // bus value of Display (21).
{
	// opcodes: Error-Status-StatusAck
	byte param1; // ASG_Req_Resp
	byte param2; // FSG_Req_Resp
	byte param3; // Content
	// DATATYPE_BYTESEQUENCE / DATATYPE_FIXEDBYTESEQUENCE
	int i;
	byte superval[2];
	int currentPos;
	currentPos = 0;
	for( i = 0; i < 2; i++ ) {
		superval[i] = 0;
	}
	getValue(P_ASG_10_1_0_21, superval);
	///////// Start param1 - NIBBLE /////////
	param1 = (superval[currentPos] & 0xf0)>>4;
	putValue(P_ASG_10_1_0_21_1, param1);
	///////// Start param2 - NIBBLE /////////
	param2 = superval[currentPos++] & 0x0f;
	putValue(P_ASG_10_1_0_21_2, param2);
	///////// Start param3 - UINT8 /////////
	param3 = superval[currentPos++];
	putValue(P_ASG_10_1_0_21_3, param3);
}

on envVar P_ASG_10_1_0_21_1 // Display.ASG_Req_Resp
{
	byte superval[2];

	//Update Childvalue (Enum)
	byte thisval; // ASG_Req_Resp
	thisval = 0x0f & getValue(this);

    // Update superval
	getValue(P_ASG_10_1_0_21, superval);
	superval[0]= superval[0]&0x0f;
	superval[0]= superval[0]|(thisval<<4);
	putValue(P_ASG_10_1_0_21,superval);
}

on envVar P_ASG_10_1_0_21_2 // Display.FSG_Req_Resp
{
	byte superval[2];

	//Update Childvalue (Enum)
	byte thisval; // FSG_Req_Resp
	thisval = 0x0f & getValue(this);

    // Update superval
	getValue(P_ASG_10_1_0_21, superval);
	superval[0]= superval[0]&0xf0;
	superval[0]= superval[0]|thisval;
	putValue(P_ASG_10_1_0_21,superval);
}

on envVar P_ASG_10_1_0_21_3 // Display.Content
{
	byte superval[2];

	//Update Childvalue (Enum)
	byte thisval; // Content
	thisval = getValue(this);

    // Update superval
	getValue(P_ASG_10_1_0_21, superval);
	superval[1]=thisval;
	putValue(P_ASG_10_1_0_21,superval);
}

on envVar P_ASG_10_1_0_21_Ack // bus value of Display (21).
{
	// opcodes: Error-Status-StatusAck
	byte param1; // ASG_Req_Resp
	byte param2; // FSG_Req_Resp
	byte param3; // Content
	// DATATYPE_BYTESEQUENCE / DATATYPE_FIXEDBYTESEQUENCE
	int i;
	byte superval[2];
	int currentPos;
	currentPos = 0;
	for( i = 0; i < 2; i++ ) {
		superval[i] = 0;
	}
	getValue(P_ASG_10_1_0_21_Ack, superval);
	///////// Start param1 - NIBBLE /////////
	param1 = (superval[currentPos] & 0xf0)>>4;
	putValue(P_ASG_10_1_0_21_Ack_1, param1);
	///////// Start param2 - NIBBLE /////////
	param2 = superval[currentPos++] & 0x0f;
	putValue(P_ASG_10_1_0_21_Ack_2, param2);
	///////// Start param3 - UINT8 /////////
	param3 = superval[currentPos++];
	putValue(P_ASG_10_1_0_21_Ack_3, param3);
}

on envVar P_ASG_10_1_0_21_Ack_1 // Display.ASG_Req_Resp
{
	byte superval[2];

	//Update Childvalue (Enum)
	byte thisval; // ASG_Req_Resp
	thisval = 0x0f & getValue(this);

    // Update superval
	getValue(P_ASG_10_1_0_21_Ack, superval);
	superval[0]= superval[0]&0x0f;
	superval[0]= superval[0]|(thisval<<4);
	putValue(P_ASG_10_1_0_21_Ack,superval);
}

on envVar P_ASG_10_1_0_21_Ack_2 // Display.FSG_Req_Resp
{
	byte superval[2];

	//Update Childvalue (Enum)
	byte thisval; // FSG_Req_Resp
	thisval = 0x0f & getValue(this);

    // Update superval
	getValue(P_ASG_10_1_0_21_Ack, superval);
	superval[0]= superval[0]&0xf0;
	superval[0]= superval[0]|thisval;
	putValue(P_ASG_10_1_0_21_Ack,superval);
}

on envVar P_ASG_10_1_0_21_Ack_3 // Display.Content
{
	byte superval[2];

	//Update Childvalue (Enum)
	byte thisval; // Content
	thisval = getValue(this);

    // Update superval
	getValue(P_ASG_10_1_0_21_Ack, superval);
	superval[1]=thisval;
	putValue(P_ASG_10_1_0_21_Ack,superval);
}

on envVar P_ASG_10_1_0_22Get_BTN
{
 if (P_ASG_10_1_0_22Get_BTN_already_pressed == 0)
  {
       putValue(P_ASG_10_1_0_22_ErrCode,0);
       SetControlBackColor(panel_name,"errField_P_ASG_10_1_0_22",MakeRGB(255,255,255));
       P_ASG_10_1_0_22Get_BTN_already_pressed = 1;
 }
 else
 {
       Request_Void(LSGID, P_ASG_10_1_0_22_ID, DataGet_REQ); 
       P_ASG_10_1_0_22Get_BTN_already_pressed = 0;
 }
}
on envVar P_ASG_10_1_0_22SetGet_BTN
{
    if (P_ASG_10_1_0_22SetGet_BTN_already_pressed == 0)
    {
       putValue(P_ASG_10_1_0_22_ErrCode,0);
       SetControlBackColor(panel_name,"errField_P_ASG_10_1_0_22",MakeRGB(255,255,255));
       P_ASG_10_1_0_22SetGet_BTN_already_pressed = 1;
    }
    else
    {
       Request_Int8(LSGID, P_ASG_10_1_0_22_ID, DataSetGet_REQ, getValue(P_ASG_10_1_0_22));
       P_ASG_10_1_0_22SetGet_BTN_already_pressed = 0;
    }
}
on envVar P_ASG_10_1_0_22 // bus value of DefaultParkingmode (22).
{
	// opcodes: Error-Status
	byte param1; // Defaultmode
	// DATATYPE_UINTXX
	param1 = getValue(P_ASG_10_1_0_22);
	putValue(P_ASG_10_1_0_22_1, param1);
}

on envVar P_ASG_10_1_0_22_1 // DefaultParkingmode.Defaultmode
{
	byte superval;

	//Update Childvalue (Enum)
	byte thisval; // Defaultmode
	thisval = getValue(this);

    // Update superval
	superval = getValue(P_ASG_10_1_0_22);
	superval = thisval;
	putValue(P_ASG_10_1_0_22,superval);
}

on envVar P_ASG_10_1_0_23Get_BTN
{
 if (P_ASG_10_1_0_23Get_BTN_already_pressed == 0)
  {
       putValue(P_ASG_10_1_0_23_ErrCode,0);
       SetControlBackColor(panel_name,"errField_P_ASG_10_1_0_23",MakeRGB(255,255,255));
       P_ASG_10_1_0_23Get_BTN_already_pressed = 1;
 }
 else
 {
       Request_Void(LSGID, P_ASG_10_1_0_23_ID, DataGet_REQ); 
       P_ASG_10_1_0_23Get_BTN_already_pressed = 0;
 }
}
on envVar P_ASG_10_1_0_23 // bus value of Trailer (23).
{
	// opcodes: Error-Status
	byte param1; // Hitched
	// DATATYPE_UINTXX
	param1 = getValue(P_ASG_10_1_0_23);
	putValue(P_ASG_10_1_0_23_1, param1);
}

on envVar P_ASG_10_1_0_23_1_0
{
	byte bitval;
	//thisval steht hier fuer den bitfield-wert, 
	//aus Generierungsgruenden hier keine einheitliche Bezeichnung moeglich.
	byte thisval; // Hitched
	bitval= getValue(this);
	thisval = getValue(P_ASG_10_1_0_23_1);
	thisval = thisval&~(1<<0)|(bitval<<0);
	putValue(P_ASG_10_1_0_23_1,thisval);
}

on envVar P_ASG_10_1_0_23_1 // Trailer.Hitched
{
	byte superval;

	//Update Childvalue (BitField)
	byte mask=0x01;
	int i = 0;
	byte thisval; // Hitched
	thisval = getValue(this);
	if(thisval&(mask<<0))
		putValue(P_ASG_10_1_0_23_1_0, 1);
	else
		putValue(P_ASG_10_1_0_23_1_0, 0);

    // Update superval
	superval = getValue(P_ASG_10_1_0_23);
	superval = thisval;
	putValue(P_ASG_10_1_0_23,superval);
}

on envVar P_ASG_10_1_0_24Get_BTN
{
 if (P_ASG_10_1_0_24Get_BTN_already_pressed == 0)
  {
       putValue(P_ASG_10_1_0_24_ErrCode,0);
       SetControlBackColor(panel_name,"errField_P_ASG_10_1_0_24",MakeRGB(255,255,255));
       P_ASG_10_1_0_24Get_BTN_already_pressed = 1;
 }
 else
 {
       Request_Void(LSGID, P_ASG_10_1_0_24_ID, DataGet_REQ); 
       P_ASG_10_1_0_24Get_BTN_already_pressed = 0;
 }
}
on envVar P_ASG_10_1_0_24SetGet_BTN
{
	byte BAPTemp[2];
    if (P_ASG_10_1_0_24SetGet_BTN_already_pressed == 0)
    {
       putValue(P_ASG_10_1_0_24_ErrCode,0);
       SetControlBackColor(panel_name,"errField_P_ASG_10_1_0_24",MakeRGB(255,255,255));
       P_ASG_10_1_0_24SetGet_BTN_already_pressed = 1;
    }
    else
    {
       getValue(P_ASG_10_1_0_24, BAPTemp);
       Request_ByteSequence(LSGID, P_ASG_10_1_0_24_ID, DataSetGet_REQ, BAPTemp, getValueSize(P_ASG_10_1_0_24));
       P_ASG_10_1_0_24SetGet_BTN_already_pressed = 0;
    }
}
on envVar P_ASG_10_1_0_24 // bus value of AutoActivation (24).
{
	// opcodes: Error-Status
	byte param1; // Setup
	byte param2; // ModificationReason
	byte param3; // ModificationState
	// DATATYPE_BYTESEQUENCE / DATATYPE_FIXEDBYTESEQUENCE
	int i;
	byte superval[2];
	int currentPos;
	currentPos = 0;
	for( i = 0; i < 2; i++ ) {
		superval[i] = 0;
	}
	getValue(P_ASG_10_1_0_24, superval);
	///////// Start param1 - UINT8 /////////
	param1 = superval[currentPos++];
	putValue(P_ASG_10_1_0_24_1, param1);
	///////// Start param2 - NIBBLE /////////
	param2 = (superval[currentPos] & 0xf0)>>4;
	putValue(P_ASG_10_1_0_24_2, param2);
	///////// Start param3 - NIBBLE /////////
	param3 = superval[currentPos++] & 0x0f;
	putValue(P_ASG_10_1_0_24_3, param3);
}

on envVar P_ASG_10_1_0_24_1_0
{
	byte bitval;
	//thisval steht hier fuer den bitfield-wert, 
	//aus Generierungsgruenden hier keine einheitliche Bezeichnung moeglich.
	byte thisval; // Setup
	bitval= getValue(this);
	thisval = getValue(P_ASG_10_1_0_24_1);
	thisval = thisval&~(1<<0)|(bitval<<0);
	putValue(P_ASG_10_1_0_24_1,thisval);
}

on envVar P_ASG_10_1_0_24_1 // AutoActivation.Setup
{
	byte superval[2];

	//Update Childvalue (BitField)
	byte mask=0x01;
	int i = 0;
	byte thisval; // Setup
	thisval = getValue(this);
	if(thisval&(mask<<0))
		putValue(P_ASG_10_1_0_24_1_0, 1);
	else
		putValue(P_ASG_10_1_0_24_1_0, 0);

    // Update superval
	getValue(P_ASG_10_1_0_24, superval);
	superval[0]=thisval;
	putValue(P_ASG_10_1_0_24,superval);
}

on envVar P_ASG_10_1_0_24_2 // AutoActivation.ModificationReason
{
	byte superval[2];

	//Update Childvalue (Enum)
	byte thisval; // ModificationReason
	thisval = 0x0f & getValue(this);

    // Update superval
	getValue(P_ASG_10_1_0_24, superval);
	superval[1]= superval[1]&0x0f;
	superval[1]= superval[1]|(thisval<<4);
	putValue(P_ASG_10_1_0_24,superval);
}

on envVar P_ASG_10_1_0_24_3_0
{
	byte bitval;
	//thisval steht hier fuer den bitfield-wert, 
	//aus Generierungsgruenden hier keine einheitliche Bezeichnung moeglich.
	byte thisval; // ModificationState
	bitval= getValue(this);
	thisval = getValue(P_ASG_10_1_0_24_3);
	thisval = thisval&~(1<<0)|(bitval<<0);
	putValue(P_ASG_10_1_0_24_3,thisval);
}

on envVar P_ASG_10_1_0_24_3 // AutoActivation.ModificationState
{
	byte superval[2];

	//Update Childvalue (BitField)
	byte mask=0x01;
	int i = 0;
	byte thisval; // ModificationState
	thisval = getValue(this);
	if(thisval&(mask<<0))
		putValue(P_ASG_10_1_0_24_3_0, 1);
	else
		putValue(P_ASG_10_1_0_24_3_0, 0);

    // Update superval
	getValue(P_ASG_10_1_0_24, superval);
	superval[1]= superval[1]&0xf0;
	superval[1]= superval[1]|thisval;
	putValue(P_ASG_10_1_0_24,superval);
}

on envVar P_ASG_10_1_0_25Get_BTN
{
 if (P_ASG_10_1_0_25Get_BTN_already_pressed == 0)
  {
       putValue(P_ASG_10_1_0_25_ErrCode,0);
       SetControlBackColor(panel_name,"errField_P_ASG_10_1_0_25",MakeRGB(255,255,255));
       P_ASG_10_1_0_25Get_BTN_already_pressed = 1;
 }
 else
 {
       Request_Void(LSGID, P_ASG_10_1_0_25_ID, DataGet_REQ); 
       P_ASG_10_1_0_25Get_BTN_already_pressed = 0;
 }
}
on envVar P_ASG_10_1_0_25 // bus value of Spacing_Right (25).
{
	// opcodes: Error-Status
	byte param1; // Spacing1
	byte param2; // Spacing2
	byte param3; // Spacing3
	byte param4; // Spacing4
	byte param5; // StatusLevel1
	byte param6; // StatusLevel2
	byte param7; // StatusLevel3
	byte param8; // StatusLevel4
	// DATATYPE_BYTESEQUENCE / DATATYPE_FIXEDBYTESEQUENCE
	int i;
	byte superval[6];
	int currentPos;
	currentPos = 0;
	for( i = 0; i < 6; i++ ) {
		superval[i] = 0;
	}
	getValue(P_ASG_10_1_0_25, superval);
	///////// Start param1 - UINT8 /////////
	param1 = superval[currentPos++];
	putValue(P_ASG_10_1_0_25_1, round((param1 * 1.0) - (0) + (0), 1.0));
	///////// Start param2 - UINT8 /////////
	param2 = superval[currentPos++];
	putValue(P_ASG_10_1_0_25_2, round((param2 * 1.0) - (0) + (0), 1.0));
	///////// Start param3 - UINT8 /////////
	param3 = superval[currentPos++];
	putValue(P_ASG_10_1_0_25_3, round((param3 * 1.0) - (0) + (0), 1.0));
	///////// Start param4 - UINT8 /////////
	param4 = superval[currentPos++];
	putValue(P_ASG_10_1_0_25_4, round((param4 * 1.0) - (0) + (0), 1.0));
	///////// Start param5 - NIBBLE /////////
	param5 = (superval[currentPos] & 0xf0)>>4;
	putValue(P_ASG_10_1_0_25_5, param5);
	///////// Start param6 - NIBBLE /////////
	param6 = superval[currentPos++] & 0x0f;
	putValue(P_ASG_10_1_0_25_6, param6);
	///////// Start param7 - NIBBLE /////////
	param7 = (superval[currentPos] & 0xf0)>>4;
	putValue(P_ASG_10_1_0_25_7, param7);
	///////// Start param8 - NIBBLE /////////
	param8 = superval[currentPos++] & 0x0f;
	putValue(P_ASG_10_1_0_25_8, param8);
}

// Ueberwachung der Darstellungsvariable der Range.
on envVar P_ASG_10_1_0_25_1_range // Spacing_Right.Spacing1 
{
	@P_ASG_10_1_0_25_1 = @P_ASG_10_1_0_25_1_range - (0); // slider = range - min
}

on envVar P_ASG_10_1_0_25_1 // Spacing_Right.Spacing1
{
	byte superval[6];

	//Update Childvalue (Number)
	byte thisval; // Spacing1
	float slider_value;

	slider_value = round(@P_ASG_10_1_0_25_1, 1.0);
	@P_ASG_10_1_0_25_1_range = slider_value + (0); // real value := slider value + range min.
	thisval = (byte)round((slider_value + (0) - (0)) / (1.0), 1); // bus value := (slider value + min - offset) / step.

    // Update superval
	getValue(P_ASG_10_1_0_25, superval);
	superval[0]=thisval;
	putValue(P_ASG_10_1_0_25,superval);
}

// Ueberwachung der Darstellungsvariable der Range.
on envVar P_ASG_10_1_0_25_2_range // Spacing_Right.Spacing2 
{
	@P_ASG_10_1_0_25_2 = @P_ASG_10_1_0_25_2_range - (0); // slider = range - min
}

on envVar P_ASG_10_1_0_25_2 // Spacing_Right.Spacing2
{
	byte superval[6];

	//Update Childvalue (Number)
	byte thisval; // Spacing2
	float slider_value;

	slider_value = round(@P_ASG_10_1_0_25_2, 1.0);
	@P_ASG_10_1_0_25_2_range = slider_value + (0); // real value := slider value + range min.
	thisval = (byte)round((slider_value + (0) - (0)) / (1.0), 1); // bus value := (slider value + min - offset) / step.

    // Update superval
	getValue(P_ASG_10_1_0_25, superval);
	superval[1]=thisval;
	putValue(P_ASG_10_1_0_25,superval);
}

// Ueberwachung der Darstellungsvariable der Range.
on envVar P_ASG_10_1_0_25_3_range // Spacing_Right.Spacing3 
{
	@P_ASG_10_1_0_25_3 = @P_ASG_10_1_0_25_3_range - (0); // slider = range - min
}

on envVar P_ASG_10_1_0_25_3 // Spacing_Right.Spacing3
{
	byte superval[6];

	//Update Childvalue (Number)
	byte thisval; // Spacing3
	float slider_value;

	slider_value = round(@P_ASG_10_1_0_25_3, 1.0);
	@P_ASG_10_1_0_25_3_range = slider_value + (0); // real value := slider value + range min.
	thisval = (byte)round((slider_value + (0) - (0)) / (1.0), 1); // bus value := (slider value + min - offset) / step.

    // Update superval
	getValue(P_ASG_10_1_0_25, superval);
	superval[2]=thisval;
	putValue(P_ASG_10_1_0_25,superval);
}

// Ueberwachung der Darstellungsvariable der Range.
on envVar P_ASG_10_1_0_25_4_range // Spacing_Right.Spacing4 
{
	@P_ASG_10_1_0_25_4 = @P_ASG_10_1_0_25_4_range - (0); // slider = range - min
}

on envVar P_ASG_10_1_0_25_4 // Spacing_Right.Spacing4
{
	byte superval[6];

	//Update Childvalue (Number)
	byte thisval; // Spacing4
	float slider_value;

	slider_value = round(@P_ASG_10_1_0_25_4, 1.0);
	@P_ASG_10_1_0_25_4_range = slider_value + (0); // real value := slider value + range min.
	thisval = (byte)round((slider_value + (0) - (0)) / (1.0), 1); // bus value := (slider value + min - offset) / step.

    // Update superval
	getValue(P_ASG_10_1_0_25, superval);
	superval[3]=thisval;
	putValue(P_ASG_10_1_0_25,superval);
}

on envVar P_ASG_10_1_0_25_5 // Spacing_Right.StatusLevel1
{
	byte superval[6];

	//Update Childvalue (Enum)
	byte thisval; // StatusLevel1
	thisval = 0x0f & getValue(this);

    // Update superval
	getValue(P_ASG_10_1_0_25, superval);
	superval[4]= superval[4]&0x0f;
	superval[4]= superval[4]|(thisval<<4);
	putValue(P_ASG_10_1_0_25,superval);
}

on envVar P_ASG_10_1_0_25_6 // Spacing_Right.StatusLevel2
{
	byte superval[6];

	//Update Childvalue (Enum)
	byte thisval; // StatusLevel2
	thisval = 0x0f & getValue(this);

    // Update superval
	getValue(P_ASG_10_1_0_25, superval);
	superval[4]= superval[4]&0xf0;
	superval[4]= superval[4]|thisval;
	putValue(P_ASG_10_1_0_25,superval);
}

on envVar P_ASG_10_1_0_25_7 // Spacing_Right.StatusLevel3
{
	byte superval[6];

	//Update Childvalue (Enum)
	byte thisval; // StatusLevel3
	thisval = 0x0f & getValue(this);

    // Update superval
	getValue(P_ASG_10_1_0_25, superval);
	superval[5]= superval[5]&0x0f;
	superval[5]= superval[5]|(thisval<<4);
	putValue(P_ASG_10_1_0_25,superval);
}

on envVar P_ASG_10_1_0_25_8 // Spacing_Right.StatusLevel4
{
	byte superval[6];

	//Update Childvalue (Enum)
	byte thisval; // StatusLevel4
	thisval = 0x0f & getValue(this);

    // Update superval
	getValue(P_ASG_10_1_0_25, superval);
	superval[5]= superval[5]&0xf0;
	superval[5]= superval[5]|thisval;
	putValue(P_ASG_10_1_0_25,superval);
}

on envVar P_ASG_10_1_0_26Get_BTN
{
 if (P_ASG_10_1_0_26Get_BTN_already_pressed == 0)
  {
       putValue(P_ASG_10_1_0_26_ErrCode,0);
       SetControlBackColor(panel_name,"errField_P_ASG_10_1_0_26",MakeRGB(255,255,255));
       P_ASG_10_1_0_26Get_BTN_already_pressed = 1;
 }
 else
 {
       Request_Void(LSGID, P_ASG_10_1_0_26_ID, DataGet_REQ); 
       P_ASG_10_1_0_26Get_BTN_already_pressed = 0;
 }
}
on envVar P_ASG_10_1_0_26 // bus value of Spacing_Left (26).
{
	// opcodes: Error-Status
	byte param1; // Spacing1
	byte param2; // Spacing2
	byte param3; // Spacing3
	byte param4; // Spacing4
	byte param5; // StatusLevel1
	byte param6; // StatusLevel2
	byte param7; // StatusLevel3
	byte param8; // StatusLevel4
	// DATATYPE_BYTESEQUENCE / DATATYPE_FIXEDBYTESEQUENCE
	int i;
	byte superval[6];
	int currentPos;
	currentPos = 0;
	for( i = 0; i < 6; i++ ) {
		superval[i] = 0;
	}
	getValue(P_ASG_10_1_0_26, superval);
	///////// Start param1 - UINT8 /////////
	param1 = superval[currentPos++];
	putValue(P_ASG_10_1_0_26_1, round((param1 * 1.0) - (0) + (0), 1.0));
	///////// Start param2 - UINT8 /////////
	param2 = superval[currentPos++];
	putValue(P_ASG_10_1_0_26_2, round((param2 * 1.0) - (0) + (0), 1.0));
	///////// Start param3 - UINT8 /////////
	param3 = superval[currentPos++];
	putValue(P_ASG_10_1_0_26_3, round((param3 * 1.0) - (0) + (0), 1.0));
	///////// Start param4 - UINT8 /////////
	param4 = superval[currentPos++];
	putValue(P_ASG_10_1_0_26_4, round((param4 * 1.0) - (0) + (0), 1.0));
	///////// Start param5 - NIBBLE /////////
	param5 = (superval[currentPos] & 0xf0)>>4;
	putValue(P_ASG_10_1_0_26_5, param5);
	///////// Start param6 - NIBBLE /////////
	param6 = superval[currentPos++] & 0x0f;
	putValue(P_ASG_10_1_0_26_6, param6);
	///////// Start param7 - NIBBLE /////////
	param7 = (superval[currentPos] & 0xf0)>>4;
	putValue(P_ASG_10_1_0_26_7, param7);
	///////// Start param8 - NIBBLE /////////
	param8 = superval[currentPos++] & 0x0f;
	putValue(P_ASG_10_1_0_26_8, param8);
}

// Ueberwachung der Darstellungsvariable der Range.
on envVar P_ASG_10_1_0_26_1_range // Spacing_Left.Spacing1 
{
	@P_ASG_10_1_0_26_1 = @P_ASG_10_1_0_26_1_range - (0); // slider = range - min
}

on envVar P_ASG_10_1_0_26_1 // Spacing_Left.Spacing1
{
	byte superval[6];

	//Update Childvalue (Number)
	byte thisval; // Spacing1
	float slider_value;

	slider_value = round(@P_ASG_10_1_0_26_1, 1.0);
	@P_ASG_10_1_0_26_1_range = slider_value + (0); // real value := slider value + range min.
	thisval = (byte)round((slider_value + (0) - (0)) / (1.0), 1); // bus value := (slider value + min - offset) / step.

    // Update superval
	getValue(P_ASG_10_1_0_26, superval);
	superval[0]=thisval;
	putValue(P_ASG_10_1_0_26,superval);
}

// Ueberwachung der Darstellungsvariable der Range.
on envVar P_ASG_10_1_0_26_2_range // Spacing_Left.Spacing2 
{
	@P_ASG_10_1_0_26_2 = @P_ASG_10_1_0_26_2_range - (0); // slider = range - min
}

on envVar P_ASG_10_1_0_26_2 // Spacing_Left.Spacing2
{
	byte superval[6];

	//Update Childvalue (Number)
	byte thisval; // Spacing2
	float slider_value;

	slider_value = round(@P_ASG_10_1_0_26_2, 1.0);
	@P_ASG_10_1_0_26_2_range = slider_value + (0); // real value := slider value + range min.
	thisval = (byte)round((slider_value + (0) - (0)) / (1.0), 1); // bus value := (slider value + min - offset) / step.

    // Update superval
	getValue(P_ASG_10_1_0_26, superval);
	superval[1]=thisval;
	putValue(P_ASG_10_1_0_26,superval);
}

// Ueberwachung der Darstellungsvariable der Range.
on envVar P_ASG_10_1_0_26_3_range // Spacing_Left.Spacing3 
{
	@P_ASG_10_1_0_26_3 = @P_ASG_10_1_0_26_3_range - (0); // slider = range - min
}

on envVar P_ASG_10_1_0_26_3 // Spacing_Left.Spacing3
{
	byte superval[6];

	//Update Childvalue (Number)
	byte thisval; // Spacing3
	float slider_value;

	slider_value = round(@P_ASG_10_1_0_26_3, 1.0);
	@P_ASG_10_1_0_26_3_range = slider_value + (0); // real value := slider value + range min.
	thisval = (byte)round((slider_value + (0) - (0)) / (1.0), 1); // bus value := (slider value + min - offset) / step.

    // Update superval
	getValue(P_ASG_10_1_0_26, superval);
	superval[2]=thisval;
	putValue(P_ASG_10_1_0_26,superval);
}

// Ueberwachung der Darstellungsvariable der Range.
on envVar P_ASG_10_1_0_26_4_range // Spacing_Left.Spacing4 
{
	@P_ASG_10_1_0_26_4 = @P_ASG_10_1_0_26_4_range - (0); // slider = range - min
}

on envVar P_ASG_10_1_0_26_4 // Spacing_Left.Spacing4
{
	byte superval[6];

	//Update Childvalue (Number)
	byte thisval; // Spacing4
	float slider_value;

	slider_value = round(@P_ASG_10_1_0_26_4, 1.0);
	@P_ASG_10_1_0_26_4_range = slider_value + (0); // real value := slider value + range min.
	thisval = (byte)round((slider_value + (0) - (0)) / (1.0), 1); // bus value := (slider value + min - offset) / step.

    // Update superval
	getValue(P_ASG_10_1_0_26, superval);
	superval[3]=thisval;
	putValue(P_ASG_10_1_0_26,superval);
}

on envVar P_ASG_10_1_0_26_5 // Spacing_Left.StatusLevel1
{
	byte superval[6];

	//Update Childvalue (Enum)
	byte thisval; // StatusLevel1
	thisval = 0x0f & getValue(this);

    // Update superval
	getValue(P_ASG_10_1_0_26, superval);
	superval[4]= superval[4]&0x0f;
	superval[4]= superval[4]|(thisval<<4);
	putValue(P_ASG_10_1_0_26,superval);
}

on envVar P_ASG_10_1_0_26_6 // Spacing_Left.StatusLevel2
{
	byte superval[6];

	//Update Childvalue (Enum)
	byte thisval; // StatusLevel2
	thisval = 0x0f & getValue(this);

    // Update superval
	getValue(P_ASG_10_1_0_26, superval);
	superval[4]= superval[4]&0xf0;
	superval[4]= superval[4]|thisval;
	putValue(P_ASG_10_1_0_26,superval);
}

on envVar P_ASG_10_1_0_26_7 // Spacing_Left.StatusLevel3
{
	byte superval[6];

	//Update Childvalue (Enum)
	byte thisval; // StatusLevel3
	thisval = 0x0f & getValue(this);

    // Update superval
	getValue(P_ASG_10_1_0_26, superval);
	superval[5]= superval[5]&0x0f;
	superval[5]= superval[5]|(thisval<<4);
	putValue(P_ASG_10_1_0_26,superval);
}

on envVar P_ASG_10_1_0_26_8 // Spacing_Left.StatusLevel4
{
	byte superval[6];

	//Update Childvalue (Enum)
	byte thisval; // StatusLevel4
	thisval = 0x0f & getValue(this);

    // Update superval
	getValue(P_ASG_10_1_0_26, superval);
	superval[5]= superval[5]&0xf0;
	superval[5]= superval[5]|thisval;
	putValue(P_ASG_10_1_0_26,superval);
}

on envVar P_ASG_10_1_0_27Get_BTN
{
 if (P_ASG_10_1_0_27Get_BTN_already_pressed == 0)
  {
       putValue(P_ASG_10_1_0_27_ErrCode,0);
       SetControlBackColor(panel_name,"errField_P_ASG_10_1_0_27",MakeRGB(255,255,255));
       P_ASG_10_1_0_27Get_BTN_already_pressed = 1;
 }
 else
 {
       Request_Void(LSGID, P_ASG_10_1_0_27_ID, DataGet_REQ); 
       P_ASG_10_1_0_27Get_BTN_already_pressed = 0;
 }
}
on envVar P_ASG_10_1_0_27SetGet_BTN
{
	byte BAPTemp[2];
    if (P_ASG_10_1_0_27SetGet_BTN_already_pressed == 0)
    {
       putValue(P_ASG_10_1_0_27_ErrCode,0);
       SetControlBackColor(panel_name,"errField_P_ASG_10_1_0_27",MakeRGB(255,255,255));
       P_ASG_10_1_0_27SetGet_BTN_already_pressed = 1;
    }
    else
    {
       getValue(P_ASG_10_1_0_27, BAPTemp);
       Request_ByteSequence(LSGID, P_ASG_10_1_0_27_ID, DataSetGet_REQ, BAPTemp, getValueSize(P_ASG_10_1_0_27));
       P_ASG_10_1_0_27SetGet_BTN_already_pressed = 0;
    }
}
on envVar P_ASG_10_1_0_27 // bus value of Sound_Right (27).
{
	// opcodes: Error-Status
	byte param1; // FrequencyRight
	byte param2; // VolumeRight
	// DATATYPE_BYTESEQUENCE / DATATYPE_FIXEDBYTESEQUENCE
	int i;
	byte superval[2];
	int currentPos;
	currentPos = 0;
	for( i = 0; i < 2; i++ ) {
		superval[i] = 0;
	}
	getValue(P_ASG_10_1_0_27, superval);
	///////// Start param1 - UINT8 /////////
	param1 = superval[currentPos++];
	putValue(P_ASG_10_1_0_27_1, round((param1 * 1.0) - (1) + (1), 1.0));
	///////// Start param2 - UINT8 /////////
	param2 = superval[currentPos++];
	putValue(P_ASG_10_1_0_27_2, round((param2 * 1.0) - (1) + (1), 1.0));
}

// Ueberwachung der Darstellungsvariable der Range.
on envVar P_ASG_10_1_0_27_1_range // Sound_Right.FrequencyRight 
{
	@P_ASG_10_1_0_27_1 = @P_ASG_10_1_0_27_1_range - (1); // slider = range - min
}

on envVar P_ASG_10_1_0_27_1 // Sound_Right.FrequencyRight
{
	byte superval[2];

	//Update Childvalue (Number)
	byte thisval; // FrequencyRight
	float slider_value;

	slider_value = round(@P_ASG_10_1_0_27_1, 1.0);
	@P_ASG_10_1_0_27_1_range = slider_value + (1); // real value := slider value + range min.
	thisval = (byte)round((slider_value + (1) - (1)) / (1.0), 1); // bus value := (slider value + min - offset) / step.

    // Update superval
	getValue(P_ASG_10_1_0_27, superval);
	superval[0]=thisval;
	putValue(P_ASG_10_1_0_27,superval);
}

// Ueberwachung der Darstellungsvariable der Range.
on envVar P_ASG_10_1_0_27_2_range // Sound_Right.VolumeRight 
{
	@P_ASG_10_1_0_27_2 = @P_ASG_10_1_0_27_2_range - (1); // slider = range - min
}

on envVar P_ASG_10_1_0_27_2 // Sound_Right.VolumeRight
{
	byte superval[2];

	//Update Childvalue (Number)
	byte thisval; // VolumeRight
	float slider_value;

	slider_value = round(@P_ASG_10_1_0_27_2, 1.0);
	@P_ASG_10_1_0_27_2_range = slider_value + (1); // real value := slider value + range min.
	thisval = (byte)round((slider_value + (1) - (1)) / (1.0), 1); // bus value := (slider value + min - offset) / step.

    // Update superval
	getValue(P_ASG_10_1_0_27, superval);
	superval[1]=thisval;
	putValue(P_ASG_10_1_0_27,superval);
}

on envVar P_ASG_10_1_0_28Get_BTN
{
 if (P_ASG_10_1_0_28Get_BTN_already_pressed == 0)
  {
       putValue(P_ASG_10_1_0_28_ErrCode,0);
       SetControlBackColor(panel_name,"errField_P_ASG_10_1_0_28",MakeRGB(255,255,255));
       P_ASG_10_1_0_28Get_BTN_already_pressed = 1;
 }
 else
 {
       Request_Void(LSGID, P_ASG_10_1_0_28_ID, DataGet_REQ); 
       P_ASG_10_1_0_28Get_BTN_already_pressed = 0;
 }
}
on envVar P_ASG_10_1_0_28SetGet_BTN
{
	byte BAPTemp[2];
    if (P_ASG_10_1_0_28SetGet_BTN_already_pressed == 0)
    {
       putValue(P_ASG_10_1_0_28_ErrCode,0);
       SetControlBackColor(panel_name,"errField_P_ASG_10_1_0_28",MakeRGB(255,255,255));
       P_ASG_10_1_0_28SetGet_BTN_already_pressed = 1;
    }
    else
    {
       getValue(P_ASG_10_1_0_28, BAPTemp);
       Request_ByteSequence(LSGID, P_ASG_10_1_0_28_ID, DataSetGet_REQ, BAPTemp, getValueSize(P_ASG_10_1_0_28));
       P_ASG_10_1_0_28SetGet_BTN_already_pressed = 0;
    }
}
on envVar P_ASG_10_1_0_28 // bus value of Sound_Left (28).
{
	// opcodes: Error-Status
	byte param1; // FrequencyLeft
	byte param2; // VolumeLeft
	// DATATYPE_BYTESEQUENCE / DATATYPE_FIXEDBYTESEQUENCE
	int i;
	byte superval[2];
	int currentPos;
	currentPos = 0;
	for( i = 0; i < 2; i++ ) {
		superval[i] = 0;
	}
	getValue(P_ASG_10_1_0_28, superval);
	///////// Start param1 - UINT8 /////////
	param1 = superval[currentPos++];
	putValue(P_ASG_10_1_0_28_1, round((param1 * 1.0) - (1) + (1), 1.0));
	///////// Start param2 - UINT8 /////////
	param2 = superval[currentPos++];
	putValue(P_ASG_10_1_0_28_2, round((param2 * 1.0) - (1) + (1), 1.0));
}

// Ueberwachung der Darstellungsvariable der Range.
on envVar P_ASG_10_1_0_28_1_range // Sound_Left.FrequencyLeft 
{
	@P_ASG_10_1_0_28_1 = @P_ASG_10_1_0_28_1_range - (1); // slider = range - min
}

on envVar P_ASG_10_1_0_28_1 // Sound_Left.FrequencyLeft
{
	byte superval[2];

	//Update Childvalue (Number)
	byte thisval; // FrequencyLeft
	float slider_value;

	slider_value = round(@P_ASG_10_1_0_28_1, 1.0);
	@P_ASG_10_1_0_28_1_range = slider_value + (1); // real value := slider value + range min.
	thisval = (byte)round((slider_value + (1) - (1)) / (1.0), 1); // bus value := (slider value + min - offset) / step.

    // Update superval
	getValue(P_ASG_10_1_0_28, superval);
	superval[0]=thisval;
	putValue(P_ASG_10_1_0_28,superval);
}

// Ueberwachung der Darstellungsvariable der Range.
on envVar P_ASG_10_1_0_28_2_range // Sound_Left.VolumeLeft 
{
	@P_ASG_10_1_0_28_2 = @P_ASG_10_1_0_28_2_range - (1); // slider = range - min
}

on envVar P_ASG_10_1_0_28_2 // Sound_Left.VolumeLeft
{
	byte superval[2];

	//Update Childvalue (Number)
	byte thisval; // VolumeLeft
	float slider_value;

	slider_value = round(@P_ASG_10_1_0_28_2, 1.0);
	@P_ASG_10_1_0_28_2_range = slider_value + (1); // real value := slider value + range min.
	thisval = (byte)round((slider_value + (1) - (1)) / (1.0), 1); // bus value := (slider value + min - offset) / step.

    // Update superval
	getValue(P_ASG_10_1_0_28, superval);
	superval[1]=thisval;
	putValue(P_ASG_10_1_0_28,superval);
}

on envVar P_ASG_10_1_0_29Get_BTN
{
 if (P_ASG_10_1_0_29Get_BTN_already_pressed == 0)
  {
       putValue(P_ASG_10_1_0_29_ErrCode,0);
       SetControlBackColor(panel_name,"errField_P_ASG_10_1_0_29",MakeRGB(255,255,255));
       P_ASG_10_1_0_29Get_BTN_already_pressed = 1;
 }
 else
 {
       Request_Void(LSGID, P_ASG_10_1_0_29_ID, DataGet_REQ); 
       P_ASG_10_1_0_29Get_BTN_already_pressed = 0;
 }
}
on envVar P_ASG_10_1_0_29SetGet_BTN
{
	byte BAPTemp[2];
    if (P_ASG_10_1_0_29SetGet_BTN_already_pressed == 0)
    {
       putValue(P_ASG_10_1_0_29_ErrCode,0);
       SetControlBackColor(panel_name,"errField_P_ASG_10_1_0_29",MakeRGB(255,255,255));
       P_ASG_10_1_0_29SetGet_BTN_already_pressed = 1;
    }
    else
    {
       getValue(P_ASG_10_1_0_29, BAPTemp);
       Request_ByteSequence(LSGID, P_ASG_10_1_0_29_ID, DataSetGet_REQ, BAPTemp, getValueSize(P_ASG_10_1_0_29));
       P_ASG_10_1_0_29SetGet_BTN_already_pressed = 0;
    }
}
on envVar P_ASG_10_1_0_29 // bus value of FlankGuard (29).
{
	// opcodes: Error-Status
	byte param1; // Setup
	byte param2; // ModificationReason
	byte param3; // ModificationState
	// DATATYPE_BYTESEQUENCE / DATATYPE_FIXEDBYTESEQUENCE
	int i;
	byte superval[2];
	int currentPos;
	currentPos = 0;
	for( i = 0; i < 2; i++ ) {
		superval[i] = 0;
	}
	getValue(P_ASG_10_1_0_29, superval);
	///////// Start param1 - UINT8 /////////
	param1 = superval[currentPos++];
	putValue(P_ASG_10_1_0_29_1, param1);
	///////// Start param2 - NIBBLE /////////
	param2 = (superval[currentPos] & 0xf0)>>4;
	putValue(P_ASG_10_1_0_29_2, param2);
	///////// Start param3 - NIBBLE /////////
	param3 = superval[currentPos++] & 0x0f;
	putValue(P_ASG_10_1_0_29_3, param3);
}

on envVar P_ASG_10_1_0_29_1_0
{
	byte bitval;
	//thisval steht hier fuer den bitfield-wert, 
	//aus Generierungsgruenden hier keine einheitliche Bezeichnung moeglich.
	byte thisval; // Setup
	bitval= getValue(this);
	thisval = getValue(P_ASG_10_1_0_29_1);
	thisval = thisval&~(1<<0)|(bitval<<0);
	putValue(P_ASG_10_1_0_29_1,thisval);
}

on envVar P_ASG_10_1_0_29_1 // FlankGuard.Setup
{
	byte superval[2];

	//Update Childvalue (BitField)
	byte mask=0x01;
	int i = 0;
	byte thisval; // Setup
	thisval = getValue(this);
	if(thisval&(mask<<0))
		putValue(P_ASG_10_1_0_29_1_0, 1);
	else
		putValue(P_ASG_10_1_0_29_1_0, 0);

    // Update superval
	getValue(P_ASG_10_1_0_29, superval);
	superval[0]=thisval;
	putValue(P_ASG_10_1_0_29,superval);
}

on envVar P_ASG_10_1_0_29_2 // FlankGuard.ModificationReason
{
	byte superval[2];

	//Update Childvalue (Enum)
	byte thisval; // ModificationReason
	thisval = 0x0f & getValue(this);

    // Update superval
	getValue(P_ASG_10_1_0_29, superval);
	superval[1]= superval[1]&0x0f;
	superval[1]= superval[1]|(thisval<<4);
	putValue(P_ASG_10_1_0_29,superval);
}

on envVar P_ASG_10_1_0_29_3_0
{
	byte bitval;
	//thisval steht hier fuer den bitfield-wert, 
	//aus Generierungsgruenden hier keine einheitliche Bezeichnung moeglich.
	byte thisval; // ModificationState
	bitval= getValue(this);
	thisval = getValue(P_ASG_10_1_0_29_3);
	thisval = thisval&~(1<<0)|(bitval<<0);
	putValue(P_ASG_10_1_0_29_3,thisval);
}

on envVar P_ASG_10_1_0_29_3 // FlankGuard.ModificationState
{
	byte superval[2];

	//Update Childvalue (BitField)
	byte mask=0x01;
	int i = 0;
	byte thisval; // ModificationState
	thisval = getValue(this);
	if(thisval&(mask<<0))
		putValue(P_ASG_10_1_0_29_3_0, 1);
	else
		putValue(P_ASG_10_1_0_29_3_0, 0);

    // Update superval
	getValue(P_ASG_10_1_0_29, superval);
	superval[1]= superval[1]&0xf0;
	superval[1]= superval[1]|thisval;
	putValue(P_ASG_10_1_0_29,superval);
}

on envVar P_ASG_10_1_0_30Get_BTN
{
 if (P_ASG_10_1_0_30Get_BTN_already_pressed == 0)
  {
       putValue(P_ASG_10_1_0_30_ErrCode,0);
       SetControlBackColor(panel_name,"errField_P_ASG_10_1_0_30",MakeRGB(255,255,255));
       P_ASG_10_1_0_30Get_BTN_already_pressed = 1;
 }
 else
 {
       Request_Void(LSGID, P_ASG_10_1_0_30_ID, DataGet_REQ); 
       P_ASG_10_1_0_30Get_BTN_already_pressed = 0;
 }
}
on envVar P_ASG_10_1_0_30 // bus value of CrashWarning (30).
{
	// opcodes: Error-Status
	byte param1; // SectorsFront
	byte param2; // SectorsRear
	byte param3; // SectorsRight
	byte param4; // SectorsLeft
	// DATATYPE_BYTESEQUENCE / DATATYPE_FIXEDBYTESEQUENCE
	int i;
	byte superval[2];
	int currentPos;
	currentPos = 0;
	for( i = 0; i < 2; i++ ) {
		superval[i] = 0;
	}
	getValue(P_ASG_10_1_0_30, superval);
	///////// Start param1 - NIBBLE /////////
	param1 = (superval[currentPos] & 0xf0)>>4;
	putValue(P_ASG_10_1_0_30_1, param1);
	///////// Start param2 - NIBBLE /////////
	param2 = superval[currentPos++] & 0x0f;
	putValue(P_ASG_10_1_0_30_2, param2);
	///////// Start param3 - NIBBLE /////////
	param3 = (superval[currentPos] & 0xf0)>>4;
	putValue(P_ASG_10_1_0_30_3, param3);
	///////// Start param4 - NIBBLE /////////
	param4 = superval[currentPos++] & 0x0f;
	putValue(P_ASG_10_1_0_30_4, param4);
}

on envVar P_ASG_10_1_0_30_1_0
{
	byte bitval;
	//thisval steht hier fuer den bitfield-wert, 
	//aus Generierungsgruenden hier keine einheitliche Bezeichnung moeglich.
	byte thisval; // SectorsFront
	bitval= getValue(this);
	thisval = getValue(P_ASG_10_1_0_30_1);
	thisval = thisval&~(1<<0)|(bitval<<0);
	putValue(P_ASG_10_1_0_30_1,thisval);
}

on envVar P_ASG_10_1_0_30_1_1
{
	byte bitval;
	//thisval steht hier fuer den bitfield-wert, 
	//aus Generierungsgruenden hier keine einheitliche Bezeichnung moeglich.
	byte thisval; // SectorsFront
	bitval= getValue(this);
	thisval = getValue(P_ASG_10_1_0_30_1);
	thisval = thisval&~(1<<1)|(bitval<<1);
	putValue(P_ASG_10_1_0_30_1,thisval);
}

on envVar P_ASG_10_1_0_30_1_2
{
	byte bitval;
	//thisval steht hier fuer den bitfield-wert, 
	//aus Generierungsgruenden hier keine einheitliche Bezeichnung moeglich.
	byte thisval; // SectorsFront
	bitval= getValue(this);
	thisval = getValue(P_ASG_10_1_0_30_1);
	thisval = thisval&~(1<<2)|(bitval<<2);
	putValue(P_ASG_10_1_0_30_1,thisval);
}

on envVar P_ASG_10_1_0_30_1_3
{
	byte bitval;
	//thisval steht hier fuer den bitfield-wert, 
	//aus Generierungsgruenden hier keine einheitliche Bezeichnung moeglich.
	byte thisval; // SectorsFront
	bitval= getValue(this);
	thisval = getValue(P_ASG_10_1_0_30_1);
	thisval = thisval&~(1<<3)|(bitval<<3);
	putValue(P_ASG_10_1_0_30_1,thisval);
}

on envVar P_ASG_10_1_0_30_1 // CrashWarning.SectorsFront
{
	byte superval[2];

	//Update Childvalue (BitField)
	byte mask=0x01;
	int i = 0;
	byte thisval; // SectorsFront
	thisval = getValue(this);
	if(thisval&(mask<<0))
		putValue(P_ASG_10_1_0_30_1_0, 1);
	else
		putValue(P_ASG_10_1_0_30_1_0, 0);
	if(thisval&(mask<<1))
		putValue(P_ASG_10_1_0_30_1_1, 1);
	else
		putValue(P_ASG_10_1_0_30_1_1, 0);
	if(thisval&(mask<<2))
		putValue(P_ASG_10_1_0_30_1_2, 1);
	else
		putValue(P_ASG_10_1_0_30_1_2, 0);
	if(thisval&(mask<<3))
		putValue(P_ASG_10_1_0_30_1_3, 1);
	else
		putValue(P_ASG_10_1_0_30_1_3, 0);

    // Update superval
	getValue(P_ASG_10_1_0_30, superval);
	superval[0]= superval[0]&0x0f;
	superval[0]= superval[0]|(thisval<<4);
	putValue(P_ASG_10_1_0_30,superval);
}

on envVar P_ASG_10_1_0_30_2_0
{
	byte bitval;
	//thisval steht hier fuer den bitfield-wert, 
	//aus Generierungsgruenden hier keine einheitliche Bezeichnung moeglich.
	byte thisval; // SectorsRear
	bitval= getValue(this);
	thisval = getValue(P_ASG_10_1_0_30_2);
	thisval = thisval&~(1<<0)|(bitval<<0);
	putValue(P_ASG_10_1_0_30_2,thisval);
}

on envVar P_ASG_10_1_0_30_2_1
{
	byte bitval;
	//thisval steht hier fuer den bitfield-wert, 
	//aus Generierungsgruenden hier keine einheitliche Bezeichnung moeglich.
	byte thisval; // SectorsRear
	bitval= getValue(this);
	thisval = getValue(P_ASG_10_1_0_30_2);
	thisval = thisval&~(1<<1)|(bitval<<1);
	putValue(P_ASG_10_1_0_30_2,thisval);
}

on envVar P_ASG_10_1_0_30_2_2
{
	byte bitval;
	//thisval steht hier fuer den bitfield-wert, 
	//aus Generierungsgruenden hier keine einheitliche Bezeichnung moeglich.
	byte thisval; // SectorsRear
	bitval= getValue(this);
	thisval = getValue(P_ASG_10_1_0_30_2);
	thisval = thisval&~(1<<2)|(bitval<<2);
	putValue(P_ASG_10_1_0_30_2,thisval);
}

on envVar P_ASG_10_1_0_30_2_3
{
	byte bitval;
	//thisval steht hier fuer den bitfield-wert, 
	//aus Generierungsgruenden hier keine einheitliche Bezeichnung moeglich.
	byte thisval; // SectorsRear
	bitval= getValue(this);
	thisval = getValue(P_ASG_10_1_0_30_2);
	thisval = thisval&~(1<<3)|(bitval<<3);
	putValue(P_ASG_10_1_0_30_2,thisval);
}

on envVar P_ASG_10_1_0_30_2 // CrashWarning.SectorsRear
{
	byte superval[2];

	//Update Childvalue (BitField)
	byte mask=0x01;
	int i = 0;
	byte thisval; // SectorsRear
	thisval = getValue(this);
	if(thisval&(mask<<0))
		putValue(P_ASG_10_1_0_30_2_0, 1);
	else
		putValue(P_ASG_10_1_0_30_2_0, 0);
	if(thisval&(mask<<1))
		putValue(P_ASG_10_1_0_30_2_1, 1);
	else
		putValue(P_ASG_10_1_0_30_2_1, 0);
	if(thisval&(mask<<2))
		putValue(P_ASG_10_1_0_30_2_2, 1);
	else
		putValue(P_ASG_10_1_0_30_2_2, 0);
	if(thisval&(mask<<3))
		putValue(P_ASG_10_1_0_30_2_3, 1);
	else
		putValue(P_ASG_10_1_0_30_2_3, 0);

    // Update superval
	getValue(P_ASG_10_1_0_30, superval);
	superval[0]= superval[0]&0xf0;
	superval[0]= superval[0]|thisval;
	putValue(P_ASG_10_1_0_30,superval);
}

on envVar P_ASG_10_1_0_30_3_0
{
	byte bitval;
	//thisval steht hier fuer den bitfield-wert, 
	//aus Generierungsgruenden hier keine einheitliche Bezeichnung moeglich.
	byte thisval; // SectorsRight
	bitval= getValue(this);
	thisval = getValue(P_ASG_10_1_0_30_3);
	thisval = thisval&~(1<<0)|(bitval<<0);
	putValue(P_ASG_10_1_0_30_3,thisval);
}

on envVar P_ASG_10_1_0_30_3_1
{
	byte bitval;
	//thisval steht hier fuer den bitfield-wert, 
	//aus Generierungsgruenden hier keine einheitliche Bezeichnung moeglich.
	byte thisval; // SectorsRight
	bitval= getValue(this);
	thisval = getValue(P_ASG_10_1_0_30_3);
	thisval = thisval&~(1<<1)|(bitval<<1);
	putValue(P_ASG_10_1_0_30_3,thisval);
}

on envVar P_ASG_10_1_0_30_3_2
{
	byte bitval;
	//thisval steht hier fuer den bitfield-wert, 
	//aus Generierungsgruenden hier keine einheitliche Bezeichnung moeglich.
	byte thisval; // SectorsRight
	bitval= getValue(this);
	thisval = getValue(P_ASG_10_1_0_30_3);
	thisval = thisval&~(1<<2)|(bitval<<2);
	putValue(P_ASG_10_1_0_30_3,thisval);
}

on envVar P_ASG_10_1_0_30_3_3
{
	byte bitval;
	//thisval steht hier fuer den bitfield-wert, 
	//aus Generierungsgruenden hier keine einheitliche Bezeichnung moeglich.
	byte thisval; // SectorsRight
	bitval= getValue(this);
	thisval = getValue(P_ASG_10_1_0_30_3);
	thisval = thisval&~(1<<3)|(bitval<<3);
	putValue(P_ASG_10_1_0_30_3,thisval);
}

on envVar P_ASG_10_1_0_30_3 // CrashWarning.SectorsRight
{
	byte superval[2];

	//Update Childvalue (BitField)
	byte mask=0x01;
	int i = 0;
	byte thisval; // SectorsRight
	thisval = getValue(this);
	if(thisval&(mask<<0))
		putValue(P_ASG_10_1_0_30_3_0, 1);
	else
		putValue(P_ASG_10_1_0_30_3_0, 0);
	if(thisval&(mask<<1))
		putValue(P_ASG_10_1_0_30_3_1, 1);
	else
		putValue(P_ASG_10_1_0_30_3_1, 0);
	if(thisval&(mask<<2))
		putValue(P_ASG_10_1_0_30_3_2, 1);
	else
		putValue(P_ASG_10_1_0_30_3_2, 0);
	if(thisval&(mask<<3))
		putValue(P_ASG_10_1_0_30_3_3, 1);
	else
		putValue(P_ASG_10_1_0_30_3_3, 0);

    // Update superval
	getValue(P_ASG_10_1_0_30, superval);
	superval[1]= superval[1]&0x0f;
	superval[1]= superval[1]|(thisval<<4);
	putValue(P_ASG_10_1_0_30,superval);
}

on envVar P_ASG_10_1_0_30_4_0
{
	byte bitval;
	//thisval steht hier fuer den bitfield-wert, 
	//aus Generierungsgruenden hier keine einheitliche Bezeichnung moeglich.
	byte thisval; // SectorsLeft
	bitval= getValue(this);
	thisval = getValue(P_ASG_10_1_0_30_4);
	thisval = thisval&~(1<<0)|(bitval<<0);
	putValue(P_ASG_10_1_0_30_4,thisval);
}

on envVar P_ASG_10_1_0_30_4_1
{
	byte bitval;
	//thisval steht hier fuer den bitfield-wert, 
	//aus Generierungsgruenden hier keine einheitliche Bezeichnung moeglich.
	byte thisval; // SectorsLeft
	bitval= getValue(this);
	thisval = getValue(P_ASG_10_1_0_30_4);
	thisval = thisval&~(1<<1)|(bitval<<1);
	putValue(P_ASG_10_1_0_30_4,thisval);
}

on envVar P_ASG_10_1_0_30_4_2
{
	byte bitval;
	//thisval steht hier fuer den bitfield-wert, 
	//aus Generierungsgruenden hier keine einheitliche Bezeichnung moeglich.
	byte thisval; // SectorsLeft
	bitval= getValue(this);
	thisval = getValue(P_ASG_10_1_0_30_4);
	thisval = thisval&~(1<<2)|(bitval<<2);
	putValue(P_ASG_10_1_0_30_4,thisval);
}

on envVar P_ASG_10_1_0_30_4_3
{
	byte bitval;
	//thisval steht hier fuer den bitfield-wert, 
	//aus Generierungsgruenden hier keine einheitliche Bezeichnung moeglich.
	byte thisval; // SectorsLeft
	bitval= getValue(this);
	thisval = getValue(P_ASG_10_1_0_30_4);
	thisval = thisval&~(1<<3)|(bitval<<3);
	putValue(P_ASG_10_1_0_30_4,thisval);
}

on envVar P_ASG_10_1_0_30_4 // CrashWarning.SectorsLeft
{
	byte superval[2];

	//Update Childvalue (BitField)
	byte mask=0x01;
	int i = 0;
	byte thisval; // SectorsLeft
	thisval = getValue(this);
	if(thisval&(mask<<0))
		putValue(P_ASG_10_1_0_30_4_0, 1);
	else
		putValue(P_ASG_10_1_0_30_4_0, 0);
	if(thisval&(mask<<1))
		putValue(P_ASG_10_1_0_30_4_1, 1);
	else
		putValue(P_ASG_10_1_0_30_4_1, 0);
	if(thisval&(mask<<2))
		putValue(P_ASG_10_1_0_30_4_2, 1);
	else
		putValue(P_ASG_10_1_0_30_4_2, 0);
	if(thisval&(mask<<3))
		putValue(P_ASG_10_1_0_30_4_3, 1);
	else
		putValue(P_ASG_10_1_0_30_4_3, 0);

    // Update superval
	getValue(P_ASG_10_1_0_30, superval);
	superval[1]= superval[1]&0xf0;
	superval[1]= superval[1]|thisval;
	putValue(P_ASG_10_1_0_30,superval);
}

on envVar P_ASG_10_1_0_31Get_BTN
{
 if (P_ASG_10_1_0_31Get_BTN_already_pressed == 0)
  {
       putValue(P_ASG_10_1_0_31_ErrCode,0);
       SetControlBackColor(panel_name,"errField_P_ASG_10_1_0_31",MakeRGB(255,255,255));
       P_ASG_10_1_0_31Get_BTN_already_pressed = 1;
 }
 else
 {
       Request_Void(LSGID, P_ASG_10_1_0_31_ID, DataGet_REQ); 
       P_ASG_10_1_0_31Get_BTN_already_pressed = 0;
 }
}
on envVar P_ASG_10_1_0_31 // bus value of SteeringInformation (31).
{
	// opcodes: Error-Status
	byte param1; // AdditionalInfo
	byte param2; // TrackDisplay
	byte param3; // Direction
	word param4; // RadiusRearWheel
	word param5; // RadiusFrontWheel
	// DATATYPE_BYTESEQUENCE / DATATYPE_FIXEDBYTESEQUENCE
	int i;
	byte superval[6];
	int currentPos;
	currentPos = 0;
	for( i = 0; i < 6; i++ ) {
		superval[i] = 0;
	}
	getValue(P_ASG_10_1_0_31, superval);
	///////// Start param1 - UINT8 /////////
	param1 = superval[currentPos++];
	putValue(P_ASG_10_1_0_31_1, param1);
	///////// Start param2 - NIBBLE /////////
	param2 = (superval[currentPos] & 0xf0)>>4;
	putValue(P_ASG_10_1_0_31_2, param2);
	///////// Start param3 - NIBBLE /////////
	param3 = superval[currentPos++] & 0x0f;
	putValue(P_ASG_10_1_0_31_3, param3);
	///////// Start param4 - UINT16 /////////
	param4 = superval[currentPos++]|(superval[currentPos++]<<8);
	putValue(P_ASG_10_1_0_31_4, round((param4 * 1.0) - (0) + (0), 1.0));
	///////// Start param5 - UINT16 /////////
	param5 = superval[currentPos++]|(superval[currentPos++]<<8);
	putValue(P_ASG_10_1_0_31_5, round((param5 * 1.0) - (0) + (0), 1.0));
}

on envVar P_ASG_10_1_0_31_1_0
{
	byte bitval;
	//thisval steht hier fuer den bitfield-wert, 
	//aus Generierungsgruenden hier keine einheitliche Bezeichnung moeglich.
	byte thisval; // AdditionalInfo
	bitval= getValue(this);
	thisval = getValue(P_ASG_10_1_0_31_1);
	thisval = thisval&~(1<<0)|(bitval<<0);
	putValue(P_ASG_10_1_0_31_1,thisval);
}

on envVar P_ASG_10_1_0_31_1 // SteeringInformation.AdditionalInfo
{
	byte superval[6];

	//Update Childvalue (BitField)
	byte mask=0x01;
	int i = 0;
	byte thisval; // AdditionalInfo
	thisval = getValue(this);
	if(thisval&(mask<<0))
		putValue(P_ASG_10_1_0_31_1_0, 1);
	else
		putValue(P_ASG_10_1_0_31_1_0, 0);

    // Update superval
	getValue(P_ASG_10_1_0_31, superval);
	superval[0]=thisval;
	putValue(P_ASG_10_1_0_31,superval);
}

on envVar P_ASG_10_1_0_31_2 // SteeringInformation.TrackDisplay
{
	byte superval[6];

	//Update Childvalue (Enum)
	byte thisval; // TrackDisplay
	thisval = 0x0f & getValue(this);

    // Update superval
	getValue(P_ASG_10_1_0_31, superval);
	superval[1]= superval[1]&0x0f;
	superval[1]= superval[1]|(thisval<<4);
	putValue(P_ASG_10_1_0_31,superval);
}

on envVar P_ASG_10_1_0_31_3 // SteeringInformation.Direction
{
	byte superval[6];

	//Update Childvalue (Enum)
	byte thisval; // Direction
	thisval = 0x0f & getValue(this);

    // Update superval
	getValue(P_ASG_10_1_0_31, superval);
	superval[1]= superval[1]&0xf0;
	superval[1]= superval[1]|thisval;
	putValue(P_ASG_10_1_0_31,superval);
}

// Ueberwachung der Darstellungsvariable der Range.
on envVar P_ASG_10_1_0_31_4_range // SteeringInformation.RadiusRearWheel 
{
	@P_ASG_10_1_0_31_4 = @P_ASG_10_1_0_31_4_range - (0); // slider = range - min
}

on envVar P_ASG_10_1_0_31_4 // SteeringInformation.RadiusRearWheel
{
	byte superval[6];

	//Update Childvalue (Number)
	word thisval; // RadiusRearWheel
	float slider_value;

	slider_value = round(@P_ASG_10_1_0_31_4, 1.0);
	@P_ASG_10_1_0_31_4_range = slider_value + (0); // real value := slider value + range min.
	thisval = (word)round((slider_value + (0) - (0)) / (1.0), 1); // bus value := (slider value + min - offset) / step.

    // Update superval
	getValue(P_ASG_10_1_0_31, superval);
	superval[2]=thisval&0x00ff;
	superval[3]=(thisval&0xff00)>>8;
	putValue(P_ASG_10_1_0_31,superval);
}

// Ueberwachung der Darstellungsvariable der Range.
on envVar P_ASG_10_1_0_31_5_range // SteeringInformation.RadiusFrontWheel 
{
	@P_ASG_10_1_0_31_5 = @P_ASG_10_1_0_31_5_range - (0); // slider = range - min
}

on envVar P_ASG_10_1_0_31_5 // SteeringInformation.RadiusFrontWheel
{
	byte superval[6];

	//Update Childvalue (Number)
	word thisval; // RadiusFrontWheel
	float slider_value;

	slider_value = round(@P_ASG_10_1_0_31_5, 1.0);
	@P_ASG_10_1_0_31_5_range = slider_value + (0); // real value := slider value + range min.
	thisval = (word)round((slider_value + (0) - (0)) / (1.0), 1); // bus value := (slider value + min - offset) / step.

    // Update superval
	getValue(P_ASG_10_1_0_31, superval);
	superval[4]=thisval&0x00ff;
	superval[5]=(thisval&0xff00)>>8;
	putValue(P_ASG_10_1_0_31,superval);
}

on envVar P_ASG_10_1_0_32Get_BTN
{
 if (P_ASG_10_1_0_32Get_BTN_already_pressed == 0)
  {
       putValue(P_ASG_10_1_0_32_ErrCode,0);
       SetControlBackColor(panel_name,"errField_P_ASG_10_1_0_32",MakeRGB(255,255,255));
       P_ASG_10_1_0_32Get_BTN_already_pressed = 1;
 }
 else
 {
       Request_Void(LSGID, P_ASG_10_1_0_32_ID, DataGet_REQ); 
       P_ASG_10_1_0_32Get_BTN_already_pressed = 0;
 }
}
on envVar P_ASG_10_1_0_32SetGet_BTN
{
	byte BAPTemp[2];
    if (P_ASG_10_1_0_32SetGet_BTN_already_pressed == 0)
    {
       putValue(P_ASG_10_1_0_32_ErrCode,0);
       SetControlBackColor(panel_name,"errField_P_ASG_10_1_0_32",MakeRGB(255,255,255));
       P_ASG_10_1_0_32SetGet_BTN_already_pressed = 1;
    }
    else
    {
       getValue(P_ASG_10_1_0_32, BAPTemp);
       Request_ByteSequence(LSGID, P_ASG_10_1_0_32_ID, DataSetGet_REQ, BAPTemp, getValueSize(P_ASG_10_1_0_32));
       P_ASG_10_1_0_32SetGet_BTN_already_pressed = 0;
    }
}
on envVar P_ASG_10_1_0_32 // bus value of SoundReproduction (32).
{
	// opcodes: Error-Status
	byte param1; // Setup
	byte param2; // ModificationReason
	byte param3; // ModificationState
	// DATATYPE_BYTESEQUENCE / DATATYPE_FIXEDBYTESEQUENCE
	int i;
	byte superval[2];
	int currentPos;
	currentPos = 0;
	for( i = 0; i < 2; i++ ) {
		superval[i] = 0;
	}
	getValue(P_ASG_10_1_0_32, superval);
	///////// Start param1 - UINT8 /////////
	param1 = superval[currentPos++];
	putValue(P_ASG_10_1_0_32_1, param1);
	///////// Start param2 - NIBBLE /////////
	param2 = (superval[currentPos] & 0xf0)>>4;
	putValue(P_ASG_10_1_0_32_2, param2);
	///////// Start param3 - NIBBLE /////////
	param3 = superval[currentPos++] & 0x0f;
	putValue(P_ASG_10_1_0_32_3, param3);
}

on envVar P_ASG_10_1_0_32_1_0
{
	byte bitval;
	//thisval steht hier fuer den bitfield-wert, 
	//aus Generierungsgruenden hier keine einheitliche Bezeichnung moeglich.
	byte thisval; // Setup
	bitval= getValue(this);
	thisval = getValue(P_ASG_10_1_0_32_1);
	thisval = thisval&~(1<<0)|(bitval<<0);
	putValue(P_ASG_10_1_0_32_1,thisval);
}

on envVar P_ASG_10_1_0_32_1_1
{
	byte bitval;
	//thisval steht hier fuer den bitfield-wert, 
	//aus Generierungsgruenden hier keine einheitliche Bezeichnung moeglich.
	byte thisval; // Setup
	bitval= getValue(this);
	thisval = getValue(P_ASG_10_1_0_32_1);
	thisval = thisval&~(1<<1)|(bitval<<1);
	putValue(P_ASG_10_1_0_32_1,thisval);
}

on envVar P_ASG_10_1_0_32_1_2
{
	byte bitval;
	//thisval steht hier fuer den bitfield-wert, 
	//aus Generierungsgruenden hier keine einheitliche Bezeichnung moeglich.
	byte thisval; // Setup
	bitval= getValue(this);
	thisval = getValue(P_ASG_10_1_0_32_1);
	thisval = thisval&~(1<<2)|(bitval<<2);
	putValue(P_ASG_10_1_0_32_1,thisval);
}

on envVar P_ASG_10_1_0_32_1_3
{
	byte bitval;
	//thisval steht hier fuer den bitfield-wert, 
	//aus Generierungsgruenden hier keine einheitliche Bezeichnung moeglich.
	byte thisval; // Setup
	bitval= getValue(this);
	thisval = getValue(P_ASG_10_1_0_32_1);
	thisval = thisval&~(1<<3)|(bitval<<3);
	putValue(P_ASG_10_1_0_32_1,thisval);
}

on envVar P_ASG_10_1_0_32_1 // SoundReproduction.Setup
{
	byte superval[2];

	//Update Childvalue (BitField)
	byte mask=0x01;
	int i = 0;
	byte thisval; // Setup
	thisval = getValue(this);
	if(thisval&(mask<<0))
		putValue(P_ASG_10_1_0_32_1_0, 1);
	else
		putValue(P_ASG_10_1_0_32_1_0, 0);
	if(thisval&(mask<<1))
		putValue(P_ASG_10_1_0_32_1_1, 1);
	else
		putValue(P_ASG_10_1_0_32_1_1, 0);
	if(thisval&(mask<<2))
		putValue(P_ASG_10_1_0_32_1_2, 1);
	else
		putValue(P_ASG_10_1_0_32_1_2, 0);
	if(thisval&(mask<<3))
		putValue(P_ASG_10_1_0_32_1_3, 1);
	else
		putValue(P_ASG_10_1_0_32_1_3, 0);

    // Update superval
	getValue(P_ASG_10_1_0_32, superval);
	superval[0]=thisval;
	putValue(P_ASG_10_1_0_32,superval);
}

on envVar P_ASG_10_1_0_32_2 // SoundReproduction.ModificationReason
{
	byte superval[2];

	//Update Childvalue (Enum)
	byte thisval; // ModificationReason
	thisval = 0x0f & getValue(this);

    // Update superval
	getValue(P_ASG_10_1_0_32, superval);
	superval[1]= superval[1]&0x0f;
	superval[1]= superval[1]|(thisval<<4);
	putValue(P_ASG_10_1_0_32,superval);
}

on envVar P_ASG_10_1_0_32_3_0
{
	byte bitval;
	//thisval steht hier fuer den bitfield-wert, 
	//aus Generierungsgruenden hier keine einheitliche Bezeichnung moeglich.
	byte thisval; // ModificationState
	bitval= getValue(this);
	thisval = getValue(P_ASG_10_1_0_32_3);
	thisval = thisval&~(1<<0)|(bitval<<0);
	putValue(P_ASG_10_1_0_32_3,thisval);
}

on envVar P_ASG_10_1_0_32_3 // SoundReproduction.ModificationState
{
	byte superval[2];

	//Update Childvalue (BitField)
	byte mask=0x01;
	int i = 0;
	byte thisval; // ModificationState
	thisval = getValue(this);
	if(thisval&(mask<<0))
		putValue(P_ASG_10_1_0_32_3_0, 1);
	else
		putValue(P_ASG_10_1_0_32_3_0, 0);

    // Update superval
	getValue(P_ASG_10_1_0_32, superval);
	superval[1]= superval[1]&0xf0;
	superval[1]= superval[1]|thisval;
	putValue(P_ASG_10_1_0_32,superval);
}

on envVar P_ASG_10_1_0_33Get_BTN
{
 if (P_ASG_10_1_0_33Get_BTN_already_pressed == 0)
  {
       putValue(P_ASG_10_1_0_33_ErrCode,0);
       SetControlBackColor(panel_name,"errField_P_ASG_10_1_0_33",MakeRGB(255,255,255));
       P_ASG_10_1_0_33Get_BTN_already_pressed = 1;
 }
 else
 {
       Request_Void(LSGID, P_ASG_10_1_0_33_ID, DataGet_REQ); 
       P_ASG_10_1_0_33Get_BTN_already_pressed = 0;
 }
}
on envVar P_ASG_10_1_0_33 // bus value of Info (33).
{
	// opcodes: Error-Status
	word param1; // Information
	// DATATYPE_UINTXX
	param1 = getValue(P_ASG_10_1_0_33);
	putValue(P_ASG_10_1_0_33_1, param1);
}

on envVar P_ASG_10_1_0_33_1_0
{
	byte bitval;
	//thisval steht hier fuer den bitfield-wert, 
	//aus Generierungsgruenden hier keine einheitliche Bezeichnung moeglich.
	word thisval; // Information
	bitval= getValue(this);
	thisval = getValue(P_ASG_10_1_0_33_1);
	thisval = thisval&~(1<<0)|(bitval<<0);
	putValue(P_ASG_10_1_0_33_1,thisval);
}

on envVar P_ASG_10_1_0_33_1_1
{
	byte bitval;
	//thisval steht hier fuer den bitfield-wert, 
	//aus Generierungsgruenden hier keine einheitliche Bezeichnung moeglich.
	word thisval; // Information
	bitval= getValue(this);
	thisval = getValue(P_ASG_10_1_0_33_1);
	thisval = thisval&~(1<<1)|(bitval<<1);
	putValue(P_ASG_10_1_0_33_1,thisval);
}

on envVar P_ASG_10_1_0_33_1 // Info.Information
{
	word superval;

	//Update Childvalue (BitField)
	byte mask=0x01;
	int i = 0;
	word thisval; // Information
	thisval = getValue(this);
	if(thisval&(mask<<0))
		putValue(P_ASG_10_1_0_33_1_0, 1);
	else
		putValue(P_ASG_10_1_0_33_1_0, 0);
	if(thisval&(mask<<1))
		putValue(P_ASG_10_1_0_33_1_1, 1);
	else
		putValue(P_ASG_10_1_0_33_1_1, 0);

    // Update superval
	superval = getValue(P_ASG_10_1_0_33);
	superval = thisval;
	putValue(P_ASG_10_1_0_33,superval);
}

on envVar P_ASG_10_1_0_34Get_BTN
{
 if (P_ASG_10_1_0_34Get_BTN_already_pressed == 0)
  {
       putValue(P_ASG_10_1_0_34_ErrCode,0);
       SetControlBackColor(panel_name,"errField_P_ASG_10_1_0_34",MakeRGB(255,255,255));
       P_ASG_10_1_0_34Get_BTN_already_pressed = 1;
 }
 else
 {
       Request_Void(LSGID, P_ASG_10_1_0_34_ID, DataGet_REQ); 
       P_ASG_10_1_0_34Get_BTN_already_pressed = 0;
 }
}
on envVar P_ASG_10_1_0_34 // bus value of Spacing_Front_Extended (34).
{
	// opcodes: Error-Status
	byte param1; // Spacing5
	byte param2; // Spacing6
	byte param3; // Spacing7
	byte param4; // Spacing8
	byte param5; // StatusLevel5
	byte param6; // StatusLevel6
	byte param7; // StatusLevel7
	byte param8; // StatusLevel8
	// DATATYPE_BYTESEQUENCE / DATATYPE_FIXEDBYTESEQUENCE
	int i;
	byte superval[6];
	int currentPos;
	currentPos = 0;
	for( i = 0; i < 6; i++ ) {
		superval[i] = 0;
	}
	getValue(P_ASG_10_1_0_34, superval);
	///////// Start param1 - UINT8 /////////
	param1 = superval[currentPos++];
	putValue(P_ASG_10_1_0_34_1, round((param1 * 1.0) - (0) + (0), 1.0));
	///////// Start param2 - UINT8 /////////
	param2 = superval[currentPos++];
	putValue(P_ASG_10_1_0_34_2, round((param2 * 1.0) - (0) + (0), 1.0));
	///////// Start param3 - UINT8 /////////
	param3 = superval[currentPos++];
	putValue(P_ASG_10_1_0_34_3, round((param3 * 1.0) - (0) + (0), 1.0));
	///////// Start param4 - UINT8 /////////
	param4 = superval[currentPos++];
	putValue(P_ASG_10_1_0_34_4, round((param4 * 1.0) - (0) + (0), 1.0));
	///////// Start param5 - NIBBLE /////////
	param5 = (superval[currentPos] & 0xf0)>>4;
	putValue(P_ASG_10_1_0_34_5, param5);
	///////// Start param6 - NIBBLE /////////
	param6 = superval[currentPos++] & 0x0f;
	putValue(P_ASG_10_1_0_34_6, param6);
	///////// Start param7 - NIBBLE /////////
	param7 = (superval[currentPos] & 0xf0)>>4;
	putValue(P_ASG_10_1_0_34_7, param7);
	///////// Start param8 - NIBBLE /////////
	param8 = superval[currentPos++] & 0x0f;
	putValue(P_ASG_10_1_0_34_8, param8);
}

// Ueberwachung der Darstellungsvariable der Range.
on envVar P_ASG_10_1_0_34_1_range // Spacing_Front_Extended.Spacing5 
{
	@P_ASG_10_1_0_34_1 = @P_ASG_10_1_0_34_1_range - (0); // slider = range - min
}

on envVar P_ASG_10_1_0_34_1 // Spacing_Front_Extended.Spacing5
{
	byte superval[6];

	//Update Childvalue (Number)
	byte thisval; // Spacing5
	float slider_value;

	slider_value = round(@P_ASG_10_1_0_34_1, 1.0);
	@P_ASG_10_1_0_34_1_range = slider_value + (0); // real value := slider value + range min.
	thisval = (byte)round((slider_value + (0) - (0)) / (1.0), 1); // bus value := (slider value + min - offset) / step.

    // Update superval
	getValue(P_ASG_10_1_0_34, superval);
	superval[0]=thisval;
	putValue(P_ASG_10_1_0_34,superval);
}

// Ueberwachung der Darstellungsvariable der Range.
on envVar P_ASG_10_1_0_34_2_range // Spacing_Front_Extended.Spacing6 
{
	@P_ASG_10_1_0_34_2 = @P_ASG_10_1_0_34_2_range - (0); // slider = range - min
}

on envVar P_ASG_10_1_0_34_2 // Spacing_Front_Extended.Spacing6
{
	byte superval[6];

	//Update Childvalue (Number)
	byte thisval; // Spacing6
	float slider_value;

	slider_value = round(@P_ASG_10_1_0_34_2, 1.0);
	@P_ASG_10_1_0_34_2_range = slider_value + (0); // real value := slider value + range min.
	thisval = (byte)round((slider_value + (0) - (0)) / (1.0), 1); // bus value := (slider value + min - offset) / step.

    // Update superval
	getValue(P_ASG_10_1_0_34, superval);
	superval[1]=thisval;
	putValue(P_ASG_10_1_0_34,superval);
}

// Ueberwachung der Darstellungsvariable der Range.
on envVar P_ASG_10_1_0_34_3_range // Spacing_Front_Extended.Spacing7 
{
	@P_ASG_10_1_0_34_3 = @P_ASG_10_1_0_34_3_range - (0); // slider = range - min
}

on envVar P_ASG_10_1_0_34_3 // Spacing_Front_Extended.Spacing7
{
	byte superval[6];

	//Update Childvalue (Number)
	byte thisval; // Spacing7
	float slider_value;

	slider_value = round(@P_ASG_10_1_0_34_3, 1.0);
	@P_ASG_10_1_0_34_3_range = slider_value + (0); // real value := slider value + range min.
	thisval = (byte)round((slider_value + (0) - (0)) / (1.0), 1); // bus value := (slider value + min - offset) / step.

    // Update superval
	getValue(P_ASG_10_1_0_34, superval);
	superval[2]=thisval;
	putValue(P_ASG_10_1_0_34,superval);
}

// Ueberwachung der Darstellungsvariable der Range.
on envVar P_ASG_10_1_0_34_4_range // Spacing_Front_Extended.Spacing8 
{
	@P_ASG_10_1_0_34_4 = @P_ASG_10_1_0_34_4_range - (0); // slider = range - min
}

on envVar P_ASG_10_1_0_34_4 // Spacing_Front_Extended.Spacing8
{
	byte superval[6];

	//Update Childvalue (Number)
	byte thisval; // Spacing8
	float slider_value;

	slider_value = round(@P_ASG_10_1_0_34_4, 1.0);
	@P_ASG_10_1_0_34_4_range = slider_value + (0); // real value := slider value + range min.
	thisval = (byte)round((slider_value + (0) - (0)) / (1.0), 1); // bus value := (slider value + min - offset) / step.

    // Update superval
	getValue(P_ASG_10_1_0_34, superval);
	superval[3]=thisval;
	putValue(P_ASG_10_1_0_34,superval);
}

on envVar P_ASG_10_1_0_34_5 // Spacing_Front_Extended.StatusLevel5
{
	byte superval[6];

	//Update Childvalue (Enum)
	byte thisval; // StatusLevel5
	thisval = 0x0f & getValue(this);

    // Update superval
	getValue(P_ASG_10_1_0_34, superval);
	superval[4]= superval[4]&0x0f;
	superval[4]= superval[4]|(thisval<<4);
	putValue(P_ASG_10_1_0_34,superval);
}

on envVar P_ASG_10_1_0_34_6 // Spacing_Front_Extended.StatusLevel6
{
	byte superval[6];

	//Update Childvalue (Enum)
	byte thisval; // StatusLevel6
	thisval = 0x0f & getValue(this);

    // Update superval
	getValue(P_ASG_10_1_0_34, superval);
	superval[4]= superval[4]&0xf0;
	superval[4]= superval[4]|thisval;
	putValue(P_ASG_10_1_0_34,superval);
}

on envVar P_ASG_10_1_0_34_7 // Spacing_Front_Extended.StatusLevel7
{
	byte superval[6];

	//Update Childvalue (Enum)
	byte thisval; // StatusLevel7
	thisval = 0x0f & getValue(this);

    // Update superval
	getValue(P_ASG_10_1_0_34, superval);
	superval[5]= superval[5]&0x0f;
	superval[5]= superval[5]|(thisval<<4);
	putValue(P_ASG_10_1_0_34,superval);
}

on envVar P_ASG_10_1_0_34_8 // Spacing_Front_Extended.StatusLevel8
{
	byte superval[6];

	//Update Childvalue (Enum)
	byte thisval; // StatusLevel8
	thisval = 0x0f & getValue(this);

    // Update superval
	getValue(P_ASG_10_1_0_34, superval);
	superval[5]= superval[5]&0xf0;
	superval[5]= superval[5]|thisval;
	putValue(P_ASG_10_1_0_34,superval);
}

on envVar P_ASG_10_1_0_35Get_BTN
{
 if (P_ASG_10_1_0_35Get_BTN_already_pressed == 0)
  {
       putValue(P_ASG_10_1_0_35_ErrCode,0);
       SetControlBackColor(panel_name,"errField_P_ASG_10_1_0_35",MakeRGB(255,255,255));
       P_ASG_10_1_0_35Get_BTN_already_pressed = 1;
 }
 else
 {
       Request_Void(LSGID, P_ASG_10_1_0_35_ID, DataGet_REQ); 
       P_ASG_10_1_0_35Get_BTN_already_pressed = 0;
 }
}
on envVar P_ASG_10_1_0_35 // bus value of Spacing_Rear_Extended (35).
{
	// opcodes: Error-Status
	byte param1; // Spacing5
	byte param2; // Spacing6
	byte param3; // Spacing7
	byte param4; // Spacing8
	byte param5; // StatusLevel5
	byte param6; // StatusLevel6
	byte param7; // StatusLevel7
	byte param8; // StatusLevel8
	// DATATYPE_BYTESEQUENCE / DATATYPE_FIXEDBYTESEQUENCE
	int i;
	byte superval[6];
	int currentPos;
	currentPos = 0;
	for( i = 0; i < 6; i++ ) {
		superval[i] = 0;
	}
	getValue(P_ASG_10_1_0_35, superval);
	///////// Start param1 - UINT8 /////////
	param1 = superval[currentPos++];
	putValue(P_ASG_10_1_0_35_1, round((param1 * 1.0) - (0) + (0), 1.0));
	///////// Start param2 - UINT8 /////////
	param2 = superval[currentPos++];
	putValue(P_ASG_10_1_0_35_2, round((param2 * 1.0) - (0) + (0), 1.0));
	///////// Start param3 - UINT8 /////////
	param3 = superval[currentPos++];
	putValue(P_ASG_10_1_0_35_3, round((param3 * 1.0) - (0) + (0), 1.0));
	///////// Start param4 - UINT8 /////////
	param4 = superval[currentPos++];
	putValue(P_ASG_10_1_0_35_4, round((param4 * 1.0) - (0) + (0), 1.0));
	///////// Start param5 - NIBBLE /////////
	param5 = (superval[currentPos] & 0xf0)>>4;
	putValue(P_ASG_10_1_0_35_5, param5);
	///////// Start param6 - NIBBLE /////////
	param6 = superval[currentPos++] & 0x0f;
	putValue(P_ASG_10_1_0_35_6, param6);
	///////// Start param7 - NIBBLE /////////
	param7 = (superval[currentPos] & 0xf0)>>4;
	putValue(P_ASG_10_1_0_35_7, param7);
	///////// Start param8 - NIBBLE /////////
	param8 = superval[currentPos++] & 0x0f;
	putValue(P_ASG_10_1_0_35_8, param8);
}

// Ueberwachung der Darstellungsvariable der Range.
on envVar P_ASG_10_1_0_35_1_range // Spacing_Rear_Extended.Spacing5 
{
	@P_ASG_10_1_0_35_1 = @P_ASG_10_1_0_35_1_range - (0); // slider = range - min
}

on envVar P_ASG_10_1_0_35_1 // Spacing_Rear_Extended.Spacing5
{
	byte superval[6];

	//Update Childvalue (Number)
	byte thisval; // Spacing5
	float slider_value;

	slider_value = round(@P_ASG_10_1_0_35_1, 1.0);
	@P_ASG_10_1_0_35_1_range = slider_value + (0); // real value := slider value + range min.
	thisval = (byte)round((slider_value + (0) - (0)) / (1.0), 1); // bus value := (slider value + min - offset) / step.

    // Update superval
	getValue(P_ASG_10_1_0_35, superval);
	superval[0]=thisval;
	putValue(P_ASG_10_1_0_35,superval);
}

// Ueberwachung der Darstellungsvariable der Range.
on envVar P_ASG_10_1_0_35_2_range // Spacing_Rear_Extended.Spacing6 
{
	@P_ASG_10_1_0_35_2 = @P_ASG_10_1_0_35_2_range - (0); // slider = range - min
}

on envVar P_ASG_10_1_0_35_2 // Spacing_Rear_Extended.Spacing6
{
	byte superval[6];

	//Update Childvalue (Number)
	byte thisval; // Spacing6
	float slider_value;

	slider_value = round(@P_ASG_10_1_0_35_2, 1.0);
	@P_ASG_10_1_0_35_2_range = slider_value + (0); // real value := slider value + range min.
	thisval = (byte)round((slider_value + (0) - (0)) / (1.0), 1); // bus value := (slider value + min - offset) / step.

    // Update superval
	getValue(P_ASG_10_1_0_35, superval);
	superval[1]=thisval;
	putValue(P_ASG_10_1_0_35,superval);
}

// Ueberwachung der Darstellungsvariable der Range.
on envVar P_ASG_10_1_0_35_3_range // Spacing_Rear_Extended.Spacing7 
{
	@P_ASG_10_1_0_35_3 = @P_ASG_10_1_0_35_3_range - (0); // slider = range - min
}

on envVar P_ASG_10_1_0_35_3 // Spacing_Rear_Extended.Spacing7
{
	byte superval[6];

	//Update Childvalue (Number)
	byte thisval; // Spacing7
	float slider_value;

	slider_value = round(@P_ASG_10_1_0_35_3, 1.0);
	@P_ASG_10_1_0_35_3_range = slider_value + (0); // real value := slider value + range min.
	thisval = (byte)round((slider_value + (0) - (0)) / (1.0), 1); // bus value := (slider value + min - offset) / step.

    // Update superval
	getValue(P_ASG_10_1_0_35, superval);
	superval[2]=thisval;
	putValue(P_ASG_10_1_0_35,superval);
}

// Ueberwachung der Darstellungsvariable der Range.
on envVar P_ASG_10_1_0_35_4_range // Spacing_Rear_Extended.Spacing8 
{
	@P_ASG_10_1_0_35_4 = @P_ASG_10_1_0_35_4_range - (0); // slider = range - min
}

on envVar P_ASG_10_1_0_35_4 // Spacing_Rear_Extended.Spacing8
{
	byte superval[6];

	//Update Childvalue (Number)
	byte thisval; // Spacing8
	float slider_value;

	slider_value = round(@P_ASG_10_1_0_35_4, 1.0);
	@P_ASG_10_1_0_35_4_range = slider_value + (0); // real value := slider value + range min.
	thisval = (byte)round((slider_value + (0) - (0)) / (1.0), 1); // bus value := (slider value + min - offset) / step.

    // Update superval
	getValue(P_ASG_10_1_0_35, superval);
	superval[3]=thisval;
	putValue(P_ASG_10_1_0_35,superval);
}

on envVar P_ASG_10_1_0_35_5 // Spacing_Rear_Extended.StatusLevel5
{
	byte superval[6];

	//Update Childvalue (Enum)
	byte thisval; // StatusLevel5
	thisval = 0x0f & getValue(this);

    // Update superval
	getValue(P_ASG_10_1_0_35, superval);
	superval[4]= superval[4]&0x0f;
	superval[4]= superval[4]|(thisval<<4);
	putValue(P_ASG_10_1_0_35,superval);
}

on envVar P_ASG_10_1_0_35_6 // Spacing_Rear_Extended.StatusLevel6
{
	byte superval[6];

	//Update Childvalue (Enum)
	byte thisval; // StatusLevel6
	thisval = 0x0f & getValue(this);

    // Update superval
	getValue(P_ASG_10_1_0_35, superval);
	superval[4]= superval[4]&0xf0;
	superval[4]= superval[4]|thisval;
	putValue(P_ASG_10_1_0_35,superval);
}

on envVar P_ASG_10_1_0_35_7 // Spacing_Rear_Extended.StatusLevel7
{
	byte superval[6];

	//Update Childvalue (Enum)
	byte thisval; // StatusLevel7
	thisval = 0x0f & getValue(this);

    // Update superval
	getValue(P_ASG_10_1_0_35, superval);
	superval[5]= superval[5]&0x0f;
	superval[5]= superval[5]|(thisval<<4);
	putValue(P_ASG_10_1_0_35,superval);
}

on envVar P_ASG_10_1_0_35_8 // Spacing_Rear_Extended.StatusLevel8
{
	byte superval[6];

	//Update Childvalue (Enum)
	byte thisval; // StatusLevel8
	thisval = 0x0f & getValue(this);

    // Update superval
	getValue(P_ASG_10_1_0_35, superval);
	superval[5]= superval[5]&0xf0;
	superval[5]= superval[5]|thisval;
	putValue(P_ASG_10_1_0_35,superval);
}

on envVar P_ASG_10_1_0_36Get_BTN
{
 if (P_ASG_10_1_0_36Get_BTN_already_pressed == 0)
  {
       putValue(P_ASG_10_1_0_36_ErrCode,0);
       SetControlBackColor(panel_name,"errField_P_ASG_10_1_0_36",MakeRGB(255,255,255));
       P_ASG_10_1_0_36Get_BTN_already_pressed = 1;
 }
 else
 {
       Request_Void(LSGID, P_ASG_10_1_0_36_ID, DataGet_REQ); 
       P_ASG_10_1_0_36Get_BTN_already_pressed = 0;
 }
}
on envVar P_ASG_10_1_0_36 // bus value of WallDetection (36).
{
	// opcodes: Error-Status
	byte param1; // SectorsFront
	byte param2; // SectorsRear
	byte param3; // SectorsRight
	byte param4; // SectorsLeft
	// DATATYPE_BYTESEQUENCE / DATATYPE_FIXEDBYTESEQUENCE
	int i;
	byte superval[4];
	int currentPos;
	currentPos = 0;
	for( i = 0; i < 4; i++ ) {
		superval[i] = 0;
	}
	getValue(P_ASG_10_1_0_36, superval);
	///////// Start param1 - UINT8 /////////
	param1 = superval[currentPos++];
	putValue(P_ASG_10_1_0_36_1, param1);
	///////// Start param2 - UINT8 /////////
	param2 = superval[currentPos++];
	putValue(P_ASG_10_1_0_36_2, param2);
	///////// Start param3 - UINT8 /////////
	param3 = superval[currentPos++];
	putValue(P_ASG_10_1_0_36_3, param3);
	///////// Start param4 - UINT8 /////////
	param4 = superval[currentPos++];
	putValue(P_ASG_10_1_0_36_4, param4);
}

on envVar P_ASG_10_1_0_36_1_0
{
	byte bitval;
	//thisval steht hier fuer den bitfield-wert, 
	//aus Generierungsgruenden hier keine einheitliche Bezeichnung moeglich.
	byte thisval; // SectorsFront
	bitval= getValue(this);
	thisval = getValue(P_ASG_10_1_0_36_1);
	thisval = thisval&~(1<<0)|(bitval<<0);
	putValue(P_ASG_10_1_0_36_1,thisval);
}

on envVar P_ASG_10_1_0_36_1_1
{
	byte bitval;
	//thisval steht hier fuer den bitfield-wert, 
	//aus Generierungsgruenden hier keine einheitliche Bezeichnung moeglich.
	byte thisval; // SectorsFront
	bitval= getValue(this);
	thisval = getValue(P_ASG_10_1_0_36_1);
	thisval = thisval&~(1<<1)|(bitval<<1);
	putValue(P_ASG_10_1_0_36_1,thisval);
}

on envVar P_ASG_10_1_0_36_1_2
{
	byte bitval;
	//thisval steht hier fuer den bitfield-wert, 
	//aus Generierungsgruenden hier keine einheitliche Bezeichnung moeglich.
	byte thisval; // SectorsFront
	bitval= getValue(this);
	thisval = getValue(P_ASG_10_1_0_36_1);
	thisval = thisval&~(1<<2)|(bitval<<2);
	putValue(P_ASG_10_1_0_36_1,thisval);
}

on envVar P_ASG_10_1_0_36_1_3
{
	byte bitval;
	//thisval steht hier fuer den bitfield-wert, 
	//aus Generierungsgruenden hier keine einheitliche Bezeichnung moeglich.
	byte thisval; // SectorsFront
	bitval= getValue(this);
	thisval = getValue(P_ASG_10_1_0_36_1);
	thisval = thisval&~(1<<3)|(bitval<<3);
	putValue(P_ASG_10_1_0_36_1,thisval);
}

on envVar P_ASG_10_1_0_36_1_4
{
	byte bitval;
	//thisval steht hier fuer den bitfield-wert, 
	//aus Generierungsgruenden hier keine einheitliche Bezeichnung moeglich.
	byte thisval; // SectorsFront
	bitval= getValue(this);
	thisval = getValue(P_ASG_10_1_0_36_1);
	thisval = thisval&~(1<<4)|(bitval<<4);
	putValue(P_ASG_10_1_0_36_1,thisval);
}

on envVar P_ASG_10_1_0_36_1_5
{
	byte bitval;
	//thisval steht hier fuer den bitfield-wert, 
	//aus Generierungsgruenden hier keine einheitliche Bezeichnung moeglich.
	byte thisval; // SectorsFront
	bitval= getValue(this);
	thisval = getValue(P_ASG_10_1_0_36_1);
	thisval = thisval&~(1<<5)|(bitval<<5);
	putValue(P_ASG_10_1_0_36_1,thisval);
}

on envVar P_ASG_10_1_0_36_1_6
{
	byte bitval;
	//thisval steht hier fuer den bitfield-wert, 
	//aus Generierungsgruenden hier keine einheitliche Bezeichnung moeglich.
	byte thisval; // SectorsFront
	bitval= getValue(this);
	thisval = getValue(P_ASG_10_1_0_36_1);
	thisval = thisval&~(1<<6)|(bitval<<6);
	putValue(P_ASG_10_1_0_36_1,thisval);
}

on envVar P_ASG_10_1_0_36_1_7
{
	byte bitval;
	//thisval steht hier fuer den bitfield-wert, 
	//aus Generierungsgruenden hier keine einheitliche Bezeichnung moeglich.
	byte thisval; // SectorsFront
	bitval= getValue(this);
	thisval = getValue(P_ASG_10_1_0_36_1);
	thisval = thisval&~(1<<7)|(bitval<<7);
	putValue(P_ASG_10_1_0_36_1,thisval);
}

on envVar P_ASG_10_1_0_36_1 // WallDetection.SectorsFront
{
	byte superval[4];

	//Update Childvalue (BitField)
	byte mask=0x01;
	int i = 0;
	byte thisval; // SectorsFront
	thisval = getValue(this);
	if(thisval&(mask<<0))
		putValue(P_ASG_10_1_0_36_1_0, 1);
	else
		putValue(P_ASG_10_1_0_36_1_0, 0);
	if(thisval&(mask<<1))
		putValue(P_ASG_10_1_0_36_1_1, 1);
	else
		putValue(P_ASG_10_1_0_36_1_1, 0);
	if(thisval&(mask<<2))
		putValue(P_ASG_10_1_0_36_1_2, 1);
	else
		putValue(P_ASG_10_1_0_36_1_2, 0);
	if(thisval&(mask<<3))
		putValue(P_ASG_10_1_0_36_1_3, 1);
	else
		putValue(P_ASG_10_1_0_36_1_3, 0);
	if(thisval&(mask<<4))
		putValue(P_ASG_10_1_0_36_1_4, 1);
	else
		putValue(P_ASG_10_1_0_36_1_4, 0);
	if(thisval&(mask<<5))
		putValue(P_ASG_10_1_0_36_1_5, 1);
	else
		putValue(P_ASG_10_1_0_36_1_5, 0);
	if(thisval&(mask<<6))
		putValue(P_ASG_10_1_0_36_1_6, 1);
	else
		putValue(P_ASG_10_1_0_36_1_6, 0);
	if(thisval&(mask<<7))
		putValue(P_ASG_10_1_0_36_1_7, 1);
	else
		putValue(P_ASG_10_1_0_36_1_7, 0);

    // Update superval
	getValue(P_ASG_10_1_0_36, superval);
	superval[0]=thisval;
	putValue(P_ASG_10_1_0_36,superval);
}

on envVar P_ASG_10_1_0_36_2_0
{
	byte bitval;
	//thisval steht hier fuer den bitfield-wert, 
	//aus Generierungsgruenden hier keine einheitliche Bezeichnung moeglich.
	byte thisval; // SectorsRear
	bitval= getValue(this);
	thisval = getValue(P_ASG_10_1_0_36_2);
	thisval = thisval&~(1<<0)|(bitval<<0);
	putValue(P_ASG_10_1_0_36_2,thisval);
}

on envVar P_ASG_10_1_0_36_2_1
{
	byte bitval;
	//thisval steht hier fuer den bitfield-wert, 
	//aus Generierungsgruenden hier keine einheitliche Bezeichnung moeglich.
	byte thisval; // SectorsRear
	bitval= getValue(this);
	thisval = getValue(P_ASG_10_1_0_36_2);
	thisval = thisval&~(1<<1)|(bitval<<1);
	putValue(P_ASG_10_1_0_36_2,thisval);
}

on envVar P_ASG_10_1_0_36_2_2
{
	byte bitval;
	//thisval steht hier fuer den bitfield-wert, 
	//aus Generierungsgruenden hier keine einheitliche Bezeichnung moeglich.
	byte thisval; // SectorsRear
	bitval= getValue(this);
	thisval = getValue(P_ASG_10_1_0_36_2);
	thisval = thisval&~(1<<2)|(bitval<<2);
	putValue(P_ASG_10_1_0_36_2,thisval);
}

on envVar P_ASG_10_1_0_36_2_3
{
	byte bitval;
	//thisval steht hier fuer den bitfield-wert, 
	//aus Generierungsgruenden hier keine einheitliche Bezeichnung moeglich.
	byte thisval; // SectorsRear
	bitval= getValue(this);
	thisval = getValue(P_ASG_10_1_0_36_2);
	thisval = thisval&~(1<<3)|(bitval<<3);
	putValue(P_ASG_10_1_0_36_2,thisval);
}

on envVar P_ASG_10_1_0_36_2_4
{
	byte bitval;
	//thisval steht hier fuer den bitfield-wert, 
	//aus Generierungsgruenden hier keine einheitliche Bezeichnung moeglich.
	byte thisval; // SectorsRear
	bitval= getValue(this);
	thisval = getValue(P_ASG_10_1_0_36_2);
	thisval = thisval&~(1<<4)|(bitval<<4);
	putValue(P_ASG_10_1_0_36_2,thisval);
}

on envVar P_ASG_10_1_0_36_2_5
{
	byte bitval;
	//thisval steht hier fuer den bitfield-wert, 
	//aus Generierungsgruenden hier keine einheitliche Bezeichnung moeglich.
	byte thisval; // SectorsRear
	bitval= getValue(this);
	thisval = getValue(P_ASG_10_1_0_36_2);
	thisval = thisval&~(1<<5)|(bitval<<5);
	putValue(P_ASG_10_1_0_36_2,thisval);
}

on envVar P_ASG_10_1_0_36_2_6
{
	byte bitval;
	//thisval steht hier fuer den bitfield-wert, 
	//aus Generierungsgruenden hier keine einheitliche Bezeichnung moeglich.
	byte thisval; // SectorsRear
	bitval= getValue(this);
	thisval = getValue(P_ASG_10_1_0_36_2);
	thisval = thisval&~(1<<6)|(bitval<<6);
	putValue(P_ASG_10_1_0_36_2,thisval);
}

on envVar P_ASG_10_1_0_36_2_7
{
	byte bitval;
	//thisval steht hier fuer den bitfield-wert, 
	//aus Generierungsgruenden hier keine einheitliche Bezeichnung moeglich.
	byte thisval; // SectorsRear
	bitval= getValue(this);
	thisval = getValue(P_ASG_10_1_0_36_2);
	thisval = thisval&~(1<<7)|(bitval<<7);
	putValue(P_ASG_10_1_0_36_2,thisval);
}

on envVar P_ASG_10_1_0_36_2 // WallDetection.SectorsRear
{
	byte superval[4];

	//Update Childvalue (BitField)
	byte mask=0x01;
	int i = 0;
	byte thisval; // SectorsRear
	thisval = getValue(this);
	if(thisval&(mask<<0))
		putValue(P_ASG_10_1_0_36_2_0, 1);
	else
		putValue(P_ASG_10_1_0_36_2_0, 0);
	if(thisval&(mask<<1))
		putValue(P_ASG_10_1_0_36_2_1, 1);
	else
		putValue(P_ASG_10_1_0_36_2_1, 0);
	if(thisval&(mask<<2))
		putValue(P_ASG_10_1_0_36_2_2, 1);
	else
		putValue(P_ASG_10_1_0_36_2_2, 0);
	if(thisval&(mask<<3))
		putValue(P_ASG_10_1_0_36_2_3, 1);
	else
		putValue(P_ASG_10_1_0_36_2_3, 0);
	if(thisval&(mask<<4))
		putValue(P_ASG_10_1_0_36_2_4, 1);
	else
		putValue(P_ASG_10_1_0_36_2_4, 0);
	if(thisval&(mask<<5))
		putValue(P_ASG_10_1_0_36_2_5, 1);
	else
		putValue(P_ASG_10_1_0_36_2_5, 0);
	if(thisval&(mask<<6))
		putValue(P_ASG_10_1_0_36_2_6, 1);
	else
		putValue(P_ASG_10_1_0_36_2_6, 0);
	if(thisval&(mask<<7))
		putValue(P_ASG_10_1_0_36_2_7, 1);
	else
		putValue(P_ASG_10_1_0_36_2_7, 0);

    // Update superval
	getValue(P_ASG_10_1_0_36, superval);
	superval[1]=thisval;
	putValue(P_ASG_10_1_0_36,superval);
}

on envVar P_ASG_10_1_0_36_3_0
{
	byte bitval;
	//thisval steht hier fuer den bitfield-wert, 
	//aus Generierungsgruenden hier keine einheitliche Bezeichnung moeglich.
	byte thisval; // SectorsRight
	bitval= getValue(this);
	thisval = getValue(P_ASG_10_1_0_36_3);
	thisval = thisval&~(1<<0)|(bitval<<0);
	putValue(P_ASG_10_1_0_36_3,thisval);
}

on envVar P_ASG_10_1_0_36_3_1
{
	byte bitval;
	//thisval steht hier fuer den bitfield-wert, 
	//aus Generierungsgruenden hier keine einheitliche Bezeichnung moeglich.
	byte thisval; // SectorsRight
	bitval= getValue(this);
	thisval = getValue(P_ASG_10_1_0_36_3);
	thisval = thisval&~(1<<1)|(bitval<<1);
	putValue(P_ASG_10_1_0_36_3,thisval);
}

on envVar P_ASG_10_1_0_36_3_2
{
	byte bitval;
	//thisval steht hier fuer den bitfield-wert, 
	//aus Generierungsgruenden hier keine einheitliche Bezeichnung moeglich.
	byte thisval; // SectorsRight
	bitval= getValue(this);
	thisval = getValue(P_ASG_10_1_0_36_3);
	thisval = thisval&~(1<<2)|(bitval<<2);
	putValue(P_ASG_10_1_0_36_3,thisval);
}

on envVar P_ASG_10_1_0_36_3_3
{
	byte bitval;
	//thisval steht hier fuer den bitfield-wert, 
	//aus Generierungsgruenden hier keine einheitliche Bezeichnung moeglich.
	byte thisval; // SectorsRight
	bitval= getValue(this);
	thisval = getValue(P_ASG_10_1_0_36_3);
	thisval = thisval&~(1<<3)|(bitval<<3);
	putValue(P_ASG_10_1_0_36_3,thisval);
}

on envVar P_ASG_10_1_0_36_3 // WallDetection.SectorsRight
{
	byte superval[4];

	//Update Childvalue (BitField)
	byte mask=0x01;
	int i = 0;
	byte thisval; // SectorsRight
	thisval = getValue(this);
	if(thisval&(mask<<0))
		putValue(P_ASG_10_1_0_36_3_0, 1);
	else
		putValue(P_ASG_10_1_0_36_3_0, 0);
	if(thisval&(mask<<1))
		putValue(P_ASG_10_1_0_36_3_1, 1);
	else
		putValue(P_ASG_10_1_0_36_3_1, 0);
	if(thisval&(mask<<2))
		putValue(P_ASG_10_1_0_36_3_2, 1);
	else
		putValue(P_ASG_10_1_0_36_3_2, 0);
	if(thisval&(mask<<3))
		putValue(P_ASG_10_1_0_36_3_3, 1);
	else
		putValue(P_ASG_10_1_0_36_3_3, 0);

    // Update superval
	getValue(P_ASG_10_1_0_36, superval);
	superval[2]=thisval;
	putValue(P_ASG_10_1_0_36,superval);
}

on envVar P_ASG_10_1_0_36_4_0
{
	byte bitval;
	//thisval steht hier fuer den bitfield-wert, 
	//aus Generierungsgruenden hier keine einheitliche Bezeichnung moeglich.
	byte thisval; // SectorsLeft
	bitval= getValue(this);
	thisval = getValue(P_ASG_10_1_0_36_4);
	thisval = thisval&~(1<<0)|(bitval<<0);
	putValue(P_ASG_10_1_0_36_4,thisval);
}

on envVar P_ASG_10_1_0_36_4_1
{
	byte bitval;
	//thisval steht hier fuer den bitfield-wert, 
	//aus Generierungsgruenden hier keine einheitliche Bezeichnung moeglich.
	byte thisval; // SectorsLeft
	bitval= getValue(this);
	thisval = getValue(P_ASG_10_1_0_36_4);
	thisval = thisval&~(1<<1)|(bitval<<1);
	putValue(P_ASG_10_1_0_36_4,thisval);
}

on envVar P_ASG_10_1_0_36_4_2
{
	byte bitval;
	//thisval steht hier fuer den bitfield-wert, 
	//aus Generierungsgruenden hier keine einheitliche Bezeichnung moeglich.
	byte thisval; // SectorsLeft
	bitval= getValue(this);
	thisval = getValue(P_ASG_10_1_0_36_4);
	thisval = thisval&~(1<<2)|(bitval<<2);
	putValue(P_ASG_10_1_0_36_4,thisval);
}

on envVar P_ASG_10_1_0_36_4_3
{
	byte bitval;
	//thisval steht hier fuer den bitfield-wert, 
	//aus Generierungsgruenden hier keine einheitliche Bezeichnung moeglich.
	byte thisval; // SectorsLeft
	bitval= getValue(this);
	thisval = getValue(P_ASG_10_1_0_36_4);
	thisval = thisval&~(1<<3)|(bitval<<3);
	putValue(P_ASG_10_1_0_36_4,thisval);
}

on envVar P_ASG_10_1_0_36_4 // WallDetection.SectorsLeft
{
	byte superval[4];

	//Update Childvalue (BitField)
	byte mask=0x01;
	int i = 0;
	byte thisval; // SectorsLeft
	thisval = getValue(this);
	if(thisval&(mask<<0))
		putValue(P_ASG_10_1_0_36_4_0, 1);
	else
		putValue(P_ASG_10_1_0_36_4_0, 0);
	if(thisval&(mask<<1))
		putValue(P_ASG_10_1_0_36_4_1, 1);
	else
		putValue(P_ASG_10_1_0_36_4_1, 0);
	if(thisval&(mask<<2))
		putValue(P_ASG_10_1_0_36_4_2, 1);
	else
		putValue(P_ASG_10_1_0_36_4_2, 0);
	if(thisval&(mask<<3))
		putValue(P_ASG_10_1_0_36_4_3, 1);
	else
		putValue(P_ASG_10_1_0_36_4_3, 0);

    // Update superval
	getValue(P_ASG_10_1_0_36, superval);
	superval[3]=thisval;
	putValue(P_ASG_10_1_0_36,superval);
}

on envVar P_ASG_10_1_0_37Get_BTN
{
 if (P_ASG_10_1_0_37Get_BTN_already_pressed == 0)
  {
       putValue(P_ASG_10_1_0_37_ErrCode,0);
       SetControlBackColor(panel_name,"errField_P_ASG_10_1_0_37",MakeRGB(255,255,255));
       P_ASG_10_1_0_37Get_BTN_already_pressed = 1;
 }
 else
 {
       Request_Void(LSGID, P_ASG_10_1_0_37_ID, DataGet_REQ); 
       P_ASG_10_1_0_37Get_BTN_already_pressed = 0;
 }
}
on envVar P_ASG_10_1_0_37SetGet_BTN
{
	byte BAPTemp[5];
    if (P_ASG_10_1_0_37SetGet_BTN_already_pressed == 0)
    {
       putValue(P_ASG_10_1_0_37_ErrCode,0);
       SetControlBackColor(panel_name,"errField_P_ASG_10_1_0_37",MakeRGB(255,255,255));
       P_ASG_10_1_0_37SetGet_BTN_already_pressed = 1;
    }
    else
    {
       getValue(P_ASG_10_1_0_37, BAPTemp);
       Request_ByteSequence(LSGID, P_ASG_10_1_0_37_ID, DataSetGet_REQ, BAPTemp, getValueSize(P_ASG_10_1_0_37));
       P_ASG_10_1_0_37SetGet_BTN_already_pressed = 0;
    }
}
on envVar P_ASG_10_1_0_37 // bus value of PLA_Status (37).
{
	// opcodes: Error-Status
	byte param1; // Mode
	byte param2; // ParkingSpotStatus
	byte param3; // ParkingSpotStatus2
	byte param4; // DrivingDirection
	byte param5; // Instructions
	byte param6; // GPParkingSpotStatus
	byte param7; // PreSelection
	// DATATYPE_BYTESEQUENCE / DATATYPE_FIXEDBYTESEQUENCE
	int i;
	byte superval[5];
	int currentPos;
	currentPos = 0;
	for( i = 0; i < 5; i++ ) {
		superval[i] = 0;
	}
	getValue(P_ASG_10_1_0_37, superval);
	///////// Start param1 - UINT8 /////////
	param1 = superval[currentPos++];
	putValue(P_ASG_10_1_0_37_1, param1);
	///////// Start param2 - UINT8 /////////
	param2 = superval[currentPos++];
	putValue(P_ASG_10_1_0_37_2, param2);
	///////// Start param3 - NIBBLE /////////
	param3 = (superval[currentPos] & 0xf0)>>4;
	putValue(P_ASG_10_1_0_37_3, param3);
	///////// Start param4 - NIBBLE /////////
	param4 = superval[currentPos++] & 0x0f;
	putValue(P_ASG_10_1_0_37_4, param4);
	///////// Start param5 - UINT8 /////////
	param5 = superval[currentPos++];
	putValue(P_ASG_10_1_0_37_5, param5);
	///////// Start param6 - NIBBLE /////////
	param6 = (superval[currentPos] & 0xf0)>>4;
	putValue(P_ASG_10_1_0_37_6, param6);
	///////// Start param7 - NIBBLE /////////
	param7 = superval[currentPos++] & 0x0f;
	putValue(P_ASG_10_1_0_37_7, param7);
}

on envVar P_ASG_10_1_0_37_1 // PLA_Status.Mode
{
	byte superval[5];

	//Update Childvalue (Enum)
	byte thisval; // Mode
	thisval = getValue(this);

    // Update superval
	getValue(P_ASG_10_1_0_37, superval);
	superval[0]=thisval;
	putValue(P_ASG_10_1_0_37,superval);
}

on envVar P_ASG_10_1_0_37_2_0
{
	byte bitval;
	//thisval steht hier fuer den bitfield-wert, 
	//aus Generierungsgruenden hier keine einheitliche Bezeichnung moeglich.
	byte thisval; // ParkingSpotStatus
	bitval= getValue(this);
	thisval = getValue(P_ASG_10_1_0_37_2);
	thisval = thisval&~(1<<0)|(bitval<<0);
	putValue(P_ASG_10_1_0_37_2,thisval);
}

on envVar P_ASG_10_1_0_37_2_1
{
	byte bitval;
	//thisval steht hier fuer den bitfield-wert, 
	//aus Generierungsgruenden hier keine einheitliche Bezeichnung moeglich.
	byte thisval; // ParkingSpotStatus
	bitval= getValue(this);
	thisval = getValue(P_ASG_10_1_0_37_2);
	thisval = thisval&~(1<<1)|(bitval<<1);
	putValue(P_ASG_10_1_0_37_2,thisval);
}

on envVar P_ASG_10_1_0_37_2_2
{
	byte bitval;
	//thisval steht hier fuer den bitfield-wert, 
	//aus Generierungsgruenden hier keine einheitliche Bezeichnung moeglich.
	byte thisval; // ParkingSpotStatus
	bitval= getValue(this);
	thisval = getValue(P_ASG_10_1_0_37_2);
	thisval = thisval&~(1<<2)|(bitval<<2);
	putValue(P_ASG_10_1_0_37_2,thisval);
}

on envVar P_ASG_10_1_0_37_2_3
{
	byte bitval;
	//thisval steht hier fuer den bitfield-wert, 
	//aus Generierungsgruenden hier keine einheitliche Bezeichnung moeglich.
	byte thisval; // ParkingSpotStatus
	bitval= getValue(this);
	thisval = getValue(P_ASG_10_1_0_37_2);
	thisval = thisval&~(1<<3)|(bitval<<3);
	putValue(P_ASG_10_1_0_37_2,thisval);
}

on envVar P_ASG_10_1_0_37_2_4
{
	byte bitval;
	//thisval steht hier fuer den bitfield-wert, 
	//aus Generierungsgruenden hier keine einheitliche Bezeichnung moeglich.
	byte thisval; // ParkingSpotStatus
	bitval= getValue(this);
	thisval = getValue(P_ASG_10_1_0_37_2);
	thisval = thisval&~(1<<4)|(bitval<<4);
	putValue(P_ASG_10_1_0_37_2,thisval);
}

on envVar P_ASG_10_1_0_37_2_5
{
	byte bitval;
	//thisval steht hier fuer den bitfield-wert, 
	//aus Generierungsgruenden hier keine einheitliche Bezeichnung moeglich.
	byte thisval; // ParkingSpotStatus
	bitval= getValue(this);
	thisval = getValue(P_ASG_10_1_0_37_2);
	thisval = thisval&~(1<<5)|(bitval<<5);
	putValue(P_ASG_10_1_0_37_2,thisval);
}

on envVar P_ASG_10_1_0_37_2_6
{
	byte bitval;
	//thisval steht hier fuer den bitfield-wert, 
	//aus Generierungsgruenden hier keine einheitliche Bezeichnung moeglich.
	byte thisval; // ParkingSpotStatus
	bitval= getValue(this);
	thisval = getValue(P_ASG_10_1_0_37_2);
	thisval = thisval&~(1<<6)|(bitval<<6);
	putValue(P_ASG_10_1_0_37_2,thisval);
}

on envVar P_ASG_10_1_0_37_2 // PLA_Status.ParkingSpotStatus
{
	byte superval[5];

	//Update Childvalue (BitField)
	byte mask=0x01;
	int i = 0;
	byte thisval; // ParkingSpotStatus
	thisval = getValue(this);
	if(thisval&(mask<<0))
		putValue(P_ASG_10_1_0_37_2_0, 1);
	else
		putValue(P_ASG_10_1_0_37_2_0, 0);
	if(thisval&(mask<<1))
		putValue(P_ASG_10_1_0_37_2_1, 1);
	else
		putValue(P_ASG_10_1_0_37_2_1, 0);
	if(thisval&(mask<<2))
		putValue(P_ASG_10_1_0_37_2_2, 1);
	else
		putValue(P_ASG_10_1_0_37_2_2, 0);
	if(thisval&(mask<<3))
		putValue(P_ASG_10_1_0_37_2_3, 1);
	else
		putValue(P_ASG_10_1_0_37_2_3, 0);
	if(thisval&(mask<<4))
		putValue(P_ASG_10_1_0_37_2_4, 1);
	else
		putValue(P_ASG_10_1_0_37_2_4, 0);
	if(thisval&(mask<<5))
		putValue(P_ASG_10_1_0_37_2_5, 1);
	else
		putValue(P_ASG_10_1_0_37_2_5, 0);
	if(thisval&(mask<<6))
		putValue(P_ASG_10_1_0_37_2_6, 1);
	else
		putValue(P_ASG_10_1_0_37_2_6, 0);

    // Update superval
	getValue(P_ASG_10_1_0_37, superval);
	superval[1]=thisval;
	putValue(P_ASG_10_1_0_37,superval);
}

on envVar P_ASG_10_1_0_37_3_0
{
	byte bitval;
	//thisval steht hier fuer den bitfield-wert, 
	//aus Generierungsgruenden hier keine einheitliche Bezeichnung moeglich.
	byte thisval; // ParkingSpotStatus2
	bitval= getValue(this);
	thisval = getValue(P_ASG_10_1_0_37_3);
	thisval = thisval&~(1<<0)|(bitval<<0);
	putValue(P_ASG_10_1_0_37_3,thisval);
}

on envVar P_ASG_10_1_0_37_3_1
{
	byte bitval;
	//thisval steht hier fuer den bitfield-wert, 
	//aus Generierungsgruenden hier keine einheitliche Bezeichnung moeglich.
	byte thisval; // ParkingSpotStatus2
	bitval= getValue(this);
	thisval = getValue(P_ASG_10_1_0_37_3);
	thisval = thisval&~(1<<1)|(bitval<<1);
	putValue(P_ASG_10_1_0_37_3,thisval);
}

on envVar P_ASG_10_1_0_37_3_2
{
	byte bitval;
	//thisval steht hier fuer den bitfield-wert, 
	//aus Generierungsgruenden hier keine einheitliche Bezeichnung moeglich.
	byte thisval; // ParkingSpotStatus2
	bitval= getValue(this);
	thisval = getValue(P_ASG_10_1_0_37_3);
	thisval = thisval&~(1<<2)|(bitval<<2);
	putValue(P_ASG_10_1_0_37_3,thisval);
}

on envVar P_ASG_10_1_0_37_3_3
{
	byte bitval;
	//thisval steht hier fuer den bitfield-wert, 
	//aus Generierungsgruenden hier keine einheitliche Bezeichnung moeglich.
	byte thisval; // ParkingSpotStatus2
	bitval= getValue(this);
	thisval = getValue(P_ASG_10_1_0_37_3);
	thisval = thisval&~(1<<3)|(bitval<<3);
	putValue(P_ASG_10_1_0_37_3,thisval);
}

on envVar P_ASG_10_1_0_37_3 // PLA_Status.ParkingSpotStatus2
{
	byte superval[5];

	//Update Childvalue (BitField)
	byte mask=0x01;
	int i = 0;
	byte thisval; // ParkingSpotStatus2
	thisval = getValue(this);
	if(thisval&(mask<<0))
		putValue(P_ASG_10_1_0_37_3_0, 1);
	else
		putValue(P_ASG_10_1_0_37_3_0, 0);
	if(thisval&(mask<<1))
		putValue(P_ASG_10_1_0_37_3_1, 1);
	else
		putValue(P_ASG_10_1_0_37_3_1, 0);
	if(thisval&(mask<<2))
		putValue(P_ASG_10_1_0_37_3_2, 1);
	else
		putValue(P_ASG_10_1_0_37_3_2, 0);
	if(thisval&(mask<<3))
		putValue(P_ASG_10_1_0_37_3_3, 1);
	else
		putValue(P_ASG_10_1_0_37_3_3, 0);

    // Update superval
	getValue(P_ASG_10_1_0_37, superval);
	superval[2]= superval[2]&0x0f;
	superval[2]= superval[2]|(thisval<<4);
	putValue(P_ASG_10_1_0_37,superval);
}

on envVar P_ASG_10_1_0_37_4 // PLA_Status.DrivingDirection
{
	byte superval[5];

	//Update Childvalue (Enum)
	byte thisval; // DrivingDirection
	thisval = 0x0f & getValue(this);

    // Update superval
	getValue(P_ASG_10_1_0_37, superval);
	superval[2]= superval[2]&0xf0;
	superval[2]= superval[2]|thisval;
	putValue(P_ASG_10_1_0_37,superval);
}

on envVar P_ASG_10_1_0_37_5_0
{
	byte bitval;
	//thisval steht hier fuer den bitfield-wert, 
	//aus Generierungsgruenden hier keine einheitliche Bezeichnung moeglich.
	byte thisval; // Instructions
	bitval= getValue(this);
	thisval = getValue(P_ASG_10_1_0_37_5);
	thisval = thisval&~(1<<0)|(bitval<<0);
	putValue(P_ASG_10_1_0_37_5,thisval);
}

on envVar P_ASG_10_1_0_37_5_1
{
	byte bitval;
	//thisval steht hier fuer den bitfield-wert, 
	//aus Generierungsgruenden hier keine einheitliche Bezeichnung moeglich.
	byte thisval; // Instructions
	bitval= getValue(this);
	thisval = getValue(P_ASG_10_1_0_37_5);
	thisval = thisval&~(1<<1)|(bitval<<1);
	putValue(P_ASG_10_1_0_37_5,thisval);
}

on envVar P_ASG_10_1_0_37_5_2
{
	byte bitval;
	//thisval steht hier fuer den bitfield-wert, 
	//aus Generierungsgruenden hier keine einheitliche Bezeichnung moeglich.
	byte thisval; // Instructions
	bitval= getValue(this);
	thisval = getValue(P_ASG_10_1_0_37_5);
	thisval = thisval&~(1<<2)|(bitval<<2);
	putValue(P_ASG_10_1_0_37_5,thisval);
}

on envVar P_ASG_10_1_0_37_5_3
{
	byte bitval;
	//thisval steht hier fuer den bitfield-wert, 
	//aus Generierungsgruenden hier keine einheitliche Bezeichnung moeglich.
	byte thisval; // Instructions
	bitval= getValue(this);
	thisval = getValue(P_ASG_10_1_0_37_5);
	thisval = thisval&~(1<<3)|(bitval<<3);
	putValue(P_ASG_10_1_0_37_5,thisval);
}

on envVar P_ASG_10_1_0_37_5_4
{
	byte bitval;
	//thisval steht hier fuer den bitfield-wert, 
	//aus Generierungsgruenden hier keine einheitliche Bezeichnung moeglich.
	byte thisval; // Instructions
	bitval= getValue(this);
	thisval = getValue(P_ASG_10_1_0_37_5);
	thisval = thisval&~(1<<4)|(bitval<<4);
	putValue(P_ASG_10_1_0_37_5,thisval);
}

on envVar P_ASG_10_1_0_37_5_5
{
	byte bitval;
	//thisval steht hier fuer den bitfield-wert, 
	//aus Generierungsgruenden hier keine einheitliche Bezeichnung moeglich.
	byte thisval; // Instructions
	bitval= getValue(this);
	thisval = getValue(P_ASG_10_1_0_37_5);
	thisval = thisval&~(1<<5)|(bitval<<5);
	putValue(P_ASG_10_1_0_37_5,thisval);
}

on envVar P_ASG_10_1_0_37_5 // PLA_Status.Instructions
{
	byte superval[5];

	//Update Childvalue (BitField)
	byte mask=0x01;
	int i = 0;
	byte thisval; // Instructions
	thisval = getValue(this);
	if(thisval&(mask<<0))
		putValue(P_ASG_10_1_0_37_5_0, 1);
	else
		putValue(P_ASG_10_1_0_37_5_0, 0);
	if(thisval&(mask<<1))
		putValue(P_ASG_10_1_0_37_5_1, 1);
	else
		putValue(P_ASG_10_1_0_37_5_1, 0);
	if(thisval&(mask<<2))
		putValue(P_ASG_10_1_0_37_5_2, 1);
	else
		putValue(P_ASG_10_1_0_37_5_2, 0);
	if(thisval&(mask<<3))
		putValue(P_ASG_10_1_0_37_5_3, 1);
	else
		putValue(P_ASG_10_1_0_37_5_3, 0);
	if(thisval&(mask<<4))
		putValue(P_ASG_10_1_0_37_5_4, 1);
	else
		putValue(P_ASG_10_1_0_37_5_4, 0);
	if(thisval&(mask<<5))
		putValue(P_ASG_10_1_0_37_5_5, 1);
	else
		putValue(P_ASG_10_1_0_37_5_5, 0);

    // Update superval
	getValue(P_ASG_10_1_0_37, superval);
	superval[3]=thisval;
	putValue(P_ASG_10_1_0_37,superval);
}

on envVar P_ASG_10_1_0_37_6_0
{
	byte bitval;
	//thisval steht hier fuer den bitfield-wert, 
	//aus Generierungsgruenden hier keine einheitliche Bezeichnung moeglich.
	byte thisval; // GPParkingSpotStatus
	bitval= getValue(this);
	thisval = getValue(P_ASG_10_1_0_37_6);
	thisval = thisval&~(1<<0)|(bitval<<0);
	putValue(P_ASG_10_1_0_37_6,thisval);
}

on envVar P_ASG_10_1_0_37_6_1
{
	byte bitval;
	//thisval steht hier fuer den bitfield-wert, 
	//aus Generierungsgruenden hier keine einheitliche Bezeichnung moeglich.
	byte thisval; // GPParkingSpotStatus
	bitval= getValue(this);
	thisval = getValue(P_ASG_10_1_0_37_6);
	thisval = thisval&~(1<<1)|(bitval<<1);
	putValue(P_ASG_10_1_0_37_6,thisval);
}

on envVar P_ASG_10_1_0_37_6_2
{
	byte bitval;
	//thisval steht hier fuer den bitfield-wert, 
	//aus Generierungsgruenden hier keine einheitliche Bezeichnung moeglich.
	byte thisval; // GPParkingSpotStatus
	bitval= getValue(this);
	thisval = getValue(P_ASG_10_1_0_37_6);
	thisval = thisval&~(1<<2)|(bitval<<2);
	putValue(P_ASG_10_1_0_37_6,thisval);
}

on envVar P_ASG_10_1_0_37_6_3
{
	byte bitval;
	//thisval steht hier fuer den bitfield-wert, 
	//aus Generierungsgruenden hier keine einheitliche Bezeichnung moeglich.
	byte thisval; // GPParkingSpotStatus
	bitval= getValue(this);
	thisval = getValue(P_ASG_10_1_0_37_6);
	thisval = thisval&~(1<<3)|(bitval<<3);
	putValue(P_ASG_10_1_0_37_6,thisval);
}

on envVar P_ASG_10_1_0_37_6 // PLA_Status.GPParkingSpotStatus
{
	byte superval[5];

	//Update Childvalue (BitField)
	byte mask=0x01;
	int i = 0;
	byte thisval; // GPParkingSpotStatus
	thisval = getValue(this);
	if(thisval&(mask<<0))
		putValue(P_ASG_10_1_0_37_6_0, 1);
	else
		putValue(P_ASG_10_1_0_37_6_0, 0);
	if(thisval&(mask<<1))
		putValue(P_ASG_10_1_0_37_6_1, 1);
	else
		putValue(P_ASG_10_1_0_37_6_1, 0);
	if(thisval&(mask<<2))
		putValue(P_ASG_10_1_0_37_6_2, 1);
	else
		putValue(P_ASG_10_1_0_37_6_2, 0);
	if(thisval&(mask<<3))
		putValue(P_ASG_10_1_0_37_6_3, 1);
	else
		putValue(P_ASG_10_1_0_37_6_3, 0);

    // Update superval
	getValue(P_ASG_10_1_0_37, superval);
	superval[4]= superval[4]&0x0f;
	superval[4]= superval[4]|(thisval<<4);
	putValue(P_ASG_10_1_0_37,superval);
}

on envVar P_ASG_10_1_0_37_7 // PLA_Status.PreSelection
{
	byte superval[5];

	//Update Childvalue (Enum)
	byte thisval; // PreSelection
	thisval = 0x0f & getValue(this);

    // Update superval
	getValue(P_ASG_10_1_0_37, superval);
	superval[4]= superval[4]&0xf0;
	superval[4]= superval[4]|thisval;
	putValue(P_ASG_10_1_0_37,superval);
}

on envVar P_ASG_10_1_0_38Get_BTN
{
 if (P_ASG_10_1_0_38Get_BTN_already_pressed == 0)
  {
       putValue(P_ASG_10_1_0_38_ErrCode,0);
       SetControlBackColor(panel_name,"errField_P_ASG_10_1_0_38",MakeRGB(255,255,255));
       P_ASG_10_1_0_38Get_BTN_already_pressed = 1;
 }
 else
 {
       Request_Void(LSGID, P_ASG_10_1_0_38_ID, DataGet_REQ); 
       P_ASG_10_1_0_38Get_BTN_already_pressed = 0;
 }
}
on envVar P_ASG_10_1_0_38 // bus value of PLA_Bargraph (38).
{
	// opcodes: Error-Status
	byte param1; // AdditionalArrowIndication
	byte param2; // AdditionalArrowLevel
	// DATATYPE_BYTESEQUENCE / DATATYPE_FIXEDBYTESEQUENCE
	int i;
	byte superval[1];
	int currentPos;
	currentPos = 0;
	for( i = 0; i < 1; i++ ) {
		superval[i] = 0;
	}
	getValue(P_ASG_10_1_0_38, superval);
	///////// Start param1 - NIBBLE /////////
	param1 = (superval[currentPos] & 0xf0)>>4;
	putValue(P_ASG_10_1_0_38_1, param1);
	///////// Start param2 - NIBBLE /////////
	param2 = superval[currentPos++] & 0x0f;
	putValue(P_ASG_10_1_0_38_2, round((param2 * 1.0) - (0) + (0), 1.0));
}

on envVar P_ASG_10_1_0_38_1 // PLA_Bargraph.AdditionalArrowIndication
{
	byte superval[1];

	//Update Childvalue (Enum)
	byte thisval; // AdditionalArrowIndication
	thisval = 0x0f & getValue(this);

    // Update superval
	getValue(P_ASG_10_1_0_38, superval);
	superval[0]= superval[0]&0x0f;
	superval[0]= superval[0]|(thisval<<4);
	putValue(P_ASG_10_1_0_38,superval);
}

// Ueberwachung der Darstellungsvariable der Range.
on envVar P_ASG_10_1_0_38_2_range // PLA_Bargraph.AdditionalArrowLevel 
{
	@P_ASG_10_1_0_38_2 = @P_ASG_10_1_0_38_2_range - (0); // slider = range - min
}

on envVar P_ASG_10_1_0_38_2 // PLA_Bargraph.AdditionalArrowLevel
{
	byte superval[1];

	//Update Childvalue (Number)
	byte thisval; // AdditionalArrowLevel
	float slider_value;

	slider_value = round(@P_ASG_10_1_0_38_2, 1.0);
	@P_ASG_10_1_0_38_2_range = slider_value + (0); // real value := slider value + range min.
	thisval = (byte)round((slider_value + (0) - (0)) / (1.0), 1); // bus value := (slider value + min - offset) / step.

    // Update superval
	getValue(P_ASG_10_1_0_38, superval);
	superval[0]= superval[0]&0xf0;
	superval[0]= superval[0]|thisval;
	putValue(P_ASG_10_1_0_38,superval);
}

on envVar P_ASG_10_1_0_39Get_BTN
{
 if (P_ASG_10_1_0_39Get_BTN_already_pressed == 0)
  {
       putValue(P_ASG_10_1_0_39_ErrCode,0);
       SetControlBackColor(panel_name,"errField_P_ASG_10_1_0_39",MakeRGB(255,255,255));
       P_ASG_10_1_0_39Get_BTN_already_pressed = 1;
 }
 else
 {
       Request_Void(LSGID, P_ASG_10_1_0_39_ID, DataGet_REQ); 
       P_ASG_10_1_0_39Get_BTN_already_pressed = 0;
 }
}
on envVar P_ASG_10_1_0_39 // bus value of PLA_Messages (39).
{
	// opcodes: Error-Status
	byte param1; // Messages
	// DATATYPE_UINTXX
	param1 = getValue(P_ASG_10_1_0_39);
	putValue(P_ASG_10_1_0_39_1, param1);
}

on envVar P_ASG_10_1_0_39_1 // PLA_Messages.Messages
{
	byte superval;

	//Update Childvalue (Enum)
	byte thisval; // Messages
	thisval = getValue(this);

    // Update superval
	superval = getValue(P_ASG_10_1_0_39);
	superval = thisval;
	putValue(P_ASG_10_1_0_39,superval);
}

on envVar P_ASG_10_1_0_40Get_BTN
{
 if (P_ASG_10_1_0_40Get_BTN_already_pressed == 0)
  {
       putValue(P_ASG_10_1_0_40_ErrCode,0);
       SetControlBackColor(panel_name,"errField_P_ASG_10_1_0_40",MakeRGB(255,255,255));
       P_ASG_10_1_0_40Get_BTN_already_pressed = 1;
 }
 else
 {
       Request_Void(LSGID, P_ASG_10_1_0_40_ID, DataGet_REQ); 
       P_ASG_10_1_0_40Get_BTN_already_pressed = 0;
 }
}
on envVar P_ASG_10_1_0_40SetGet_BTN
{
	byte BAPTemp[2];
    if (P_ASG_10_1_0_40SetGet_BTN_already_pressed == 0)
    {
       putValue(P_ASG_10_1_0_40_ErrCode,0);
       SetControlBackColor(panel_name,"errField_P_ASG_10_1_0_40",MakeRGB(255,255,255));
       P_ASG_10_1_0_40SetGet_BTN_already_pressed = 1;
    }
    else
    {
       getValue(P_ASG_10_1_0_40, BAPTemp);
       Request_ByteSequence(LSGID, P_ASG_10_1_0_40_ID, DataSetGet_REQ, BAPTemp, getValueSize(P_ASG_10_1_0_40));
       P_ASG_10_1_0_40SetGet_BTN_already_pressed = 0;
    }
}
on envVar P_ASG_10_1_0_40 // bus value of PLA_ParkmodeSelection (40).
{
	// opcodes: Error-Status
	byte param1; // Setup
	byte param2; // ModificationReason
	byte param3; // ModificationState
	// DATATYPE_BYTESEQUENCE / DATATYPE_FIXEDBYTESEQUENCE
	int i;
	byte superval[2];
	int currentPos;
	currentPos = 0;
	for( i = 0; i < 2; i++ ) {
		superval[i] = 0;
	}
	getValue(P_ASG_10_1_0_40, superval);
	///////// Start param1 - UINT8 /////////
	param1 = superval[currentPos++];
	putValue(P_ASG_10_1_0_40_1, param1);
	///////// Start param2 - NIBBLE /////////
	param2 = (superval[currentPos] & 0xf0)>>4;
	putValue(P_ASG_10_1_0_40_2, param2);
	///////// Start param3 - NIBBLE /////////
	param3 = superval[currentPos++] & 0x0f;
	putValue(P_ASG_10_1_0_40_3, param3);
}

on envVar P_ASG_10_1_0_40_1 // PLA_ParkmodeSelection.Setup
{
	byte superval[2];

	//Update Childvalue (Enum)
	byte thisval; // Setup
	thisval = getValue(this);

    // Update superval
	getValue(P_ASG_10_1_0_40, superval);
	superval[0]=thisval;
	putValue(P_ASG_10_1_0_40,superval);
}

on envVar P_ASG_10_1_0_40_2 // PLA_ParkmodeSelection.ModificationReason
{
	byte superval[2];

	//Update Childvalue (Enum)
	byte thisval; // ModificationReason
	thisval = 0x0f & getValue(this);

    // Update superval
	getValue(P_ASG_10_1_0_40, superval);
	superval[1]= superval[1]&0x0f;
	superval[1]= superval[1]|(thisval<<4);
	putValue(P_ASG_10_1_0_40,superval);
}

on envVar P_ASG_10_1_0_40_3_0
{
	byte bitval;
	//thisval steht hier fuer den bitfield-wert, 
	//aus Generierungsgruenden hier keine einheitliche Bezeichnung moeglich.
	byte thisval; // ModificationState
	bitval= getValue(this);
	thisval = getValue(P_ASG_10_1_0_40_3);
	thisval = thisval&~(1<<0)|(bitval<<0);
	putValue(P_ASG_10_1_0_40_3,thisval);
}

on envVar P_ASG_10_1_0_40_3 // PLA_ParkmodeSelection.ModificationState
{
	byte superval[2];

	//Update Childvalue (BitField)
	byte mask=0x01;
	int i = 0;
	byte thisval; // ModificationState
	thisval = getValue(this);
	if(thisval&(mask<<0))
		putValue(P_ASG_10_1_0_40_3_0, 1);
	else
		putValue(P_ASG_10_1_0_40_3_0, 0);

    // Update superval
	getValue(P_ASG_10_1_0_40, superval);
	superval[1]= superval[1]&0xf0;
	superval[1]= superval[1]|thisval;
	putValue(P_ASG_10_1_0_40,superval);
}

on envVar P_ASG_10_1_0_41Get_BTN
{
 if (P_ASG_10_1_0_41Get_BTN_already_pressed == 0)
  {
       putValue(P_ASG_10_1_0_41_ErrCode,0);
       SetControlBackColor(panel_name,"errField_P_ASG_10_1_0_41",MakeRGB(255,255,255));
       P_ASG_10_1_0_41Get_BTN_already_pressed = 1;
 }
 else
 {
       Request_Void(LSGID, P_ASG_10_1_0_41_ID, DataGet_REQ); 
       P_ASG_10_1_0_41Get_BTN_already_pressed = 0;
 }
}
on envVar P_ASG_10_1_0_41SetGet_BTN
{
	byte BAPTemp[2];
    if (P_ASG_10_1_0_41SetGet_BTN_already_pressed == 0)
    {
       putValue(P_ASG_10_1_0_41_ErrCode,0);
       SetControlBackColor(panel_name,"errField_P_ASG_10_1_0_41",MakeRGB(255,255,255));
       P_ASG_10_1_0_41SetGet_BTN_already_pressed = 1;
    }
    else
    {
       getValue(P_ASG_10_1_0_41, BAPTemp);
       Request_ByteSequence(LSGID, P_ASG_10_1_0_41_ID, DataSetGet_REQ, BAPTemp, getValueSize(P_ASG_10_1_0_41));
       P_ASG_10_1_0_41SetGet_BTN_already_pressed = 0;
    }
}
on envVar P_ASG_10_1_0_41 // bus value of PDC_PLA_SystemState (41).
{
	// opcodes: Error-Status
	byte param1; // PDCActivationReason
	byte param2; // Status
	byte param3; // ModificationReason
	byte param4; // ModificationState
	// DATATYPE_BYTESEQUENCE / DATATYPE_FIXEDBYTESEQUENCE
	int i;
	byte superval[2];
	int currentPos;
	currentPos = 0;
	for( i = 0; i < 2; i++ ) {
		superval[i] = 0;
	}
	getValue(P_ASG_10_1_0_41, superval);
	///////// Start param1 - NIBBLE /////////
	param1 = (superval[currentPos] & 0xf0)>>4;
	putValue(P_ASG_10_1_0_41_1, param1);
	///////// Start param2 - NIBBLE /////////
	param2 = superval[currentPos++] & 0x0f;
	putValue(P_ASG_10_1_0_41_2, param2);
	///////// Start param3 - NIBBLE /////////
	param3 = (superval[currentPos] & 0xf0)>>4;
	putValue(P_ASG_10_1_0_41_3, param3);
	///////// Start param4 - NIBBLE /////////
	param4 = superval[currentPos++] & 0x0f;
	putValue(P_ASG_10_1_0_41_4, param4);
}

on envVar P_ASG_10_1_0_41_1 // PDC_PLA_SystemState.PDCActivationReason
{
	byte superval[2];

	//Update Childvalue (Enum)
	byte thisval; // PDCActivationReason
	thisval = 0x0f & getValue(this);

    // Update superval
	getValue(P_ASG_10_1_0_41, superval);
	superval[0]= superval[0]&0x0f;
	superval[0]= superval[0]|(thisval<<4);
	putValue(P_ASG_10_1_0_41,superval);
}

on envVar P_ASG_10_1_0_41_2_0
{
	byte bitval;
	//thisval steht hier fuer den bitfield-wert, 
	//aus Generierungsgruenden hier keine einheitliche Bezeichnung moeglich.
	byte thisval; // Status
	bitval= getValue(this);
	thisval = getValue(P_ASG_10_1_0_41_2);
	thisval = thisval&~(1<<0)|(bitval<<0);
	putValue(P_ASG_10_1_0_41_2,thisval);
}

on envVar P_ASG_10_1_0_41_2_1
{
	byte bitval;
	//thisval steht hier fuer den bitfield-wert, 
	//aus Generierungsgruenden hier keine einheitliche Bezeichnung moeglich.
	byte thisval; // Status
	bitval= getValue(this);
	thisval = getValue(P_ASG_10_1_0_41_2);
	thisval = thisval&~(1<<1)|(bitval<<1);
	putValue(P_ASG_10_1_0_41_2,thisval);
}

on envVar P_ASG_10_1_0_41_2 // PDC_PLA_SystemState.Status
{
	byte superval[2];

	//Update Childvalue (BitField)
	byte mask=0x01;
	int i = 0;
	byte thisval; // Status
	thisval = getValue(this);
	if(thisval&(mask<<0))
		putValue(P_ASG_10_1_0_41_2_0, 1);
	else
		putValue(P_ASG_10_1_0_41_2_0, 0);
	if(thisval&(mask<<1))
		putValue(P_ASG_10_1_0_41_2_1, 1);
	else
		putValue(P_ASG_10_1_0_41_2_1, 0);

    // Update superval
	getValue(P_ASG_10_1_0_41, superval);
	superval[0]= superval[0]&0xf0;
	superval[0]= superval[0]|thisval;
	putValue(P_ASG_10_1_0_41,superval);
}

on envVar P_ASG_10_1_0_41_3 // PDC_PLA_SystemState.ModificationReason
{
	byte superval[2];

	//Update Childvalue (Enum)
	byte thisval; // ModificationReason
	thisval = 0x0f & getValue(this);

    // Update superval
	getValue(P_ASG_10_1_0_41, superval);
	superval[1]= superval[1]&0x0f;
	superval[1]= superval[1]|(thisval<<4);
	putValue(P_ASG_10_1_0_41,superval);
}

on envVar P_ASG_10_1_0_41_4_0
{
	byte bitval;
	//thisval steht hier fuer den bitfield-wert, 
	//aus Generierungsgruenden hier keine einheitliche Bezeichnung moeglich.
	byte thisval; // ModificationState
	bitval= getValue(this);
	thisval = getValue(P_ASG_10_1_0_41_4);
	thisval = thisval&~(1<<0)|(bitval<<0);
	putValue(P_ASG_10_1_0_41_4,thisval);
}

on envVar P_ASG_10_1_0_41_4_1
{
	byte bitval;
	//thisval steht hier fuer den bitfield-wert, 
	//aus Generierungsgruenden hier keine einheitliche Bezeichnung moeglich.
	byte thisval; // ModificationState
	bitval= getValue(this);
	thisval = getValue(P_ASG_10_1_0_41_4);
	thisval = thisval&~(1<<1)|(bitval<<1);
	putValue(P_ASG_10_1_0_41_4,thisval);
}

on envVar P_ASG_10_1_0_41_4 // PDC_PLA_SystemState.ModificationState
{
	byte superval[2];

	//Update Childvalue (BitField)
	byte mask=0x01;
	int i = 0;
	byte thisval; // ModificationState
	thisval = getValue(this);
	if(thisval&(mask<<0))
		putValue(P_ASG_10_1_0_41_4_0, 1);
	else
		putValue(P_ASG_10_1_0_41_4_0, 0);
	if(thisval&(mask<<1))
		putValue(P_ASG_10_1_0_41_4_1, 1);
	else
		putValue(P_ASG_10_1_0_41_4_1, 0);

    // Update superval
	getValue(P_ASG_10_1_0_41, superval);
	superval[1]= superval[1]&0xf0;
	superval[1]= superval[1]|thisval;
	putValue(P_ASG_10_1_0_41,superval);
}

on envVar P_ASG_10_1_0_42Get_BTN
{
 if (P_ASG_10_1_0_42Get_BTN_already_pressed == 0)
  {
       putValue(P_ASG_10_1_0_42_ErrCode,0);
       SetControlBackColor(panel_name,"errField_P_ASG_10_1_0_42",MakeRGB(255,255,255));
       P_ASG_10_1_0_42Get_BTN_already_pressed = 1;
 }
 else
 {
       Request_Void(LSGID, P_ASG_10_1_0_42_ID, DataGet_REQ); 
       P_ASG_10_1_0_42Get_BTN_already_pressed = 0;
 }
}
on envVar P_ASG_10_1_0_42SetGet_BTN
{
	byte BAPTemp[2];
    if (P_ASG_10_1_0_42SetGet_BTN_already_pressed == 0)
    {
       putValue(P_ASG_10_1_0_42_ErrCode,0);
       SetControlBackColor(panel_name,"errField_P_ASG_10_1_0_42",MakeRGB(255,255,255));
       P_ASG_10_1_0_42SetGet_BTN_already_pressed = 1;
    }
    else
    {
       getValue(P_ASG_10_1_0_42, BAPTemp);
       Request_ByteSequence(LSGID, P_ASG_10_1_0_42_ID, DataSetGet_REQ, BAPTemp, getValueSize(P_ASG_10_1_0_42));
       P_ASG_10_1_0_42SetGet_BTN_already_pressed = 0;
    }
}
on envVar P_ASG_10_1_0_42 // bus value of PDC_Offroad (42).
{
	// opcodes: Error-Status
	byte param1; // Setup
	byte param2; // ModificationReason
	byte param3; // ModificationState
	// DATATYPE_BYTESEQUENCE / DATATYPE_FIXEDBYTESEQUENCE
	int i;
	byte superval[2];
	int currentPos;
	currentPos = 0;
	for( i = 0; i < 2; i++ ) {
		superval[i] = 0;
	}
	getValue(P_ASG_10_1_0_42, superval);
	///////// Start param1 - UINT8 /////////
	param1 = superval[currentPos++];
	putValue(P_ASG_10_1_0_42_1, param1);
	///////// Start param2 - NIBBLE /////////
	param2 = (superval[currentPos] & 0xf0)>>4;
	putValue(P_ASG_10_1_0_42_2, param2);
	///////// Start param3 - NIBBLE /////////
	param3 = superval[currentPos++] & 0x0f;
	putValue(P_ASG_10_1_0_42_3, param3);
}

on envVar P_ASG_10_1_0_42_1_0
{
	byte bitval;
	//thisval steht hier fuer den bitfield-wert, 
	//aus Generierungsgruenden hier keine einheitliche Bezeichnung moeglich.
	byte thisval; // Setup
	bitval= getValue(this);
	thisval = getValue(P_ASG_10_1_0_42_1);
	thisval = thisval&~(1<<0)|(bitval<<0);
	putValue(P_ASG_10_1_0_42_1,thisval);
}

on envVar P_ASG_10_1_0_42_1 // PDC_Offroad.Setup
{
	byte superval[2];

	//Update Childvalue (BitField)
	byte mask=0x01;
	int i = 0;
	byte thisval; // Setup
	thisval = getValue(this);
	if(thisval&(mask<<0))
		putValue(P_ASG_10_1_0_42_1_0, 1);
	else
		putValue(P_ASG_10_1_0_42_1_0, 0);

    // Update superval
	getValue(P_ASG_10_1_0_42, superval);
	superval[0]=thisval;
	putValue(P_ASG_10_1_0_42,superval);
}

on envVar P_ASG_10_1_0_42_2 // PDC_Offroad.ModificationReason
{
	byte superval[2];

	//Update Childvalue (Enum)
	byte thisval; // ModificationReason
	thisval = 0x0f & getValue(this);

    // Update superval
	getValue(P_ASG_10_1_0_42, superval);
	superval[1]= superval[1]&0x0f;
	superval[1]= superval[1]|(thisval<<4);
	putValue(P_ASG_10_1_0_42,superval);
}

on envVar P_ASG_10_1_0_42_3_0
{
	byte bitval;
	//thisval steht hier fuer den bitfield-wert, 
	//aus Generierungsgruenden hier keine einheitliche Bezeichnung moeglich.
	byte thisval; // ModificationState
	bitval= getValue(this);
	thisval = getValue(P_ASG_10_1_0_42_3);
	thisval = thisval&~(1<<0)|(bitval<<0);
	putValue(P_ASG_10_1_0_42_3,thisval);
}

on envVar P_ASG_10_1_0_42_3 // PDC_Offroad.ModificationState
{
	byte superval[2];

	//Update Childvalue (BitField)
	byte mask=0x01;
	int i = 0;
	byte thisval; // ModificationState
	thisval = getValue(this);
	if(thisval&(mask<<0))
		putValue(P_ASG_10_1_0_42_3_0, 1);
	else
		putValue(P_ASG_10_1_0_42_3_0, 0);

    // Update superval
	getValue(P_ASG_10_1_0_42, superval);
	superval[1]= superval[1]&0xf0;
	superval[1]= superval[1]|thisval;
	putValue(P_ASG_10_1_0_42,superval);
}

on envVar P_ASG_10_1_0_43Get_BTN
{
 if (P_ASG_10_1_0_43Get_BTN_already_pressed == 0)
  {
       putValue(P_ASG_10_1_0_43_ErrCode,0);
       SetControlBackColor(panel_name,"errField_P_ASG_10_1_0_43",MakeRGB(255,255,255));
       P_ASG_10_1_0_43Get_BTN_already_pressed = 1;
 }
 else
 {
       Request_Void(LSGID, P_ASG_10_1_0_43_ID, DataGet_REQ); 
       P_ASG_10_1_0_43Get_BTN_already_pressed = 0;
 }
}
on envVar P_ASG_10_1_0_43SetGet_BTN
{
	byte BAPTemp[3];
    if (P_ASG_10_1_0_43SetGet_BTN_already_pressed == 0)
    {
       putValue(P_ASG_10_1_0_43_ErrCode,0);
       SetControlBackColor(panel_name,"errField_P_ASG_10_1_0_43",MakeRGB(255,255,255));
       P_ASG_10_1_0_43SetGet_BTN_already_pressed = 1;
    }
    else
    {
       getValue(P_ASG_10_1_0_43, BAPTemp);
       Request_ByteSequence(LSGID, P_ASG_10_1_0_43_ID, DataSetGet_REQ, BAPTemp, getValueSize(P_ASG_10_1_0_43));
       P_ASG_10_1_0_43SetGet_BTN_already_pressed = 0;
    }
}
on envVar P_ASG_10_1_0_43 // bus value of ParkboxVisualisation (43).
{
	// opcodes: Error-Status
	byte param1; // Setup
	byte param2; // Extension
	byte param3; // ModificationReason
	byte param4; // ModificationState
	// DATATYPE_BYTESEQUENCE / DATATYPE_FIXEDBYTESEQUENCE
	int i;
	byte superval[3];
	int currentPos;
	currentPos = 0;
	for( i = 0; i < 3; i++ ) {
		superval[i] = 0;
	}
	getValue(P_ASG_10_1_0_43, superval);
	///////// Start param1 - UINT8 /////////
	param1 = superval[currentPos++];
	putValue(P_ASG_10_1_0_43_1, param1);
	///////// Start param2 - UINT8 /////////
	param2 = superval[currentPos++];
	putValue(P_ASG_10_1_0_43_2, round((param2 * 1.0) - (0) + (0), 1.0));
	///////// Start param3 - NIBBLE /////////
	param3 = (superval[currentPos] & 0xf0)>>4;
	putValue(P_ASG_10_1_0_43_3, param3);
	///////// Start param4 - NIBBLE /////////
	param4 = superval[currentPos++] & 0x0f;
	putValue(P_ASG_10_1_0_43_4, param4);
}

on envVar P_ASG_10_1_0_43_1_0
{
	byte bitval;
	//thisval steht hier fuer den bitfield-wert, 
	//aus Generierungsgruenden hier keine einheitliche Bezeichnung moeglich.
	byte thisval; // Setup
	bitval= getValue(this);
	thisval = getValue(P_ASG_10_1_0_43_1);
	thisval = thisval&~(1<<0)|(bitval<<0);
	putValue(P_ASG_10_1_0_43_1,thisval);
}

on envVar P_ASG_10_1_0_43_1 // ParkboxVisualisation.Setup
{
	byte superval[3];

	//Update Childvalue (BitField)
	byte mask=0x01;
	int i = 0;
	byte thisval; // Setup
	thisval = getValue(this);
	if(thisval&(mask<<0))
		putValue(P_ASG_10_1_0_43_1_0, 1);
	else
		putValue(P_ASG_10_1_0_43_1_0, 0);

    // Update superval
	getValue(P_ASG_10_1_0_43, superval);
	superval[0]=thisval;
	putValue(P_ASG_10_1_0_43,superval);
}

// Ueberwachung der Darstellungsvariable der Range.
on envVar P_ASG_10_1_0_43_2_range // ParkboxVisualisation.Extension 
{
	@P_ASG_10_1_0_43_2 = @P_ASG_10_1_0_43_2_range - (0); // slider = range - min
}

on envVar P_ASG_10_1_0_43_2 // ParkboxVisualisation.Extension
{
	byte superval[3];

	//Update Childvalue (Number)
	byte thisval; // Extension
	float slider_value;

	slider_value = 0; // Konstanter Parameter.
	@P_ASG_10_1_0_43_2_range = slider_value + (0); // real value := slider value + range min.
	thisval = (byte)round((slider_value + (0) - (0)) / (1.0), 1); // bus value := (slider value + min - offset) / step.

    // Update superval
	getValue(P_ASG_10_1_0_43, superval);
	superval[1]=thisval;
	putValue(P_ASG_10_1_0_43,superval);
}

on envVar P_ASG_10_1_0_43_3 // ParkboxVisualisation.ModificationReason
{
	byte superval[3];

	//Update Childvalue (Enum)
	byte thisval; // ModificationReason
	thisval = 0x0f & getValue(this);

    // Update superval
	getValue(P_ASG_10_1_0_43, superval);
	superval[2]= superval[2]&0x0f;
	superval[2]= superval[2]|(thisval<<4);
	putValue(P_ASG_10_1_0_43,superval);
}

on envVar P_ASG_10_1_0_43_4_0
{
	byte bitval;
	//thisval steht hier fuer den bitfield-wert, 
	//aus Generierungsgruenden hier keine einheitliche Bezeichnung moeglich.
	byte thisval; // ModificationState
	bitval= getValue(this);
	thisval = getValue(P_ASG_10_1_0_43_4);
	thisval = thisval&~(1<<0)|(bitval<<0);
	putValue(P_ASG_10_1_0_43_4,thisval);
}

on envVar P_ASG_10_1_0_43_4 // ParkboxVisualisation.ModificationState
{
	byte superval[3];

	//Update Childvalue (BitField)
	byte mask=0x01;
	int i = 0;
	byte thisval; // ModificationState
	thisval = getValue(this);
	if(thisval&(mask<<0))
		putValue(P_ASG_10_1_0_43_4_0, 1);
	else
		putValue(P_ASG_10_1_0_43_4_0, 0);

    // Update superval
	getValue(P_ASG_10_1_0_43, superval);
	superval[2]= superval[2]&0xf0;
	superval[2]= superval[2]|thisval;
	putValue(P_ASG_10_1_0_43,superval);
}

on envVar P_ASG_10_1_0_44Get_BTN
{
 if (P_ASG_10_1_0_44Get_BTN_already_pressed == 0)
  {
       putValue(P_ASG_10_1_0_44_ErrCode,0);
       SetControlBackColor(panel_name,"errField_P_ASG_10_1_0_44",MakeRGB(255,255,255));
       P_ASG_10_1_0_44Get_BTN_already_pressed = 1;
 }
 else
 {
       Request_Void(LSGID, P_ASG_10_1_0_44_ID, DataGet_REQ); 
       P_ASG_10_1_0_44Get_BTN_already_pressed = 0;
 }
}
on envVar P_ASG_10_1_0_44SetGet_BTN
{
	byte BAPTemp[2];
    if (P_ASG_10_1_0_44SetGet_BTN_already_pressed == 0)
    {
       putValue(P_ASG_10_1_0_44_ErrCode,0);
       SetControlBackColor(panel_name,"errField_P_ASG_10_1_0_44",MakeRGB(255,255,255));
       P_ASG_10_1_0_44SetGet_BTN_already_pressed = 1;
    }
    else
    {
       getValue(P_ASG_10_1_0_44, BAPTemp);
       Request_ByteSequence(LSGID, P_ASG_10_1_0_44_ID, DataSetGet_REQ, BAPTemp, getValueSize(P_ASG_10_1_0_44));
       P_ASG_10_1_0_44SetGet_BTN_already_pressed = 0;
    }
}
on envVar P_ASG_10_1_0_44 // bus value of OPSVisualisation_Position (44).
{
	// opcodes: Error-Status
	byte param1; // Position
	byte param2; // ModificationReason
	byte param3; // ModificationState
	// DATATYPE_BYTESEQUENCE / DATATYPE_FIXEDBYTESEQUENCE
	int i;
	byte superval[2];
	int currentPos;
	currentPos = 0;
	for( i = 0; i < 2; i++ ) {
		superval[i] = 0;
	}
	getValue(P_ASG_10_1_0_44, superval);
	///////// Start param1 - UINT8 /////////
	param1 = superval[currentPos++];
	putValue(P_ASG_10_1_0_44_1, param1);
	///////// Start param2 - NIBBLE /////////
	param2 = (superval[currentPos] & 0xf0)>>4;
	putValue(P_ASG_10_1_0_44_2, param2);
	///////// Start param3 - NIBBLE /////////
	param3 = superval[currentPos++] & 0x0f;
	putValue(P_ASG_10_1_0_44_3, param3);
}

on envVar P_ASG_10_1_0_44_1 // OPSVisualisation_Position.Position
{
	byte superval[2];

	//Update Childvalue (Enum)
	byte thisval; // Position
	thisval = getValue(this);

    // Update superval
	getValue(P_ASG_10_1_0_44, superval);
	superval[0]=thisval;
	putValue(P_ASG_10_1_0_44,superval);
}

on envVar P_ASG_10_1_0_44_2 // OPSVisualisation_Position.ModificationReason
{
	byte superval[2];

	//Update Childvalue (Enum)
	byte thisval; // ModificationReason
	thisval = 0x0f & getValue(this);

    // Update superval
	getValue(P_ASG_10_1_0_44, superval);
	superval[1]= superval[1]&0x0f;
	superval[1]= superval[1]|(thisval<<4);
	putValue(P_ASG_10_1_0_44,superval);
}

on envVar P_ASG_10_1_0_44_3_0
{
	byte bitval;
	//thisval steht hier fuer den bitfield-wert, 
	//aus Generierungsgruenden hier keine einheitliche Bezeichnung moeglich.
	byte thisval; // ModificationState
	bitval= getValue(this);
	thisval = getValue(P_ASG_10_1_0_44_3);
	thisval = thisval&~(1<<0)|(bitval<<0);
	putValue(P_ASG_10_1_0_44_3,thisval);
}

on envVar P_ASG_10_1_0_44_3 // OPSVisualisation_Position.ModificationState
{
	byte superval[2];

	//Update Childvalue (BitField)
	byte mask=0x01;
	int i = 0;
	byte thisval; // ModificationState
	thisval = getValue(this);
	if(thisval&(mask<<0))
		putValue(P_ASG_10_1_0_44_3_0, 1);
	else
		putValue(P_ASG_10_1_0_44_3_0, 0);

    // Update superval
	getValue(P_ASG_10_1_0_44, superval);
	superval[1]= superval[1]&0xf0;
	superval[1]= superval[1]|thisval;
	putValue(P_ASG_10_1_0_44,superval);
}

on envVar P_ASG_10_1_0_45Get_BTN
{
 if (P_ASG_10_1_0_45Get_BTN_already_pressed == 0)
  {
       putValue(P_ASG_10_1_0_45_ErrCode,0);
       SetControlBackColor(panel_name,"errField_P_ASG_10_1_0_45",MakeRGB(255,255,255));
       P_ASG_10_1_0_45Get_BTN_already_pressed = 1;
 }
 else
 {
       Request_Void(LSGID, P_ASG_10_1_0_45_ID, DataGet_REQ); 
       P_ASG_10_1_0_45Get_BTN_already_pressed = 0;
 }
}
on envVar P_ASG_10_1_0_45SetGet_BTN
{
	byte BAPTemp[2];
    if (P_ASG_10_1_0_45SetGet_BTN_already_pressed == 0)
    {
       putValue(P_ASG_10_1_0_45_ErrCode,0);
       SetControlBackColor(panel_name,"errField_P_ASG_10_1_0_45",MakeRGB(255,255,255));
       P_ASG_10_1_0_45SetGet_BTN_already_pressed = 1;
    }
    else
    {
       getValue(P_ASG_10_1_0_45, BAPTemp);
       Request_ByteSequence(LSGID, P_ASG_10_1_0_45_ID, DataSetGet_REQ, BAPTemp, getValueSize(P_ASG_10_1_0_45));
       P_ASG_10_1_0_45SetGet_BTN_already_pressed = 0;
    }
}
on envVar P_ASG_10_1_0_45 // bus value of ManeuverAssist_Config (45).
{
	// opcodes: Error-Status
	byte param1; // Setup
	byte param2; // ModificationReason
	byte param3; // ModificationState
	// DATATYPE_BYTESEQUENCE / DATATYPE_FIXEDBYTESEQUENCE
	int i;
	byte superval[2];
	int currentPos;
	currentPos = 0;
	for( i = 0; i < 2; i++ ) {
		superval[i] = 0;
	}
	getValue(P_ASG_10_1_0_45, superval);
	///////// Start param1 - UINT8 /////////
	param1 = superval[currentPos++];
	putValue(P_ASG_10_1_0_45_1, param1);
	///////// Start param2 - NIBBLE /////////
	param2 = (superval[currentPos] & 0xf0)>>4;
	putValue(P_ASG_10_1_0_45_2, param2);
	///////// Start param3 - NIBBLE /////////
	param3 = superval[currentPos++] & 0x0f;
	putValue(P_ASG_10_1_0_45_3, param3);
}

on envVar P_ASG_10_1_0_45_1 // ManeuverAssist_Config.Setup
{
	byte superval[2];

	//Update Childvalue (Enum)
	byte thisval; // Setup
	thisval = getValue(this);

    // Update superval
	getValue(P_ASG_10_1_0_45, superval);
	superval[0]=thisval;
	putValue(P_ASG_10_1_0_45,superval);
}

on envVar P_ASG_10_1_0_45_2 // ManeuverAssist_Config.ModificationReason
{
	byte superval[2];

	//Update Childvalue (Enum)
	byte thisval; // ModificationReason
	thisval = 0x0f & getValue(this);

    // Update superval
	getValue(P_ASG_10_1_0_45, superval);
	superval[1]= superval[1]&0x0f;
	superval[1]= superval[1]|(thisval<<4);
	putValue(P_ASG_10_1_0_45,superval);
}

on envVar P_ASG_10_1_0_45_3_0
{
	byte bitval;
	//thisval steht hier fuer den bitfield-wert, 
	//aus Generierungsgruenden hier keine einheitliche Bezeichnung moeglich.
	byte thisval; // ModificationState
	bitval= getValue(this);
	thisval = getValue(P_ASG_10_1_0_45_3);
	thisval = thisval&~(1<<0)|(bitval<<0);
	putValue(P_ASG_10_1_0_45_3,thisval);
}

on envVar P_ASG_10_1_0_45_3 // ManeuverAssist_Config.ModificationState
{
	byte superval[2];

	//Update Childvalue (BitField)
	byte mask=0x01;
	int i = 0;
	byte thisval; // ModificationState
	thisval = getValue(this);
	if(thisval&(mask<<0))
		putValue(P_ASG_10_1_0_45_3_0, 1);
	else
		putValue(P_ASG_10_1_0_45_3_0, 0);

    // Update superval
	getValue(P_ASG_10_1_0_45, superval);
	superval[1]= superval[1]&0xf0;
	superval[1]= superval[1]|thisval;
	putValue(P_ASG_10_1_0_45,superval);
}

on envVar P_ASG_10_1_0_46Get_BTN
{
 if (P_ASG_10_1_0_46Get_BTN_already_pressed == 0)
  {
       putValue(P_ASG_10_1_0_46_ErrCode,0);
       SetControlBackColor(panel_name,"errField_P_ASG_10_1_0_46",MakeRGB(255,255,255));
       P_ASG_10_1_0_46Get_BTN_already_pressed = 1;
 }
 else
 {
       Request_Void(LSGID, P_ASG_10_1_0_46_ID, DataGet_REQ); 
       P_ASG_10_1_0_46Get_BTN_already_pressed = 0;
 }
}
on envVar P_ASG_10_1_0_46SetGet_BTN
{
	byte BAPTemp[2];
    if (P_ASG_10_1_0_46SetGet_BTN_already_pressed == 0)
    {
       putValue(P_ASG_10_1_0_46_ErrCode,0);
       SetControlBackColor(panel_name,"errField_P_ASG_10_1_0_46",MakeRGB(255,255,255));
       P_ASG_10_1_0_46SetGet_BTN_already_pressed = 1;
    }
    else
    {
       getValue(P_ASG_10_1_0_46, BAPTemp);
       Request_ByteSequence(LSGID, P_ASG_10_1_0_46_ID, DataSetGet_REQ, BAPTemp, getValueSize(P_ASG_10_1_0_46));
       P_ASG_10_1_0_46SetGet_BTN_already_pressed = 0;
    }
}
on envVar P_ASG_10_1_0_46 // bus value of ManeuverAssist (46).
{
	// opcodes: Error-Status
	byte param1; // Setup
	byte param2; // ModificationReason
	byte param3; // ModificationState
	// DATATYPE_BYTESEQUENCE / DATATYPE_FIXEDBYTESEQUENCE
	int i;
	byte superval[2];
	int currentPos;
	currentPos = 0;
	for( i = 0; i < 2; i++ ) {
		superval[i] = 0;
	}
	getValue(P_ASG_10_1_0_46, superval);
	///////// Start param1 - UINT8 /////////
	param1 = superval[currentPos++];
	putValue(P_ASG_10_1_0_46_1, param1);
	///////// Start param2 - NIBBLE /////////
	param2 = (superval[currentPos] & 0xf0)>>4;
	putValue(P_ASG_10_1_0_46_2, param2);
	///////// Start param3 - NIBBLE /////////
	param3 = superval[currentPos++] & 0x0f;
	putValue(P_ASG_10_1_0_46_3, param3);
}

on envVar P_ASG_10_1_0_46_1_0
{
	byte bitval;
	//thisval steht hier fuer den bitfield-wert, 
	//aus Generierungsgruenden hier keine einheitliche Bezeichnung moeglich.
	byte thisval; // Setup
	bitval= getValue(this);
	thisval = getValue(P_ASG_10_1_0_46_1);
	thisval = thisval&~(1<<0)|(bitval<<0);
	putValue(P_ASG_10_1_0_46_1,thisval);
}

on envVar P_ASG_10_1_0_46_1 // ManeuverAssist.Setup
{
	byte superval[2];

	//Update Childvalue (BitField)
	byte mask=0x01;
	int i = 0;
	byte thisval; // Setup
	thisval = getValue(this);
	if(thisval&(mask<<0))
		putValue(P_ASG_10_1_0_46_1_0, 1);
	else
		putValue(P_ASG_10_1_0_46_1_0, 0);

    // Update superval
	getValue(P_ASG_10_1_0_46, superval);
	superval[0]=thisval;
	putValue(P_ASG_10_1_0_46,superval);
}

on envVar P_ASG_10_1_0_46_2 // ManeuverAssist.ModificationReason
{
	byte superval[2];

	//Update Childvalue (Enum)
	byte thisval; // ModificationReason
	thisval = 0x0f & getValue(this);

    // Update superval
	getValue(P_ASG_10_1_0_46, superval);
	superval[1]= superval[1]&0x0f;
	superval[1]= superval[1]|(thisval<<4);
	putValue(P_ASG_10_1_0_46,superval);
}

on envVar P_ASG_10_1_0_46_3_0
{
	byte bitval;
	//thisval steht hier fuer den bitfield-wert, 
	//aus Generierungsgruenden hier keine einheitliche Bezeichnung moeglich.
	byte thisval; // ModificationState
	bitval= getValue(this);
	thisval = getValue(P_ASG_10_1_0_46_3);
	thisval = thisval&~(1<<0)|(bitval<<0);
	putValue(P_ASG_10_1_0_46_3,thisval);
}

on envVar P_ASG_10_1_0_46_3 // ManeuverAssist.ModificationState
{
	byte superval[2];

	//Update Childvalue (BitField)
	byte mask=0x01;
	int i = 0;
	byte thisval; // ModificationState
	thisval = getValue(this);
	if(thisval&(mask<<0))
		putValue(P_ASG_10_1_0_46_3_0, 1);
	else
		putValue(P_ASG_10_1_0_46_3_0, 0);

    // Update superval
	getValue(P_ASG_10_1_0_46, superval);
	superval[1]= superval[1]&0xf0;
	superval[1]= superval[1]|thisval;
	putValue(P_ASG_10_1_0_46,superval);
}

on envVar P_ASG_10_1_0_47Get_BTN
{
 if (P_ASG_10_1_0_47Get_BTN_already_pressed == 0)
  {
       putValue(P_ASG_10_1_0_47_ErrCode,0);
       SetControlBackColor(panel_name,"errField_P_ASG_10_1_0_47",MakeRGB(255,255,255));
       P_ASG_10_1_0_47Get_BTN_already_pressed = 1;
 }
 else
 {
       Request_Void(LSGID, P_ASG_10_1_0_47_ID, DataGet_REQ); 
       P_ASG_10_1_0_47Get_BTN_already_pressed = 0;
 }
}
on envVar P_ASG_10_1_0_47 // bus value of ManeuverAssist_State (47).
{
	// opcodes: Error-Status
	byte param1; // State
	byte param2; // Messages
	byte param3; // FrontLeftActivity
	byte param4; // RearLeftActivity
	byte param5; // FrontRightActivity
	byte param6; // RearRightActivity
	// DATATYPE_BYTESEQUENCE / DATATYPE_FIXEDBYTESEQUENCE
	int i;
	byte superval[4];
	int currentPos;
	currentPos = 0;
	for( i = 0; i < 4; i++ ) {
		superval[i] = 0;
	}
	getValue(P_ASG_10_1_0_47, superval);
	///////// Start param1 - UINT8 /////////
	param1 = superval[currentPos++];
	putValue(P_ASG_10_1_0_47_1, param1);
	///////// Start param2 - UINT8 /////////
	param2 = superval[currentPos++];
	putValue(P_ASG_10_1_0_47_2, param2);
	///////// Start param3 - NIBBLE /////////
	param3 = (superval[currentPos] & 0xf0)>>4;
	putValue(P_ASG_10_1_0_47_3, param3);
	///////// Start param4 - NIBBLE /////////
	param4 = superval[currentPos++] & 0x0f;
	putValue(P_ASG_10_1_0_47_4, param4);
	///////// Start param5 - NIBBLE /////////
	param5 = (superval[currentPos] & 0xf0)>>4;
	putValue(P_ASG_10_1_0_47_5, param5);
	///////// Start param6 - NIBBLE /////////
	param6 = superval[currentPos++] & 0x0f;
	putValue(P_ASG_10_1_0_47_6, param6);
}

on envVar P_ASG_10_1_0_47_1_0
{
	byte bitval;
	//thisval steht hier fuer den bitfield-wert, 
	//aus Generierungsgruenden hier keine einheitliche Bezeichnung moeglich.
	byte thisval; // State
	bitval= getValue(this);
	thisval = getValue(P_ASG_10_1_0_47_1);
	thisval = thisval&~(1<<0)|(bitval<<0);
	putValue(P_ASG_10_1_0_47_1,thisval);
}

on envVar P_ASG_10_1_0_47_1_1
{
	byte bitval;
	//thisval steht hier fuer den bitfield-wert, 
	//aus Generierungsgruenden hier keine einheitliche Bezeichnung moeglich.
	byte thisval; // State
	bitval= getValue(this);
	thisval = getValue(P_ASG_10_1_0_47_1);
	thisval = thisval&~(1<<1)|(bitval<<1);
	putValue(P_ASG_10_1_0_47_1,thisval);
}

on envVar P_ASG_10_1_0_47_1_2
{
	byte bitval;
	//thisval steht hier fuer den bitfield-wert, 
	//aus Generierungsgruenden hier keine einheitliche Bezeichnung moeglich.
	byte thisval; // State
	bitval= getValue(this);
	thisval = getValue(P_ASG_10_1_0_47_1);
	thisval = thisval&~(1<<2)|(bitval<<2);
	putValue(P_ASG_10_1_0_47_1,thisval);
}

on envVar P_ASG_10_1_0_47_1_3
{
	byte bitval;
	//thisval steht hier fuer den bitfield-wert, 
	//aus Generierungsgruenden hier keine einheitliche Bezeichnung moeglich.
	byte thisval; // State
	bitval= getValue(this);
	thisval = getValue(P_ASG_10_1_0_47_1);
	thisval = thisval&~(1<<3)|(bitval<<3);
	putValue(P_ASG_10_1_0_47_1,thisval);
}

on envVar P_ASG_10_1_0_47_1_4
{
	byte bitval;
	//thisval steht hier fuer den bitfield-wert, 
	//aus Generierungsgruenden hier keine einheitliche Bezeichnung moeglich.
	byte thisval; // State
	bitval= getValue(this);
	thisval = getValue(P_ASG_10_1_0_47_1);
	thisval = thisval&~(1<<4)|(bitval<<4);
	putValue(P_ASG_10_1_0_47_1,thisval);
}

on envVar P_ASG_10_1_0_47_1 // ManeuverAssist_State.State
{
	byte superval[4];

	//Update Childvalue (BitField)
	byte mask=0x01;
	int i = 0;
	byte thisval; // State
	thisval = getValue(this);
	if(thisval&(mask<<0))
		putValue(P_ASG_10_1_0_47_1_0, 1);
	else
		putValue(P_ASG_10_1_0_47_1_0, 0);
	if(thisval&(mask<<1))
		putValue(P_ASG_10_1_0_47_1_1, 1);
	else
		putValue(P_ASG_10_1_0_47_1_1, 0);
	if(thisval&(mask<<2))
		putValue(P_ASG_10_1_0_47_1_2, 1);
	else
		putValue(P_ASG_10_1_0_47_1_2, 0);
	if(thisval&(mask<<3))
		putValue(P_ASG_10_1_0_47_1_3, 1);
	else
		putValue(P_ASG_10_1_0_47_1_3, 0);
	if(thisval&(mask<<4))
		putValue(P_ASG_10_1_0_47_1_4, 1);
	else
		putValue(P_ASG_10_1_0_47_1_4, 0);

    // Update superval
	getValue(P_ASG_10_1_0_47, superval);
	superval[0]=thisval;
	putValue(P_ASG_10_1_0_47,superval);
}

on envVar P_ASG_10_1_0_47_2 // ManeuverAssist_State.Messages
{
	byte superval[4];

	//Update Childvalue (Enum)
	byte thisval; // Messages
	thisval = getValue(this);

    // Update superval
	getValue(P_ASG_10_1_0_47, superval);
	superval[1]=thisval;
	putValue(P_ASG_10_1_0_47,superval);
}

on envVar P_ASG_10_1_0_47_3 // ManeuverAssist_State.FrontLeftActivity
{
	byte superval[4];

	//Update Childvalue (Enum)
	byte thisval; // FrontLeftActivity
	thisval = 0x0f & getValue(this);

    // Update superval
	getValue(P_ASG_10_1_0_47, superval);
	superval[2]= superval[2]&0x0f;
	superval[2]= superval[2]|(thisval<<4);
	putValue(P_ASG_10_1_0_47,superval);
}

on envVar P_ASG_10_1_0_47_4 // ManeuverAssist_State.RearLeftActivity
{
	byte superval[4];

	//Update Childvalue (Enum)
	byte thisval; // RearLeftActivity
	thisval = 0x0f & getValue(this);

    // Update superval
	getValue(P_ASG_10_1_0_47, superval);
	superval[2]= superval[2]&0xf0;
	superval[2]= superval[2]|thisval;
	putValue(P_ASG_10_1_0_47,superval);
}

on envVar P_ASG_10_1_0_47_5 // ManeuverAssist_State.FrontRightActivity
{
	byte superval[4];

	//Update Childvalue (Enum)
	byte thisval; // FrontRightActivity
	thisval = 0x0f & getValue(this);

    // Update superval
	getValue(P_ASG_10_1_0_47, superval);
	superval[3]= superval[3]&0x0f;
	superval[3]= superval[3]|(thisval<<4);
	putValue(P_ASG_10_1_0_47,superval);
}

on envVar P_ASG_10_1_0_47_6 // ManeuverAssist_State.RearRightActivity
{
	byte superval[4];

	//Update Childvalue (Enum)
	byte thisval; // RearRightActivity
	thisval = 0x0f & getValue(this);

    // Update superval
	getValue(P_ASG_10_1_0_47, superval);
	superval[3]= superval[3]&0xf0;
	superval[3]= superval[3]|thisval;
	putValue(P_ASG_10_1_0_47,superval);
}

on envVar P_ASG_10_1_0_48Get_BTN
{
 if (P_ASG_10_1_0_48Get_BTN_already_pressed == 0)
  {
       putValue(P_ASG_10_1_0_48_ErrCode,0);
       SetControlBackColor(panel_name,"errField_P_ASG_10_1_0_48",MakeRGB(255,255,255));
       P_ASG_10_1_0_48Get_BTN_already_pressed = 1;
 }
 else
 {
       Request_Void(LSGID, P_ASG_10_1_0_48_ID, DataGet_REQ); 
       P_ASG_10_1_0_48Get_BTN_already_pressed = 0;
 }
}
on envVar P_ASG_10_1_0_48SetGet_BTN
{
	byte BAPTemp[2];
    if (P_ASG_10_1_0_48SetGet_BTN_already_pressed == 0)
    {
       putValue(P_ASG_10_1_0_48_ErrCode,0);
       SetControlBackColor(panel_name,"errField_P_ASG_10_1_0_48",MakeRGB(255,255,255));
       P_ASG_10_1_0_48SetGet_BTN_already_pressed = 1;
    }
    else
    {
       getValue(P_ASG_10_1_0_48, BAPTemp);
       Request_ByteSequence(LSGID, P_ASG_10_1_0_48_ID, DataSetGet_REQ, BAPTemp, getValueSize(P_ASG_10_1_0_48));
       P_ASG_10_1_0_48SetGet_BTN_already_pressed = 0;
    }
}
on envVar P_ASG_10_1_0_48 // bus value of IPA_Config (48).
{
	// opcodes: Error-Status
	byte param1; // Mode
	byte param2; // ModificationReason
	byte param3; // ModificationState
	// DATATYPE_BYTESEQUENCE / DATATYPE_FIXEDBYTESEQUENCE
	int i;
	byte superval[2];
	int currentPos;
	currentPos = 0;
	for( i = 0; i < 2; i++ ) {
		superval[i] = 0;
	}
	getValue(P_ASG_10_1_0_48, superval);
	///////// Start param1 - UINT8 /////////
	param1 = superval[currentPos++];
	putValue(P_ASG_10_1_0_48_1, param1);
	///////// Start param2 - NIBBLE /////////
	param2 = (superval[currentPos] & 0xf0)>>4;
	putValue(P_ASG_10_1_0_48_2, param2);
	///////// Start param3 - NIBBLE /////////
	param3 = superval[currentPos++] & 0x0f;
	putValue(P_ASG_10_1_0_48_3, param3);
}

on envVar P_ASG_10_1_0_48_1 // IPA_Config.Mode
{
	byte superval[2];

	//Update Childvalue (Enum)
	byte thisval; // Mode
	thisval = getValue(this);

    // Update superval
	getValue(P_ASG_10_1_0_48, superval);
	superval[0]=thisval;
	putValue(P_ASG_10_1_0_48,superval);
}

on envVar P_ASG_10_1_0_48_2 // IPA_Config.ModificationReason
{
	byte superval[2];

	//Update Childvalue (Enum)
	byte thisval; // ModificationReason
	thisval = 0x0f & getValue(this);

    // Update superval
	getValue(P_ASG_10_1_0_48, superval);
	superval[1]= superval[1]&0x0f;
	superval[1]= superval[1]|(thisval<<4);
	putValue(P_ASG_10_1_0_48,superval);
}

on envVar P_ASG_10_1_0_48_3_0
{
	byte bitval;
	//thisval steht hier fuer den bitfield-wert, 
	//aus Generierungsgruenden hier keine einheitliche Bezeichnung moeglich.
	byte thisval; // ModificationState
	bitval= getValue(this);
	thisval = getValue(P_ASG_10_1_0_48_3);
	thisval = thisval&~(1<<0)|(bitval<<0);
	putValue(P_ASG_10_1_0_48_3,thisval);
}

on envVar P_ASG_10_1_0_48_3 // IPA_Config.ModificationState
{
	byte superval[2];

	//Update Childvalue (BitField)
	byte mask=0x01;
	int i = 0;
	byte thisval; // ModificationState
	thisval = getValue(this);
	if(thisval&(mask<<0))
		putValue(P_ASG_10_1_0_48_3_0, 1);
	else
		putValue(P_ASG_10_1_0_48_3_0, 0);

    // Update superval
	getValue(P_ASG_10_1_0_48, superval);
	superval[1]= superval[1]&0xf0;
	superval[1]= superval[1]|thisval;
	putValue(P_ASG_10_1_0_48,superval);
}

on envVar P_ASG_10_1_0_49Get_BTN
{
 if (P_ASG_10_1_0_49Get_BTN_already_pressed == 0)
  {
       putValue(P_ASG_10_1_0_49_ErrCode,0);
       SetControlBackColor(panel_name,"errField_P_ASG_10_1_0_49",MakeRGB(255,255,255));
       P_ASG_10_1_0_49Get_BTN_already_pressed = 1;
 }
 else
 {
       Request_Void(LSGID, P_ASG_10_1_0_49_ID, DataGet_REQ); 
       P_ASG_10_1_0_49Get_BTN_already_pressed = 0;
 }
}
on envVar P_ASG_10_1_0_49SetGet_BTN
{
	byte BAPTemp[5];
    if (P_ASG_10_1_0_49SetGet_BTN_already_pressed == 0)
    {
       putValue(P_ASG_10_1_0_49_ErrCode,0);
       SetControlBackColor(panel_name,"errField_P_ASG_10_1_0_49",MakeRGB(255,255,255));
       P_ASG_10_1_0_49SetGet_BTN_already_pressed = 1;
    }
    else
    {
       getValue(P_ASG_10_1_0_49, BAPTemp);
       Request_ByteSequence(LSGID, P_ASG_10_1_0_49_ID, DataSetGet_REQ, BAPTemp, getValueSize(P_ASG_10_1_0_49));
       P_ASG_10_1_0_49SetGet_BTN_already_pressed = 0;
    }
}
on envVar P_ASG_10_1_0_49 // bus value of PiloPa_SystemState (49).
{
	// opcodes: Error-Status
	byte param1; // Status
	byte param2; // ModificationState
	byte param3; // PP_ModificationReason
	byte param4; // GP_ModificationReason
	byte param5; // Extension1
	byte param6; // Extension2
	// DATATYPE_BYTESEQUENCE / DATATYPE_FIXEDBYTESEQUENCE
	int i;
	byte superval[5];
	int currentPos;
	currentPos = 0;
	for( i = 0; i < 5; i++ ) {
		superval[i] = 0;
	}
	getValue(P_ASG_10_1_0_49, superval);
	///////// Start param1 - UINT8 /////////
	param1 = superval[currentPos++];
	putValue(P_ASG_10_1_0_49_1, param1);
	///////// Start param2 - UINT8 /////////
	param2 = superval[currentPos++];
	putValue(P_ASG_10_1_0_49_2, param2);
	///////// Start param3 - NIBBLE /////////
	param3 = (superval[currentPos] & 0xf0)>>4;
	putValue(P_ASG_10_1_0_49_3, param3);
	///////// Start param4 - NIBBLE /////////
	param4 = superval[currentPos++] & 0x0f;
	putValue(P_ASG_10_1_0_49_4, param4);
	///////// Start param5 - UINT8 /////////
	param5 = superval[currentPos++];
	putValue(P_ASG_10_1_0_49_5, round((param5 * 1.0) - (0) + (0), 1.0));
	///////// Start param6 - UINT8 /////////
	param6 = superval[currentPos++];
	putValue(P_ASG_10_1_0_49_6, round((param6 * 1.0) - (0) + (0), 1.0));
}

on envVar P_ASG_10_1_0_49_1_0
{
	byte bitval;
	//thisval steht hier fuer den bitfield-wert, 
	//aus Generierungsgruenden hier keine einheitliche Bezeichnung moeglich.
	byte thisval; // Status
	bitval= getValue(this);
	thisval = getValue(P_ASG_10_1_0_49_1);
	thisval = thisval&~(1<<0)|(bitval<<0);
	putValue(P_ASG_10_1_0_49_1,thisval);
}

on envVar P_ASG_10_1_0_49_1_1
{
	byte bitval;
	//thisval steht hier fuer den bitfield-wert, 
	//aus Generierungsgruenden hier keine einheitliche Bezeichnung moeglich.
	byte thisval; // Status
	bitval= getValue(this);
	thisval = getValue(P_ASG_10_1_0_49_1);
	thisval = thisval&~(1<<1)|(bitval<<1);
	putValue(P_ASG_10_1_0_49_1,thisval);
}

on envVar P_ASG_10_1_0_49_1 // PiloPa_SystemState.Status
{
	byte superval[5];

	//Update Childvalue (BitField)
	byte mask=0x01;
	int i = 0;
	byte thisval; // Status
	thisval = getValue(this);
	if(thisval&(mask<<0))
		putValue(P_ASG_10_1_0_49_1_0, 1);
	else
		putValue(P_ASG_10_1_0_49_1_0, 0);
	if(thisval&(mask<<1))
		putValue(P_ASG_10_1_0_49_1_1, 1);
	else
		putValue(P_ASG_10_1_0_49_1_1, 0);

    // Update superval
	getValue(P_ASG_10_1_0_49, superval);
	superval[0]=thisval;
	putValue(P_ASG_10_1_0_49,superval);
}

on envVar P_ASG_10_1_0_49_2_0
{
	byte bitval;
	//thisval steht hier fuer den bitfield-wert, 
	//aus Generierungsgruenden hier keine einheitliche Bezeichnung moeglich.
	byte thisval; // ModificationState
	bitval= getValue(this);
	thisval = getValue(P_ASG_10_1_0_49_2);
	thisval = thisval&~(1<<0)|(bitval<<0);
	putValue(P_ASG_10_1_0_49_2,thisval);
}

on envVar P_ASG_10_1_0_49_2_1
{
	byte bitval;
	//thisval steht hier fuer den bitfield-wert, 
	//aus Generierungsgruenden hier keine einheitliche Bezeichnung moeglich.
	byte thisval; // ModificationState
	bitval= getValue(this);
	thisval = getValue(P_ASG_10_1_0_49_2);
	thisval = thisval&~(1<<1)|(bitval<<1);
	putValue(P_ASG_10_1_0_49_2,thisval);
}

on envVar P_ASG_10_1_0_49_2 // PiloPa_SystemState.ModificationState
{
	byte superval[5];

	//Update Childvalue (BitField)
	byte mask=0x01;
	int i = 0;
	byte thisval; // ModificationState
	thisval = getValue(this);
	if(thisval&(mask<<0))
		putValue(P_ASG_10_1_0_49_2_0, 1);
	else
		putValue(P_ASG_10_1_0_49_2_0, 0);
	if(thisval&(mask<<1))
		putValue(P_ASG_10_1_0_49_2_1, 1);
	else
		putValue(P_ASG_10_1_0_49_2_1, 0);

    // Update superval
	getValue(P_ASG_10_1_0_49, superval);
	superval[1]=thisval;
	putValue(P_ASG_10_1_0_49,superval);
}

on envVar P_ASG_10_1_0_49_3 // PiloPa_SystemState.PP_ModificationReason
{
	byte superval[5];

	//Update Childvalue (Enum)
	byte thisval; // PP_ModificationReason
	thisval = 0x0f & getValue(this);

    // Update superval
	getValue(P_ASG_10_1_0_49, superval);
	superval[2]= superval[2]&0x0f;
	superval[2]= superval[2]|(thisval<<4);
	putValue(P_ASG_10_1_0_49,superval);
}

on envVar P_ASG_10_1_0_49_4 // PiloPa_SystemState.GP_ModificationReason
{
	byte superval[5];

	//Update Childvalue (Enum)
	byte thisval; // GP_ModificationReason
	thisval = 0x0f & getValue(this);

    // Update superval
	getValue(P_ASG_10_1_0_49, superval);
	superval[2]= superval[2]&0xf0;
	superval[2]= superval[2]|thisval;
	putValue(P_ASG_10_1_0_49,superval);
}

// Ueberwachung der Darstellungsvariable der Range.
on envVar P_ASG_10_1_0_49_5_range // PiloPa_SystemState.Extension1 
{
	@P_ASG_10_1_0_49_5 = @P_ASG_10_1_0_49_5_range - (0); // slider = range - min
}

on envVar P_ASG_10_1_0_49_5 // PiloPa_SystemState.Extension1
{
	byte superval[5];

	//Update Childvalue (Number)
	byte thisval; // Extension1
	float slider_value;

	slider_value = 0; // Konstanter Parameter.
	@P_ASG_10_1_0_49_5_range = slider_value + (0); // real value := slider value + range min.
	thisval = (byte)round((slider_value + (0) - (0)) / (1.0), 1); // bus value := (slider value + min - offset) / step.

    // Update superval
	getValue(P_ASG_10_1_0_49, superval);
	superval[3]=thisval;
	putValue(P_ASG_10_1_0_49,superval);
}

// Ueberwachung der Darstellungsvariable der Range.
on envVar P_ASG_10_1_0_49_6_range // PiloPa_SystemState.Extension2 
{
	@P_ASG_10_1_0_49_6 = @P_ASG_10_1_0_49_6_range - (0); // slider = range - min
}

on envVar P_ASG_10_1_0_49_6 // PiloPa_SystemState.Extension2
{
	byte superval[5];

	//Update Childvalue (Number)
	byte thisval; // Extension2
	float slider_value;

	slider_value = 0; // Konstanter Parameter.
	@P_ASG_10_1_0_49_6_range = slider_value + (0); // real value := slider value + range min.
	thisval = (byte)round((slider_value + (0) - (0)) / (1.0), 1); // bus value := (slider value + min - offset) / step.

    // Update superval
	getValue(P_ASG_10_1_0_49, superval);
	superval[4]=thisval;
	putValue(P_ASG_10_1_0_49,superval);
}

on envVar P_ASG_10_1_0_50Get_BTN
{
 if (P_ASG_10_1_0_50Get_BTN_already_pressed == 0)
  {
       putValue(P_ASG_10_1_0_50_ErrCode,0);
       SetControlBackColor(panel_name,"errField_P_ASG_10_1_0_50",MakeRGB(255,255,255));
       P_ASG_10_1_0_50Get_BTN_already_pressed = 1;
 }
 else
 {
       Request_Void(LSGID, P_ASG_10_1_0_50_ID, DataGet_REQ); 
       P_ASG_10_1_0_50Get_BTN_already_pressed = 0;
 }
}
on envVar P_ASG_10_1_0_50 // bus value of IPA_Messages (50).
{
	// opcodes: Error-Status
	byte param1; // Messages
	byte param2; // Extension1
	// DATATYPE_BYTESEQUENCE / DATATYPE_FIXEDBYTESEQUENCE
	int i;
	byte superval[2];
	int currentPos;
	currentPos = 0;
	for( i = 0; i < 2; i++ ) {
		superval[i] = 0;
	}
	getValue(P_ASG_10_1_0_50, superval);
	///////// Start param1 - UINT8 /////////
	param1 = superval[currentPos++];
	putValue(P_ASG_10_1_0_50_1, param1);
	///////// Start param2 - UINT8 /////////
	param2 = superval[currentPos++];
	putValue(P_ASG_10_1_0_50_2, round((param2 * 1.0) - (0) + (0), 1.0));
}

on envVar P_ASG_10_1_0_50_1 // IPA_Messages.Messages
{
	byte superval[2];

	//Update Childvalue (Enum)
	byte thisval; // Messages
	thisval = getValue(this);

    // Update superval
	getValue(P_ASG_10_1_0_50, superval);
	superval[0]=thisval;
	putValue(P_ASG_10_1_0_50,superval);
}

// Ueberwachung der Darstellungsvariable der Range.
on envVar P_ASG_10_1_0_50_2_range // IPA_Messages.Extension1 
{
	@P_ASG_10_1_0_50_2 = @P_ASG_10_1_0_50_2_range - (0); // slider = range - min
}

on envVar P_ASG_10_1_0_50_2 // IPA_Messages.Extension1
{
	byte superval[2];

	//Update Childvalue (Number)
	byte thisval; // Extension1
	float slider_value;

	slider_value = 0; // Konstanter Parameter.
	@P_ASG_10_1_0_50_2_range = slider_value + (0); // real value := slider value + range min.
	thisval = (byte)round((slider_value + (0) - (0)) / (1.0), 1); // bus value := (slider value + min - offset) / step.

    // Update superval
	getValue(P_ASG_10_1_0_50, superval);
	superval[1]=thisval;
	putValue(P_ASG_10_1_0_50,superval);
}

on envVar P_ASG_10_1_0_51Get_BTN
{
 if (P_ASG_10_1_0_51Get_BTN_already_pressed == 0)
  {
       putValue(P_ASG_10_1_0_51_ErrCode,0);
       SetControlBackColor(panel_name,"errField_P_ASG_10_1_0_51",MakeRGB(255,255,255));
       P_ASG_10_1_0_51Get_BTN_already_pressed = 1;
 }
 else
 {
       Request_Void(LSGID, P_ASG_10_1_0_51_ID, DataGet_REQ); 
       P_ASG_10_1_0_51Get_BTN_already_pressed = 0;
 }
}
on envVar P_ASG_10_1_0_51SetGet_BTN
{
	byte BAPTemp[2];
    if (P_ASG_10_1_0_51SetGet_BTN_already_pressed == 0)
    {
       putValue(P_ASG_10_1_0_51_ErrCode,0);
       SetControlBackColor(panel_name,"errField_P_ASG_10_1_0_51",MakeRGB(255,255,255));
       P_ASG_10_1_0_51SetGet_BTN_already_pressed = 1;
    }
    else
    {
       getValue(P_ASG_10_1_0_51, BAPTemp);
       Request_ByteSequence(LSGID, P_ASG_10_1_0_51_ID, DataSetGet_REQ, BAPTemp, getValueSize(P_ASG_10_1_0_51));
       P_ASG_10_1_0_51SetGet_BTN_already_pressed = 0;
    }
}
on envVar P_ASG_10_1_0_51 // bus value of ContinueDrivingAssist (51).
{
	// opcodes: Error-Status
	byte param1; // Setup
	byte param2; // ModificationReason
	byte param3; // ModificationState
	// DATATYPE_BYTESEQUENCE / DATATYPE_FIXEDBYTESEQUENCE
	int i;
	byte superval[2];
	int currentPos;
	currentPos = 0;
	for( i = 0; i < 2; i++ ) {
		superval[i] = 0;
	}
	getValue(P_ASG_10_1_0_51, superval);
	///////// Start param1 - UINT8 /////////
	param1 = superval[currentPos++];
	putValue(P_ASG_10_1_0_51_1, param1);
	///////// Start param2 - NIBBLE /////////
	param2 = (superval[currentPos] & 0xf0)>>4;
	putValue(P_ASG_10_1_0_51_2, param2);
	///////// Start param3 - NIBBLE /////////
	param3 = superval[currentPos++] & 0x0f;
	putValue(P_ASG_10_1_0_51_3, param3);
}

on envVar P_ASG_10_1_0_51_1 // ContinueDrivingAssist.Setup
{
	byte superval[2];

	//Update Childvalue (Enum)
	byte thisval; // Setup
	thisval = getValue(this);

    // Update superval
	getValue(P_ASG_10_1_0_51, superval);
	superval[0]=thisval;
	putValue(P_ASG_10_1_0_51,superval);
}

on envVar P_ASG_10_1_0_51_2 // ContinueDrivingAssist.ModificationReason
{
	byte superval[2];

	//Update Childvalue (Enum)
	byte thisval; // ModificationReason
	thisval = 0x0f & getValue(this);

    // Update superval
	getValue(P_ASG_10_1_0_51, superval);
	superval[1]= superval[1]&0x0f;
	superval[1]= superval[1]|(thisval<<4);
	putValue(P_ASG_10_1_0_51,superval);
}

on envVar P_ASG_10_1_0_51_3_0
{
	byte bitval;
	//thisval steht hier fuer den bitfield-wert, 
	//aus Generierungsgruenden hier keine einheitliche Bezeichnung moeglich.
	byte thisval; // ModificationState
	bitval= getValue(this);
	thisval = getValue(P_ASG_10_1_0_51_3);
	thisval = thisval&~(1<<0)|(bitval<<0);
	putValue(P_ASG_10_1_0_51_3,thisval);
}

on envVar P_ASG_10_1_0_51_3 // ContinueDrivingAssist.ModificationState
{
	byte superval[2];

	//Update Childvalue (BitField)
	byte mask=0x01;
	int i = 0;
	byte thisval; // ModificationState
	thisval = getValue(this);
	if(thisval&(mask<<0))
		putValue(P_ASG_10_1_0_51_3_0, 1);
	else
		putValue(P_ASG_10_1_0_51_3_0, 0);

    // Update superval
	getValue(P_ASG_10_1_0_51, superval);
	superval[1]= superval[1]&0xf0;
	superval[1]= superval[1]|thisval;
	putValue(P_ASG_10_1_0_51,superval);
}

on envVar P_ASG_10_1_0_52Get_BTN
{
 if (P_ASG_10_1_0_52Get_BTN_already_pressed == 0)
  {
       putValue(P_ASG_10_1_0_52_ErrCode,0);
       SetControlBackColor(panel_name,"errField_P_ASG_10_1_0_52",MakeRGB(255,255,255));
       P_ASG_10_1_0_52Get_BTN_already_pressed = 1;
 }
 else
 {
       Request_Void(LSGID, P_ASG_10_1_0_52_ID, DataGet_REQ); 
       P_ASG_10_1_0_52Get_BTN_already_pressed = 0;
 }
}
on envVar P_ASG_10_1_0_52 // bus value of FSG_Setup2 (52).
{
	// opcodes: Error-Status
	byte param1; // ManeuverAssist
	byte param2; // ContinueDrivingAssist
	byte param3; // Installation
	byte param4; // Extension1
	byte param5; // Extension2
	byte param6; // Extension3
	byte param7; // Extension4
	// DATATYPE_BYTESEQUENCE / DATATYPE_FIXEDBYTESEQUENCE
	int i;
	byte superval[6];
	int currentPos;
	currentPos = 0;
	for( i = 0; i < 6; i++ ) {
		superval[i] = 0;
	}
	getValue(P_ASG_10_1_0_52, superval);
	///////// Start param1 - NIBBLE /////////
	param1 = (superval[currentPos] & 0xf0)>>4;
	putValue(P_ASG_10_1_0_52_1, param1);
	///////// Start param2 - NIBBLE /////////
	param2 = superval[currentPos++] & 0x0f;
	putValue(P_ASG_10_1_0_52_2, param2);
	///////// Start param3 - UINT8 /////////
	param3 = superval[currentPos++];
	putValue(P_ASG_10_1_0_52_3, param3);
	///////// Start param4 - UINT8 /////////
	param4 = superval[currentPos++];
	putValue(P_ASG_10_1_0_52_4, round((param4 * 1.0) - (0) + (0), 1.0));
	///////// Start param5 - UINT8 /////////
	param5 = superval[currentPos++];
	putValue(P_ASG_10_1_0_52_5, round((param5 * 1.0) - (0) + (0), 1.0));
	///////// Start param6 - UINT8 /////////
	param6 = superval[currentPos++];
	putValue(P_ASG_10_1_0_52_6, round((param6 * 1.0) - (0) + (0), 1.0));
	///////// Start param7 - UINT8 /////////
	param7 = superval[currentPos++];
	putValue(P_ASG_10_1_0_52_7, round((param7 * 1.0) - (0) + (0), 1.0));
}

on envVar P_ASG_10_1_0_52_1_0
{
	byte bitval;
	//thisval steht hier fuer den bitfield-wert, 
	//aus Generierungsgruenden hier keine einheitliche Bezeichnung moeglich.
	byte thisval; // ManeuverAssist
	bitval= getValue(this);
	thisval = getValue(P_ASG_10_1_0_52_1);
	thisval = thisval&~(1<<0)|(bitval<<0);
	putValue(P_ASG_10_1_0_52_1,thisval);
}

on envVar P_ASG_10_1_0_52_1_1
{
	byte bitval;
	//thisval steht hier fuer den bitfield-wert, 
	//aus Generierungsgruenden hier keine einheitliche Bezeichnung moeglich.
	byte thisval; // ManeuverAssist
	bitval= getValue(this);
	thisval = getValue(P_ASG_10_1_0_52_1);
	thisval = thisval&~(1<<1)|(bitval<<1);
	putValue(P_ASG_10_1_0_52_1,thisval);
}

on envVar P_ASG_10_1_0_52_1 // FSG_Setup2.ManeuverAssist
{
	byte superval[6];

	//Update Childvalue (BitField)
	byte mask=0x01;
	int i = 0;
	byte thisval; // ManeuverAssist
	thisval = getValue(this);
	if(thisval&(mask<<0))
		putValue(P_ASG_10_1_0_52_1_0, 1);
	else
		putValue(P_ASG_10_1_0_52_1_0, 0);
	if(thisval&(mask<<1))
		putValue(P_ASG_10_1_0_52_1_1, 1);
	else
		putValue(P_ASG_10_1_0_52_1_1, 0);

    // Update superval
	getValue(P_ASG_10_1_0_52, superval);
	superval[0]= superval[0]&0x0f;
	superval[0]= superval[0]|(thisval<<4);
	putValue(P_ASG_10_1_0_52,superval);
}

on envVar P_ASG_10_1_0_52_2_0
{
	byte bitval;
	//thisval steht hier fuer den bitfield-wert, 
	//aus Generierungsgruenden hier keine einheitliche Bezeichnung moeglich.
	byte thisval; // ContinueDrivingAssist
	bitval= getValue(this);
	thisval = getValue(P_ASG_10_1_0_52_2);
	thisval = thisval&~(1<<0)|(bitval<<0);
	putValue(P_ASG_10_1_0_52_2,thisval);
}

on envVar P_ASG_10_1_0_52_2 // FSG_Setup2.ContinueDrivingAssist
{
	byte superval[6];

	//Update Childvalue (BitField)
	byte mask=0x01;
	int i = 0;
	byte thisval; // ContinueDrivingAssist
	thisval = getValue(this);
	if(thisval&(mask<<0))
		putValue(P_ASG_10_1_0_52_2_0, 1);
	else
		putValue(P_ASG_10_1_0_52_2_0, 0);

    // Update superval
	getValue(P_ASG_10_1_0_52, superval);
	superval[0]= superval[0]&0xf0;
	superval[0]= superval[0]|thisval;
	putValue(P_ASG_10_1_0_52,superval);
}

on envVar P_ASG_10_1_0_52_3_0
{
	byte bitval;
	//thisval steht hier fuer den bitfield-wert, 
	//aus Generierungsgruenden hier keine einheitliche Bezeichnung moeglich.
	byte thisval; // Installation
	bitval= getValue(this);
	thisval = getValue(P_ASG_10_1_0_52_3);
	thisval = thisval&~(1<<0)|(bitval<<0);
	putValue(P_ASG_10_1_0_52_3,thisval);
}

on envVar P_ASG_10_1_0_52_3_1
{
	byte bitval;
	//thisval steht hier fuer den bitfield-wert, 
	//aus Generierungsgruenden hier keine einheitliche Bezeichnung moeglich.
	byte thisval; // Installation
	bitval= getValue(this);
	thisval = getValue(P_ASG_10_1_0_52_3);
	thisval = thisval&~(1<<1)|(bitval<<1);
	putValue(P_ASG_10_1_0_52_3,thisval);
}

on envVar P_ASG_10_1_0_52_3_2
{
	byte bitval;
	//thisval steht hier fuer den bitfield-wert, 
	//aus Generierungsgruenden hier keine einheitliche Bezeichnung moeglich.
	byte thisval; // Installation
	bitval= getValue(this);
	thisval = getValue(P_ASG_10_1_0_52_3);
	thisval = thisval&~(1<<2)|(bitval<<2);
	putValue(P_ASG_10_1_0_52_3,thisval);
}

on envVar P_ASG_10_1_0_52_3_3
{
	byte bitval;
	//thisval steht hier fuer den bitfield-wert, 
	//aus Generierungsgruenden hier keine einheitliche Bezeichnung moeglich.
	byte thisval; // Installation
	bitval= getValue(this);
	thisval = getValue(P_ASG_10_1_0_52_3);
	thisval = thisval&~(1<<3)|(bitval<<3);
	putValue(P_ASG_10_1_0_52_3,thisval);
}

on envVar P_ASG_10_1_0_52_3 // FSG_Setup2.Installation
{
	byte superval[6];

	//Update Childvalue (BitField)
	byte mask=0x01;
	int i = 0;
	byte thisval; // Installation
	thisval = getValue(this);
	if(thisval&(mask<<0))
		putValue(P_ASG_10_1_0_52_3_0, 1);
	else
		putValue(P_ASG_10_1_0_52_3_0, 0);
	if(thisval&(mask<<1))
		putValue(P_ASG_10_1_0_52_3_1, 1);
	else
		putValue(P_ASG_10_1_0_52_3_1, 0);
	if(thisval&(mask<<2))
		putValue(P_ASG_10_1_0_52_3_2, 1);
	else
		putValue(P_ASG_10_1_0_52_3_2, 0);
	if(thisval&(mask<<3))
		putValue(P_ASG_10_1_0_52_3_3, 1);
	else
		putValue(P_ASG_10_1_0_52_3_3, 0);

    // Update superval
	getValue(P_ASG_10_1_0_52, superval);
	superval[1]=thisval;
	putValue(P_ASG_10_1_0_52,superval);
}

// Ueberwachung der Darstellungsvariable der Range.
on envVar P_ASG_10_1_0_52_4_range // FSG_Setup2.Extension1 
{
	@P_ASG_10_1_0_52_4 = @P_ASG_10_1_0_52_4_range - (0); // slider = range - min
}

on envVar P_ASG_10_1_0_52_4 // FSG_Setup2.Extension1
{
	byte superval[6];

	//Update Childvalue (Number)
	byte thisval; // Extension1
	float slider_value;

	slider_value = 0; // Konstanter Parameter.
	@P_ASG_10_1_0_52_4_range = slider_value + (0); // real value := slider value + range min.
	thisval = (byte)round((slider_value + (0) - (0)) / (1.0), 1); // bus value := (slider value + min - offset) / step.

    // Update superval
	getValue(P_ASG_10_1_0_52, superval);
	superval[2]=thisval;
	putValue(P_ASG_10_1_0_52,superval);
}

// Ueberwachung der Darstellungsvariable der Range.
on envVar P_ASG_10_1_0_52_5_range // FSG_Setup2.Extension2 
{
	@P_ASG_10_1_0_52_5 = @P_ASG_10_1_0_52_5_range - (0); // slider = range - min
}

on envVar P_ASG_10_1_0_52_5 // FSG_Setup2.Extension2
{
	byte superval[6];

	//Update Childvalue (Number)
	byte thisval; // Extension2
	float slider_value;

	slider_value = 0; // Konstanter Parameter.
	@P_ASG_10_1_0_52_5_range = slider_value + (0); // real value := slider value + range min.
	thisval = (byte)round((slider_value + (0) - (0)) / (1.0), 1); // bus value := (slider value + min - offset) / step.

    // Update superval
	getValue(P_ASG_10_1_0_52, superval);
	superval[3]=thisval;
	putValue(P_ASG_10_1_0_52,superval);
}

// Ueberwachung der Darstellungsvariable der Range.
on envVar P_ASG_10_1_0_52_6_range // FSG_Setup2.Extension3 
{
	@P_ASG_10_1_0_52_6 = @P_ASG_10_1_0_52_6_range - (0); // slider = range - min
}

on envVar P_ASG_10_1_0_52_6 // FSG_Setup2.Extension3
{
	byte superval[6];

	//Update Childvalue (Number)
	byte thisval; // Extension3
	float slider_value;

	slider_value = 0; // Konstanter Parameter.
	@P_ASG_10_1_0_52_6_range = slider_value + (0); // real value := slider value + range min.
	thisval = (byte)round((slider_value + (0) - (0)) / (1.0), 1); // bus value := (slider value + min - offset) / step.

    // Update superval
	getValue(P_ASG_10_1_0_52, superval);
	superval[4]=thisval;
	putValue(P_ASG_10_1_0_52,superval);
}

// Ueberwachung der Darstellungsvariable der Range.
on envVar P_ASG_10_1_0_52_7_range // FSG_Setup2.Extension4 
{
	@P_ASG_10_1_0_52_7 = @P_ASG_10_1_0_52_7_range - (0); // slider = range - min
}

on envVar P_ASG_10_1_0_52_7 // FSG_Setup2.Extension4
{
	byte superval[6];

	//Update Childvalue (Number)
	byte thisval; // Extension4
	float slider_value;

	slider_value = 0; // Konstanter Parameter.
	@P_ASG_10_1_0_52_7_range = slider_value + (0); // real value := slider value + range min.
	thisval = (byte)round((slider_value + (0) - (0)) / (1.0), 1); // bus value := (slider value + min - offset) / step.

    // Update superval
	getValue(P_ASG_10_1_0_52, superval);
	superval[5]=thisval;
	putValue(P_ASG_10_1_0_52,superval);
}

on envVar P_ASG_10_1_0_53Get_BTN
{
 if (P_ASG_10_1_0_53Get_BTN_already_pressed == 0)
  {
       putValue(P_ASG_10_1_0_53_ErrCode,0);
       SetControlBackColor(panel_name,"errField_P_ASG_10_1_0_53",MakeRGB(255,255,255));
       P_ASG_10_1_0_53Get_BTN_already_pressed = 1;
 }
 else
 {
       Request_Void(LSGID, P_ASG_10_1_0_53_ID, DataGet_REQ); 
       P_ASG_10_1_0_53Get_BTN_already_pressed = 0;
 }
}
on envVar P_ASG_10_1_0_53SetGet_BTN
{
	byte BAPTemp[4];
    if (P_ASG_10_1_0_53SetGet_BTN_already_pressed == 0)
    {
       putValue(P_ASG_10_1_0_53_ErrCode,0);
       SetControlBackColor(panel_name,"errField_P_ASG_10_1_0_53",MakeRGB(255,255,255));
       P_ASG_10_1_0_53SetGet_BTN_already_pressed = 1;
    }
    else
    {
       getValue(P_ASG_10_1_0_53, BAPTemp);
       Request_ByteSequence(LSGID, P_ASG_10_1_0_53_ID, DataSetGet_REQ, BAPTemp, getValueSize(P_ASG_10_1_0_53));
       P_ASG_10_1_0_53SetGet_BTN_already_pressed = 0;
    }
}
on envVar P_ASG_10_1_0_53 // bus value of ParkSideSelection (53).
{
	// opcodes: Error-Status
	byte param1; // Setup
	byte param2; // Extension1
	byte param3; // Extension2
	byte param4; // ModificationReason
	byte param5; // ModificationState
	// DATATYPE_BYTESEQUENCE / DATATYPE_FIXEDBYTESEQUENCE
	int i;
	byte superval[4];
	int currentPos;
	currentPos = 0;
	for( i = 0; i < 4; i++ ) {
		superval[i] = 0;
	}
	getValue(P_ASG_10_1_0_53, superval);
	///////// Start param1 - UINT8 /////////
	param1 = superval[currentPos++];
	putValue(P_ASG_10_1_0_53_1, param1);
	///////// Start param2 - UINT8 /////////
	param2 = superval[currentPos++];
	putValue(P_ASG_10_1_0_53_2, round((param2 * 1.0) - (0) + (0), 1.0));
	///////// Start param3 - UINT8 /////////
	param3 = superval[currentPos++];
	putValue(P_ASG_10_1_0_53_3, round((param3 * 1.0) - (0) + (0), 1.0));
	///////// Start param4 - NIBBLE /////////
	param4 = (superval[currentPos] & 0xf0)>>4;
	putValue(P_ASG_10_1_0_53_4, param4);
	///////// Start param5 - NIBBLE /////////
	param5 = superval[currentPos++] & 0x0f;
	putValue(P_ASG_10_1_0_53_5, param5);
}

on envVar P_ASG_10_1_0_53_1_0
{
	byte bitval;
	//thisval steht hier fuer den bitfield-wert, 
	//aus Generierungsgruenden hier keine einheitliche Bezeichnung moeglich.
	byte thisval; // Setup
	bitval= getValue(this);
	thisval = getValue(P_ASG_10_1_0_53_1);
	thisval = thisval&~(1<<0)|(bitval<<0);
	putValue(P_ASG_10_1_0_53_1,thisval);
}

on envVar P_ASG_10_1_0_53_1_1
{
	byte bitval;
	//thisval steht hier fuer den bitfield-wert, 
	//aus Generierungsgruenden hier keine einheitliche Bezeichnung moeglich.
	byte thisval; // Setup
	bitval= getValue(this);
	thisval = getValue(P_ASG_10_1_0_53_1);
	thisval = thisval&~(1<<1)|(bitval<<1);
	putValue(P_ASG_10_1_0_53_1,thisval);
}

on envVar P_ASG_10_1_0_53_1 // ParkSideSelection.Setup
{
	byte superval[4];

	//Update Childvalue (BitField)
	byte mask=0x01;
	int i = 0;
	byte thisval; // Setup
	thisval = getValue(this);
	if(thisval&(mask<<0))
		putValue(P_ASG_10_1_0_53_1_0, 1);
	else
		putValue(P_ASG_10_1_0_53_1_0, 0);
	if(thisval&(mask<<1))
		putValue(P_ASG_10_1_0_53_1_1, 1);
	else
		putValue(P_ASG_10_1_0_53_1_1, 0);

    // Update superval
	getValue(P_ASG_10_1_0_53, superval);
	superval[0]=thisval;
	putValue(P_ASG_10_1_0_53,superval);
}

// Ueberwachung der Darstellungsvariable der Range.
on envVar P_ASG_10_1_0_53_2_range // ParkSideSelection.Extension1 
{
	@P_ASG_10_1_0_53_2 = @P_ASG_10_1_0_53_2_range - (0); // slider = range - min
}

on envVar P_ASG_10_1_0_53_2 // ParkSideSelection.Extension1
{
	byte superval[4];

	//Update Childvalue (Number)
	byte thisval; // Extension1
	float slider_value;

	slider_value = 0; // Konstanter Parameter.
	@P_ASG_10_1_0_53_2_range = slider_value + (0); // real value := slider value + range min.
	thisval = (byte)round((slider_value + (0) - (0)) / (1.0), 1); // bus value := (slider value + min - offset) / step.

    // Update superval
	getValue(P_ASG_10_1_0_53, superval);
	superval[1]=thisval;
	putValue(P_ASG_10_1_0_53,superval);
}

// Ueberwachung der Darstellungsvariable der Range.
on envVar P_ASG_10_1_0_53_3_range // ParkSideSelection.Extension2 
{
	@P_ASG_10_1_0_53_3 = @P_ASG_10_1_0_53_3_range - (0); // slider = range - min
}

on envVar P_ASG_10_1_0_53_3 // ParkSideSelection.Extension2
{
	byte superval[4];

	//Update Childvalue (Number)
	byte thisval; // Extension2
	float slider_value;

	slider_value = 0; // Konstanter Parameter.
	@P_ASG_10_1_0_53_3_range = slider_value + (0); // real value := slider value + range min.
	thisval = (byte)round((slider_value + (0) - (0)) / (1.0), 1); // bus value := (slider value + min - offset) / step.

    // Update superval
	getValue(P_ASG_10_1_0_53, superval);
	superval[2]=thisval;
	putValue(P_ASG_10_1_0_53,superval);
}

on envVar P_ASG_10_1_0_53_4 // ParkSideSelection.ModificationReason
{
	byte superval[4];

	//Update Childvalue (Enum)
	byte thisval; // ModificationReason
	thisval = 0x0f & getValue(this);

    // Update superval
	getValue(P_ASG_10_1_0_53, superval);
	superval[3]= superval[3]&0x0f;
	superval[3]= superval[3]|(thisval<<4);
	putValue(P_ASG_10_1_0_53,superval);
}

on envVar P_ASG_10_1_0_53_5_0
{
	byte bitval;
	//thisval steht hier fuer den bitfield-wert, 
	//aus Generierungsgruenden hier keine einheitliche Bezeichnung moeglich.
	byte thisval; // ModificationState
	bitval= getValue(this);
	thisval = getValue(P_ASG_10_1_0_53_5);
	thisval = thisval&~(1<<0)|(bitval<<0);
	putValue(P_ASG_10_1_0_53_5,thisval);
}

on envVar P_ASG_10_1_0_53_5 // ParkSideSelection.ModificationState
{
	byte superval[4];

	//Update Childvalue (BitField)
	byte mask=0x01;
	int i = 0;
	byte thisval; // ModificationState
	thisval = getValue(this);
	if(thisval&(mask<<0))
		putValue(P_ASG_10_1_0_53_5_0, 1);
	else
		putValue(P_ASG_10_1_0_53_5_0, 0);

    // Update superval
	getValue(P_ASG_10_1_0_53, superval);
	superval[3]= superval[3]&0xf0;
	superval[3]= superval[3]|thisval;
	putValue(P_ASG_10_1_0_53,superval);
}


/*@@end*/

/*@@caplFunc:name:*/
/**
*
* Template-Funktion zum automatischen befuellen der Array-Daten, die in einer Arrayfunktion genutzt werden.
* Die Funktion wird durch den von BAPSimGen generierten Code aufgerufen.
*
* Parameter:
* - structArray: Muss mindestens nMax * Arraygroesse Bytes Platz haben, wird vom BAPSimGen automatisch generiert
* - structElementsSizeArray: Enthaelt die Groesseangabe jedes Array-Elements. Die Arraygroesse entspricht der Elementanzahl im Array.
*       Byte & Nibble = 1; Word = 2; usw. Bei Strings wird die maximale Stringlaenge angegeben.
* - structElementsTypeArray: Gibt den Datentyp eines Array-Elements zurueck. Die Arraygroesse entspricht der Elmentanzahl im Array.
*                               0x0 = Zahlenwert, also ein Slider, Enum, Bitfield,...
*                               0xE = String (darauf folgt immer eine 2, mit der Angabe der benutzen Bytes im String)
*                               0xF = Laenge der Nutzdaten des Strings, nur return Wert
* - fctID: Kann zur Fallunterscheidung der Funktions-IDs verwendet werden.
* - nMax: Array-Index
*
* Die Funktion kann im Switch-Case beliebig erweitert werden. Der Switch-Case wertet den Parameter fctID aus.
*           
*                    
**/
initStruct(byte structArray[], dword structElementsSizeArray[], byte structElementsTypeArray[], dword structElementsMaxSizeArray[], word fctID, word nMax )
{
    byte rand8;
    word rand16;
    word randSize;
    word index;           //indexNr die an die String Parameter angehaengt wird.
    dword destArraySize;   //groesse von structArray
    dword destStructSize;  //groesse eines "Structs" also destArraySize / Anzahl Elemente (nMax))
    dword rand32;    
    dword i;
    dword pos;    //aktuelle Position im structArray
    dword elpos;  //aktuelle Position in den structElementsXXXArray's
    
    destArraySize = elCount(structArray);
    destStructSize = destArraySize / nMax;    

    Switch(fctID){

        //Idee ist, die Arrays je nach Funcion-ID speziell initalisieren zu koennen.
        //hierbei koennten die Daten z.B. aus einer Datei eingelesen werden,
        //oder auch ueber spezielle init Funktionen mit festen Werten initialisiert werden.
        //Der Default-Fall befuellt das Array mit Random-Werten und Strings mit einem vordefinierten Wort (hier test,)

        default :
        {
            pos = 0; 
            for(i = 1; i <= nMax; i++)
            {
                //walk through the array
                
                elpos = 0;
                while(pos < (destStructSize * i) )
                {   
                    //check Element type
                    if( structElementsTypeArray[elpos] == 0x0)          
                    { //Params like int, word, etc.
                        //check element length
                        Switch(structElementsSizeArray[elpos])
                        {
                            case(1) : //byte / nibble
                                rand8 = random(structElementsMaxSizeArray[elpos]);
                                structArray[pos] = rand8;
                                pos++;
                                break;

                            case(2) : //word / int
                                rand16 = random(structElementsMaxSizeArray[elpos]);
                                int2byte(structArray, pos, rand16);
                                pos += 2;
                                break;

                            case (4) : //dword / long
                                rand32 = random(structElementsMaxSizeArray[elpos]);
                                long2byte(structArray, pos, rand32);
                                pos += 4;
                                break;                        
                         }
                    }
                    else if(structElementsTypeArray[elpos] == 0xE)          
                    { //String Params like byte[]
                        randSize = random(structElementsSizeArray[elpos]);
                        if(randSize < 2) randSize = 2; 
                        index = i-1;
                        setRandomString(structArray ,pos ,structElementsSizeArray[elpos], randSize, index);
                        pos += structElementsSizeArray[elpos];
                    }
                    else if(structElementsTypeArray[elpos] == 0xF)          
                    {
                        int2byte(structArray, pos, randSize);
                        pos += 2;
                        //write("Pos: %d Strlth: %d Type: %d ",pos-1,randSize,structElementsTypeArray[elpos]);
                    
                    }
                    elpos++;
                }
            }   
        break;
        }            
    }
}
/*@@end*/

/*@@caplFunc:name:*/
long2Byte(byte in[], dword pos, dword value)
{
    if( (elCount(in)-pos) < 4)
        write("Array out ouf bounds - too small!");
    in[pos] = value;
    in[++pos] = (value >> 8);
    in[++pos] = (value >> 16);
    in[++pos] = (value >> 24);
}
/*@@end*/

/*@@caplFunc:name:*/
int2byte (byte in[],dword pos,word value)
{
    if( (elCount(in)-pos) < 2 )
        write("Array out of bounds - too small!");
    in[pos] = value;
    in[++pos] = (value >> 8);        
}
/*@@end*/

/*@@caplFunc:name:*/
setRandomString (byte in[], dword pos, word strSize, word randSize, word count)
{
    word endPos, endString, j;
    byte testString[4]={'t','e','s','t'};
    
    endPos = pos + strSize;
    endString = pos + randSize;
    j=0;
    
    int2ascii(in, pos, count);
    pos += 2;
    
    for(pos; pos < endPos ;pos ++)
    {
        if(j > 3 )
            j = 0;
        if(pos < endString)
            in[pos] = testString[j++];
        else
            in[pos] = 0x0;
    }
}
/*@@end*/

/*@@caplFunc:name:*/
int2ascii (byte in[], dword pos, word value)
{
    //Konvertiert nur die erste und zweite Dezimalstelle, also Zahlen zw. 0 und 99.
    
    //auf 2 Stellen kuerzen
    value = value%100;
    //10er schreiben
    in[pos] = (value/10) + 48;    //  0x30 hex = 48 dez = ascii null
    //1er schreiben
    in[pos+1] = (value%10) + 48;  //  0x30 hex = 48 dez = ascii null
}
/*@@end*/

