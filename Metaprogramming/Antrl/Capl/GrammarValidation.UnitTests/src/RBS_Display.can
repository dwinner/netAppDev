/*@!Encoding:1252*/
variables
{
    //watchdog function
    int gExceedancesCtr1, gUndercutsCtr1;
    int gUpperLimit1, gLowerLimit1;
    int gcurrentValue,gstoredValue;
    byte beepFlag;
    
    //IssueList #75
    double hour, min, sec;

    //IssueList #165
    word msgReset_Ctr =0;
    word msgEinheiten_01_Ctr=0;
    word msgKN_Kombi_Ctr = 0;
    word msgKombi_01_Ctr = 0;
    word msgKombi_02_Ctr = 0;
    word msgKombi_03_Ctr = 0;
    word msgNMH_Kombi_Ctr = 0;
    word msgOBD_Tank_01_Ctr = 0;
    word msgSensorik_Dim_01_Ctr = 0;
    word msgUhrzeit_01_Ctr = 0;
    word msgVIN_01_Ctr = 0;
    word msgWFS_01_Ctr = 0;

    word Einheiten_01_defTxCycle;
    word KN_Kombi_defTxCycle;
    word Kombi_01_defTxCycle;
    word Kombi_02_defTxCycle;
    word Kombi_03_defTxCycle;
    word NMH_Kombi_defTxCycle;
    word OBD_Tank_01_defTxCycle;
    word Reset_defTxCycle;
    word Sensorik_Dim_01_defTxCycle;
    word Uhrzeit_01_defTxCycle;
    word VIN_01_defTxCycle;
    word WFS_01_defTxCycle;

    double Kombi_01_min=0,Kombi_01_max=0;
    double mKombi_01_time_prev=0;
    double mKombi_01_cycleTime=0;

    double mEinheiten_01_time_prev=0;
    double mEinheiten_01_cycleTime=0;
    double Einheiten_01_min=0,Einheiten_01_max=0;
    const Einheiten_01_delayTime = 101;

    double mKN_Kombi_time_prev=0;
    double mKN_Kombi_cycleTime=0;
    double KN_Kombi_min=0,KN_Kombi_max=0;

    double mKombi_02_time_prev=0;
    double mKombi_02_cycleTime=0;
    double Kombi_02_min=0,Kombi_02_max=0;
    const  Kombi_02_delayTime = 101;

    double mKombi_03_time_prev=0;
    double mKombi_03_cycleTime=0;
    double Kombi_03_min=0,Kombi_03_max=0;

    double mNMH_Kombi_time_prev=0;
    double mNMH_Kombi_cycleTime=0;
    double NMH_Kombi_min=0,NMH_Kombi_max=0;
    byte msgNMH_Kombi_check;

    double mOBD_Tank_01_time_prev=0;
    double mOBD_Tank_01_cycleTime=0;
    double OBD_Tank_01_min=0,OBD_Tank_01_max=0;

    double mReset_time_prev=0;
    double mReset_cycleTime=0;
    double Reset_min=0,Reset_max=0;

    double mSensorik_Dim_01_time_prev=0;
    double mSensorik_Dim_01_cycleTime=0;
    double Sensorik_Dim_min=0,Sensorik_Dim_max=0;
    const  Sensorik_Dim_delayTime = 51;


    double mUhrzeit_01_time_prev=0;
    
    double mUhrzeit_01_cycleTime=0;
    double Uhrzeit_01_min=0,Uhrzeit_01_max=0;

    double mVIN_01_time_prev=0;
    double mVIN_01_cycleTime=0;
    double VIN_01_min=0,VIN_01_max=0;

    double mWFS_01_time_prev=0;
    double mWFS_01_cycleTime=0;
    double WFS_01_min=0,WFS_01_max=0;
    const WFS_01_delayTime = 51;

    word Einheiten_01_RedStatCtr;
    word KN_Kombi_RedStatCtr;
    word Kombi_01_RedStatCtr;
    word Kombi_02_RedStatCtr;
    word Kombi_03_RedStatCtr;
    word NMH_Kombi_RedStatCtr;
    word OBD_Tank_01_RedStatCtr;
    word Reset_RedStatCtr;
    word Sensorik_Dim_01_RedStatCtr;
    word Uhrzeit_01_RedStatCtr;
    word VIN_01_RedStatCtr;
    word WFS_01_RedStatCtr;

    byte Einheiten_01_TxFlg;
    byte KN_Kombi_TxFlg;
    byte Kombi_01_TxFlg;
    byte Kombi_02_TxFlg;
    byte Kombi_03_TxFlg;
    byte NMH_Kombi_TxFlg;
    byte OBD_Tank_01_TxFlg;
    byte Reset_TxFlg;
    byte Sensorik_Dim_01_TxFlg;
    byte Uhrzeit_01_TxFlg;
    byte VIN_01_TxFlg;
    byte WFS_01_TxFlg;

    word Service_Key_01_Ctr;
    word IMMO_MSG1_Antwort_Ctr;
    word IMMO_MSG2_Antwort_Ctr;
    word IMMO_MSG3_Antwort_Ctr;
    word IMMO_MSG4_Antwort_Ctr;
    word IMMO_GSG_Antwort_Ctr;
    word IMMO_ELV_Antwort_Ctr;
    word WFS_GO1_Ctr;
    word WFS_GO2_Ctr;

    Timer _tTxMute_timer;
    message Einheiten_01 msgEin;
    
    //IssueList #210
    int g_eKombi_01_BZD=0;
    msTimer _tKombi_01_BZD;
}

on Message Einheiten_01
{
    //IssueList #165 - start


    if (getValue(KombiMQB_TxCycle_Check) == 0x01)
    {
        Einheiten_01_TxFlg = 0x01;      //flag for TxMute check
        
        mEinheiten_01_cycleTime = 0;

        if (msgEinheiten_01_Ctr==0)
        {

        mEinheiten_01_time_prev = this.time;
        }
        else
        {
        mEinheiten_01_cycleTime= (this.time - mEinheiten_01_time_prev)/100;
        mEinheiten_01_time_prev = this.time;
        

        //status 
        //green
        if (mEinheiten_01_cycleTime == Einheiten_01_defTxCycle)
        putValue(Einheiten_01_TxC_stat,1);

        //yellow
        //else if (mEinheiten_01_cycleTime >= (Einheiten_01_defTxCycle - (Einheiten_01_defTxCycle*0.10)) && mEinheiten_01_cycleTime <= (Einheiten_01_defTxCycle + (Einheiten_01_defTxCycle*0.10)))  //yellow
        else if (mEinheiten_01_cycleTime >= Einheiten_01_delayTime && mEinheiten_01_cycleTime <= (Einheiten_01_defTxCycle + (Einheiten_01_defTxCycle*0.10)))  //yellow
        putValue(Einheiten_01_TxC_stat,2);

        //red
        //else if ((mEinheiten_01_cycleTime < (Einheiten_01_defTxCycle - (Einheiten_01_defTxCycle*0.10)) || mEinheiten_01_cycleTime > (Einheiten_01_defTxCycle + (Einheiten_01_defTxCycle*0.10)))  && msgEinheiten_01_Ctr!=0)  //red
        else if ((mEinheiten_01_cycleTime < Einheiten_01_delayTime || mEinheiten_01_cycleTime > (Einheiten_01_defTxCycle + (Einheiten_01_defTxCycle*0.10)))  && msgEinheiten_01_Ctr!=0)  //red
        {
        putValue(Einheiten_01_TxC_stat,3);
        putValue(Einheiten_01_TxC_timeStamp,mEinheiten_01_time_prev/100000);
        Einheiten_01_RedStatCtr++;
        putvalue(Einheiten_01_RedCtr,Einheiten_01_RedStatCtr);
        putValue(TxCycleCheck_ErrSummary, 3);
        }

        //MIN-MAX

        if (mEinheiten_01_cycleTime < Einheiten_01_min)
        {
        Einheiten_01_min = mEinheiten_01_cycleTime;
        putValue(Einheiten_01_TxC_min, Einheiten_01_min);
        }

        if (mEinheiten_01_cycleTime > Einheiten_01_max)
        {
        Einheiten_01_max = mEinheiten_01_cycleTime;
        putValue(Einheiten_01_TxC_max, Einheiten_01_max);
        }

        }
        msgEinheiten_01_Ctr++;
       }
       //IssueList #165 - end
  
  
    
  putValue( eKBI_Einheit_DatumD, this.KBI_Einheit_Datum );
  switch (this.KBI_Einheit_Datum)
  {
    case  0: putValue( eKBI_Einheit_DatumT, "Tag/Monat/Jahr" ); break;
    case  1: putValue( eKBI_Einheit_DatumT, "Monat/Tag/Jahr" ); break;
    case  2: putValue( eKBI_Einheit_DatumT, "Jahr/Monat/Tag" ); break;
    case  3: putValue( eKBI_Einheit_DatumT, "reserviert" ); break;
    default: putValue( eKBI_Einheit_DatumT, "!?!" );
  }
  putValue( eKBI_Einheit_DruckD, this.KBI_Einheit_Druck );
  switch (this.KBI_Einheit_Druck)
  {
    case  0: putValue( eKBI_Einheit_DruckT, "Druckangabe in bar" ); break;
    case  1: putValue( eKBI_Einheit_DruckT, "Druckangabe in psi" ); break;
    case  2: putValue( eKBI_Einheit_DruckT, "Druckangabe in kPa" ); break;
    case  3: putValue( eKBI_Einheit_DruckT, "tbd." ); break;
    default: putValue( eKBI_Einheit_DruckT, "!?!" );
  }
  putValue( eKBI_Einheit_StreckenanzD, this.KBI_Einheit_Streckenanz );
  switch (this.KBI_Einheit_Streckenanz)
  {
    case  0: putValue( eKBI_Einheit_StreckenanzT, "Kilometer" ); break;
    case  1: putValue( eKBI_Einheit_StreckenanzT, "Meilen" ); break;
    default: putValue( eKBI_Einheit_StreckenanzT, "!?!" );
  }
  putValue( eKBI_MFA_v_Einheit_02D, this.KBI_MFA_v_Einheit_02 );
  switch (this.KBI_MFA_v_Einheit_02)
  {
    case  0: putValue( eKBI_MFA_v_Einheit_02T, "kmh" ); break;
    case  1: putValue( eKBI_MFA_v_Einheit_02T, "mph" ); break;
    default: putValue( eKBI_MFA_v_Einheit_02T, "!?!" );
  }
  putValue( eKBI_Einheit_TempD, this.KBI_Einheit_Temp );
  switch (this.KBI_Einheit_Temp)
  {
    case  0: putValue( eKBI_Einheit_TempT, "Grad Celsius °C" ); break;
    case  1: putValue( eKBI_Einheit_TempT, "Grad Fahrenheit °F" ); break;
    default: putValue( eKBI_Einheit_TempT, "!?!" );
  }
  putValue( eKBI_Einheit_UhrzeitD, this.KBI_Einheit_Uhrzeit );
  switch (this.KBI_Einheit_Uhrzeit)
  {
    case  0: putValue( eKBI_Einheit_UhrzeitT, "24h" ); break;
    case  1: putValue( eKBI_Einheit_UhrzeitT, "12h AM/PM" ); break;
    default: putValue( eKBI_Einheit_UhrzeitT, "!?!" );
  }
  putValue( eKBI_Einheit_VerbrauchD, this.KBI_Einheit_Verbrauch );
  switch (this.KBI_Einheit_Verbrauch)
  {
    case  0: putValue( eKBI_Einheit_VerbrauchT, "mpg UK" ); break;
    case  1: putValue( eKBI_Einheit_VerbrauchT, "mpg USA" ); break;
    case  2: putValue( eKBI_Einheit_VerbrauchT, "Liter/100km" ); break;
    case  3: putValue( eKBI_Einheit_VerbrauchT, "km/Liter" ); break;
    default: putValue( eKBI_Einheit_VerbrauchT, "!?!" );
  }
  putValue( eKBI_Einheit_VolumenD, this.KBI_Einheit_Volumen );
  switch (this.KBI_Einheit_Volumen)
  {
    case  0: putValue( eKBI_Einheit_VolumenT, "Liter" ); break;
    case  1: putValue( eKBI_Einheit_VolumenT, "Gallonen UK" ); break;
    case  2: putValue( eKBI_Einheit_VolumenT, "Gallonen USA" ); break;
    case  3: putValue( eKBI_Einheit_VolumenT, "reserviert" ); break;
    default: putValue( eKBI_Einheit_VolumenT, "!?!" );
  }
  putValue( eKBI_Einheit_SpracheD, this.KBI_Einheit_Sprache );
  putValue( eKBI_Einheit_Verbrauch_elektrD, this.KBI_Einheit_Verbrauch_elektr);
  

}

on Message IMMO_ELV_Antwort
{
//    putValue( KCAN_WFS_IMMO_ELV_CRC, this.WFS_IMMO_ELV_CRC );
//    putValue( KCAN_WFS_IMMO_ELV_RND, this.WFS_IMMO_ELV_RND );
}

on Message IMMO_GSG_Antwort
{
  putValue( eWFS_IMMO_GSG_CRCD, this.WFS_IMMO_GSG_CRC );
  putValue( eWFS_IMMO_GSG_StatusD, this.WFS_IMMO_GSG_Status );

  //IssueList #165
  if (getValue(KombiMQB_TxCycle_Check) == 0x01)
  {
  IMMO_GSG_Antwort_Ctr++;
  putValue(IMMO_GSG_Antwort_MsgCtr,IMMO_GSG_Antwort_Ctr);
  }
}

on Message IMMO_MSG1_Antwort
{
  putValue( eWFS_IMMO_MSG1_CRCD, this.WFS_IMMO_MSG1_CRC );
  putValue( eWFS_IMMO_MSG1_StatusD, this.WFS_IMMO_MSG1_Status );

  //IssueList #165
  if (getValue(KombiMQB_TxCycle_Check) == 0x01)
  {
  IMMO_MSG1_Antwort_Ctr++;
  putValue(IMMO_MSG1_Antwort_MsgCtr,IMMO_MSG1_Antwort_Ctr);
  }
}

on Message IMMO_MSG2_Antwort
{
  putValue( eWFS_IMMO_MSG2_CRCD, this.WFS_IMMO_MSG2_CRC );
  putValue( eWFS_IMMO_MSG2_StatusD, this.WFS_IMMO_MSG2_Status );

  //IssueList #165
  if (getValue(KombiMQB_TxCycle_Check) == 0x01)
  {
  IMMO_MSG2_Antwort_Ctr++;
  putValue(IMMO_MSG2_Antwort_MsgCtr,IMMO_MSG2_Antwort_Ctr);
  }
}

on Message IMMO_MSG3_Antwort
{
  putValue( eWFS_IMMO_MSG3_CRCD, this.WFS_IMMO_MSG3_CRC );
  putValue( eWFS_IMMO_MSG3_StatusD, this.WFS_IMMO_MSG3_Status );

  //IssueList #165
  if (getValue(KombiMQB_TxCycle_Check) == 0x01)
  {
  IMMO_MSG3_Antwort_Ctr++;
  putValue(IMMO_MSG3_Antwort_MsgCtr,IMMO_MSG3_Antwort_Ctr);
  }
}

on Message IMMO_MSG4_Antwort
{
  putValue( eWFS_IMMO_MSG4_CRCD, this.WFS_IMMO_MSG4_CRC );
  putValue( eWFS_IMMO_MSG4_StatusD, this.WFS_IMMO_MSG4_Status );

  //IssueList #165
  if (getValue(KombiMQB_TxCycle_Check) == 0x01)
  {
  IMMO_MSG4_Antwort_Ctr++;
  putValue(IMMO_MSG4_Antwort_MsgCtr,IMMO_MSG4_Antwort_Ctr);
  }
}

/*on Message ISO_Kombi_Resp
{
  putValue( eISO_Kombi_Resp_DataD, this.ISO_Kombi_Resp_Data );
}
*/
on Message KN_Kombi_CAN
{
  
      //IssueList #165 - start


    if (getValue(KombiMQB_TxCycle_Check) == 0x01)
    {
        KN_Kombi_TxFlg = 0x01;      //flag for TxMute check
        
        mKN_Kombi_cycleTime = 0;

        if (msgKN_Kombi_Ctr==0)
        {

        mKN_Kombi_time_prev = this.time;
        }
        else
		{
			mKN_Kombi_cycleTime= (this.time - mKN_Kombi_time_prev)/100;
			mKN_Kombi_time_prev = this.time;

			//status 
			if (mKN_Kombi_cycleTime == KN_Kombi_defTxCycle)       //green
			putValue(KN_Kombi_TxC_stat,1);

			else if (mKN_Kombi_cycleTime >= (KN_Kombi_defTxCycle - (KN_Kombi_defTxCycle*0.10)) && mKN_Kombi_cycleTime <= (KN_Kombi_defTxCycle + (KN_Kombi_defTxCycle*0.10)))  //yellow
			putValue(KN_Kombi_TxC_stat,2);

			else if ((mKN_Kombi_cycleTime < (KN_Kombi_defTxCycle - (KN_Kombi_defTxCycle*0.10)) || mKN_Kombi_cycleTime > (KN_Kombi_defTxCycle + (KN_Kombi_defTxCycle*0.10)))  && msgKN_Kombi_Ctr!=0)  //red
			{
			putValue(KN_Kombi_TxC_stat,3);
			putValue(KN_Kombi_TxC_timeStamp,mKN_Kombi_time_prev/100000);
			KN_Kombi_RedStatCtr++;
			putvalue(KN_Kombi_RedCtr,KN_Kombi_RedStatCtr);
			putValue(TxCycleCheck_ErrSummary, 3);
			}

			//MIN-MAX

			if (mKN_Kombi_cycleTime < KN_Kombi_min)
			{
			KN_Kombi_min = mKN_Kombi_cycleTime;
			putValue(KN_Kombi_TxC_min, KN_Kombi_min);
			}

			if (mKN_Kombi_cycleTime > KN_Kombi_max)
			{
			KN_Kombi_max = mKN_Kombi_cycleTime;
			putValue(KN_Kombi_TxC_max, KN_Kombi_max);
			}

        }
        msgKN_Kombi_Ctr++;
    }
       //IssueList #165 - end

  putValue( eKombi_NachlauftypD, this.Kombi_Nachlauftyp );
  switch (this.Kombi_Nachlauftyp)
  {
    case  0: putValue( eKombi_NachlauftypT, "Komm bei KL15 EIN" ); break;
    case  1: putValue( eKombi_NachlauftypT, "Komm nach KL15 AUS" ); break;
    case  2: putValue( eKombi_NachlauftypT, "Komm bei KL15 AUS" ); break;
    default: putValue( eKombi_NachlauftypT, "!?!" );
  }
  putValue( eKBI_KD_FehlerD, this.KBI_KD_Fehler );
  switch (this.KBI_KD_Fehler)
  {
    case  0: putValue( eKBI_KD_FehlerT, "kein KD Fehler" ); break;
    case  1: putValue( eKBI_KD_FehlerT, "KD Fehler" ); break;
    default: putValue( eKBI_KD_FehlerT, "!?!" );
  }
  //MR77431
  putValue( eKN_KBI_DiagPfadD, this.KN_KBI_DiagPfad );
  switch (this.KN_KBI_DiagPfad)
  {
    case  0: putValue( eKN_KBI_DiagPfadT, "aktiv" ); break;
    case  1: putValue( eKN_KBI_DiagPfadT, "inaktiv" ); break;
    default: putValue( eKN_KBI_DiagPfadT, "!?!" );
  }
  
}

on Message Kombi_01
{

   //IssueList #165 - start
    if (getValue(KombiMQB_TxCycle_Check) == 0x01)
    {
        Kombi_01_TxFlg = 0x01;      //flag for TxMute check
        
        mKombi_01_cycleTime = 0;

        if (msgKombi_01_Ctr==0)
        mKombi_01_time_prev = this.time;
        else
        {
        mKombi_01_cycleTime= (this.time - mKombi_01_time_prev)/100;
        mKombi_01_time_prev = this.time;

        //status 
        if (mKombi_01_cycleTime == Kombi_01_defTxCycle)       //green
        putValue(Kombi_01_TxC_stat,1);

        else if (mKombi_01_cycleTime >= (Kombi_01_defTxCycle - (Kombi_01_defTxCycle*0.10)) && mKombi_01_cycleTime <= (Kombi_01_defTxCycle + (Kombi_01_defTxCycle*0.10)))  //yellow
        putValue(Kombi_01_TxC_stat,2);

        else if ((mKombi_01_cycleTime < (Kombi_01_defTxCycle - (Kombi_01_defTxCycle*0.10)) || mKombi_01_cycleTime > (Kombi_01_defTxCycle + (Kombi_01_defTxCycle*0.10)))  && msgKombi_01_Ctr!=0)  //red
        {
        putValue(Kombi_01_TxC_stat,3);
        putValue(Kombi_01_TxC_timeStamp,mKombi_01_time_prev/100000);
        Kombi_01_RedStatCtr++;
        putvalue(Kombi_01_RedCtr,Kombi_01_RedStatCtr);
        putValue(TxCycleCheck_ErrSummary, 3);

        }

        //MIN-MAX

        if (mKombi_01_cycleTime < Kombi_01_min)
        {
        Kombi_01_min = mKombi_01_cycleTime;
        putValue(Kombi_01_TxC_min, Kombi_01_min);
        }

        if (mKombi_01_cycleTime > Kombi_01_max )
        {
        Kombi_01_max = mKombi_01_cycleTime;
        putValue(Kombi_01_TxC_max, Kombi_01_max);

        }

        }
        msgKombi_01_Ctr++;
       }
       //IssueList #165 - end
  
  
  putValue( eKBI_ABS_LampeD, this.KBI_ABS_Lampe );
  switch (this.KBI_ABS_Lampe)
  {
    case  0: putValue( eKBI_ABS_LampeT, "ABS Lampe aus" ); break;
    case  1: putValue( eKBI_ABS_LampeT, "ABS Lampe ein" ); break;
    default: putValue( eKBI_ABS_LampeT, "!?!" );
  }
  putValue( eKBI_ESP_LampeD, this.KBI_ESP_Lampe );
  switch (this.KBI_ESP_Lampe)
  {
    case  0: putValue( eKBI_ESP_LampeT, "ESP Lampe aus" ); break;
    case  1: putValue( eKBI_ESP_LampeT, "ESP Lampe ein" ); break;
    default: putValue( eKBI_ESP_LampeT, "!?!" );
  }
  putValue( eKBI_BKL_LampeD, this.KBI_BKL_Lampe );
  switch (this.KBI_BKL_Lampe)
  {
    case  0: putValue( eKBI_BKL_LampeT, "BKL aus" ); break;
    case  1: putValue( eKBI_BKL_LampeT, "BKL ein" ); break;
    default: putValue( eKBI_BKL_LampeT, "!?!" );
  }
  putValue( eKBI_Airbag_LampeD, this.KBI_Airbag_Lampe );
  switch (this.KBI_Airbag_Lampe)
  {
    case  0: putValue( eKBI_Airbag_LampeT, "Airbag Lampe aus" ); break;
    case  1: putValue( eKBI_Airbag_LampeT, "Airbag Lampe ein" ); break;
    default: putValue( eKBI_Airbag_LampeT, "!?!" );
  }
  putValue( eKBI_SILA_gueltigD, this.KBI_SILA_gueltig );
  switch (this.KBI_SILA_gueltig)
  {
    case  0: putValue( eKBI_SILA_gueltigT, "ungueltig" ); break;
    case  1: putValue( eKBI_SILA_gueltigT, "gueltig" ); break;
    default: putValue( eKBI_SILA_gueltigT, "!?!" );
  }
  putValue( eKBI_Lenkung_LampeD, this.KBI_Lenkung_Lampe );
  putValue( eKBI_Vorglueh_System_LampeD, this.KBI_Vorglueh_System_Lampe );
  switch (this.KBI_Vorglueh_System_Lampe)
  {
    case  0: putValue( eKBI_Vorglueh_System_LampeT, "Lampe aus" ); break;
    case  1: putValue( eKBI_Vorglueh_System_LampeT, "Lampe ein" ); break;
    default: putValue( eKBI_Vorglueh_System_LampeT, "!?!" );
  }
  putValue( eKBI_NV_in_AnzeigeD, this.KBI_NV_in_Anzeige );
  switch (this.KBI_NV_in_Anzeige)
  {
    case  0: putValue( eKBI_NV_in_AnzeigeT, "NV nicht in Anzeige" ); break;
    case  1: putValue( eKBI_NV_in_AnzeigeT, "NV in Anzeige" ); break;
    default: putValue( eKBI_NV_in_AnzeigeT, "!?!" );
  }
  //IssueList #210
  //putValue( eKombi_01_BZD, this.Kombi_01_BZ );
  g_eKombi_01_BZD = this.Kombi_01_BZ;
  
  putValue( eKBI_Anzeigestatus_ACCD, this.KBI_Anzeigestatus_ACC );
  switch (this.KBI_Anzeigestatus_ACC)
  {
    case  0: putValue( eKBI_Anzeigestatus_ACCT, "keine ACC Anzeige" ); break;
    case  1: putValue( eKBI_Anzeigestatus_ACCT, "ACC Anzeige aktiv" ); break;
    default: putValue( eKBI_Anzeigestatus_ACCT, "!?!" );
  }
  putValue( eKBI_Anzeigestatus_GRAD, this.KBI_Anzeigestatus_GRA );
  switch (this.KBI_Anzeigestatus_GRA)
  {
    case  0: putValue( eKBI_Anzeigestatus_GRAT, "nicht vorhanden oder GRA low" ); break;
    case  1: putValue( eKBI_Anzeigestatus_GRAT, "Anzeigemoeglichtkeit vorhanden" ); break;
    case  2: putValue( eKBI_Anzeigestatus_GRAT, "in Anzeige" ); break;
    case  3: putValue( eKBI_Anzeigestatus_GRAT, "Fehler" ); break;
    default: putValue( eKBI_Anzeigestatus_GRAT, "!?!" );
  }
  putValue( eKBI_Oeldruck_SchalterD, this.KBI_Oeldruck_Schalter );
  putValue( eKBI_TankwarnungD, this.KBI_Tankwarnung );
  switch (this.KBI_Tankwarnung)
  {
    case  0: putValue( eKBI_TankwarnungT, "Lampe aus" ); break;
    case  1: putValue( eKBI_TankwarnungT, "Lampe ein" ); break;
    default: putValue( eKBI_TankwarnungT, "!?!" );
  }
  putValue( eKBI_MFA_v_Einheit_01D, this.KBI_MFA_v_Einheit_01 );
  switch (this.KBI_MFA_v_Einheit_01)
  {
    case  0: putValue( eKBI_MFA_v_Einheit_01T, "kmh" ); break;
    case  1: putValue( eKBI_MFA_v_Einheit_01T, "mph" ); break;
    default: putValue( eKBI_MFA_v_Einheit_01T, "!?!" );
  }
  putValue( eKBI_im_StellgliedtestD, this.KBI_im_Stellgliedtest );
  switch (this.KBI_im_Stellgliedtest)
  {
    case  0: putValue( eKBI_im_StellgliedtestT, "kein Stellgliedtest" ); break;
    case  1: putValue( eKBI_im_StellgliedtestT, "Kombi im Stellgliedtest" ); break;
    default: putValue( eKBI_im_StellgliedtestT, "!?!" );
  }
  putValue( eKBI_Anzeigefehler_LDWD, this.KBI_Anzeigefehler_LDW );
  switch (this.KBI_Anzeigefehler_LDW)
  {
    case  0: putValue( eKBI_Anzeigefehler_LDWT, "nicht vorhanden bzw. unterstützt" ); break;
    case  1: putValue( eKBI_Anzeigefehler_LDWT, "Anzeige iO" ); break;
    case  2: putValue( eKBI_Anzeigefehler_LDWT, "Anzeigefehler" ); break;
    case  3: putValue( eKBI_Anzeigefehler_LDWT, "nicht definiert" ); break;
    default: putValue( eKBI_Anzeigefehler_LDWT, "!?!" );
  }
  //putValue( eKBI_Variante_USAD, this.KBI_Variante_USA );
  //switch (this.KBI_Variante_USA)
  //{
    //case  0: putValue( eKBI_Variante_USAT, "keine USA-Variante" ); break;
    //case  1: putValue( eKBI_Variante_USAT, "USA-Variante" ); break;
    //default: putValue( eKBI_Variante_USAT, "!?!" );
  //}
  putValue( eKBI_OeldruckwarnungD, this.KBI_Oeldruckwarnung );
  switch (this.KBI_Oeldruckwarnung)
  {
    case  0: putValue( eKBI_OeldruckwarnungT, "inaktiv" ); break;
    case  1: putValue( eKBI_OeldruckwarnungT, "aktiv" ); break;
    default: putValue( eKBI_OeldruckwarnungT, "!?!" );
  }
  putValue( eKBI_HandbremseD, this.KBI_Handbremse );
  switch (this.KBI_Handbremse)
  {
    case  0: putValue( eKBI_HandbremseT, "nicht angezogen" ); break;
    case  1: putValue( eKBI_HandbremseT, "angezogen" ); break;
    default: putValue( eKBI_HandbremseT, "!?!" );
  }
  putValue( eKBI_V_DigitalD, this.KBI_V_Digital );
  putValue( eKBI_PLA_in_AnzeigeD, this.KBI_PLA_in_Anzeige );
  switch (this.KBI_PLA_in_Anzeige)
  {
    case  0: putValue( eKBI_PLA_in_AnzeigeT, "PLA nicht in Anzeige" ); break;
    case  1: putValue( eKBI_PLA_in_AnzeigeT, "PLA in Anzeige" ); break;
    default: putValue( eKBI_PLA_in_AnzeigeT, "!?!" );
  }
  putValue( eKBI_Anzeigefehler_NVD, this.KBI_Anzeigefehler_NV );
  switch (this.KBI_Anzeigefehler_NV)
  {
    case  0: putValue( eKBI_Anzeigefehler_NVT, "kein Anzeigefehler" ); break;
    case  1: putValue( eKBI_Anzeigefehler_NVT, "Anzeigefehler" ); break;
    default: putValue( eKBI_Anzeigefehler_NVT, "!?!" );
  }
  putValue( eKBI_Anzeigestatus_LIMD, this.KBI_Anzeigestatus_LIM );
  switch (this.KBI_Anzeigestatus_LIM)
  {
    case  0: putValue( eKBI_Anzeigestatus_LIMT, "nicht vorhanden" ); break;
    case  1: putValue( eKBI_Anzeigestatus_LIMT, "Anzeigemoeglichtkeit vorhanden" ); break;
    case  2: putValue( eKBI_Anzeigestatus_LIMT, "in Anzeige" ); break;
    case  3: putValue( eKBI_Anzeigestatus_LIMT, "Fehler" ); break;
    default: putValue( eKBI_Anzeigestatus_LIMT, "!?!" );
  }
  putValue( eKBI_angez_GeschwD, this.KBI_angez_Geschw.phys );
  putValue( eKBI_Einheit_TachoD, this.KBI_Einheit_Tacho );
  switch (this.KBI_Einheit_Tacho)
  {
    case  0: putValue( eKBI_Einheit_TachoT, "km/h" ); break;
    case  1: putValue( eKBI_Einheit_TachoT, "mph" ); break;
    default: putValue( eKBI_Einheit_TachoT, "!?!" );
  }
  putValue( eKBI_Konsistenz_ACCD, this.KBI_Konsistenz_ACC );
  switch (this.KBI_Konsistenz_ACC)
  {
    case  0: putValue( eKBI_Konsistenz_ACCT, "ACC Botschaft konsistent" ); break;
    case  1: putValue( eKBI_Konsistenz_ACCT, "ACC Botschaft inkonsistent" ); break;
    default: putValue( eKBI_Konsistenz_ACCT, "!?!" );
  }
  putValue( eKBI_Fehler_Anzeige_ACCD, this.KBI_Fehler_Anzeige_ACC );
  switch (this.KBI_Fehler_Anzeige_ACC)
  {
    case  0: putValue( eKBI_Fehler_Anzeige_ACCT, "iO" ); break;
    case  1: putValue( eKBI_Fehler_Anzeige_ACCT, "Anzeigefehler ACC" ); break;
    default: putValue( eKBI_Fehler_Anzeige_ACCT, "!?!" );
  }
  putValue( eKBI_Anzeigefehler_SWAD, this.KBI_Anzeigefehler_SWA );
  switch (this.KBI_Anzeigefehler_SWA)
  {
    case  0: putValue( eKBI_Anzeigefehler_SWAT, "nicht vorhanden bzw. unterstützt" ); break;
    case  1: putValue( eKBI_Anzeigefehler_SWAT, "Anzeige iO" ); break;
    case  2: putValue( eKBI_Anzeigefehler_SWAT, "Anzeigefehler" ); break;
    case  3: putValue( eKBI_Anzeigefehler_SWAT, "nicht definiert" ); break;
    default: putValue( eKBI_Anzeigefehler_SWAT, "!?!" );
  }
  
  //MR77431
    putValue( eKBI_Tankwarnung_ungueltigD, this.KBI_Tankwarnung_ungueltig );
  switch (this.KBI_Tankwarnung_ungueltig)
  {
    case  0: putValue( eKBI_Tankwarnung_ungueltigT, "KBI_Tankwarnung_gueltig" ); break;
    case  1: putValue( eKBI_Tankwarnung_ungueltigT, "KBI_Tankwarnung_ungueltig" ); break;
    default: putValue( eKBI_Tankwarnung_ungueltigT, "!?!" );
  }
  
  //MR77431
  putValue( eKBI_SystemstatusD, this.KBI_Systemstatus );
  switch (this.KBI_Systemstatus)
  {
    case  0: putValue( eKBI_SystemstatusT, "KBI_IO" ); break;
    case  1: putValue( eKBI_SystemstatusT, "KBI_System_Failure" ); break;
    default: putValue( eKBI_SystemstatusT, "!?!" );
  }
  
  
     //MR 53874
  putValue( eKBI_ARA_in_AnzeigeD, this.KBI_ARA_in_Anzeige );

}

on Message Kombi_02
{
     //IssueList #165 - start
    if (getValue(KombiMQB_TxCycle_Check) == 0x01)
    {
        Kombi_02_TxFlg = 0x01;      //flag for TxMute check
        
        mKombi_02_cycleTime = 0;

        if (msgKombi_02_Ctr==0)
        {
        
        mKombi_02_time_prev = this.time;
        }
        else
        {
            mKombi_02_cycleTime= (this.time - mKombi_02_time_prev)/100;
            mKombi_02_time_prev = this.time;
        

            //status 
            //green
            if (mKombi_02_cycleTime == Kombi_02_defTxCycle)       
            putValue(Kombi_02_TxC_stat,1);

            //yellow
            //else if (mKombi_02_cycleTime >= (Kombi_02_defTxCycle - (Kombi_02_defTxCycle*0.10)) && mKombi_02_cycleTime <= (Kombi_02_defTxCycle + (Kombi_02_defTxCycle*0.10)))  
            else if (mKombi_02_cycleTime >= Kombi_02_delayTime && mKombi_02_cycleTime <= (Kombi_02_defTxCycle + (Kombi_02_defTxCycle*0.10)))  
            putValue(Kombi_02_TxC_stat,2);

            //red  
            //else if ((mKombi_02_cycleTime < (Kombi_02_defTxCycle - (Kombi_02_defTxCycle*0.10)) || mKombi_02_cycleTime > (Kombi_02_defTxCycle + (Kombi_02_defTxCycle*0.10)))  && msgKombi_02_Ctr!=0)  
            else if ((mKombi_02_cycleTime < Kombi_02_delayTime || mKombi_02_cycleTime > (Kombi_02_defTxCycle + (Kombi_02_defTxCycle*0.10)))  && msgKombi_02_Ctr!=0)
            {
            putValue(Kombi_02_TxC_stat,3);
            putValue(Kombi_02_TxC_timeStamp,mKombi_02_time_prev/100000);
            Kombi_02_RedStatCtr++;
            putvalue(Kombi_02_RedCtr,Kombi_02_RedStatCtr);
            putValue(TxCycleCheck_ErrSummary, 3);
            }

            //MIN-MAX

            if (mKombi_02_cycleTime < Kombi_02_min)
            {
            Kombi_02_min = mKombi_02_cycleTime;
            putValue(Kombi_02_TxC_min, Kombi_02_min);
            }

            if (mKombi_02_cycleTime > Kombi_02_max)
            {
            Kombi_02_max = mKombi_02_cycleTime;
            putValue(Kombi_02_TxC_max, Kombi_02_max);
            }
        } //else
        
    msgKombi_02_Ctr++;
    }
       //IssueList #165 - end
  
  putValue( eKBI_Kilometerstand_0D, this.KBI_Kilometerstand );
  switch (this.KBI_Kilometerstand)
  {
    case 1048574: putValue( eKBI_Kilometerstand_0T, "Init" ); break;
    case 1048575: putValue( eKBI_Kilometerstand_0T, "Fehler" ); break;
    default: putValue( eKBI_Kilometerstand_0T, "" );
  }
  putValue( eKBI_Standzeit_02D, this.KBI_Standzeit_02 );
  switch (this.KBI_Standzeit_02)
  {
    case 131069: putValue( eKBI_Standzeit_02T, "nicht verfuegbar" ); break;
    case 131070: putValue( eKBI_Standzeit_02T, "Init" ); break;
    case 131071: putValue( eKBI_Standzeit_02T, "Fehler" ); break;
    default: putValue( eKBI_Standzeit_02T, "" );
  }
  putValue( eKBI_Inhalt_TankD, this.KBI_Inhalt_Tank );
  switch (this.KBI_Inhalt_Tank)
  {
    case 127: putValue( eKBI_Inhalt_TankT, "Fehler" ); break;
    default: putValue( eKBI_Inhalt_TankT, "" );
  }
  putValue( eKBI_FStatus_TankD, this.KBI_FStatus_Tank );
  switch (this.KBI_FStatus_Tank)
  {
    case  0: putValue( eKBI_FStatus_TankT, "Tankfüllstand i.O." ); break;
    case  1: putValue( eKBI_FStatus_TankT, "Tankfüllstand n.i.O" ); break;
    default: putValue( eKBI_FStatus_TankT, "!?!" );
  }
  putValue( eKBI_QBit_Aussen_Temp_gefD, this.KBI_QBit_Aussen_Temp_gef );
  switch (this.KBI_QBit_Aussen_Temp_gef)
  {
    case  0: putValue( eKBI_QBit_Aussen_Temp_gefT, "gueltiger Wert" ); break;
    case  1: putValue( eKBI_QBit_Aussen_Temp_gefT, "Ersatz Init oder Fehlerwert" ); break;
    default: putValue( eKBI_QBit_Aussen_Temp_gefT, "!?!" );
  }
  putValue( eKBI_Aussen_Temp_gefD, this.KBI_Aussen_Temp_gef.phys );
  switch (this.KBI_Aussen_Temp_gef)
  {
    case 253 /*     76.5 */ : putValue( eKBI_Aussen_Temp_gefT, "nicht verbaut" ); break;
    case 254 /*       77 */ : putValue( eKBI_Aussen_Temp_gefT, "Init" ); break;
    case 255 /*     77.5 */ : putValue( eKBI_Aussen_Temp_gefT, "Fehler" ); break;
    default: putValue( eKBI_Aussen_Temp_gefT, "" );
  }

  putValue( eKBI_Oelwechsel_durchgefuehrtD, this.KBI_Oelwechsel_durchgefuehrt );
  switch (this.KBI_Oelwechsel_durchgefuehrt)
  {
    case  0: putValue( eKBI_Oelwechsel_durchgefuehrtT, "Oelwechsel_nicht_durchgefuehrt" ); break;
    case  1: putValue( eKBI_Oelwechsel_durchgefuehrtT, "Oelwechsel_durchgefuehrt" ); break;
    default: putValue( eKBI_Oelwechsel_durchgefuehrtT, "!?!" );
  }

   //MR 53874
  putValue( eKBI_Reserve_Warnung_SekD, this.KBI_Reserve_Warnung_Sek );
  putValue( eKBI_aktive_Laengsfunktion_02D, this.KBI_aktive_Laengsfunktion_02);
}

on Message Kombi_03
{
  
  //IssueList #165 - start

    if (getValue(KombiMQB_TxCycle_Check) == 0x01)
    {
        Kombi_03_TxFlg = 0x01;      //flag for TxMute check
        
        mKombi_03_cycleTime = 0;

        if (msgKombi_03_Ctr==0)
        {
        Kombi_03_min = Kombi_03_max = Kombi_03_defTxCycle;
        mKombi_03_time_prev = this.time;
        }
        else
        {
        mKombi_03_cycleTime= (this.time - mKombi_03_time_prev)/100;
        mKombi_03_time_prev = this.time;
       

        //status 
        if (mKombi_03_cycleTime == Kombi_03_defTxCycle)       //green
        putValue(Kombi_03_TxC_stat,1);

        else if (mKombi_03_cycleTime >= (Kombi_03_defTxCycle - (Kombi_03_defTxCycle*0.10)) && mKombi_03_cycleTime <= (Kombi_03_defTxCycle + (Kombi_03_defTxCycle*0.10)))  //yellow
        putValue(Kombi_03_TxC_stat,2);

        else if ((mKombi_03_cycleTime < (Kombi_03_defTxCycle - (Kombi_03_defTxCycle*0.10)) || mKombi_03_cycleTime > (Kombi_03_defTxCycle + (Kombi_03_defTxCycle*0.10)))  && msgKombi_03_Ctr!=0)  //red
        {
        putValue(Kombi_03_TxC_stat,3);
        putValue(Kombi_03_TxC_timeStamp,mKombi_03_time_prev/100000);
        Kombi_03_RedStatCtr++;
        putvalue(Kombi_03_RedCtr,Kombi_03_RedStatCtr);
        putValue(TxCycleCheck_ErrSummary, 3);
        }

        //MIN-MAX

        if (mKombi_03_cycleTime < Kombi_03_min)
        {
        Kombi_03_min = mKombi_03_cycleTime;
        putValue(Kombi_03_TxC_min, Kombi_03_min);
        }

        if (mKombi_03_cycleTime > Kombi_03_max)
        {
        Kombi_03_max = mKombi_03_cycleTime;
        putValue(Kombi_03_TxC_max, Kombi_03_max);
        }

         }
        msgKombi_03_Ctr++;
       }
       //IssueList #165 - end
  
 
  putValue( eKBI_ReifenumfangD, this.KBI_Reifenumfang );
  putValue( eKBI_BCmE_aktivD, this.KBI_BCmE_aktiv );
  switch (this.KBI_BCmE_aktiv)
  {
    case  0: putValue( eKBI_BCmE_aktivT, "Anzeige nicht aktiv" ); break;
    case  1: putValue( eKBI_BCmE_aktivT, "Anzeige aktiv" ); break;
    default: putValue( eKBI_BCmE_aktivT, "!?!" );
  }
  putValue( eKBI_Sparhinweis_quittiertD, this.KBI_Sparhinweis_quittiert );
  switch (this.KBI_Sparhinweis_quittiert)
  {
    case  0: putValue( eKBI_Sparhinweis_quittiertT, "nicht quittiert" ); break;
    case  1: putValue( eKBI_Sparhinweis_quittiertT, "quittiert" ); break;
    default: putValue( eKBI_Sparhinweis_quittiertT, "!?!" );
  }

  putValue( eKBI_Tankfuellstand_ProzentD, this.KBI_Tankfuellstand_Prozent);
  putValue( eKBI_Nachtanken_erkanntD, this.KBI_Nachtanken_erkannt);
  putValue( eKBI_Tankinhalt_hochauflD, this.KBI_Tankinhalt_hochaufl.phys);
  //MR 53874
  putValue( eKBI_Variante_USAD, this.KBI_Variante_USA );

    //MR 56253
  putValue( eKBI_VarianteD, this.KBI_Variante);
}

on Message KS_Kombi_Resp
{
  putValue( eKS_Kombi_Resp_DataD, this.KS_Kombi_Resp_Data );
}

on Message NMH_Kombi
{
  //IssueList #165 - start


    if (msgNMH_Kombi_check==0)
    putValue(KombiMQB_TxCycle_Check, 1);

    if (getValue(KombiMQB_TxCycle_Check) == 0x01)
    {
        mNMH_Kombi_cycleTime = 0;

        if (msgNMH_Kombi_Ctr==0)
        {

        mNMH_Kombi_time_prev = this.time;
        }
        else
        {
            mNMH_Kombi_cycleTime= (this.time - mNMH_Kombi_time_prev)/100;
            mNMH_Kombi_time_prev = this.time;
        

            //status 
            if (mNMH_Kombi_cycleTime == NMH_Kombi_defTxCycle)       //green
            putValue(NMH_Kombi_TxC_stat,1);

            else if (mNMH_Kombi_cycleTime >= (NMH_Kombi_defTxCycle - (NMH_Kombi_defTxCycle*0.10)) && mNMH_Kombi_cycleTime <= (NMH_Kombi_defTxCycle + (NMH_Kombi_defTxCycle*0.10)))  //yellow
            putValue(NMH_Kombi_TxC_stat,2);

            else if ((mNMH_Kombi_cycleTime < (NMH_Kombi_defTxCycle - (NMH_Kombi_defTxCycle*0.10)) || mNMH_Kombi_cycleTime > (NMH_Kombi_defTxCycle + (NMH_Kombi_defTxCycle*0.10)))  && msgNMH_Kombi_Ctr!=0)  //red
            {
            putValue(NMH_Kombi_TxC_stat,3);
            putValue(NMH_Kombi_TxC_timeStamp,mNMH_Kombi_time_prev/100000);
            NMH_Kombi_RedStatCtr++;
            putvalue(NMH_Kombi_RedCtr,NMH_Kombi_RedStatCtr);
            }

            //MIN-MAX

            if (mNMH_Kombi_cycleTime < NMH_Kombi_min)
            {
            NMH_Kombi_min = mNMH_Kombi_cycleTime;
            putValue(NMH_Kombi_TxC_min, NMH_Kombi_min);
            }

            if (mNMH_Kombi_cycleTime > NMH_Kombi_max)
            {
            NMH_Kombi_max = mNMH_Kombi_cycleTime;
            putValue(NMH_Kombi_TxC_max, NMH_Kombi_max);
            }

        }
        msgNMH_Kombi_Ctr++;

        
    }
       //IssueList #165 - end

  msgNMH_Kombi_check++;
    
 //   putValue( KCAN_NM_Kombi_CAB_V09, this.NM_Kombi_CAB_V09 );
 //   putValue( KCAN_NM_Kombi_Car_Wakeup, this.NM_Kombi_Car_Wakeup );
 //   putValue( KCAN_NM_Kombi_CBV_AWB, this.NM_Kombi_CBV_AWB );
 //   putValue( KCAN_NM_Kombi_CBV_CRI, this.NM_Kombi_CBV_CRI );
 //   putValue( KCAN_NM_Kombi_NM_aktiv_Buzzer, this.NM_Kombi_NM_aktiv_Buzzer );
 //   putValue( KCAN_NM_Kombi_NM_aktiv_Diagnose, this.NM_Kombi_NM_aktiv_Diagnose );
 //   putValue( KCAN_NM_Kombi_NM_aktiv_KL15, this.NM_Kombi_NM_aktiv_KL15 );
 //   putValue( KCAN_NM_Kombi_NM_aktiv_Schluesselkomm, this.NM_Kombi_NM_aktiv_Schluesselkomm );
 //   putValue( KCAN_NM_Kombi_NM_aktiv_Tmin, this.NM_Kombi_NM_aktiv_Tmin );
 //   putValue( KCAN_NM_Kombi_NM_aktiv_VLW, this.NM_Kombi_NM_aktiv_VLW );
 //   putValue( KCAN_NM_Kombi_NM_State, this.NM_Kombi_NM_State );
 //   putValue( KCAN_NM_Kombi_UDS_CC, this.NM_Kombi_UDS_CC );

 //   putValue( eNM_Kombi_CAB_V09D, this.NM_Kombi_CAB_V09 );
    putValue( eNM_Kombi_Car_WakeupD, this.NM_Kombi_Car_Wakeup );
//    putValue( eNM_Kombi_CBV_AWBD, this.NM_Kombi_CBV_AWB );
 //   putValue( eNM_Kombi_CBV_CRID, this.NM_Kombi_CBV_CRI );
    putValue( eNM_Kombi_NM_aktiv_BuzzerD, this.NM_Kombi_NM_aktiv_Buzzer );
 //   putValue( eNM_Kombi_NM_aktiv_DiagnoseD, this.NM_Kombi_NM_aktiv_Diagnose );
//    putValue( eNM_Kombi_NM_aktiv_KL15D, this.NM_Kombi_NM_aktiv_KL15 );
 //   putValue( eNM_Kombi_NM_aktiv_SchluesselkommD, this.NM_Kombi_NM_aktiv_Schluesselkomm );
 //   putValue( eNM_Kombi_NM_aktiv_TminD, this.NM_Kombi_NM_aktiv_Tmin );
//    putValue( eNM_Kombi_NM_aktiv_VLWD, this.NM_Kombi_NM_aktiv_VLW );
    putValue( eNM_Kombi_NM_StateD, this.NM_Kombi_NM_State );
 //   putValue( eNM_Kombi_UDS_CCD, this.NM_Kombi_UDS_CC );
    
    putValue( eNM_Kombi_NM_StateD, this.NM_Kombi_NM_State );
  switch (this.NM_Kombi_NM_State)
  {
    case  1: putValue( eNM_Kombi_NM_StateT, "NM RM aus BSM" ); break;
    case  2: putValue( eNM_Kombi_NM_StateT, "NM RM aus PBSM" ); break;
    case  4: putValue( eNM_Kombi_NM_StateT, "NM NO aus RM" ); break;
    case  8: putValue( eNM_Kombi_NM_StateT, "NM NO aus RS" ); break;
    default: putValue( eNM_Kombi_NM_StateT, "!?!" );
  }
  putValue( eNM_Kombi_Car_WakeupD, this.NM_Kombi_Car_Wakeup );
  switch (this.NM_Kombi_Car_Wakeup)
  {
    case  1: putValue( eNM_Kombi_Car_WakeupT, "Car Wakeup" ); break;
    default: putValue( eNM_Kombi_Car_WakeupT, "!?!" );
  }

  putValue( eNM_Kombi_NM_aktiv_BuzzerD, this.NM_Kombi_NM_aktiv_Buzzer );
  switch (this.NM_Kombi_NM_aktiv_Buzzer)
  {
    case  1: putValue( eNM_Kombi_NM_aktiv_BuzzerT, "Buzzer aktiv" ); break;
    default: putValue( eNM_Kombi_NM_aktiv_BuzzerT, "!?!" );
  }

  putValue( eNM_Kombi_NM_aktiv_SchlkomD, this.NM_Kombi_NM_aktiv_Schluesselkomm);
  switch (this.NM_Kombi_NM_aktiv_Schluesselkomm)
  {
    case  1: putValue( eNM_Kombi_NM_ak_SchlkommT, "Schluesselkomm aktiv" ); break;
    default: putValue( eNM_Kombi_NM_ak_SchlkommT, "!?!" );
  }
}

on Message OBD_Tankgeber_01
{
  
  //IssueList #165 - start


    if (getValue(KombiMQB_TxCycle_Check) == 0x01)
    {
        OBD_Tank_01_TxFlg = 0x01;      //flag for TxMute check
        
        mOBD_Tank_01_cycleTime = 0;

        if (msgOBD_Tank_01_Ctr==0)
        {

        mOBD_Tank_01_time_prev = this.time;
        }
        else
        {
        mOBD_Tank_01_cycleTime= (this.time - mOBD_Tank_01_time_prev)/100;
        mOBD_Tank_01_time_prev = this.time;
        

        //status 
        if (mOBD_Tank_01_cycleTime == OBD_Tank_01_defTxCycle)       //green
        putValue(OBD_Tank_01_TxC_stat,1);

        else if (mOBD_Tank_01_cycleTime >= (OBD_Tank_01_defTxCycle - (OBD_Tank_01_defTxCycle*0.10)) && mOBD_Tank_01_cycleTime <= (OBD_Tank_01_defTxCycle + (OBD_Tank_01_defTxCycle*0.10)))  //yellow
        putValue(OBD_Tank_01_TxC_stat,2);

        else if ((mOBD_Tank_01_cycleTime < (OBD_Tank_01_defTxCycle - (OBD_Tank_01_defTxCycle*0.10)) || mOBD_Tank_01_cycleTime > (OBD_Tank_01_defTxCycle + (OBD_Tank_01_defTxCycle*0.10)))  && msgOBD_Tank_01_Ctr!=0)  //red
        {
        putValue(OBD_Tank_01_TxC_stat,3);
        putValue(OBD_Tank_01_TxC_timeStamp,mOBD_Tank_01_time_prev/100000);
        OBD_Tank_01_RedStatCtr++;
        putvalue(OBD_Tank_01_RedCtr,OBD_Tank_01_RedStatCtr);
        putValue(TxCycleCheck_ErrSummary, 3);
        }

        //MIN-MAX

        if (mOBD_Tank_01_cycleTime < OBD_Tank_01_min) 
        {
        OBD_Tank_01_min = mOBD_Tank_01_cycleTime;
        putValue(OBD_Tank_01_TxC_min, OBD_Tank_01_min);
        }

        if (mOBD_Tank_01_cycleTime > OBD_Tank_01_max)
        {
        OBD_Tank_01_max = mOBD_Tank_01_cycleTime;
        putValue(OBD_Tank_01_TxC_max, OBD_Tank_01_max);
        }

        }
        msgOBD_Tank_01_Ctr++;
       }
       //IssueList #165 - end
  
 
  putValue( eOBD_TG_F_Status_1D, this.OBD_TG_F_Status_1 );
  switch (this.OBD_TG_F_Status_1)
  {
    case  0: putValue( eOBD_TG_F_Status_1T, "kein Fehler / Init / nicht verbaut" ); break;
    case  1: putValue( eOBD_TG_F_Status_1T, "KS-" ); break;
    case  2: putValue( eOBD_TG_F_Status_1T, "KS+ (B8: nicht bedient)" ); break;
    case  3: putValue( eOBD_TG_F_Status_1T, "OC (Leitungsunterbrechung) (B8: nicht bedient)" ); break;
    case  4: putValue( eOBD_TG_F_Status_1T, "OOR+ (out of range high) (B8: nicht bedient)" ); break;
    case  5: putValue( eOBD_TG_F_Status_1T, "OOR- (out of range low) (B8: nicht bedient)" ); break;
    case  6: putValue( eOBD_TG_F_Status_1T, "RC+ (Signal unplausibel hoch) (B8: nicht bedient)" ); break;
    case  7: putValue( eOBD_TG_F_Status_1T, "RC- (Signal unplausibel niedrig) (B8: nicht bedient)" ); break;
    case  8: putValue( eOBD_TG_F_Status_1T, "KS+/OC" ); break;
    case  9: putValue( eOBD_TG_F_Status_1T, "KS-/OC (B8: nicht bedient)" ); break;
    case 10: putValue( eOBD_TG_F_Status_1T, "KS-/KS+ (B8: nicht bedient)" ); break;
    case 11: putValue( eOBD_TG_F_Status_1T, "KS-/KS+/OC (allgemeiner Fehler)" ); break;
    case 12: putValue( eOBD_TG_F_Status_1T, "frei" ); break;
    case 13: putValue( eOBD_TG_F_Status_1T, "frei" ); break;
    case 14: putValue( eOBD_TG_F_Status_1T, "frei" ); break;
    case 15: putValue( eOBD_TG_F_Status_1T, "frei" ); break;
    default: putValue( eOBD_TG_F_Status_1T, "!?!" );
  }
  putValue( eOBD_TG_F_Status_2D, this.OBD_TG_F_Status_2 );
  switch (this.OBD_TG_F_Status_2)
  {
    case  0: putValue( eOBD_TG_F_Status_2T, "kein Fehler / Init / nicht verbaut" ); break;
    case  1: putValue( eOBD_TG_F_Status_2T, "KS-" ); break;
    case  2: putValue( eOBD_TG_F_Status_2T, "KS+ (B8: nicht bedient)" ); break;
    case  3: putValue( eOBD_TG_F_Status_2T, "OC (Leitungsunterbrechung) (B8: nicht bedient)" ); break;
    case  4: putValue( eOBD_TG_F_Status_2T, "OOR+ (out of range high) (B8: nicht bedient)" ); break;
    case  5: putValue( eOBD_TG_F_Status_2T, "OOR- (out of range low) (B8: nicht bedient)" ); break;
    case  6: putValue( eOBD_TG_F_Status_2T, "RC+ (Signal unplausibel hoch) (B8: nicht bedient)" ); break;
    case  7: putValue( eOBD_TG_F_Status_2T, "RC- (Signal unplausibel niedrig) (B8: nicht bedient)" ); break;
    case  8: putValue( eOBD_TG_F_Status_2T, "KS+/OC" ); break;
    case  9: putValue( eOBD_TG_F_Status_2T, "KS-/OC (B8: nicht bedient)" ); break;
    case 10: putValue( eOBD_TG_F_Status_2T, "KS-/KS+ (B8: nicht bedient)" ); break;
    case 11: putValue( eOBD_TG_F_Status_2T, "KS-/KS+/OC (allgemeiner Fehler)" ); break;
    case 12: putValue( eOBD_TG_F_Status_2T, "frei" ); break;
    case 13: putValue( eOBD_TG_F_Status_2T, "frei" ); break;
    case 14: putValue( eOBD_TG_F_Status_2T, "frei" ); break;
    case 15: putValue( eOBD_TG_F_Status_2T, "frei" ); break;
    default: putValue( eOBD_TG_F_Status_2T, "!?!" );
  }
  putValue( eOBD_TG_F_Status_3D, this.OBD_TG_F_Status_3 );
  switch (this.OBD_TG_F_Status_3)
  {
    case  0: putValue( eOBD_TG_F_Status_3T, "kein Fehler / Init / nicht verbaut" ); break;
    case  1: putValue( eOBD_TG_F_Status_3T, "KS-" ); break;
    case  2: putValue( eOBD_TG_F_Status_3T, "KS+ (B8: nicht bedient)" ); break;
    case  3: putValue( eOBD_TG_F_Status_3T, "OC (Leitungsunterbrechung) (B8: nicht bedient)" ); break;
    case  4: putValue( eOBD_TG_F_Status_3T, "OOR+ (out of range high) (B8: nicht bedient)" ); break;
    case  5: putValue( eOBD_TG_F_Status_3T, "OOR- (out of range low) (B8: nicht bedient)" ); break;
    case  6: putValue( eOBD_TG_F_Status_3T, "RC+ (Signal unplausibel hoch) (B8: nicht bedient)" ); break;
    case  7: putValue( eOBD_TG_F_Status_3T, "RC- (Signal unplausibel niedrig) (B8: nicht bedient)" ); break;
    case  8: putValue( eOBD_TG_F_Status_3T, "KS+/OC" ); break;
    case  9: putValue( eOBD_TG_F_Status_3T, "KS-/OC (B8: nicht bedient)" ); break;
    case 10: putValue( eOBD_TG_F_Status_3T, "KS-/KS+ (B8: nicht bedient)" ); break;
    case 11: putValue( eOBD_TG_F_Status_3T, "KS-/KS+/OC (allgemeiner Fehler)" ); break;
    case 12: putValue( eOBD_TG_F_Status_3T, "frei" ); break;
    case 13: putValue( eOBD_TG_F_Status_3T, "frei" ); break;
    case 14: putValue( eOBD_TG_F_Status_3T, "frei" ); break;
    case 15: putValue( eOBD_TG_F_Status_3T, "frei" ); break;
    default: putValue( eOBD_TG_F_Status_3T, "!?!" );
  }
  putValue( eOBD_TG_F_Status_4D, this.OBD_TG_F_Status_4 );
  switch (this.OBD_TG_F_Status_4)
  {
    case  0: putValue( eOBD_TG_F_Status_4T, "kein Fehler / Init / nicht verbaut" ); break;
    case  1: putValue( eOBD_TG_F_Status_4T, "KS-" ); break;
    case  2: putValue( eOBD_TG_F_Status_4T, "KS+ (B8: nicht bedient)" ); break;
    case  3: putValue( eOBD_TG_F_Status_4T, "OC (Leitungsunterbrechung) (B8: nicht bedient)" ); break;
    case  4: putValue( eOBD_TG_F_Status_4T, "OOR+ (out of range high) (B8: nicht bedient)" ); break;
    case  5: putValue( eOBD_TG_F_Status_4T, "OOR- (out of range low) (B8: nicht bedient)" ); break;
    case  6: putValue( eOBD_TG_F_Status_4T, "RC+ (Signal unplausibel hoch) (B8: nicht bedient)" ); break;
    case  7: putValue( eOBD_TG_F_Status_4T, "RC- (Signal unplausibel niedrig) (B8: nicht bedient)" ); break;
    case  8: putValue( eOBD_TG_F_Status_4T, "KS+/OC" ); break;
    case  9: putValue( eOBD_TG_F_Status_4T, "KS-/OC (B8: nicht bedient)" ); break;
    case 10: putValue( eOBD_TG_F_Status_4T, "KS-/KS+ (B8: nicht bedient)" ); break;
    case 11: putValue( eOBD_TG_F_Status_4T, "KS-/KS+/OC (allgemeiner Fehler)" ); break;
    case 12: putValue( eOBD_TG_F_Status_4T, "frei" ); break;
    case 13: putValue( eOBD_TG_F_Status_4T, "frei" ); break;
    case 14: putValue( eOBD_TG_F_Status_4T, "frei" ); break;
    case 15: putValue( eOBD_TG_F_Status_4T, "frei" ); break;
    default: putValue( eOBD_TG_F_Status_4T, "!?!" );
  }
  putValue( eOBD_TG_Sens_Rohwert_1D, this.OBD_TG_Sens_Rohwert_1.phys );
  putValue( eOBD_TG_Sens_Rohwert_2D, this.OBD_TG_Sens_Rohwert_2.phys );
  putValue( eOBD_TG_Sens_Rohwert_3D, this.OBD_TG_Sens_Rohwert_3.phys );
  putValue( eOBD_TG_Sens_Rohwert_4D, this.OBD_TG_Sens_Rohwert_4.phys );
}

on Message Reset
{
    //IssueList #165 - start

    if (getValue(KombiMQB_TxCycle_Check) == 0x01)
    {
        Reset_TxFlg = 0x01;      //flag for TxMute check
        
        mReset_cycleTime = 0;

        if (msgReset_Ctr==0)
        {

            mReset_time_prev = this.time;
        }
        else
        {
            mReset_cycleTime= (this.time - mReset_time_prev)/100;
            mReset_time_prev = this.time;

            //status 
            if (mReset_cycleTime == Reset_defTxCycle)       //green
            putValue(Reset_TxC_stat,1);

            else if (mReset_cycleTime >= (Reset_defTxCycle - (Reset_defTxCycle*0.10)) && mReset_cycleTime <= (Reset_defTxCycle + (Reset_defTxCycle*0.10)))  //yellow
            putValue(Reset_TxC_stat,2);

            else if (mReset_cycleTime < (Reset_defTxCycle - (Reset_defTxCycle*0.10)) || mReset_cycleTime > (Reset_defTxCycle + (Reset_defTxCycle*0.10)))    //red
            {
            putValue(Reset_TxC_stat,3);
            putValue(Reset_TxC_timeStamp,mReset_time_prev/100000);
            Reset_RedStatCtr++;
            putvalue(Reset_RedCtr,Reset_RedStatCtr);
            putValue(TxCycleCheck_ErrSummary, 3);
            }

            //MIN-MAX
            if (mReset_cycleTime < Reset_min)
            {
            Reset_min = mReset_cycleTime;
            putValue(Reset_TxC_min, Reset_min);
            }

            if (mReset_cycleTime > Reset_max)
            {
            Reset_max = mReset_cycleTime;
            putValue(Reset_TxC_max, Reset_max);
            }

         }
    msgReset_Ctr++;
    }

    //IssueList #165 - end

  putValue( eRES_TripResetD, this.RES_TripReset );
  switch (this.RES_TripReset)
  {
    case  0: putValue( eRES_TripResetT, "NoAction" ); break;
    case  1: putValue( eRES_TripResetT, "Reset" ); break;
    default: putValue( eRES_TripResetT, "!?!" );
  }
}

on Message Sensorik_Dimmung_01
{
  
    //IssueList #165 - start


    if (getValue(KombiMQB_TxCycle_Check) == 0x01)
    {
        Sensorik_Dim_01_TxFlg = 0x01;      //flag for TxMute check
        
        
        mSensorik_Dim_01_cycleTime = 0;

        if (msgSensorik_Dim_01_Ctr==0)
        {
        mSensorik_Dim_01_time_prev = this.time;
        }
        else
        {
        mSensorik_Dim_01_cycleTime= (this.time - mSensorik_Dim_01_time_prev)/100;
        mSensorik_Dim_01_time_prev = this.time;
       

        //status 
        //green
        if (mSensorik_Dim_01_cycleTime == Sensorik_Dim_01_defTxCycle)       
        putValue(Sensorik_Dim_01_TxC_stat,1);

        //yellow
        //else if (mSensorik_Dim_01_cycleTime >= (Sensorik_Dim_01_defTxCycle - (Sensorik_Dim_01_defTxCycle*0.10)) && mSensorik_Dim_01_cycleTime <= (Sensorik_Dim_01_defTxCycle + (Sensorik_Dim_01_defTxCycle*0.10)))  //yellow
        else if (mSensorik_Dim_01_cycleTime >= Sensorik_Dim_delayTime && mSensorik_Dim_01_cycleTime <= (Sensorik_Dim_01_defTxCycle + (Sensorik_Dim_01_defTxCycle*0.10)))  //yellow
        putValue(Sensorik_Dim_01_TxC_stat,2);

        //red
        //else if ((mSensorik_Dim_01_cycleTime < (Sensorik_Dim_01_defTxCycle - (Sensorik_Dim_01_defTxCycle*0.10)) || mSensorik_Dim_01_cycleTime > (Sensorik_Dim_01_defTxCycle + (Sensorik_Dim_01_defTxCycle*0.10)))  && msgSensorik_Dim_01_Ctr!=0)  //red
        else if ((mSensorik_Dim_01_cycleTime < Sensorik_Dim_delayTime || mSensorik_Dim_01_cycleTime > (Sensorik_Dim_01_defTxCycle + (Sensorik_Dim_01_defTxCycle*0.10)))  && msgSensorik_Dim_01_Ctr!=0)  //red
        {
        putValue(Sensorik_Dim_01_TxC_stat,3);
        putValue(Sensorik_Dim_01_TxC_timeStamp,mSensorik_Dim_01_time_prev/100000);

        Sensorik_Dim_01_RedStatCtr++;
        putvalue(Sensorik_Dim_01_RedCtr,Sensorik_Dim_01_RedStatCtr);
        putValue(TxCycleCheck_ErrSummary, 3);
        }

        //MIN-MAX

        if (mSensorik_Dim_01_cycleTime < Sensorik_Dim_min)
        {
        Sensorik_Dim_min = mSensorik_Dim_01_cycleTime;
        putValue(Sensorik_Dim_01_TxC_min, Sensorik_Dim_min);
        }

        if (mSensorik_Dim_01_cycleTime > Sensorik_Dim_max)
        {
        Sensorik_Dim_max = mSensorik_Dim_01_cycleTime;
        putValue(Sensorik_Dim_01_TxC_max, Sensorik_Dim_max);
        }

         }
        msgSensorik_Dim_01_Ctr++;
       }
       //IssueList #165 - end
  

  putValue( eKBI_PhototransistorD, this.KBI_Phototransistor );
  switch (this.KBI_Phototransistor)
  {
    case 254: putValue( eKBI_PhototransistorT, "Phototransistor nicht verbaut" ); break;
    case 255: putValue( eKBI_PhototransistorT, "Fehler" ); break;
    default: putValue( eKBI_PhototransistorT, "" );
  }
  putValue( eKBI_DimmpotiD, this.KBI_Dimmpoti );
  switch (this.KBI_Dimmpoti)
  {
    case 126: putValue( eKBI_DimmpotiT, "Nicht verfügbar" ); break;
    case 127: putValue( eKBI_DimmpotiT, "Fehler" ); break;
    default: putValue( eKBI_DimmpotiT, "" );
  }
    
    //watchdog function
    if (getValue(eWatchDog_Switch_1))
    {
        gcurrentValue = this.KBI_Phototransistor;
        putValue( eWatchDog_Value_1, gcurrentValue );

        if (gstoredValue!=gcurrentValue)
        {
        gstoredValue = gcurrentValue;
    
            if ((gcurrentValue) > gUpperLimit1)
            {
            gExceedancesCtr1+=1;
            SetControlBackColor("WatchDog", "EnvVar:eWatchDog_Value_1", MakeRGB(255,0,0));
            }
            else if ((gcurrentValue) < gLowerLimit1)
            {
            gUndercutsCtr1 +=1;
            SetControlBackColor("WatchDog", "EnvVar:eWatchDog_Value_1", MakeRGB(255,0,0));
            }
            else
            SetControlBackColor("WatchDog", "EnvVar:eWatchDog_Value_1", MakeRGB(0,255,0));
    
            if (((gExceedancesCtr1 == 1) || (gUndercutsCtr1== 1)) && (beepFlag==0))
            {
            msgbeep(1);
            beepFlag=1;
            }

            putValue(eWatchDog_Exceedances_1,gExceedancesCtr1);
            putValue(eWatchDog_Undercuts_1,gUndercutsCtr1);
        }
    }
    else
    SetControlBackColor("WatchDog", "EnvVar:eWatchDog_Value_1", MakeRGB(255,255,255));



}

on Message Service_Key_01
{
  putValue( eSK1_MUXD, this.SK1_MUX );
  switch (this.SK1_MUX)
  {
    case 0:
      putValue( eSK1_Key_Data_1D, this.SK1_Key_Data_1 );
    break;
    case 1:
      putValue( eSK1_Key_Data_2D, this.SK1_Key_Data_2 );
    break;
    case 2:
      putValue( eSK1_Key_Data_3D, this.SK1_Key_Data_3 );
    break;
    case 3:
      putValue( eSK1_Key_Data_4D, this.SK1_Key_Data_4 );
    break;
    case 4:
      putValue( eSK1_Key_Data_5D, this.SK1_Key_Data_5 );
    break;
    case 5:
      putValue( eSK1_Key_Data_6D, this.SK1_Key_Data_6 );
    break;
    case 6:
      putValue( eSK1_Key_Data_7D, this.SK1_Key_Data_7 );
    break;
    case 7:
      putValue( eSK1_Key_Data_8D, this.SK1_Key_Data_8 );
    break;
    case 8:
      putValue( eSK1_Key_Data_9D, this.SK1_Key_Data_9 );
    break;
  }

  //IssueList #165
  if (getValue(KombiMQB_TxCycle_Check) == 0x01)
  {
  Service_Key_01_Ctr++;
  putValue(Service_Key_01_MsgCtr,Service_Key_01_Ctr);
  }
}

on Message Uhrzeit_01
{
  
      //IssueList #165 - start


    if (getValue(KombiMQB_TxCycle_Check) == 0x01)
    {
        Uhrzeit_01_TxFlg = 0x01;      //flag for TxMute check
        
        mUhrzeit_01_cycleTime = 0;

        if (msgUhrzeit_01_Ctr==0)
        {

        mUhrzeit_01_time_prev = this.time;
        }
        else
        {
        mUhrzeit_01_cycleTime= (this.time - mUhrzeit_01_time_prev)/100;
        mUhrzeit_01_time_prev = this.time;
        

        //status 
        if (mUhrzeit_01_cycleTime == Uhrzeit_01_defTxCycle)       //green
        putValue(Uhrzeit_01_TxC_stat,1);

        else if (mUhrzeit_01_cycleTime >= (Uhrzeit_01_defTxCycle - (Uhrzeit_01_defTxCycle*0.10)) && mUhrzeit_01_cycleTime <= (Uhrzeit_01_defTxCycle + (Uhrzeit_01_defTxCycle*0.10)))  //yellow
        putValue(Uhrzeit_01_TxC_stat,2);

        else if ((mUhrzeit_01_cycleTime < (Uhrzeit_01_defTxCycle - (Uhrzeit_01_defTxCycle*0.10)) || mUhrzeit_01_cycleTime > (Uhrzeit_01_defTxCycle + (Uhrzeit_01_defTxCycle*0.10)))  && msgUhrzeit_01_Ctr!=0)  //red
        {
        putValue(Uhrzeit_01_TxC_stat,3);
        putValue(Uhrzeit_01_TxC_timeStamp,mUhrzeit_01_time_prev/100000);
        Uhrzeit_01_RedStatCtr++;
        putvalue(Uhrzeit_01_RedCtr,Uhrzeit_01_RedStatCtr);
        putValue(TxCycleCheck_ErrSummary, 3);
        }

        //MIN-MAX

        if (mUhrzeit_01_cycleTime < Uhrzeit_01_min) 
        {
        Uhrzeit_01_min = mUhrzeit_01_cycleTime;
        putValue(Uhrzeit_01_TxC_min, Uhrzeit_01_min);
        }

        if (mUhrzeit_01_cycleTime > Uhrzeit_01_max)
        {
        Uhrzeit_01_max = mUhrzeit_01_cycleTime;
        putValue(Uhrzeit_01_TxC_max, Uhrzeit_01_max);
        }

        }
        msgUhrzeit_01_Ctr++;
       }
       //IssueList #165 - end
  
  putValue( eUH_Monat_0D, this.UH_Monat );
  switch (this.UH_Monat)
  {
    case 14: putValue( eUH_Monat_0T, "reserviert" ); break;
    default: putValue( eUH_Monat_0T, "" );
  }
  putValue( eUH_Jahr_0D, this.UH_Jahr.phys );
  putValue( eUH_Tag_0D, this.UH_Tag );
  switch (this.UH_Tag)
  {
    case  0: putValue( eUH_Tag_0T, "reserviert" ); break;
    default: putValue( eUH_Tag_0T, "" );
  }
  putValue( eUH_Stunde_0D, this.UH_Stunde );
  putValue( eUH_Minute_0D, this.UH_Minute );
  putValue( eUH_Sekunde_0D, this.UH_Sekunde );


    //IssueList #58: Mapping values of Uhrzeit_01 to Diagnose_01 message
    if (getValue(eSynchronizeDiagnose_01)==0x01)
    {
    putValue(eUH_Jahr_1S, this.UH_Jahr.phys);
    putValue(eUH_Monat_1S,this.UH_Monat);
    putValue(eUH_Tag_1S, this.UH_Tag);

    putValue( eUH_Stunde_1S, this.UH_Stunde );
    putValue( eUH_Minute_1S, this.UH_Minute );
    putValue( eUH_Sekunde_1S, this.UH_Sekunde );
    }

}

on Message VIN_01
{
    //IssueList #165 - start


    if (getValue(KombiMQB_TxCycle_Check) == 0x01)
    {
        VIN_01_TxFlg = 0x01;      //flag for TxMute check
        
        mVIN_01_cycleTime = 0;

        if (msgVIN_01_Ctr==0)
        {

        mVIN_01_time_prev = this.time;
        }
        else
        {
        mVIN_01_cycleTime= (this.time - mVIN_01_time_prev)/100;
        mVIN_01_time_prev = this.time;
      

        //status 
        if (mVIN_01_cycleTime == VIN_01_defTxCycle)       //green
        putValue(VIN_01_TxC_stat,1);

        else if (mVIN_01_cycleTime >= (VIN_01_defTxCycle - (VIN_01_defTxCycle*0.10)) && mVIN_01_cycleTime <= (VIN_01_defTxCycle + (VIN_01_defTxCycle*0.10)))  //yellow
        putValue(VIN_01_TxC_stat,2);

        else if ((mVIN_01_cycleTime < (VIN_01_defTxCycle - (VIN_01_defTxCycle*0.10)) || mVIN_01_cycleTime > (VIN_01_defTxCycle + (VIN_01_defTxCycle*0.10)))  && msgVIN_01_Ctr!=0)  //red
        {
        putValue(VIN_01_TxC_stat,3);
        putValue(VIN_01_TxC_timeStamp,mVIN_01_time_prev/100000);
        VIN_01_RedStatCtr++;
        putvalue(VIN_01_RedCtr,VIN_01_RedStatCtr);
        putValue(TxCycleCheck_ErrSummary, 3);
        }

        //MIN-MAX
        if (mVIN_01_cycleTime < VIN_01_min)
        {
        VIN_01_min = mVIN_01_cycleTime;
        putValue(VIN_01_TxC_min, VIN_01_min);
        }

        if (mVIN_01_cycleTime > VIN_01_max)
        {
        VIN_01_max = mVIN_01_cycleTime;
        putValue(VIN_01_TxC_max, VIN_01_max);
        }
        
        }
        msgVIN_01_Ctr++;
       }
       //IssueList #165 - end
  
  putValue( eVIN_01_MUXD, this.VIN_01_MUX );
  switch (this.VIN_01_MUX)
  {
    case 0:
      putValue( eKS_Geheimnis_1D, this.KS_Geheimnis_1 );
      putValue( eKS_Geheimnis_2D, this.KS_Geheimnis_2 );
      putValue( eKS_Geheimnis_3D, this.KS_Geheimnis_3 );
      putValue( eKS_Geheimnis_4D, this.KS_Geheimnis_4 );
      putValue( eVIN_1D, this.VIN_1 );
      putValue( eVIN_2D, this.VIN_2 );
      putValue( eVIN_3D, this.VIN_3 );
    break;
    case 1:
      putValue( eVIN_4D, this.VIN_4 );
      putValue( eVIN_5D, this.VIN_5 );
      putValue( eVIN_6D, this.VIN_6 );
      putValue( eVIN_7D, this.VIN_7 );
      putValue( eVIN_8D, this.VIN_8 );
      putValue( eVIN_9D, this.VIN_9 );
      putValue( eVIN_10D, this.VIN_10 );
    break;
    case 2:
      putValue( eVIN_11D, this.VIN_11 );
      putValue( eVIN_12D, this.VIN_12 );
      putValue( eVIN_13D, this.VIN_13 );
      putValue( eVIN_14D, this.VIN_14 );
      putValue( eVIN_15D, this.VIN_15 );
      putValue( eVIN_16D, this.VIN_16 );
      putValue( eVIN_17D, this.VIN_17 );
    break;
  }
}

on start
{
    //watchdog function
    Watchdog1_OFF();
    SetControlBackColor("WatchDog", "EnvVar:eWatchDog_Value_1", MakeRGB(255,255,255));

  //IssueList #165
     putValue(KombiMQB_TxCycle_Check,0);
    putValue(DEV_Kombi_54_TxC_stat,0);
    putValue(Einheiten_01_TxC_stat,0);
    putValue(KN_Kombi_TxC_stat,0);
    putValue(Kombi_01_TxC_stat,0);
    putValue(Kombi_02_TxC_stat,0);
    putValue(Kombi_03_TxC_stat,0);
    putValue(NMH_Kombi_TxC_stat,0);
    putValue(OBD_Tank_01_TxC_stat,0);
    putValue(Reset_TxC_stat,0);
    putValue(Sensorik_Dim_01_TxC_stat,0);
    putValue(Uhrzeit_01_TxC_stat,0);
    putValue(VIN_01_TxC_stat,0);
    putValue(WFS_01_TxC_stat,0);

    Einheiten_01_min = Einheiten_01_max = Einheiten_01_defTxCycle;
    KN_Kombi_min = KN_Kombi_max = KN_Kombi_defTxCycle;
    Kombi_01_min = Kombi_01_max = Kombi_01_defTxCycle;
    Kombi_02_min = Kombi_02_max = Kombi_02_defTxCycle;
    Kombi_03_min = Kombi_03_max = Kombi_03_defTxCycle;
    NMH_Kombi_min = NMH_Kombi_max = NMH_Kombi_defTxCycle;
    OBD_Tank_01_min = OBD_Tank_01_max = OBD_Tank_01_defTxCycle;
    Reset_min = Reset_max = Reset_defTxCycle;
    Sensorik_Dim_min = Sensorik_Dim_max = Sensorik_Dim_01_defTxCycle;
    Uhrzeit_01_min = Uhrzeit_01_max = Uhrzeit_01_defTxCycle;
    VIN_01_min = VIN_01_max = VIN_01_defTxCycle;
    WFS_01_min = WFS_01_max = WFS_01_defTxCycle;

    Einheiten_01_RedStatCtr = 0;
    KN_Kombi_RedStatCtr = 0;
    Kombi_01_RedStatCtr = 0;
    Kombi_02_RedStatCtr = 0;
    Kombi_03_RedStatCtr = 0;
    NMH_Kombi_RedStatCtr = 0;
    OBD_Tank_01_RedStatCtr = 0;
    Reset_RedStatCtr = 0;
    Sensorik_Dim_01_RedStatCtr = 0;
    Uhrzeit_01_RedStatCtr = 0;
    VIN_01_RedStatCtr = 0;
    WFS_01_RedStatCtr = 0;
    //IssueList #210
    setTimer(_tKombi_01_BZD,200);


}

on envVar eWatchDog_LowerLimit_1
{
gLowerLimit1 = getValue(this);

    if (gcurrentValue < gLowerLimit1 )
    {
    gUndercutsCtr1+=1;
    putValue(eWatchDog_Undercuts_1,gUndercutsCtr1);
    SetControlBackColor("WatchDog", "EnvVar:eWatchDog_Value_1", MakeRGB(255,0,0));
    }
    else
     SetControlBackColor("WatchDog", "EnvVar:eWatchDog_Value_1", MakeRGB(0,255,0));
    
    if ((gUndercutsCtr1== 1)&& (beepFlag==0))
    {
    msgbeep(1);
    beepFlag=1;
    }
}

on envVar eWatchDog_Reset_1
{
if (getValue(this))
gExceedancesCtr1 = 0;
gUndercutsCtr1 = 0;
beepFlag = 0;
putValue(eWatchDog_Exceedances_1,gExceedancesCtr1);
putValue(eWatchDog_Undercuts_1,gUndercutsCtr1);
}

on envVar eWatchDog_Switch_1
{

    if (getValue(this))
    Watchdog1_init();

     else
    Watchdog1_OFF();




}

on envVar eWatchDog_UpperLimit_1
{
gUpperLimit1 = getValue(this);

    if (gcurrentValue > gUpperLimit1 )
    {
    gExceedancesCtr1+=1;
    putValue(eWatchDog_Exceedances_1,gExceedancesCtr1);
    SetControlBackColor("WatchDog", "EnvVar:eWatchDog_Value_1", MakeRGB(255,0,0));
    }
    else
    SetControlBackColor("WatchDog", "EnvVar:eWatchDog_Value_1", MakeRGB(0,255,0));

    if ((gExceedancesCtr1== 1)&& (beepFlag==0))
    {
    msgbeep(1);
    beepFlag=1;
    }
}

Watchdog1_OFF ()
{

putValue(eWatchDog_Value_1,0);
putValue(eWatchDog_UpperLimit_1,0);
putValue(eWatchDog_LowerLimit_1,0);
putValue(eWatchDog_Exceedances_1,0);
putValue(eWatchDog_Undercuts_1,0);

gExceedancesCtr1=0;
gUndercutsCtr1=0;
gcurrentValue=0;
gstoredValue=0;
beepFlag = 0;

EnableControl("WatchDog","EnvVar:eWatchdog_signalName_1",0);
EnableControl("WatchDog","eWatchdog_Value_1",0);
EnableControl("WatchDog","EnvVar:eWatchdog_Value_1",0);
EnableControl("WatchDog","EnvVar:eWatchdog_UpperLimit_1",0);
EnableControl("WatchDog","EnvVar:eWatchdog_LowerLimit_1",0);
EnableControl("WatchDog","EnvVar:eWatchdog_Exceedances_1",0);
EnableControl("WatchDog","EnvVar:eWatchdog_Undercuts_1",0);
EnableControl("WatchDog","EnvVar:eWatchdog_Reset_1",0);
SetControlBackColor("WatchDog", "EnvVar:eWatchDog_Value_1", MakeRGB(255,255,255));

}

Watchdog1_init ()
{

putvalue(eWatchDog_signalName_1,"KBI_Phototransistor");
gExceedancesCtr1=0;
gUndercutsCtr1=0;
gcurrentValue=0;
gstoredValue=0;
beepFlag = 0;
putValue(eWatchDog_Undercuts_1,0);
putValue(eWatchDog_Exceedances_1,0);

putvalue(eWatchDog_LowerLimit_1,0);
putvalue(eWatchDog_UpperLimit_1,253);


EnableControl("WatchDog","EnvVar:eWatchdog_signalName_1",1);
EnableControl("WatchDog","EnvVar:eWatchdog_Value_1",1);
EnableControl("WatchDog","EnvVar:eWatchdog_UpperLimit_1",1);
EnableControl("WatchDog","EnvVar:eWatchdog_LowerLimit_1",1);
EnableControl("WatchDog","EnvVar:eWatchdog_Exceedances_1",1);
EnableControl("WatchDog","EnvVar:eWatchdog_Undercuts_1",1);
EnableControl("WatchDog","EnvVar:eWatchdog_Reset_1",1);
gUpperLimit1 = getValue(eWatchDog_UpperLimit_1);
gLowerLimit1 = getValue(eWatchDog_LowerLimit_1);

}

on Message IMMO_OCU_Antwort
{
  putValue( eWFS_IMMO_OCU_CRCD, this.WFS_IMMO_OCU_CRC );
  putValue( eWFS_IMMO_OCU_StatusD, this.WFS_IMMO_OCU_RND );
}

//IssueList #165 - start
on envVar KombiMQB_TxCycle_Check
{
    if (getValue(this))
    {
//    DEV_Kombi_54_min = DEV_Kombi_54_max = DEV_Kombi_54_defTxCycle;
    Einheiten_01_min = Einheiten_01_max = Einheiten_01_defTxCycle;
    KN_Kombi_min = KN_Kombi_max = KN_Kombi_defTxCycle;
    Kombi_01_min = Kombi_01_max = Kombi_01_defTxCycle;
    Kombi_02_min = Kombi_02_max = Kombi_02_defTxCycle;
    Kombi_03_min = Kombi_03_max = Kombi_03_defTxCycle;
    NMH_Kombi_min = NMH_Kombi_max = NMH_Kombi_defTxCycle;
    OBD_Tank_01_min = OBD_Tank_01_max = OBD_Tank_01_defTxCycle;
    Reset_min = Reset_max = Reset_defTxCycle;
    Sensorik_Dim_min = Sensorik_Dim_max = Sensorik_Dim_01_defTxCycle;
    Uhrzeit_01_min = Uhrzeit_01_max = Uhrzeit_01_defTxCycle;
    VIN_01_min = VIN_01_max = VIN_01_defTxCycle;
    WFS_01_min = WFS_01_max = WFS_01_defTxCycle;

//    putValue(DEV_Kombi_54_TxC_min, DEV_Kombi_54_min);
    putValue(Einheiten_01_TxC_min, Einheiten_01_min);
    putValue(KN_Kombi_TxC_min, KN_Kombi_min);
    putValue(Kombi_01_TxC_min, Kombi_01_min);
    putValue(Kombi_02_TxC_min, Kombi_02_min);
    putValue(Kombi_03_TxC_min, Kombi_03_min);
    putValue(NMH_Kombi_TxC_min, NMH_Kombi_min);
    putValue(OBD_Tank_01_TxC_min, OBD_Tank_01_min);
    putValue(Reset_TxC_min, Reset_min);
    putValue(Sensorik_Dim_01_TxC_min, Sensorik_Dim_min);
    putValue(Uhrzeit_01_TxC_min, Uhrzeit_01_min);
    putValue(VIN_01_TxC_min, VIN_01_min);
    putValue(WFS_01_TxC_min, WFS_01_min);

//    putValue(DEV_Kombi_54_TxC_max, DEV_Kombi_54_max);
    putValue(Einheiten_01_TxC_max, Einheiten_01_max);
    putValue(KN_Kombi_TxC_max, KN_Kombi_max);
    putValue(Kombi_01_TxC_max, Kombi_01_max);
    putValue(Kombi_02_TxC_max, Kombi_02_max);
    putValue(Kombi_03_TxC_max, Kombi_03_max);
    putValue(NMH_Kombi_TxC_max, NMH_Kombi_max);
    putValue(OBD_Tank_01_TxC_max, OBD_Tank_01_max);
    putValue(Reset_TxC_max, Reset_max);
    putValue(Sensorik_Dim_01_TxC_max, Sensorik_Dim_max);
    putValue(Uhrzeit_01_TxC_max, Uhrzeit_01_max);
    putValue(VIN_01_TxC_max, VIN_01_max);
    putValue(WFS_01_TxC_max, WFS_01_max);

//    putValue(DEV_Kombi_54_TxC_timeStamp, 0);
    putValue(Einheiten_01_TxC_timeStamp, 0);
    putValue(KN_Kombi_TxC_timeStamp, 0);
    putValue(Kombi_01_TxC_timeStamp, 0);
    putValue(Kombi_02_TxC_timeStamp, 0);
    putValue(Kombi_03_TxC_timeStamp, 0);
    putValue(NMH_Kombi_TxC_timeStamp, 0);
    putValue(OBD_Tank_01_TxC_timeStamp, 0);
    putValue(Reset_TxC_timeStamp, 0);
    putValue(Sensorik_Dim_01_TxC_timeStamp, 0);
    putValue(Uhrzeit_01_TxC_timeStamp, 0);
    putValue(VIN_01_TxC_timeStamp, 0);
    putValue(WFS_01_TxC_timeStamp, 0);

    msgReset_Ctr =0;
//    msgDEV_Kombi_54_Ctr=0;
    msgEinheiten_01_Ctr=0;
    msgKN_Kombi_Ctr = 0;
    msgKombi_01_Ctr = 0;
    msgKombi_02_Ctr = 0;
    msgKombi_03_Ctr = 0;
    msgNMH_Kombi_Ctr = 0;
    msgOBD_Tank_01_Ctr = 0;
    msgSensorik_Dim_01_Ctr = 0;
    msgUhrzeit_01_Ctr = 0;
    msgVIN_01_Ctr = 0;
    msgWFS_01_Ctr = 0;

    //Status
//    putValue(DEV_Kombi_54_TxC_stat, 0);
    putValue(Einheiten_01_TxC_stat, 0);
    putValue(KN_Kombi_TxC_stat, 0);
    putValue(Kombi_01_TxC_stat, 0);
    putValue(Kombi_02_TxC_stat, 0);
    putValue(Kombi_03_TxC_stat, 0);
    putValue(NMH_Kombi_TxC_stat, 0);
    putValue(OBD_Tank_01_TxC_stat, 0);
    putValue(Reset_TxC_stat, 0);
    putValue(Sensorik_Dim_01_TxC_stat, 0);
    putValue(Uhrzeit_01_TxC_stat, 0);
    putValue(VIN_01_TxC_stat, 0);
    putValue(WFS_01_TxC_stat, 0);

    //Red Status counter
//    DEV_Kombi_54_RedStatCtr = 0;
    Einheiten_01_RedStatCtr = 0;
    KN_Kombi_RedStatCtr = 0;
    Kombi_01_RedStatCtr = 0;
    Kombi_02_RedStatCtr = 0;
    Kombi_03_RedStatCtr = 0;
    NMH_Kombi_RedStatCtr = 0;
    OBD_Tank_01_RedStatCtr = 0;
    Reset_RedStatCtr = 0;
    Sensorik_Dim_01_RedStatCtr = 0;
    Uhrzeit_01_RedStatCtr = 0;
    VIN_01_RedStatCtr = 0;
    WFS_01_RedStatCtr = 0;

 //   putValue(DEV_Kombi_54_RedCtr, 0);
    putValue(Einheiten_01_RedCtr, 0);
    putValue(KN_Kombi_RedCtr, 0);
    putValue(Kombi_01_RedCtr, 0);
    putValue(Kombi_02_RedCtr, 0);
    putValue(Kombi_03_RedCtr, 0);
    putValue(NMH_Kombi_RedCtr, 0);
    putValue(OBD_Tank_01_RedCtr, 0);
    putValue(Reset_RedCtr, 0);
    putValue(Sensorik_Dim_01_RedCtr, 0);
    putValue(Uhrzeit_01_RedCtr, 0);
    putValue(VIN_01_RedCtr, 0);
    putValue(WFS_01_RedCtr, 0);

    //non cyclic messages Counter
    Service_Key_01_Ctr = 0;
    IMMO_MSG1_Antwort_Ctr = 0;
    IMMO_MSG2_Antwort_Ctr = 0;
    IMMO_MSG3_Antwort_Ctr = 0;
    IMMO_MSG4_Antwort_Ctr = 0;
    IMMO_GSG_Antwort_Ctr = 0;
    IMMO_ELV_Antwort_Ctr = 0;
    WFS_GO1_Ctr = 0;
    WFS_GO2_Ctr = 0;

    putValue(Service_Key_01_MsgCtr,0);
    putValue(IMMO_MSG1_Antwort_MsgCtr,0);
    putValue(IMMO_MSG2_Antwort_MsgCtr,0);
    putValue(IMMO_MSG3_Antwort_MsgCtr,0);
    putValue(IMMO_MSG4_Antwort_MsgCtr,0);
    putValue(IMMO_GSG_Antwort_MsgCtr,0);
    putValue(IMMO_ELV_Antwort_MsgCtr,0);
    putValue(TxCycleCheck_ErrSummary,0);
    putValue(TxCycleCheck_TxMuteInd,0);
    putValue(TxCycleCheck_TxMuteInd_Msg,"");

    setTimer(_tTxMute_timer, 2);

    }
}

on preStart
{
      //IssueList #165 - Tx Cycle Definition : Kombi_MQB msgs
//    DEV_Kombi_54_defTxCycle = 1000;
    Einheiten_01_defTxCycle = 1000;
    KN_Kombi_defTxCycle = 500;
    Kombi_01_defTxCycle = 50;
    Kombi_02_defTxCycle = 1000;
    Kombi_03_defTxCycle = 1000;
    NMH_Kombi_defTxCycle = 200;
    OBD_Tank_01_defTxCycle = 500;
    Reset_defTxCycle = 1000;
    Sensorik_Dim_01_defTxCycle = 200;
    Uhrzeit_01_defTxCycle = 1000;
    VIN_01_defTxCycle = 200;
    WFS_01_defTxCycle = 200;
}

//IssueList #165
//2 second tx mute timer
on timer _tTxMute_timer
{
    if( /*DEV_Kombi_54_TxFlg==0 && */ Einheiten_01_TxFlg==0 && KN_Kombi_TxFlg==0 && Kombi_01_TxFlg==0 && Kombi_02_TxFlg==0 && Kombi_03_TxFlg==0 && OBD_Tank_01_TxFlg==0 && Reset_TxFlg==0 && Sensorik_Dim_01_TxFlg==0 && Uhrzeit_01_TxFlg==0 && VIN_01_TxFlg==0 && WFS_01_TxFlg==0)
    {
    putValue(TxCycleCheck_TxMuteInd,3);
    putValue(TxCycleCheck_TxMuteInd_Msg, "NO Cyclic message transmitted in 2s time");
    }

}

//IssueList #210
on timer _tKombi_01_BZD
{
putValue( eKombi_01_BZD, g_eKombi_01_BZD );
setTimer(_tKombi_01_BZD,600);
}

