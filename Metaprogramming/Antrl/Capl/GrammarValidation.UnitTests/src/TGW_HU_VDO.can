/*@@var:*/
/*@!Encoding:1252*/
/*
Copyright ( C ) Continental AG 2012

Date of creation :  14.04.2011

Created by :                 Hans Jürgen Hipp


Version info

1.00	   10.2013	Inital versioning introduced
1.1	04.11.2013	HMI_2013_42a database

*/


variables
{
    const TRUE =      0xAA;
    const FALSE =     0x00;
    const cManual =   0x00;
    const cAuto =     0xAA;

    const word cFLDoorNMRequest =       0x0001;
    const word cFRDoorNMRequest =       0x0002;
    const word cRLDoorNMRequest =       0x0004;
    const word cRRDoorNMRequest =       0x0008;
    const word cAllDoorNMRequest =      0x000F;
    const word cIgnitionNMRequest =     0x0010;
    const word cStWhlButtonNMRequest =  0x0020;
    const word cWakeWarningNMRequest =  0x0040;
    const word cEPKBWarningNMRequest =  0x0080;
    const word cIlluNMRequest =         0x0100;
    const word cCarClosureNMRequest =   0x0200;
    const word cGearIndNMRequest =      0x0400;
    const word cLowBeamNMRequest =      0x0800;

    const word cManualNMRequest =       0x8000;
    const word cAllNMRequest =          0xFFFF;



    /* Botschaft Disp_IC_Rq_AR ID: 314 --- Sendeart 5 cyclicAndSpontanWithDelay --- 
BA_ "ApplMessage" BO_ 314 0;
BA_ "NmAsrMessage" BO_ 314 0;
BA_ "GenMsgMinAcceptLength" BO_ 314 6;
BA_ "GenMsgILSupport" BO_ 314 1;
BA_ "DiagState" BO_ 314 0;
BA_ "DiagRequest" BO_ 314 0;
BA_ "DiagResponse" BO_ 314 0;
BA_ "GenMsgStartValue" BO_ 314 "0";
BA_ "GenMsgStartDelayTime" BO_ 314 35;
BA_ "GenMsgDelayTime" BO_ 314 20;
BA_ "GenMsgNrOfRepetition" BO_ 314 0;
BA_ "GenMsgCycleTime" BO_ 314 100;
BA_ "GenMsgSendType" BO_ 314 5;
    */ 
    word       _Disp_IC_Rq_AR_CycleTime =            100;
    byte       _Disp_IC_Rq_AR_CycleReduction =         0;
    byte      _cDisp_IC_Rq_AR_CycleReductionValue =    5;
    const word _Disp_IC_Rq_AR_OnEventDetectTime =     90;
    byte       _Disp_IC_Rq_AR_OnEventTrap_Active =     0;
    msTimer    tDisp_IC_Rq_AR_OnEventTrap;
    msTimer    tDisp_IC_Rq_AR_OnEventIND;

    /* Botschaft Dimming_Stat_AR ID: 1081 --- Sendeart 5 cyclicAndSpontanWithDelay --- 
BA_ "ApplMessage" BO_ 1081 0;
BA_ "NmAsrMessage" BO_ 1081 0;
BA_ "GenMsgMinAcceptLength" BO_ 1081 4;
BA_ "GenMsgILSupport" BO_ 1081 1;
BA_ "DiagState" BO_ 1081 0;
BA_ "DiagRequest" BO_ 1081 0;
BA_ "DiagResponse" BO_ 1081 0;
BA_ "GenMsgStartValue" BO_ 1081 "0";
BA_ "GenMsgStartDelayTime" BO_ 1081 20;
BA_ "GenMsgDelayTime" BO_ 1081 50;
BA_ "GenMsgNrOfRepetitions" BO_ 1081 0;
BA_ "GenMsgCycleTime" BO_ 1081 200;
BA_ "GenMsgSendType" BO_ 1081 5;
    */ 
    word       _Dimming_Stat_AR_CycleTime =            200;
    byte       _Dimming_Stat_AR_CycleReduction =         0;
    byte      _cDimming_Stat_AR_CycleReductionValue =    5;
    const word _Dimming_Stat_AR_OnEventDetectTime =    190;
    byte       _Dimming_Stat_AR_OnEventTrap_Active =     0;
    msTimer    tDimming_Stat_AR_OnEventTrap;
    msTimer    tDimming_Stat_AR_OnEventIND;

    /* Botschaft IC_BasicInfo_AR ID: 777 --- Sendeart 5 cyclicAndSpontanWithDelay --- 
BA_ "ApplMessage" BO_ 777 0;
BA_ "NmAsrMessage" BO_ 777 0;
BA_ "GenMsgMinAcceptLength" BO_ 777 8;
BA_ "GenMsgILSupport" BO_ 777 1;
BA_ "DiagState" BO_ 777 0;
BA_ "DiagRequest" BO_ 777 0;
BA_ "DiagResponse" BO_ 777 0;
BA_ "GenMsgStartValue" BO_ 777 "0";
BA_ "GenMsgStartDelayTime" BO_ 777 295;
BA_ "GenMsgDelayTime" BO_ 777 100;
BA_ "GenMsgNrOfRepetitions" BO_ 777 0;
BA_ "GenMsgCycleTime" BO_ 777 1000;
BA_ "GenMsgSendType" BO_ 777 5;
    */
    word       _IC_BasicInfo_AR_CycleTime =           1000;
    byte       _IC_BasicInfo_AR_CycleReduction =         0;
    byte      _cIC_BasicInfo_AR_CycleReductionValue =    5;
    const word _IC_BasicInfo_AR_OnEventDetectTime =    990;
    byte       _IC_BasicInfo_AR_OnEventTrap_Active =     0;
    msTimer    tIC_BasicInfo_AR_OnEventTrap;
    msTimer    tIC_BasicInfo_AR_OnEventIND;

    // NM_IC_AR
    word       _NM_IC_AR_CycleTime =           1000;
    byte       _NM_IC_AR_CycleReduction =         0;
    byte      _cNM_IC_AR_CycleReductionValue =    5;
    const word _NM_IC_AR_OnEventDetectTime =    990;
    byte       _NM_IC_AR_OnEventTrap_Active =     0;
    msTimer    tNM_IC_AR_OnEventTrap;
    msTimer    tNM_IC_AR_OnEventIND;

    /* Botschaft RTC_Date_Time_AR ID: 779 --- Sendeart 5 cyclicAndSpontanWithDelay --- 
BA_ "ApplMessage" BO_ 779 0;
BA_ "NmAsrMessage" BO_ 779 0;
BA_ "GenMsgMinAcceptLength" BO_ 779 8;
BA_ "GenMsgILSupport" BO_ 779 1;
BA_ "DiagState" BO_ 779 0;
BA_ "DiagRequest" BO_ 779 0;
BA_ "DiagResponse" BO_ 779 0;
BA_ "GenMsgStartValue" BO_ 779 "0";
BA_ "GenMsgStartDelayTime" BO_ 779 250;
BA_ "GenMsgDelayTime" BO_ 779 40;
BA_ "GenMsgNrOfRepetitions" BO_ 779 0;
BA_ "GenMsgCycleTime" BO_ 779 1000;
BA_ "GenMsgSendType" BO_ 779 5;
    */
    word       _RTC_Date_Time_AR_CycleTime =           1000;
    byte       _RTC_Date_Time_AR_CycleReduction =         0;
    byte      _cRTC_Date_Time_AR_CycleReductionValue =    5;
    const word _RTC_Date_Time_AR_OnEventDetectTime =    990;
    byte       _RTC_Date_Time_AR_OnEventTrap_Active =     0;
    msTimer    tRTC_Date_Time_AR_OnEventTrap;
    msTimer    tRTC_Date_Time_AR_OnEventIND;


    byte  crctable_profile02[256] = {
        0x00, 0x2F, 0x5E, 0x71, 0xBC, 0x93, 0xE2, 0xCD, 0x57, 0x78, 0x09, 0x26, 0xEB, 0xC4, 0xB5, 0x9A,
        0xAE, 0x81, 0xF0, 0xDF, 0x12, 0x3D, 0x4C, 0x63, 0xF9, 0xD6, 0xA7, 0x88, 0x45, 0x6A, 0x1B, 0x34,
        0x73, 0x5C, 0x2D, 0x02, 0xCF, 0xE0, 0x91, 0xBE, 0x24, 0x0B, 0x7A, 0x55, 0x98, 0xB7, 0xC6, 0xE9,
        0xDD, 0xF2, 0x83, 0xAC, 0x61, 0x4E, 0x3F, 0x10, 0x8A, 0xA5, 0xD4, 0xFB, 0x36, 0x19, 0x68, 0x47,
        0xE6, 0xC9, 0xB8, 0x97, 0x5A, 0x75, 0x04, 0x2B, 0xB1, 0x9E, 0xEF, 0xC0, 0x0D, 0x22, 0x53, 0x7C,
        0x48, 0x67, 0x16, 0x39, 0xF4, 0xDB, 0xAA, 0x85, 0x1F, 0x30, 0x41, 0x6E, 0xA3, 0x8C, 0xFD, 0xD2,
        0x95, 0xBA, 0xCB, 0xE4, 0x29, 0x06, 0x77, 0x58, 0xC2, 0xED, 0x9C, 0xB3, 0x7E, 0x51, 0x20, 0x0F,
        0x3B, 0x14, 0x65, 0x4A, 0x87, 0xA8, 0xD9, 0xF6, 0x6C, 0x43, 0x32, 0x1D, 0xD0, 0xFF, 0x8E, 0xA1,
        0xE3, 0xCC, 0xBD, 0x92, 0x5F, 0x70, 0x01, 0x2E, 0xB4, 0x9B, 0xEA, 0xC5, 0x08, 0x27, 0x56, 0x79,
        0x4D, 0x62, 0x13, 0x3C, 0xF1, 0xDE, 0xAF, 0x80, 0x1A, 0x35, 0x44, 0x6B, 0xA6, 0x89, 0xF8, 0xD7,
        0x90, 0xBF, 0xCE, 0xE1, 0x2C, 0x03, 0x72, 0x5D, 0xC7, 0xE8, 0x99, 0xB6, 0x7B, 0x54, 0x25, 0x0A,
        0x3E, 0x11, 0x60, 0x4F, 0x82, 0xAD, 0xDC, 0xF3, 0x69, 0x46, 0x37, 0x18, 0xD5, 0xFA, 0x8B, 0xA4,
        0x05, 0x2A, 0x5B, 0x74, 0xB9, 0x96, 0xE7, 0xC8, 0x52, 0x7D, 0x0C, 0x23, 0xEE, 0xC1, 0xB0, 0x9F,
        0xAB, 0x84, 0xF5, 0xDA, 0x17, 0x38, 0x49, 0x66, 0xFC, 0xD3, 0xA2, 0x8D, 0x40, 0x6F, 0x1E, 0x31,
        0x76, 0x59, 0x28, 0x07, 0xCA, 0xE5, 0x94, 0xBB, 0x21, 0x0E, 0x7F, 0x50, 0x9D, 0xB2, 0xC3, 0xEC,
        0xD8, 0xF7, 0x86, 0xA9, 0x64, 0x4B, 0x3A, 0x15, 0x8F, 0xA0, 0xD1, 0xFE, 0x33, 0x1C, 0x6D, 0x42
    };



}
/*@@end*/

/*@@startStart:Start:*/
on start
{
    putValue( Env_HIL_Submenu_Msg_Byte2,	0xFF );
    putValue( Env_HIL_Submenu_Msg_Byte1,	0xFF );
    putValue( Env_HIL_MainMenu,	            0xFF );
}
/*@@end*/

/*@@timer:tDimming_Stat_AR_OnEventIND:*/
on timer tDimming_Stat_AR_OnEventIND
{
    putValue( HMI__MSG_OnEvent_Dimming_Stat_AR, 0 );
}
/*@@end*/

/*@@timer:tDimming_Stat_AR_OnEventTrap:*/
on timer tDimming_Stat_AR_OnEventTrap
{
    _Dimming_Stat_AR_OnEventTrap_Active = 0;
}
/*@@end*/

/*@@timer:tIC_BasicInfo_AR_OnEventIND:*/
on timer tIC_BasicInfo_AR_OnEventIND
{
    putValue( HMI__MSG_OnEvent_IC_BasicInfo_AR, 0 );
}
/*@@end*/

/*@@timer:tIC_BasicInfo_AR_OnEventTrap:*/
on timer tIC_BasicInfo_AR_OnEventTrap
{
    _IC_BasicInfo_AR_OnEventTrap_Active = 0;
}
/*@@end*/

/*@@timer:tNM_IC_AR_OnEventIND:*/
on timer tNM_IC_AR_OnEventIND
{
    putValue( HU__NM_TGW_NM_Request, cIgnitionNMRequest );
    putValue( HU__NM_Remote_ReleaseCommRequest, 1 );
}
/*@@end*/

/*@@timer:tNM_IC_AR_OnEventTrap:*/
on timer tNM_IC_AR_OnEventTrap
{
    _NM_IC_AR_OnEventTrap_Active = 0;
}
/*@@end*/

/*@@timer:tRTC_Date_Time_AR_OnEventIND:*/
on timer tRTC_Date_Time_AR_OnEventIND
{
    putValue( HMI__MSG_OnEvent_RTC_Date_Time_AR, 0 );
}
/*@@end*/

/*@@timer:tRTC_Date_Time_AR_OnEventTrap:*/
on timer tRTC_Date_Time_AR_OnEventTrap
{
    _RTC_Date_Time_AR_OnEventTrap_Active = 0;
}
/*@@end*/

/*@@msg:CAN2.HU_2017_29a::DISP_C_Stat_AR (0x1F9):*/
on message DISP_C_Stat_AR
{
    putValue( HMI_AuxFanRPM_Rq, this.AuxFanRPM_Rq.phys );
    putValue( HMI_DISP_C_AudioFade_Stat, this.DISP_C_AudioFade_Stat.phys );
    putValue( HMI_DISP_C_BackLgt_Stat, this.DISP_C_BackLgt_Stat.phys );
    putValue( HMI_DISP_C_Heat_Mgtm, this.DISP_C_Heat_Mgtm.phys );
    putValue( HMI_DISP_C_On_Stat, this.DISP_C_On_Stat.phys );
 //   putValue( HMI_DISP_IC_BackLgt_Stat, this.DISP_IC_BackLgt_Stat.phys );
 //   putValue( HMI_DISP_IC_On_Stat, this.DISP_IC_On_Stat.phys );
    putValue( HMI_HeadPhone_Stat_DISP_C, this.HeadPhone_Stat_DISP_C.phys );
    putValue( HMI_HeadPhoneMute_Actv_DISP_C, this.HeadPhoneMute_Actv_DISP_C.phys );
  //  putValue( HMI_IP_Brt_DispCluster, this.IP_Brt_DispCluster.phys );
    putValue( HMI_Park_Disp_Stat, this.Park_Disp_Stat.phys );
    putValue( HMI_SPV_Rem_Mute, this.SPV_Rem_Mute.phys );
    putValue( HMI_SPV_Rem_Vol_Psd1, this.SPV_Rem_Vol_Psd1.phys );
    putValue( HMI_SPV_Rem_Vol_Psd2, this.SPV_Rem_Vol_Psd2.phys );
}
/*@@end*/

