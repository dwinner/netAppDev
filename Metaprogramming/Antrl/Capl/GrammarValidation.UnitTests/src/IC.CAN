/*@@var:*/
/*
Copyright ( C ) Continental AG 2012



Based on Version  1.0, 12.05.10   from M.Dangelmeyr      IBD im Auftrag von EP/ESE   Daimler AG

Date of creation :  14.04.2011

Created by :                 Hans Jürgen Hipp


Version info

1.0	   10.2013	Inital versioning introduced
1.1	04.11.2013	HMI_2013_42a database

// #VERSION#
// #VERSION_END#
*/


variables
{
    const TRUE =    0xAA;
    const FALSE =   0x00;
    const cManual = 0x00;
    const cAuto =   0xAA;

    msTimer t_DBKomTimer_20ms;      // Timer zum zyklischen Aufruf der DBKom-Task
    int c_tDBKomTimer_20ms = 20;    // msec
    msTimer t_DBKomTimer_5ms;       // Timer zum zyklischen Aufruf der DBKom-Task
    int c_tDBKomTimer_5ms = 5;      // msec


    // BA_DEF_ BO_  "GenMsgSendType" ENUM
    //  0 : cyclicX
    //  1 : spontanX
    //  2 : cyclicIfActiveX
    //  3 : spontanWithDelay
    //  4 : cyclicAndSpontanX
    //  5 : cyclicAndSpontanWithDelay
    //  6 : spontanWithRepitition
    //  7 : cyclicIfActiveAndSpontanWD
    //  8 : cyclicIfActiveFast
    //  9 : cyclicWithRepeatOnDemand
    //  10 : none

// #VAR_DEF#

    // Botschaft Assyst_Rq_AR ---- Sendeart cyclicAndSpontanWithDelay
    message Assyst_Rq_AR _mAssyst_Rq_AR;
    int _Assyst_Rq_AR_CycleCount = 50;
    int _Assyst_Rq_AR_Cnt;
    int _Assyst_Rq_AR_SpontanFlag = 0;
    msTimer _tAssyst_Rq_AR;

    // Botschaft BLSM_Disp_Stat_AR ---- Sendeart cyclicIfActive BAT
    message BLSM_Disp_Stat_AR _mBLSM_Disp_Stat_AR;
    int _BLSM_Disp_Stat_AR_CycleCount = 1;
    int _BLSM_Disp_Stat_AR_Cnt;
    int _BLSM_Disp_Stat_AR_SigActivity = 0;
    int _BLSM_Disp_Stat_AR_MsgRepetitions;
    int _BLSM_Disp_Stat_AR_NumberOfRepetitions = 4;  
    int _BLSM_Disp_Stat_ARBrkLnServMd_ActvLastState = 0;
    int _BLSM_Disp_Stat_ARBrkLnServMd_Back_PsdLastState = 0;
    int _BLSM_Disp_Stat_ARBrkLnServMd_Dn_PsdLastState = 0;
    int _BLSM_Disp_Stat_ARBrkLnServMd_Lt_PsdLastState = 0;
    int _BLSM_Disp_Stat_ARBrkLnServMd_MsgDisp_AckLastState = 0;
    int _BLSM_Disp_Stat_ARBrkLnServMd_Ok_PsdLastState = 0;
    int _BLSM_Disp_Stat_ARBrkLnServMd_Rt_PsdLastState = 0;
    int _BLSM_Disp_Stat_ARBrkLnServMd_Up_PsdLastState = 0;
    msTimer _tBLSM_Disp_Stat_AR;

    // Botschaft Dimming_Stat ---- Sendeart cyclicAndSpontanWithDelay
    message Dimming_Stat_AR _mDimming_Stat_AR;
    int _Dimming_Stat_AR_CycleCount = 10;
    int _Dimming_Stat_AR_Cnt;
    int _Dimming_Stat_AR_SpontanFlag = 0;
    int _Dimming_Stat_AR_MinDelay = 2;
    int _Dimming_Stat_AR_DelayCnt;
    msTimer _tDimming_Stat_AR;

    // Botschaft HUD_Rq_IC_AR ---- Sendeart xxxx
    message HUD_Rq_IC_AR _mHUD_Rq_IC_AR;
    int _HUD_Rq_IC_AR_CycleCount = 50;
    int _HUD_Rq_IC_AR_Cnt;
    int _HUD_Rq_IC_AR_SpontanFlag = 0;
    int _HUD_Rq_IC_AR_MinDelay = 2;
    int _HUD_Rq_IC_AR_DelayCnt;
    msTimer _tHUD_Rq_IC_AR;
	
	//  message   Config_IC_AR ID: 2427977728 --- Sendeart 5 cyclicAndSpontanWithDelay --- 
    message   Config_IC_AR _mConfig_IC_AR;
    int      _Config_IC_AR_Timebase;
    int      _Config_IC_AR_CycleCount;
    int      _Config_IC_AR_StartDelay;
    int      _Config_IC_AR_Cnt;
    int      _Config_IC_AR_SpontanFlag;
    msTimer _tConfig_IC_AR;

	//  message   IC_AddDisp_VAN_AR ID: 1172 --- Sendeart 5 cyclicAndSpontanWithDelay --- 
    message   IC_AddDisp_VAN_AR _mIC_AddDisp_VAN_AR;
    int      _IC_AddDisp_VAN_AR_Timebase;
    int      _IC_AddDisp_VAN_AR_CycleCount;
    int      _IC_AddDisp_VAN_AR_StartDelay;
    int      _IC_AddDisp_VAN_AR_Cnt;
    int      _IC_AddDisp_VAN_AR_SpontanFlag;
    msTimer _tIC_AddDisp_VAN_AR;
	
    // Botschaft IC_BasicInfo2_AR ---- Sendeart cyclicX
    message IC_BasicInfo2_AR _mIC_BasicInfo2_AR;
    int _IC_BasicInfo2_AR_CycleCount = 250;
    int _IC_BasicInfo2_AR_Cnt;
    msTimer _tIC_BasicInfo2_AR;

    // Botschaft IC_BasicInfo_AR ---- Sendeart cyclicAndSpontanWithDelay
    message IC_BasicInfo_AR _mIC_BasicInfo_AR;
    int _IC_BasicInfo_AR_CycleCount = 50;
    int _IC_BasicInfo_AR_Cnt;
    int _IC_BasicInfo_AR_SpontanFlag = 0;
    int _IC_BasicInfo_AR_MinDelay = 5;
    int _IC_BasicInfo_AR_DelayCnt;
    msTimer _tIC_BasicInfo_AR;

    // Botschaft IC_Date_Time_AR ---- Sendeart cyclicAndSpontanWithDelay
    message IC_Date_Time_AR _mIC_Date_Time_AR;
    int _IC_Date_Time_AR_CycleCount = 50;
    int _IC_Date_Time_AR_Cnt;
    int _IC_Date_Time_AR_SpontanFlag = 0;
    int _IC_Date_Time_AR_MinDelay = 2;
    int _IC_Date_Time_AR_DelayCnt;
    msTimer _tIC_Date_Time_AR;

	// Botschaft IC_DispAreaCfg_Stat_AR  ---- Sendeart cyclicAndSpontanWithDelay
    message IC_DispAreaCfg_Stat_AR  _mIC_DispAreaCfg_Stat_AR ;
    int _IC_DispAreaCfg_Stat_AR_CycleCount = 50;
    int _IC_DispAreaCfg_Stat_AR_Cnt;
    int _IC_DispAreaCfg_Stat_AR_SpontanFlag = 1;
    int _IC_DispAreaCfg_Stat_AR_MinDelay = 1;
    int _IC_DispAreaCfg_Stat_AR_DelayCnt;
    msTimer _tIC_DispAreaCfg_Stat_AR;
	
    // Botschaft IC_DriveAssistSys_AR ---- Sendeart cyclicAndSpontanWithDelay
    message IC_DriveAssistSys_AR _mIC_DriveAssistSys_AR;
    int _IC_DriveAssistSys_AR_CycleCount = 5;
    int _IC_DriveAssistSys_AR_Cnt;
    int _IC_DriveAssistSys_AR_SpontanFlag = 0;
    int _IC_DriveAssistSys_AR_MinDelay = 1;
    int _IC_DriveAssistSys_AR_DelayCnt;
    msTimer _tIC_DriveAssistSys_AR;

    // Botschaft IC_EnergyMngmnt_Stat_AR ---- Sendeart cyclicAndSpontanWithDelay
 /*   message IC_EnergyMngmnt_Stat_AR _mIC_EnergyMngmnt_Stat_AR;
    int _IC_EnergyMngmnt_Stat_AR_CycleCount = 15;
    int _IC_EnergyMngmnt_Stat_AR_Cnt;
    int _IC_EnergyMngmnt_Stat_AR_SpontanFlag = 0;
    int _IC_EnergyMngmnt_Stat_AR_MinDelay = 5;
    int _IC_EnergyMngmnt_Stat_AR_DelayCnt;
    msTimer _tIC_EnergyMngmnt_Stat_AR;*/

    // Botschaft IC_Immobilizer ---- Sendeart cyclicAndSpontanWithDelay
    message IC_Immobilizer_AR _mIC_Immobilizer_AR;
    int _IC_Immobilizer_AR_CycleCount = 50;
    int _IC_Immobilizer_AR_Cnt;
    int _IC_Immobilizer_AR_SpontanFlag = 0;
    msTimer _tIC_Immobilizer_AR;

    // Botschaft IC_Settings_AR ---- Sendeart cyclicAndSpontanWithDelay
    message IC_Settings_AR _mIC_Settings_AR;
    int _IC_Settings_AR_CycleCount = 50;
    int _IC_Settings_AR_Cnt;
    int _IC_Settings_AR_SpontanFlag = 0;
    int _IC_Settings_AR_MinDelay = 2;
    int _IC_Settings_AR_DelayCnt;
    msTimer _tIC_Settings_AR;

    // Botschaft IC_StWheelSwitches ---- Sendeart cyclicAndSpontanWithDelay
    message IC_StWheelSwitches_AR _mIC_StWheelSwitches_AR;
    int _IC_StWheelSwitches_AR_CycleCount = 5;
    int _IC_StWheelSwitches_AR_Cnt;
    int _IC_StWheelSwitches_AR_SpontanFlag = 0;
    int _IC_StWheelSwitches_AR_DelayCnt;
    int _IC_StWheelSwitches_AR_MinDelay = 1;
    msTimer _tIC_StWheelSwitches_AR;

    // Botschaft IC_WIM_AR ---- Sendeart cyclicAndSpontanWithDelay
    message IC_WIM_AR _mIC_WIM_AR;
    int _IC_WIM_AR_CycleCount = 25;
    int _IC_WIM_AR_Cnt;
    int _IC_WIM_AR_SpontanFlag = 0;
    msTimer _tIC_WIM_AR;

    // Botschaft LDC_Disp_Stat_IC ---- Sendeart cyclicAndSpontanWithDelay
    message LDC_Disp_Stat_IC_AR _mLDC_Disp_Stat_IC_AR;
    int _LDC_Disp_Stat_IC_AR_CycleCount = 10;
    int _LDC_Disp_Stat_IC_AR_Cnt;
    int _LDC_Disp_Stat_IC_AR_SpontanFlag = 0;
    msTimer _tLDC_Disp_Stat_IC_AR;

    // Botschaft Maintenance1_AR ---- Sendeart cyclicX
    message Maintenance1_AR _mMaintenance1_AR;
    int _Maintenance1_AR_CycleCount = 3;
    int _Maintenance1_AR_Cnt;
    msTimer _tMaintenance1_AR;

    // Botschaft Maintenance2_AR ---- Sendeart cyclicX
    message Maintenance2_AR _mMaintenance2_AR;
    int _Maintenance2_AR_CycleCount = 6;
    int _Maintenance2_AR_Cnt;
    msTimer _tMaintenance2_AR;

    // Botschaft Meas_IC_1 ---- Sendeart spontanX
    message Meas_IC_1 _mMeas_IC_1;
    int _Meas_IC_1_SpontanFlag = 0;

    // Botschaft Meas_IC_2 ---- Sendeart spontanX
    message Meas_IC_2 _mMeas_IC_2;
    int _Meas_IC_2_SpontanFlag = 0;

    // Botschaft Meas_IC_3 ---- Sendeart spontanX
    message Meas_IC_3 _mMeas_IC_3;
    int _Meas_IC_3_SpontanFlag = 0;

    // Botschaft Meas_IC_4 ---- Sendeart spontanX
    message Meas_IC_4 _mMeas_IC_4;
    int _Meas_IC_4_SpontanFlag = 0;

    // Botschaft NV_Rq_IC_AR ---- Sendeart xxxx
    message NV_Rq_IC_AR _mNV_Rq_IC_AR;
    int _NV_Rq_IC_AR_CycleCount = 0;
    int _NV_Rq_IC_AR_Cnt;
    msTimer _tNV_Rq_IC_AR;

    // Botschaft Park_Disp_Rs_AR ---- Sendeart xxxx
    message Park_Disp_Rs_AR _mPark_Disp_Rs_AR_2011_29a;
    
    // Botschaft Park_Disp_Rs_AR ---- Sendeart xxxx
    message Park_Disp_Rs_AR _mPark_Disp_Rs_AR;
    int _Park_Disp_Rs_AR_CycleCount = 10;
    int _Park_Disp_Rs_AR_Cnt;
    int _Park_Disp_Rs_AR_SpontanFlag = 0;
    msTimer _tPark_Disp_Rs_AR;

    // Botschaft ROE_IC ---- Sendeart xxxx
    message ROE_IC _mROE_IC;
    int _ROE_IC_CycleCount = 3276;
    int _ROE_IC_Cnt;
    int _ROE_IC_MsgRepetitions;
    int _ROE_IC_SpontanFlag = 0;

    // Botschaft TC_Dist_AR ---- Sendeart xxxx
    message TC_Dist_AR _mTC_Dist_AR;
    int _TC_Dist_AR_CycleCount = 5;
    int _TC_Dist_AR_Cnt;
    int _TC_Dist_AR_SigActivity = 0;
    int _TC_Dist_AR_TC_FuelType_ActState = 0;
    msTimer _tTC_Dist_AR;

    // Botschaft TP_IC_TGW_Aud ---- Sendeart 0 cyclicX
    message TP_IC_TGW_Aud _mTP_IC_TGW_Aud;
    int _TP_IC_TGW_Aud_CycleCount = 3276;
    int _TP_IC_TGW_Aud_Cnt;
    msTimer _tTP_IC_TGW_Aud;

    // Botschaft TP_IC_TGW_Nav ---- Sendeart 0 cyclicX
    message TP_IC_TGW_Nav _mTP_IC_TGW_Nav;
    int _TP_IC_TGW_Nav_CycleCount = 3276;
    int _TP_IC_TGW_Nav_Cnt;
    msTimer _tTP_IC_TGW_Nav;

    // Botschaft TP_IC_TGW_Tel ---- Sendeart 0 cyclicX
    message TP_IC_TGW_Tel _mTP_IC_TGW_Tel;
    int _TP_IC_TGW_Tel_CycleCount = 3276;
    int _TP_IC_TGW_Tel_Cnt;
    msTimer _tTP_IC_TGW_Tel;

/*
    // Botschaft ROE_IC ---- Sendeart cyclicWithRepeatOnDemand
    message ROE_IC _mROE_IC;
    int _ROE_IC_CycleCount = 3276;
    int _ROE_IC_Cnt;
    int _ROE_IC_MsgRepetitions;


    // Botschaft NM_IC_AR ---- Sendeart cyclicX
    message NM_IC_AR _mNM_IC_AR;
    int _NM_IC_AR_CycleCount = 3276;
    int _NM_IC_AR_Cnt;

    // Botschaft DIAG_RS_IC ---- Sendeart cyclicX
    message DIAG_RS_IC _mDIAG_RS_IC;
    int _DIAG_RS_IC_CycleCount = 3276;
    int _DIAG_RS_IC_Cnt;

    // Botschaft TPA_IC_TGW_Tel ---- Sendeart cyclicX
    message TP_IC_TGW_Tel _mTPA_IC_TGW_Tel;
    int _TPA_IC_TGW_Tel_CycleCount = 3276;
    int _TPA_IC_TGW_Tel_Cnt;

    // Botschaft TPA_IC_TGW_Nav ---- Sendeart cyclicX
    message TP_IC_TGW_Nav _mTPA_IC_TGW_Nav;
    int _TPA_IC_TGW_Nav_CycleCount = 3276;
    int _TPA_IC_TGW_Nav_Cnt;

    // Botschaft TPA_IC_TGW_Aud ---- Sendeart cyclicX
    message TP_IC_TGW_Aud _mTPA_IC_TGW_Aud;
    int _TPA_IC_TGW_Aud_CycleCount = 3276;
    int _TPA_IC_TGW_Aud_Cnt;

    // Botschaft BLSM_Disp_Stat ---- Sendeart cyclicX
    message BLSM_Disp_Stat_AR _mBLSM_Disp_Stat;
*/



// #VAR_DEF_END#
    Timer t_DoorNMCancelTimer;
    Timer t_KeyInLockNMCancelTimer;
    Timer t_StWhlButtonNMCancelTimer;
    Timer t_WakeWarningNMCancelTimer;
    Timer t_CarClosureNMCancelTimer;
    Timer t_EPKBWarningNMCancelTimer;
    Timer t_IlluNMCancelTimer;
    Timer t_GearIndNMCancelTimer;
    const byte c_NMCancelTimer_05sec = 5;
    const byte c_NMCancelTimer_30sec = 30;

    char buffer[1024], stringbuffer[512];
    int bActiveHelper;    // Hilfsvariable für "Aktive Signale"

//--------------------------------------- AUTOSAR NM ------------------------------------------------

    const byte cAUTO =   0;
    const byte cMANUAL = 1;

    msTimer t_NM_Transmit;
    long  NM_Transmit_Cycle;
    msTimer t_NM_Wait_Bus_Sleep_Time;
    const c_NM_Wait_Bus_Sleep_Time = 1500;
//    msTimer t_NM_Remote_Sleep_Ind_Time;
    const c_NM_Remote_Sleep_Ind_Time = 5000;
    msTimer t_NM_Repeat_Message_Time;
    const c_NM_Repeat_Message_Time = 6000;
    msTimer t_NM_Timeout_Time;
    const c_NM_Timeout_Time = 5000;

    byte NM_Mode = 0;
    const byte cNM_Mode_Init = 0;
    const byte cNM_Mode_Sleep = 1;
    const byte cNM_Mode_Prepare_Bus_Sleep = 2;
    const byte cNM_Mode_Ready_Sleep = 3;
    const byte cNM_Mode_Normal_Operation_State = 4;
    const byte cNM_Mode_RepeatMsg = 5;

    byte boCanNM_Rx_Indication = 0;
    byte boCanNM_Tx_Confirmation = 0;
    byte boCanNM_WaitBusSleep_Timer_Expired = 0;
    byte boCanNM_RepeatMessage_Timer_Expired = 0;
    byte boCanNM_NM_Timeout_Timer_Expired = 0;
    byte boCanNM_RepeatMessage_Requested = 0;

    const word cFLDoorNMRequest =       0x0001;
    const word cFRDoorNMRequest =       0x0002;
    const word cRLDoorNMRequest =       0x0004;
    const word cRRDoorNMRequest =       0x0008;
    const word cAllDoorNMRequest =      0x000F;
    const word cIgnitionNMRequest =     0x0010;
    const word cStWhlButtonNMRequest =  0x0020;
    const word cWakeWarningNMRequest =  0x0040;
    const word cEPKBWarningNMRequest =  0x0080;
    const word cIlluNMRequest =         0x0100;
    const word cCarClosureNMRequest =   0x0200;
    const word cGearIndNMRequest =      0x0400;

    const word cManualNMRequest =       0x8000;
    const word cAllNMRequest =          0xFFFF;

    const CanNmNodeId_Base =       1280; //  =  07h
    const CanNmNodeId_APM =          76; //  =  4Ch
    const CanNmNodeId_DRVU =         77; //  =  4Dh
    const CanNmNodeId_EIS =           7; //  =  07h
    const CanNmNodeId_HGW =          27; //  =  07h
    const CanNmNodeId_TGW =          56; //  =  38h
    const CanNmNodeId_RBTM_FR =      64; //  =  40h
    const CanNmNodeId_IC =           65; //  =  41h
    const CanNmNodeId_HUD =          66; //  =  42h
    const CanNmNodeId_NV =           67; //  =  43h
    const CanNmNodeId_RVC_SVS =      68; //  =  44h
    const CanNmNodeId_ORC =          69; //  =  45h
    const CanNmNodeId_RBTM_FL =      71; //  =  47h
    const CanNmNodeId_TPM =          82; //  =  52h

    const CanNmNodeDetectionEnabled          = 0; //false
    const CanNmNodeIdEnabled                 = 1; //true
    const CanNmUserDataEnabled               = 1; //true;
    const CanNmUserDataLentgh                = 7;
    const CanNmRepeatMsgIndEnabled           = 1; //true;
    const CanNmDevErrorDetect                = 0; //false
//    const CanNmUserDataEnabled             = 1; //true
    const CanNmRemoteSleepIndEnabled         = 0; //false
    const CanNmMsgReducedtime                = 80; //ms
    const CanNmPduRxIndicationEnabled        = 0; //false
    const CanNmStateChangeIndEnabled         = 0; //false
    const CanNmImmediateTxconfEnabled        = 0;// false
    const CanNmMsgTimeoutTime                = 5000; //ms
    const CanNmPduNidPosition                = 0; //CANNM_PDU_BYTE_0;
    const CanNmPduCbvPosition                = 0xFF; //ANNM_PDU_OFF;
    const CanNmPduLength                     = 8;
    const cCanNmPassiveModeEnabled           = 0; //false
    const CanNmBusSynchronizationEnabled     = 0; //false
    const CanNmBusLoadReductionEnabled       = 1; //true
//    const CanNmRemoteSleepIndEnabled       = 0; //false
//    const CanNmNodeDetectionEnabled        = 0; //false
    const CanNmComControlEnabled             = 1; //true    

    const NmAsrCanMsgStandardCycle =          2000;
    const NmAsrCanMsgCycleOffset_APM =          40;
    const NmAsrCanMsgReducedTime_APM =        1760;
    const NmAsrCanMsgCycleOffset_DRVU =         50;
    const NmAsrCanMsgReducedTime_DRVU =       1770;
    const NmAsrCanMsgCycleOffset_EIS =          70;
    const NmAsrCanMsgReducedTime_EIS =        1070;
    const NmAsrCanMsgCycleOffset_HGW =          30;
    const NmAsrCanMsgReducedTime_HGW =        1270;
    const NmAsrCanMsgCycleOffset_HUD =          20;
    const NmAsrCanMsgReducedTime_HUD =        1660;
    const NmAsrCanMsgCycleOffset_IC =           10;
    const NmAsrCanMsgReducedTime_IC =         1650;
    const NmAsrCanMsgCycleOffset_NV =           30;
    const NmAsrCanMsgReducedTime_NV =         1670;
    const NmAsrCanMsgCycleOffset_ORC =          50;
    const NmAsrCanMsgReducedTime_ORC =        1690;
    const NmAsrCanMsgCycleOffset_RBTM_FL =       0;
    const NmAsrCanMsgReducedTime_RBTM_FL =    1640;
    const NmAsrCanMsgCycleOffset_RBTM_FR =      70;
    const NmAsrCanMsgReducedTime_RBTM_FR =    1710;
    const NmAsrCanMsgCycleOffset_RVC =          40;
    const NmAsrCanMsgReducedTime_RVC =        1680;
    const NmAsrCanMsgCycleOffset_SVS =          40;
    const NmAsrCanMsgReducedTime_SVS =        1680;
    const NmAsrCanMsgCycleOffset_TGW =           0;
    const NmAsrCanMsgReducedTime_TGW =        1560;
    const NmAsrCanMsgCycleOffset_TPM =          20;
    const NmAsrCanMsgReducedTime_TPM =        1820;

    char gECU[12] = "HMI_IC";

    byte CanNmNodeId            = CanNmNodeId_IC;
    word NmNodeIdentifier       = CanNmNodeId_Base + CanNmNodeId_IC;
    word NmAsrCanMsgCycleOffset = NmAsrCanMsgCycleOffset_IC;
    word NmAsrCanMsgReducedTime = NmAsrCanMsgReducedTime_IC;
    word NmAsrCanMsgCycleTime   = 2000;
    byte NM_Repeat_Message_State_Active = 0;
    byte NM_AutomaticModeActive = 0;

    // Botschaft NM_xxx_AR ---- Sendeart cyclicX
      message NM_IC_AR _mNM_xxx_AR;
    byte _mNM_xxx_Transmit_Allowed = 1;

//--------------------------------------- AUTOSAR NM ------------------------------------------------

    byte  crctable[256] = {
        0x00, 0x1D, 0x3A, 0x27, 0x74, 0x69, 0x4E, 0x53, 0xE8, 0xF5, 0xD2, 0xCF, 0x9C, 0x81, 0xA6, 0xBB,
        0xCD, 0xD0, 0xF7, 0xEA, 0xB9, 0xA4, 0x83, 0x9E, 0x25, 0x38, 0x1F, 0x02, 0x51, 0x4C, 0x6B, 0x76,
        0x87, 0x9A, 0xBD, 0xA0, 0xF3, 0xEE, 0xC9, 0xD4, 0x6F, 0x72, 0x55, 0x48, 0x1B, 0x06, 0x21, 0x3C,
        0x4A, 0x57, 0x70, 0x6D, 0x3E, 0x23, 0x04, 0x19, 0xA2, 0xBF, 0x98, 0x85, 0xD6, 0xCB, 0xEC, 0xF1,
        0x13, 0x0E, 0x29, 0x34, 0x67, 0x7A, 0x5D, 0x40, 0xFB, 0xE6, 0xC1, 0xDC, 0x8F, 0x92, 0xB5, 0xA8,
        0xDE, 0xC3, 0xE4, 0xF9, 0xAA, 0xB7, 0x90, 0x8D, 0x36, 0x2B, 0x0C, 0x11, 0x42, 0x5F, 0x78, 0x65,
        0x94, 0x89, 0xAE, 0xB3, 0xE0, 0xFD, 0xDA, 0xC7, 0x7C, 0x61, 0x46, 0x5B, 0x08, 0x15, 0x32, 0x2F,
        0x59, 0x44, 0x63, 0x7E, 0x2D, 0x30, 0x17, 0x0A, 0xB1, 0xAC, 0x8B, 0x96, 0xC5, 0xD8, 0xFF, 0xE2,
        0x26, 0x3B, 0x1C, 0x01, 0x52, 0x4F, 0x68, 0x75, 0xCE, 0xD3, 0xF4, 0xE9, 0xBA, 0xA7, 0x80, 0x9D,
        0xEB, 0xF6, 0xD1, 0xCC, 0x9F, 0x82, 0xA5, 0xB8, 0x03, 0x1E, 0x39, 0x24, 0x77, 0x6A, 0x4D, 0x50,
        0xA1, 0xBC, 0x9B, 0x86, 0xD5, 0xC8, 0xEF, 0xF2, 0x49, 0x54, 0x73, 0x6E, 0x3D, 0x20, 0x07, 0x1A,
        0x6C, 0x71, 0x56, 0x4B, 0x18, 0x05, 0x22, 0x3F, 0x84, 0x99, 0xBE, 0xA3, 0xF0, 0xED, 0xCA, 0xD7,
        0x35, 0x28, 0x0F, 0x12, 0x41, 0x5C, 0x7B, 0x66, 0xDD, 0xC0, 0xE7, 0xFA, 0xA9, 0xB4, 0x93, 0x8E,
        0xF8, 0xE5, 0xC2, 0xDF, 0x8C, 0x91, 0xB6, 0xAB, 0x10, 0x0D, 0x2A, 0x37, 0x64, 0x79, 0x5E, 0x43,
        0xB2, 0xAF, 0x88, 0x95, 0xC6, 0xDB, 0xFC, 0xE1, 0x5A, 0x47, 0x60, 0x7D, 0x2E, 0x33, 0x14, 0x09,
        0x7F, 0x62, 0x45, 0x58, 0x0B, 0x16, 0x31, 0x2C, 0x97, 0x8A, 0xAD, 0xB0, 0xE3, 0xFE, 0xD9, 0xC4
    };

    byte  crctable_profile02[256] = {
        0x00, 0x2F, 0x5E, 0x71, 0xBC, 0x93, 0xE2, 0xCD, 0x57, 0x78, 0x09, 0x26, 0xEB, 0xC4, 0xB5, 0x9A,
        0xAE, 0x81, 0xF0, 0xDF, 0x12, 0x3D, 0x4C, 0x63, 0xF9, 0xD6, 0xA7, 0x88, 0x45, 0x6A, 0x1B, 0x34,
        0x73, 0x5C, 0x2D, 0x02, 0xCF, 0xE0, 0x91, 0xBE, 0x24, 0x0B, 0x7A, 0x55, 0x98, 0xB7, 0xC6, 0xE9,
        0xDD, 0xF2, 0x83, 0xAC, 0x61, 0x4E, 0x3F, 0x10, 0x8A, 0xA5, 0xD4, 0xFB, 0x36, 0x19, 0x68, 0x47,
        0xE6, 0xC9, 0xB8, 0x97, 0x5A, 0x75, 0x04, 0x2B, 0xB1, 0x9E, 0xEF, 0xC0, 0x0D, 0x22, 0x53, 0x7C,
        0x48, 0x67, 0x16, 0x39, 0xF4, 0xDB, 0xAA, 0x85, 0x1F, 0x30, 0x41, 0x6E, 0xA3, 0x8C, 0xFD, 0xD2,
        0x95, 0xBA, 0xCB, 0xE4, 0x29, 0x06, 0x77, 0x58, 0xC2, 0xED, 0x9C, 0xB3, 0x7E, 0x51, 0x20, 0x0F,
        0x3B, 0x14, 0x65, 0x4A, 0x87, 0xA8, 0xD9, 0xF6, 0x6C, 0x43, 0x32, 0x1D, 0xD0, 0xFF, 0x8E, 0xA1,
        0xE3, 0xCC, 0xBD, 0x92, 0x5F, 0x70, 0x01, 0x2E, 0xB4, 0x9B, 0xEA, 0xC5, 0x08, 0x27, 0x56, 0x79,
        0x4D, 0x62, 0x13, 0x3C, 0xF1, 0xDE, 0xAF, 0x80, 0x1A, 0x35, 0x44, 0x6B, 0xA6, 0x89, 0xF8, 0xD7,
        0x90, 0xBF, 0xCE, 0xE1, 0x2C, 0x03, 0x72, 0x5D, 0xC7, 0xE8, 0x99, 0xB6, 0x7B, 0x54, 0x25, 0x0A,
        0x3E, 0x11, 0x60, 0x4F, 0x82, 0xAD, 0xDC, 0xF3, 0x69, 0x46, 0x37, 0x18, 0xD5, 0xFA, 0x8B, 0xA4,
        0x05, 0x2A, 0x5B, 0x74, 0xB9, 0x96, 0xE7, 0xC8, 0x52, 0x7D, 0x0C, 0x23, 0xEE, 0xC1, 0xB0, 0x9F,
        0xAB, 0x84, 0xF5, 0xDA, 0x17, 0x38, 0x49, 0x66, 0xFC, 0xD3, 0xA2, 0x8D, 0x40, 0x6F, 0x1E, 0x31,
        0x76, 0x59, 0x28, 0x07, 0xCA, 0xE5, 0x94, 0xBB, 0x21, 0x0E, 0x7F, 0x50, 0x9D, 0xB2, 0xC3, 0xEC,
        0xD8, 0xF7, 0x86, 0xA9, 0x64, 0x4B, 0x3A, 0x15, 0x8F, 0xA0, 0xD1, 0xFE, 0x33, 0x1C, 0x6D, 0x42
    };
}
/*@@end*/

/*@@startStart:Start:*/
on start
{
    putValue( HMI__NM_IC_NM_Request, 0 );  // reset all requests
    _NM_Switch_NM_Mode();
    __IC_Init_Msg();
    __IC_Startup_Delay();
   
    putValue( HMI__NM_IC_AutomaticModeActive, 0 );
    putValue( HMI__NM_IC_AutomaticModeActive, 1 );
}
/*@@end*/

/*@@caplFunc:__IC_Init_Msg():*/
__IC_Init_Msg()
{
// #START_INIT#
    //Config_HU5_AR_init();
	
	Assyst_Rq_AR_init();
    BLSM_Disp_Stat_AR_init();
    Dimming_Stat_AR_init();
    HUD_Rq_IC_AR_init();
	Config_IC_AR_init();
	IC_AddDisp_VAN_AR_init();
    IC_BasicInfo2_AR_init();
    IC_BasicInfo_AR_init();
    IC_Date_Time_AR_init();
    IC_DriveAssistSys_AR_init();
	IC_DispAreaCfg_Stat_AR_init();
//    IC_EnergyMngmnt_Stat_AR_init();
    IC_Immobilizer_AR_init();
    IC_Settings_AR_init();
    IC_StWheelSwitches_AR_init();
//    IC_WIM_AR_init();
    LDC_Disp_Stat_IC_AR_init();
    Maintenance1_AR_init();
    Maintenance2_AR_init();
//    Meas_IC_1_init();
//    Meas_IC_2_init();
//    Meas_IC_3_init();
//    Meas_IC_4_init();
    NV_Rq_IC_AR_init();
//    Park_Disp_Rs_AR_init();
//    ROE_IC_init();
    TC_Dist_AR_init();
//    TP_IC_MPM_init();
//    TP_IC_TGW_Aud_init();
//    TP_IC_TGW_Nav_init();
//    TP_IC_TGW_Tel_init();




    // Botschaft IC_WIM_AR ---- Sendeart cyclicAndSpontanWithDelay ---- Beginn Initialisierung
//    _IC_WIM_Cnt = 0;
//    _IC_WIM_SpontanFlag = 0;
    /* sofort */ _mIC_WIM_AR.WarnPrio1_Mute_Rq.phys = getValue(HMI_WarnPrio1_Mute_Rq);
    /* sofort */ _mIC_WIM_AR.IC_Msg_Disp_Stat.phys = getValue(HMI_IC_Msg_Disp_Stat);
    /* sofort */ _mIC_WIM_AR.AcustWarn_Actv_IC.phys = getValue(HMI_AcustWarn_Actv_IC);
    // Botschaft IC_WIM_AR ---- Sendeart cyclicAndSpontanWithDelay ---- Ende Initialisierung


    // Botschaft TPA_IC_MPM ---- Sendeart cyclicX ---- Beginn Initialisierung
//    _TPA_IC_MPM_Cnt = 4;
//    /* zyklisch */ TP_IC_MPM_TP_IC_MPM_getValue();
    // Botschaft TPA_IC_MPM ---- Sendeart cyclicX ---- Ende Initialisierung

    // Botschaft TPA_IC_PARK ---- Sendeart cyclicX ---- Beginn Initialisierung
//    _TPA_IC_PARK_Cnt = 5;
//    /* zyklisch */ TP_IC_PARK_TP_IC_PARK_getValue();
    // Botschaft TPA_IC_PARK ---- Sendeart cyclicX ---- Ende Initialisierung


    // Botschaft TPA_IC_TGW_Tel ---- Sendeart cyclicX ---- Beginn Initialisierung
//    _TPA_IC_TGW_Tel_Cnt = 13;
//    /* zyklisch */ TPA_IC_TGW_Tel_TPA_IC_TGW_Tel_getValue();
    // Botschaft TPA_IC_TGW_Tel ---- Sendeart cyclicX ---- Ende Initialisierung

    // Botschaft TPA_IC_TGW_Nav ---- Sendeart cyclicX ---- Beginn Initialisierung
//    _TPA_IC_TGW_Nav_Cnt = 14;
//    /* zyklisch */ TPA_IC_TGW_Nav_TPA_IC_TGW_Nav_getValue();
    // Botschaft TPA_IC_TGW_Nav ---- Sendeart cyclicX ---- Ende Initialisierung


    // Botschaft TPA_IC_TGW_Aud ---- Sendeart cyclicX ---- Beginn Initialisierung
//    _TPA_IC_TGW_Aud_Cnt = 1;
//    /* zyklisch */ TPA_IC_TGW_Aud_TPA_IC_TGW_Aud_getValue();
    // Botschaft TPA_IC_TGW_Aud ---- Sendeart cyclicX ---- Ende Initialisierung

    // Botschaft TPA_IC_TELEAID ---- Sendeart cyclicX ---- Beginn Initialisierung
//    _TPA_IC_TELEAID_Cnt = 2;
//    /* zyklisch */ TPA_IC_TELEAID_TPA_IC_TELEAID_getValue();
    // Botschaft TPA_IC_TELEAID ---- Sendeart cyclicX ---- Ende Initialisierung

// #START_INIT_END#
}
/*@@end*/

/*@@envVar:HMI__STOP_All_MESSAGES_DEFAULT_STARTDELAY:*/
on envVar HMI__STOP_All_MESSAGES_DEFAULT_STARTDELAY
{
    if( getValue( this ) )
    {
        __IC_Init_Msg();
        __IC_Startup_Delay();
    }
}
/*@@end*/

/*@@envVar:HMI__STOP_All_MESSAGES_SET_STARTDELAY:*/
on envVar HMI__STOP_All_MESSAGES_SET_STARTDELAY
{
    if( getValue( this ) )
    {
        __IC_Startup_Delay();
    }
}
/*@@end*/

/*@@caplFunc:__IC_Startup_Delay():*/
__IC_Startup_Delay()
{
    write(" Delay setzen :__IC_Startup_Delay");
// #START_DELAY#
//    _AB_R_Stat_AR_Cnt                 = getValue( HMI__STMSGSD_AB_R_Stat_AR                 ) / _AB_R_Stat_AR_Timebase;
// #START_DELAY_END#
}
/*@@end*/

/*@@timer:t_DBKomTimer_5ms:*/
on Timer t_DBKomTimer_5ms
{
// *** DBKom-Sendefunktion ***
    // timer aufziehen für nächsten Zyklus
    if( getValue( HMI__NM_IC_CommActive        ) |
        getValue( HMI__NM_IC_RequestBusCom )   )
    {
        setTimer( t_DBKomTimer_5ms, c_tDBKomTimer_5ms );
    }
// #CYC_TIMER_5_MS_START#
// #CYC_TIMER_5_MS_END#
}
/*@@end*/

/*@@timer:t_DBKomTimer_20ms:*/
on Timer t_DBKomTimer_20ms
{
// *** DBKom-Sendefunktion ***
    // timer aufziehen für nächsten Zyklus
    if( getValue( HMI__NM_IC_CommActive    ) |
        getValue( HMI__NM_IC_RequestBusCom )   )
    {
        setTimer( t_DBKomTimer_20ms, c_tDBKomTimer_20ms );
    }
    //Config_HU5_AR_check_output();
	
	Assyst_Rq_AR_check_output();
    BLSM_Disp_Stat_AR_check_output();
    Dimming_Stat_AR_check_output();
    HUD_Rq_IC_AR_check_output();
	Config_IC_AR_check_output();
	IC_AddDisp_VAN_AR_check_output();
    IC_BasicInfo2_AR_check_output();
    IC_BasicInfo_AR_check_output();
    IC_Date_Time_AR_check_output();
    IC_DriveAssistSys_AR_check_output();
	IC_DispAreaCfg_Stat_AR_check_output();
//    IC_EnergyMngmnt_Stat_AR_check_output();
    IC_Immobilizer_AR_check_output();
    IC_Settings_AR_check_output();
    IC_StWheelSwitches_AR_check_output();
    LDC_Disp_Stat_IC_AR_check_output();
    Maintenance1_AR_check_output();
    Maintenance2_AR_check_output();
    NV_Rq_IC_AR_check_output();
    TC_Dist_AR_check_output();


/*
        }
          if (!getValue(HMI__STMSG_IC_WIM))
        {
            // Botschaft IC_WIM --- Sendeart cyclicAndSpontanWithDelay --- Beginn DBKOM-Bewertung
            _IC_WIM_Cnt--;
            if (_IC_WIM_Cnt < 1)
            {
                // Nachricht wg. abgelaufenem Zyklus ausgeben
                output(_mIC_WIM);
                _IC_WIM_Cnt = _IC_WIM_CycleCount; // Zyklus-Zähler zurücksetzen
                 _IC_WIM_SpontanFlag = 0; // Spontan-Flag zurücksetzen
            }
            else if (_IC_WIM_SpontanFlag)
            {
                // Nachricht wg. spontaner Änderung ausgeben
                output(_mIC_WIM);
                 _IC_WIM_SpontanFlag = 0; // Spontan-Flag zurücksetzen
            }
            // Botschaft IC_WIM --- Sendeart cyclicAndSpontanWithDelay --- Ende DBKOM-Bewertung
        }
          if (!getValue(HMI__STMSG_IC_Meas_IC_3))
        {
            // Botschaft Meas_IC_3 --- Sendeart spontanX --- Beginn DBKOM-Bewertung
            if (_Meas_IC_3_SpontanFlag)
            {
                // Nachricht wg. spontaner Änderung ausgeben
                output(_mMeas_IC_3);
                // Spontan-Flag zurücksetzen
                 _Meas_IC_3_SpontanFlag = 0;
            }
            // Botschaft Meas_IC_3 --- Sendeart spontanX --- Ende DBKOM-Bewertung
        }
          if (!getValue(HMI__STMSG_IC_Meas_IC_2))
        {
            // Botschaft Meas_IC_2 --- Sendeart spontanX --- Beginn DBKOM-Bewertung
            if (_Meas_IC_2_SpontanFlag)
            {
                // Nachricht wg. spontaner Änderung ausgeben
                output(_mMeas_IC_2);
                // Spontan-Flag zurücksetzen
                 _Meas_IC_2_SpontanFlag = 0;
            }
            // Botschaft Meas_IC_2 --- Sendeart spontanX --- Ende DBKOM-Bewertung
        }
          if (!getValue(HMI__STMSG_IC_Meas_IC_4))
        {
            // Botschaft Meas_IC_4 --- Sendeart spontanX --- Beginn DBKOM-Bewertung
            if (_Meas_IC_4_SpontanFlag)
            {
                // Nachricht wg. spontaner Änderung ausgeben
                output(_mMeas_IC_4);
                // Spontan-Flag zurücksetzen
                 _Meas_IC_4_SpontanFlag = 0;
            }
            // Botschaft Meas_IC_4 --- Sendeart spontanX --- Ende DBKOM-Bewertung
        }
          if (!getValue(HMI__STMSG_IC_Meas_IC_1))
        {
            // Botschaft Meas_IC_1 --- Sendeart spontanX --- Beginn DBKOM-Bewertung
            if (_Meas_IC_1_SpontanFlag)
            {
                // Nachricht wg. spontaner Änderung ausgeben
                output(_mMeas_IC_1);
                // Spontan-Flag zurücksetzen
                 _Meas_IC_1_SpontanFlag = 0;
            }
            // Botschaft Meas_IC_1 --- Sendeart spontanX --- Ende DBKOM-Bewertung
        }
          if (!getValue(HMI__STMSG_IC_NM_IC_AR))
        {
            // Botschaft NM_IC_AR --- Sendeart cyclicX --- Beginn DBKOM-Bewertung
            _NM_IC_AR_Cnt--;
            if (_NM_IC_AR_Cnt < 1)
            {
                // Nachricht wg. abgelaufenem Zyklus ausgeben
                output(_mNM_IC_AR);
                // Zyklus-Zähler zurücksetzen
                _NM_IC_AR_Cnt = _NM_IC_AR_CycleCount;
            }
            // Botschaft NM_IC_AR --- Sendeart cyclicX --- Ende DBKOM-Bewertung
        }
          if (!getValue(HMI__STMSG_IC_TPA_IC_MPM))
        {
            // Botschaft TPA_IC_MPM --- Sendeart cyclicX --- Beginn DBKOM-Bewertung
            _TPA_IC_MPM_Cnt--;
            if (_TPA_IC_MPM_Cnt < 1)
            {
                // Nachricht wg. abgelaufenem Zyklus ausgeben
                output(_mTPA_IC_MPM);
                // Zyklus-Zähler zurücksetzen
                _TPA_IC_MPM_Cnt = _TPA_IC_MPM_CycleCount;
            }
            // Botschaft TPA_IC_MPM --- Sendeart cyclicX --- Ende DBKOM-Bewertung
        }
          if (!getValue(HMI__STMSG_IC_TPA_IC_PARK))
        {
            // Botschaft TPA_IC_PARK --- Sendeart cyclicX --- Beginn DBKOM-Bewertung
            _TPA_IC_PARK_Cnt--;
            if (_TPA_IC_PARK_Cnt < 1)
            {
                // Nachricht wg. abgelaufenem Zyklus ausgeben
                output(_mTPA_IC_PARK);
                // Zyklus-Zähler zurücksetzen
                _TPA_IC_PARK_Cnt = _TPA_IC_PARK_CycleCount;
            }
            // Botschaft TPA_IC_PARK --- Sendeart cyclicX --- Ende DBKOM-Bewertung
        }
          if (!getValue(HMI__STMSG_IC_DIAG_RS_IC))
        {
            // Botschaft DIAG_RS_IC --- Sendeart cyclicX --- Beginn DBKOM-Bewertung
            _DIAG_RS_IC_Cnt--;
            if (_DIAG_RS_IC_Cnt < 1)
            {
                // Nachricht wg. abgelaufenem Zyklus ausgeben
                output(_mDIAG_RS_IC);
                // Zyklus-Zähler zurücksetzen
                _DIAG_RS_IC_Cnt = _DIAG_RS_IC_CycleCount;
            }
            // Botschaft DIAG_RS_IC --- Sendeart cyclicX --- Ende DBKOM-Bewertung
        }
           if (!getValue(HMI__STMSG_IC_TPA_IC_TGW_Tel))
        {
            // Botschaft TPA_IC_TGW_Tel --- Sendeart cyclicX --- Beginn DBKOM-Bewertung
            _TPA_IC_TGW_Tel_Cnt--;
            if (_TPA_IC_TGW_Tel_Cnt < 1)
            {
                // Nachricht wg. abgelaufenem Zyklus ausgeben
                output(_mTPA_IC_TGW_Tel);
                // Zyklus-Zähler zurücksetzen
                _TPA_IC_TGW_Tel_Cnt = _TPA_IC_TGW_Tel_CycleCount;
            }
            // Botschaft TPA_IC_TGW_Tel --- Sendeart cyclicX --- Ende DBKOM-Bewertung
        }
          if (!getValue(HMI__STMSG_IC_TPA_IC_TGW_Nav))
        {
            // Botschaft TPA_IC_TGW_Nav --- Sendeart cyclicX --- Beginn DBKOM-Bewertung
            _TPA_IC_TGW_Nav_Cnt--;
            if (_TPA_IC_TGW_Nav_Cnt < 1)
            {
                // Nachricht wg. abgelaufenem Zyklus ausgeben
                output(_mTPA_IC_TGW_Nav);
                // Zyklus-Zähler zurücksetzen
                _TPA_IC_TGW_Nav_Cnt = _TPA_IC_TGW_Nav_CycleCount;
            }
            // Botschaft TPA_IC_TGW_Nav --- Sendeart cyclicX --- Ende DBKOM-Bewertung
        }
          if (!getValue(HMI__STMSG_IC_TPA_IC_TGW_Aud))
        {
            // Botschaft TPA_IC_TGW_Aud --- Sendeart cyclicX --- Beginn DBKOM-Bewertung
            _TPA_IC_TGW_Aud_Cnt--;
            if (_TPA_IC_TGW_Aud_Cnt < 1)
            {
                // Nachricht wg. abgelaufenem Zyklus ausgeben
                output(_mTPA_IC_TGW_Aud);
                // Zyklus-Zähler zurücksetzen
                _TPA_IC_TGW_Aud_Cnt = _TPA_IC_TGW_Aud_CycleCount;
            }
            // Botschaft TPA_IC_TGW_Aud --- Sendeart cyclicX --- Ende DBKOM-Bewertung
        }
          if (!getValue(HMI__STMSG_IC_TPA_IC_TELEAID))
        {
            // Botschaft TPA_IC_TELEAID --- Sendeart cyclicX --- Beginn DBKOM-Bewertung
            _TPA_IC_TELEAID_Cnt--;
            if (_TPA_IC_TELEAID_Cnt < 1)
            {
                // Nachricht wg. abgelaufenem Zyklus ausgeben
                output(_mTPA_IC_TELEAID);
                // Zyklus-Zähler zurücksetzen
                _TPA_IC_TELEAID_Cnt = _TPA_IC_TELEAID_CycleCount;
            }
            // Botschaft TPA_IC_TELEAID --- Sendeart cyclicX --- Ende DBKOM-Bewertung
        }
*/
// #CYC_TIMER_20_MS_END#
}
/*@@end*/

/*@@envVar:HMI__SAVE_PANEL_CONFIG_IC:*/
on EnvVar HMI__SAVE_PANEL_CONFIG_IC
{
    dword hFile;

    if( getValue(this) )
    {
        write("Saving HMI Panel Variables ...");

        hFile = openFileWrite( "CONFIG\\HMI_PRESETS.ASC", 0 );
        filePutString( "base hex timestamps absolute\n", 31, hFile );

// #MSG_SAVEENVVAR#
   //     AB_R_Stat_AR_saveEnvVars( hFile );
// #MSG_SAVEENVVAR_END#
        fileClose(hFile );
    }
}
/*@@end*/

/*@@envVar:HMI__STOP_IC_MESSAGES_OFF:*/
on EnvVar HMI__STOP_IC_MESSAGES_OFF
{
    if( getValue(this) )
    {
// #MSG_OFF#
  //      putValue( HMI__STMSG_AB_R_Stat_AR, 1 );
// #MSG_OFF_END#
    }
}
/*@@end*/

/*@@envVar:HMI__STOP_IC_MESSAGES_ON:*/
on envVar HMI__STOP_IC_MESSAGES_ON
{
    if( getValue(this) )
    {
// #MSG_ON#
//        putValue( HMI__STMSG_AB_R_Stat_AR, 0 );
// #MSG_ON_END#
    }
}
/*@@end*/

/*@@busOff:BusOff:*/
on busOff
{
    resetCan();
    write("CAN has been resetted due to BUSOFF    ( coded version )");
}
/*@@end*/

/*@@msg:0x500-0x57F:*/
on message 0x500-0x57F
{
    byte Identifier;

    Identifier = this.byte( 1 );

    if( this.byte( 1 ) == CanNmNodeId )    // check, wether the received NM-Frame is an own one
    {
        boCanNM_Tx_Confirmation = TRUE;    // so it is a TX-confirmation
    }
    else
    {
        boCanNM_Rx_Indication = TRUE;     // else it is a NM-Frame from another ECU
    }
    _NM_Switch_NM_Mode();     // inform the state-mashine
}
/*@@end*/

/*@@timer:t_DoorNMCancelTimer:*/
on timer t_DoorNMCancelTimer
{
    if( getValue( HMI__NM_EIS_AutomaticModeActive ) == 1 )
    {
        _ReleaseCommRequest( 15 );  // all doors reset their requests
    }
}
/*@@end*/

/*@@timer:t_KeyInLockNMCancelTimer:*/
on timer t_KeyInLockNMCancelTimer
{
    if( getValue( HMI__NM_EIS_AutomaticModeActive ) == 1 )
    {
        _ReleaseCommRequest( cIgnitionNMRequest );
    }
}
/*@@end*/

/*@@timer:t_StWhlButtonNMCancelTimer:*/
on timer t_StWhlButtonNMCancelTimer
{
    if( getValue( HMI__NM_EIS_AutomaticModeActive ) == 1 )
    {
        _ReleaseCommRequest( cStWhlButtonNMRequest );  // all keys reset their requests
    }
}
/*@@end*/

/*@@timer:t_WakeWarningNMCancelTimer:*/
on timer t_WakeWarningNMCancelTimer
{
    if( getValue( HMI__NM_EIS_AutomaticModeActive ) == 1 )
    {
        _ReleaseCommRequest( cWakeWarningNMRequest );  // all keys reset their requests
    }
}
/*@@end*/

/*@@timer:t_EPKBWarningNMCancelTimer:*/
on timer t_EPKBWarningNMCancelTimer
{
    if( getValue( HMI__NM_EIS_AutomaticModeActive ) == 1 )
    {
        _ReleaseCommRequest( cEPKBWarningNMRequest );  // all keys reset their requests
    }
}
/*@@end*/

/*@@timer:t_IlluNMCancelTimer:*/
on timer t_IlluNMCancelTimer
{
    if( getValue( HMI__NM_EIS_AutomaticModeActive ) == 1 )
    {
        _ReleaseCommRequest( cIlluNMRequest );  // all keys reset their requests
    }
}
/*@@end*/

/*@@timer:t_CarClosureNMCancelTimer:*/
on timer t_CarClosureNMCancelTimer
{
    if( getValue( HMI__NM_EIS_AutomaticModeActive ) == 1 )
    {
        _ReleaseCommRequest( cCarClosureNMRequest );  // all keys reset their requests
    }
}
/*@@end*/

/*@@timer:t_GearIndNMCancelTimer:*/
on timer t_GearIndNMCancelTimer
{
    if( getValue( HMI__NM_EIS_AutomaticModeActive ) == 1 )
    {
        _ReleaseCommRequest( cGearIndNMRequest );  // all keys reset their requests
    }
}
/*@@end*/

/*@@timer:t_NM_Repeat_Message_Time:*/
on timer t_NM_Repeat_Message_Time
{
    boCanNM_RepeatMessage_Timer_Expired = TRUE;
    _NM_Switch_NM_Mode();     // inform the state-mashine
}
/*@@end*/

/*@@timer:t_NM_Timeout_Time:*/
on timer t_NM_Timeout_Time
{
    boCanNM_NM_Timeout_Timer_Expired = TRUE;
    _NM_Switch_NM_Mode();     // inform the state-mashine
}
/*@@end*/

/*@@timer:t_NM_Transmit:*/
on timer t_NM_Transmit
{
    setTimer( t_NM_Transmit, NM_Transmit_Cycle );
    _mNM_xxx_AR.byte( 1 ) = CanNmNodeId;
    if( _mNM_xxx_Transmit_Allowed )
        output( _mNM_xxx_AR );
}
/*@@end*/

/*@@timer:t_NM_Wait_Bus_Sleep_Time:*/
on timer t_NM_Wait_Bus_Sleep_Time
{
    boCanNM_WaitBusSleep_Timer_Expired = TRUE;
    _NM_Switch_NM_Mode();     // inform the state-mashine
}
/*@@end*/

/*@@caplFunc:NM_xxx_AR_init():*/
NM_xxx_AR_init()
{
/*    _mNM_xxx_AR.Nw_Id.phys = getValue( HMI_Nw_Id_IC );
    _mNM_xxx_AR.NM_Mode.phys = getValue( HMI_NM_Mode_IC );
    _mNM_xxx_AR.NM_Sleep_Ack.phys = getValue( HMI_NM_Sleep_Ack_IC );
    _mNM_xxx_AR.NM_Sleep_Ind.phys = getValue( HMI_NM_Sleep_Ind_IC );
    _mNM_xxx_AR.NM_Successor.phys = getValue( HMI_NM_Successor_IC );
    _mNM_xxx_AR.NM_Ud_Launch.phys = getValue( HMI_NM_Ud_Launch_IC );
    _mNM_xxx_AR.NM_Ud_Srv.phys = getValue( HMI_NM_Ud_Srv_IC );
    _mNM_xxx_AR.WakeupRsn_IC.phys = getValue( HMI_WakeupRsn_IC );
    _mNM_xxx_AR.AwakeRsn_IC.phys = getValue( HMI_AwakeRsn_IC );*/
}
/*@@end*/

/*@@caplFunc:NM_xxx_AR_saveEnvVars(dword):*/
NM_xxx_AR_saveEnvVars( dword hFile )
{
    filePutString("\n// Knoten NM_IC_AR\n", 33, hFile );
    snprintf(buffer, elcount(buffer), "0.0000 HMI__STMSG_NM_IC_AR := %X\n", getValue(HMI__STMSG_NM_IC_AR ));		filePutString (buffer, elcount(buffer), hFile);
    snprintf(buffer, elcount(buffer), "0.0000 HMI__STMSGT_NM_IC_AR := %X\n", getValue(HMI__STMSGT_NM_IC_AR ));		filePutString (buffer, elcount(buffer), hFile);
  /*  snprintf(buffer, elcount(buffer), "0.0000 HMI_Nw_Id := %X\n", getValue( HMI_Nw_Id_IC ) );		filePutString (buffer, elcount(buffer), hFile);
    snprintf(buffer, elcount(buffer), "0.0000 HMI_NM_Mode := %X\n", getValue( HMI_NM_Mode_IC ) );		filePutString (buffer, elcount(buffer), hFile);
    snprintf(buffer, elcount(buffer), "0.0000 HMI_NM_Sleep_Ack := %X\n", getValue( HMI_NM_Sleep_Ack_IC ) );		filePutString (buffer, elcount(buffer), hFile);
    snprintf(buffer, elcount(buffer), "0.0000 HMI_NM_Sleep_Ind := %X\n", getValue( HMI_NM_Sleep_Ind_IC ) );		filePutString (buffer, elcount(buffer), hFile);
    snprintf(buffer, elcount(buffer), "0.0000 HMI_NM_Successor := %X\n", getValue( HMI_NM_Successor_IC ) );		filePutString (buffer, elcount(buffer), hFile);
    snprintf(buffer, elcount(buffer), "0.0000 HMI_NM_Ud_Launch := %X\n", getValue( HMI_NM_Ud_Launch_IC ) );		filePutString (buffer, elcount(buffer), hFile);
    snprintf(buffer, elcount(buffer), "0.0000 HMI_NM_Ud_Srv := %X\n", getValue( HMI_NM_Ud_Srv_IC ) );		filePutString (buffer, elcount(buffer), hFile);
    snprintf(buffer, elcount(buffer), "0.0000 HMI_WakeupRsn_IC := %X\n", getValue( HMI_WakeupRsn_IC ) );		filePutString (buffer, elcount(buffer), hFile);
    snprintf(buffer, elcount(buffer), "0.0000 HMI_AwakeRsn_IC := %X\n", getValue( HMI_AwakeRsn_IC ) );		filePutString (buffer, elcount(buffer), hFile);
*/}
/*@@end*/

/*@@envVar:HMI__STMSG_NM_IC_AR:*/
on envVar HMI__STMSG_NM_IC_AR
{
    if( getValue( this ) == 0 )
        _mNM_xxx_Transmit_Allowed = 1;
    else
        _mNM_xxx_Transmit_Allowed = 0;    
}
/*@@end*/

/*@@envVar:HMI_Nw_Id_IC:*/
/*on EnvVar HMI_Nw_Id_IC
{
    _mNM_xxx_AR.Nw_Id.phys = getValue(this);
}*/
/*@@end*/

/*@@envVar:HMI_NM_Mode_IC:*/
/*on EnvVar HMI_NM_Mode_IC
{
    _mNM_xxx_AR.NM_Mode.phys = getValue(this);
}*/
/*@@end*/

/*@@envVar:HMI_NM_Sleep_Ack_IC:*/
/*on EnvVar HMI_NM_Sleep_Ack_IC
{
    _mNM_xxx_AR.NM_Sleep_Ack.phys = getValue(this);
}*/
/*@@end*/

/*@@envVar:HMI_NM_Sleep_Ind_IC:*/
/*on EnvVar HMI_NM_Sleep_Ind_IC
{
    _mNM_xxx_AR.NM_Sleep_Ind.phys = getValue(this);
}*/
/*@@end*/

/*@@envVar:HMI_NM_Successor_IC:*/
/*on EnvVar HMI_NM_Successor_IC
{
     _mNM_xxx_AR.NM_Successor.phys = getValue(this);
}*/
/*@@end*/

/*@@envVar:HMI_NM_Ud_Launch_IC:*/
/*on EnvVar HMI_NM_Ud_Launch_IC
{
    _mNM_xxx_AR.NM_Ud_Launch.phys = getValue(this);
}*/
/*@@end*/

/*@@envVar:HMI_NM_Ud_Srv_IC:*/
/*on EnvVar HMI_NM_Ud_Srv_IC
{
    _mNM_xxx_AR.NM_Ud_Srv.phys = getValue(this);
}*/
/*@@end*/

/*@@envVar:HMI_WakeupRsn_IC:*/
on EnvVar HMI_WakeupRsn_IC
{
    _mNM_xxx_AR.WakeupRsn_IC.phys = getValue(this);
}
/*@@end*/

/*@@envVar:HMI_AwakeRsn_IC:*/
/*on EnvVar HMI_AwakeRsn_IC
{
    _mNM_xxx_AR.AwakeRsn_IC.phys = getValue(this);
}*/
/*@@end*/

/*@@caplFunc:_NM_Switch_NM_Mode():*/
_NM_Switch_NM_Mode()
{
    byte bOld_NM_Mode;
    word NM_Request_State;

    bOld_NM_Mode = NM_Mode;
    NM_Request_State = getValue( HMI__NM_IC_NM_Request );
    switch( NM_Mode )
    {
        case cNM_Mode_Init:                   _NM_Init();
                                              NM_Mode = cNM_Mode_Sleep;
                                              break;
        case cNM_Mode_Sleep:                  if( boCanNM_Rx_Indication == TRUE )
                                              {
                                                  // _NM_NetworkStartIndication();   nothing to do
                                                  // _NM_PassiveStartUp();    is content of _NM_NetworkMode();
                                                  setTimer( t_NM_Transmit, NmAsrCanMsgCycleOffset );    // send NM-Frame delayed
                                                  boCanNM_Rx_Indication = FALSE;
                                                  cancelTimer( t_NM_Timeout_Time );
                                                  setTimer( t_NM_Timeout_Time, c_NM_Timeout_Time );
                                                  setTimer( t_NM_Repeat_Message_Time, c_NM_Repeat_Message_Time );
                                                  NM_Transmit_Cycle = NmAsrCanMsgStandardCycle;
                                                  _NM_NetworkMode();
                                                  NM_Mode = cNM_Mode_RepeatMsg;
                                              }
                                              if( NM_Request_State )
                                              {
                                                  setTimer( t_NM_Transmit, 1 );    //send NM-Franme immediately
                                                  NM_Transmit_Cycle = NmAsrCanMsgStandardCycle;
                                                  cancelTimer( t_NM_Timeout_Time );
                                                  setTimer( t_NM_Timeout_Time, c_NM_Timeout_Time );
                                                  setTimer( t_NM_Repeat_Message_Time, c_NM_Repeat_Message_Time );
                                                  NM_Transmit_Cycle = NmAsrCanMsgStandardCycle;
                                                  _NM_NetworkMode();
                                                  NM_Mode = cNM_Mode_RepeatMsg;
                                              }
                                              break;
        case cNM_Mode_Prepare_Bus_Sleep:      if( boCanNM_WaitBusSleep_Timer_Expired == TRUE )
                                              {
                                                  _NM_BusSleepModeInd();   // set message startup delay
                                                  NM_Mode = cNM_Mode_Sleep;
                                                  boCanNM_WaitBusSleep_Timer_Expired = FALSE;
                                              }
                                              if( boCanNM_NM_Timeout_Timer_Expired == TRUE )
                                                  boCanNM_NM_Timeout_Timer_Expired = FALSE;
                                              if( ( boCanNM_Rx_Indication == TRUE ) ||  NM_Request_State )
                                              {
                                                  boCanNM_Rx_Indication = FALSE;
                                                  if( NM_Request_State )
                                                  {
                                                      setTimer( t_NM_Transmit, 1 );    //send NM-Franme immediately
                                                  }
                                                  cancelTimer( t_NM_Timeout_Time );
                                                  setTimer( t_NM_Timeout_Time, c_NM_Timeout_Time );
                                                  setTimer( t_NM_Repeat_Message_Time, c_NM_Repeat_Message_Time );
                                                  _NM_NetworkMode();
                                                  NM_Transmit_Cycle = NmAsrCanMsgStandardCycle;
                                                  NM_Mode = cNM_Mode_RepeatMsg;
                                              }
                                              break;
        case cNM_Mode_Ready_Sleep:            if( boCanNM_Rx_Indication == TRUE )
                                              {
                                                  cancelTimer( t_NM_Timeout_Time );
                                                  setTimer( t_NM_Timeout_Time, c_NM_Timeout_Time );
                                                  boCanNM_Rx_Indication = FALSE;
                                              }
                                              if( boCanNM_Tx_Confirmation == TRUE )
                                              {
                                                  cancelTimer( t_NM_Timeout_Time );
                                                  setTimer( t_NM_Timeout_Time, c_NM_Timeout_Time );
                                                  boCanNM_Tx_Confirmation = FALSE;
                                              }
                                              if( NM_Request_State )
                                              {
                                                  setTimer( t_NM_Transmit, 1 );    //send NM-Franme immediately
                                                  cancelTimer( t_NM_Timeout_Time );
                                                  setTimer( t_NM_Timeout_Time, c_NM_Timeout_Time );
                                                  NM_Transmit_Cycle = NmAsrCanMsgReducedTime;
                                                  NM_Mode = cNM_Mode_Normal_Operation_State;
                                              }
                                              if( boCanNM_RepeatMessage_Requested == TRUE )
                                              {
                                                  setTimer( t_NM_Transmit, NmAsrCanMsgCycleOffset );    // send NM-Frame delayed
                                                  cancelTimer( t_NM_Timeout_Time );
                                                  setTimer( t_NM_Timeout_Time, c_NM_Timeout_Time );
                                                  setTimer( t_NM_Repeat_Message_Time, c_NM_Repeat_Message_Time );
                                                  NM_Transmit_Cycle = NmAsrCanMsgStandardCycle;
                                                  boCanNM_RepeatMessage_Requested = FALSE;
                                                  NM_Mode = cNM_Mode_RepeatMsg;
                                              }
                                              if( boCanNM_NM_Timeout_Timer_Expired == TRUE )
                                              {
                                                  setTimer( t_NM_Wait_Bus_Sleep_Time, c_NM_Wait_Bus_Sleep_Time );
                                                  _NM_PrepareBusSleepModeInd();    // here t_DBKonTimer is stopped
                                                  NM_Mode = cNM_Mode_Prepare_Bus_Sleep;
                                                  boCanNM_NM_Timeout_Timer_Expired = FALSE;
                                              }
                                              break;
        case cNM_Mode_Normal_Operation_State: if( boCanNM_NM_Timeout_Timer_Expired == TRUE )
                                              {
                                                  setTimer( t_NM_Timeout_Time, c_NM_Timeout_Time );
                                                  // _NM_TimeoutExeption();    // no action to be done
                                                  boCanNM_NM_Timeout_Timer_Expired = FALSE;
                                              }
                                              if( boCanNM_Rx_Indication == TRUE )
                                              {
                                                  cancelTimer( t_NM_Timeout_Time );
                                                  setTimer( t_NM_Timeout_Time, c_NM_Timeout_Time );
                                                  cancelTimer( t_NM_Transmit );
                                                  setTimer( t_NM_Transmit, NmAsrCanMsgReducedTime );
                                                  boCanNM_Rx_Indication = FALSE;
                                              }
                                              if( boCanNM_Tx_Confirmation == TRUE )
                                              {
                                                  cancelTimer( t_NM_Timeout_Time );
                                                  setTimer( t_NM_Timeout_Time, c_NM_Timeout_Time );
                                                  cancelTimer( t_NM_Transmit );
                                                  setTimer( t_NM_Transmit, NmAsrCanMsgStandardCycle );
                                                  boCanNM_Tx_Confirmation = FALSE;
                                              }
                                              if( NM_Request_State == 0 )    //no network requested
                                              {
                                                  cancelTimer( t_NM_Transmit );    // stop NM-Franme immediately
                                                  NM_Mode = cNM_Mode_Ready_Sleep;
                                              }
                                              if( boCanNM_RepeatMessage_Requested == TRUE )
                                              {
                                                  setTimer( t_NM_Transmit, NmAsrCanMsgCycleOffset );    // send NM-Frame delayed
                                                  cancelTimer( t_NM_Timeout_Time );
                                                  setTimer( t_NM_Timeout_Time, c_NM_Timeout_Time );
                                                  setTimer( t_NM_Repeat_Message_Time, c_NM_Repeat_Message_Time );
                                                  boCanNM_RepeatMessage_Requested = FALSE;
                                                  NM_Transmit_Cycle = NmAsrCanMsgStandardCycle;
                                                  NM_Mode = cNM_Mode_RepeatMsg;
                                              }
                                              break;
        case cNM_Mode_RepeatMsg:              if( boCanNM_NM_Timeout_Timer_Expired == TRUE )
                                              {
                                                  setTimer( t_NM_Timeout_Time, c_NM_Timeout_Time );
                                                  boCanNM_NM_Timeout_Timer_Expired = FALSE;
                                              }
                                              if( boCanNM_Rx_Indication == TRUE )
                                              {
                                                  cancelTimer( t_NM_Timeout_Time );
                                                  setTimer( t_NM_Timeout_Time, c_NM_Timeout_Time );
                                                  boCanNM_Rx_Indication = FALSE;
                                              }
                                              if( boCanNM_Tx_Confirmation == TRUE )
                                              {
                                                  cancelTimer( t_NM_Timeout_Time );
                                                  setTimer( t_NM_Timeout_Time, c_NM_Timeout_Time );
                                                  boCanNM_Tx_Confirmation = FALSE;
                                              }
                                              if( boCanNM_RepeatMessage_Timer_Expired == TRUE )
                                              {
                                                  boCanNM_RepeatMessage_Timer_Expired = FALSE;
                                                  if( NM_Request_State )
                                                  {
                                                      NM_Mode = cNM_Mode_Normal_Operation_State;
                                                      NM_Transmit_Cycle = NmAsrCanMsgReducedTime;
                                                  }
                                                  else
                                                  {
                                                      cancelTimer( t_NM_Transmit );    // stop NM-Franme immediately
                                                      NM_Mode = cNM_Mode_Ready_Sleep;
                                                  }
                                              }
                                              break;
    }
    if( bOld_NM_Mode != NM_Mode )
    {
        _Nm_StateChangeNotification( bOld_NM_Mode, NM_Mode );    // does the Trace
        putValue( HMI__NM_IC_ActualState, NM_Mode );
    }
}
/*@@end*/

/*@@caplFunc:_NM_Init():*/
_NM_Init()
{
    NM_Transmit_Cycle = NmAsrCanMsgStandardCycle;
}
/*@@end*/

/*@@caplFunc:_NM_NetworkMode():*/
_NM_NetworkMode()
{
    setTimer( t_DBKomTimer_5ms, 1 ); //  ms     start CAN-communication immediately
    setTimer( t_DBKomTimer_20ms, 2 ); //  ms     start CAN-communication immediately
    putValue( HMI__NM_IC_CommActive, 1 );
}
/*@@end*/

/*@@caplFunc:_Nm_BusSleepModeInd():*/
_Nm_BusSleepModeInd()
{
//    _Trace( "_Nm_BusSleepModeInd", "Sleep Mode active");
    __IC_Startup_Delay();
}
/*@@end*/

/*@@caplFunc:_Nm_PrepareBusSleepModeInd():*/
void _Nm_PrepareBusSleepModeInd()
{
//    _Trace( "Nm_PrepareBusSleepModeInd", "Prepare Sleep Mode active");
    putValue( HMI__NM_IC_CommActive, 0 );
    cancelTimer( t_DBKomTimer_5ms );
    cancelTimer( t_DBKomTimer_20ms );
}
/*@@end*/

/*@@caplFunc:_Nm_StateChangeNotification(byte,byte):*/
_Nm_StateChangeNotification( byte previousState, byte currentState )
{
/*
    char line[50];

    snprintf( line, elcount(line ), "Transition from %d to %d", previousState, currentState );
    _Trace( "Nm_StateChangeNotification", "", line );
*/
}
/*@@end*/

/*@@caplFunc:_ReleaseCommRequest(word):*/
_ReleaseCommRequest( word RequestID )
{
    word temp; // actual NM request status

    temp = getValue( HMI__NM_SVS_NM_Request );
    temp &= ~RequestID; // reset NM request 
    putValue( HMI__NM_SVS_NM_Request, temp );
    _NM_Switch_NM_Mode();
}
/*@@end*/

/*@@caplFunc:_SetCommRequest(word):*/
_SetCommRequest( word RequestID )
{
    word temp; // actual NM request status

    temp = getValue( HMI__NM_IC_NM_Request );
    temp |= RequestID; // set NM request 
    putValue( HMI__NM_IC_NM_Request, temp );
    _NM_Switch_NM_Mode();
}
/*@@end*/

/*@@caplFunc:_TraceCall(char[],long):*/
void _TraceCall( char functionName[], long callResult )
{
    char line[100];

    if( callResult == 1 )
        snprintf( line, elcount(line ), "calling %s", functionName );
    else
        snprintf( line, elcount(line ), "call to %s failed - wrong state?", functionName );
    _Trace( "", "", line );
}
/*@@end*/

/*@@caplFunc:_Trace(char[],char[]):*/
void _Trace( char functionName[], char info[])
{
    _Trace( functionName, info, "");
}
/*@@end*/

/*@@caplFunc:_Trace(char[],char[],char[],long):*/
void _Trace( char functionName[], char info[], char verbose[], long argument )
{
    char line[100];

    snprintf( line, elcount(line ), verbose, argument );
    _Trace( functionName, info, line );
}
/*@@end*/

/*@@caplFunc:_Trace(char[],char[],char[]):*/
void _Trace( char functionName[], char info[], char verbose[])
{
  char sep[2] = "/";
  sep[0] = functionName[0] ? '/' : 0;
  if( verbose[0])
  {
    write( "[%.3f]%s%s%s: %s", timeNow()/100000.0, gECU
           , sep
           , functionName
           , verbose
           );
  } else
  {
    write( "[%.3f]%s%s%s: %s", timeNow()/100000.0, gECU
           , sep
           , functionName
           , info
           );
  }
}
/*@@end*/

/*@@caplFunc:___Template_Header():*/
___Template_Header()
{
// #FUNCTIONS#
// #FUNCTIONS_END#
// #TIMERS#
// #TIMERS_END#
// #ENVVARS#
// #ENVVARS_END#
}
/*@@end*/

/*@@envVar:HMI_WarnPrio1_Mute_Rq:*/
on EnvVar HMI_WarnPrio1_Mute_Rq
{
   _mIC_WIM_AR.WarnPrio1_Mute_Rq.phys = getValue(this);
    _IC_WIM_AR_SpontanFlag = 1;
}
/*@@end*/

/*@@envVar:HMI_IC_Msg_Disp_Stat:*/
on EnvVar HMI_IC_Msg_Disp_Stat
{
   _mIC_WIM_AR.IC_Msg_Disp_Stat.phys = getValue(this);
    _IC_WIM_AR_SpontanFlag = 1;
}
/*@@end*/

/*@@envVar:HMI_AcustWarn_Actv_IC:*/
on EnvVar HMI_AcustWarn_Actv_IC
{
   _mIC_WIM_AR.AcustWarn_Actv_IC.phys = getValue(this);
    _IC_WIM_AR_SpontanFlag = 1;
}
/*@@end*/

/*@@caplFunc:TC_Dist_AR_Change(int,int,int):*/
int TC_Dist_AR_Change(int lastValue, int sigValue, int inActValue)
{
    bActiveHelper = (sigValue != inActValue);
      if (!lastValue && bActiveHelper)
        TC_Dist_AR_Activity(1);
      else if (lastValue && !bActiveHelper)
        TC_Dist_AR_Activity(0);
    return bActiveHelper;
}
/*@@end*/

/*@@envVar:HMI_TC_LiquidFuelDist_Reset:*/
on EnvVar HMI_TC_LiquidFuelDist_Reset
{
   _mTC_Dist_AR.TC_LiquidFuelDist_Reset.phys = getValue(this);
}
/*@@end*/

/*@@envVar:HMI_TC_LiquidFuelTankLvl:*/
on EnvVar HMI_TC_LiquidFuelTankLvl
{
   _mTC_Dist_AR.TC_LiquidFuelTankLvl.phys = getValue(this);
}
/*@@end*/

/*@@envVar:HMI_TC_LiquidFuelDist_Start:*/
on EnvVar HMI_TC_LiquidFuelDist_Start
{
   _mTC_Dist_AR.TC_LiquidFuelDist_Start.phys = getValue(this);
}
/*@@end*/

/*@@envVar:HMI_TC_LiquidFuelRefillEvent_Dtct:*/
on EnvVar HMI_TC_LiquidFuelRefillEvent_Dtct
{
   _mTC_Dist_AR.TC_LiquidFuelRefillEvent_Dtct = getValue(this);
}
/*@@end*/

/*@@envVar:HMI_TC_GasFuelDist_Start:*/
on EnvVar HMI_TC_GasFuelDist_Start
{
   _mTC_Dist_AR.TC_GasFuelDist_Start.phys = getValue(this);
}
/*@@end*/

/*@@envVar:HMI_TC_GasFuelTankLvl:*/
on EnvVar HMI_TC_GasFuelTankLvl
{
   _mTC_Dist_AR.TC_GasFuelTankLvl.phys = getValue(this);
}
/*@@end*/

/*@@envVar:HMI_TC_GasFuelDist_Reset:*/
on EnvVar HMI_TC_GasFuelDist_Reset
{
   _mTC_Dist_AR.TC_GasFuelDist_Reset.phys = getValue(this);
}
/*@@end*/

/*@@envVar:HMI_CNG_FuelMdChg_Rq:*/
/*@@end*/

/*@@envVar:HMI_NVP_Disp_Actv:*/
on EnvVar HMI_NVP_Disp_Actv
{
   _mNV_Rq_IC_AR.NVP_Disp_Actv.phys = getValue(this);
}
/*@@end*/

/*@@envVar:HMI_NVP_DispMd:*/
on EnvVar HMI_NVP_DispMd
{
   _mNV_Rq_IC_AR.NVP_DispMd.phys = getValue(this);
}
/*@@end*/

/*@@envVar:HMI_NVP_DispLnk_Stat:*/
on EnvVar HMI_NVP_DispLnk_Stat
{
   _mNV_Rq_IC_AR.NVP_DispLnk_Stat.phys = getValue(this);
}
/*@@end*/

/*@@envVar:HMI_Meas_IC_3H:*/
on EnvVar HMI_Meas_IC_3H
{
    _mMeas_IC_3.Meas_IC_3H.phys = getValue(this);
    _Meas_IC_3_SpontanFlag = 1;
}
/*@@end*/

/*@@envVar:HMI_Meas_IC_3G:*/
on EnvVar HMI_Meas_IC_3G
{
    _mMeas_IC_3.Meas_IC_3G.phys = getValue(this);
    _Meas_IC_3_SpontanFlag = 1;
}
/*@@end*/

/*@@envVar:HMI_Meas_IC_3F:*/
on EnvVar HMI_Meas_IC_3F
{
    _mMeas_IC_3.Meas_IC_3F.phys = getValue(this);
    _Meas_IC_3_SpontanFlag = 1;
}
/*@@end*/

/*@@envVar:HMI_Meas_IC_3E:*/
on EnvVar HMI_Meas_IC_3E
{
    _mMeas_IC_3.Meas_IC_3E.phys = getValue(this);
    _Meas_IC_3_SpontanFlag = 1;
}
/*@@end*/

/*@@envVar:HMI_Meas_IC_3D:*/
on EnvVar HMI_Meas_IC_3D
{
    _mMeas_IC_3.Meas_IC_3D.phys = getValue(this);
    _Meas_IC_3_SpontanFlag = 1;
}
/*@@end*/

/*@@envVar:HMI_Meas_IC_3C:*/
on EnvVar HMI_Meas_IC_3C
{
    _mMeas_IC_3.Meas_IC_3C.phys = getValue(this);
    _Meas_IC_3_SpontanFlag = 1;
}
/*@@end*/

/*@@envVar:HMI_Meas_IC_3B:*/
on EnvVar HMI_Meas_IC_3B
{
    _mMeas_IC_3.Meas_IC_3B.phys = getValue(this);
    _Meas_IC_3_SpontanFlag = 1;
}
/*@@end*/

/*@@envVar:HMI_Meas_IC_3A:*/
on EnvVar HMI_Meas_IC_3A
{
    _mMeas_IC_3.Meas_IC_3A.phys = getValue(this);
    _Meas_IC_3_SpontanFlag = 1;
}
/*@@end*/

/*@@envVar:HMI_Meas_IC_2H:*/
on EnvVar HMI_Meas_IC_2H
{
    _mMeas_IC_2.Meas_IC_2H.phys = getValue(this);
    _Meas_IC_2_SpontanFlag = 1;
}
/*@@end*/

/*@@envVar:HMI_Meas_IC_2G:*/
on EnvVar HMI_Meas_IC_2G
{
    _mMeas_IC_2.Meas_IC_2G.phys = getValue(this);
    _Meas_IC_2_SpontanFlag = 1;
}
/*@@end*/

/*@@envVar:HMI_Meas_IC_2F:*/
on EnvVar HMI_Meas_IC_2F
{
    _mMeas_IC_2.Meas_IC_2F.phys = getValue(this);
    _Meas_IC_2_SpontanFlag = 1;
}
/*@@end*/

/*@@envVar:HMI_Meas_IC_2E:*/
on EnvVar HMI_Meas_IC_2E
{
    _mMeas_IC_2.Meas_IC_2E.phys = getValue(this);
    _Meas_IC_2_SpontanFlag = 1;
}
/*@@end*/

/*@@envVar:HMI_Meas_IC_2D:*/
on EnvVar HMI_Meas_IC_2D
{
    _mMeas_IC_2.Meas_IC_2D.phys = getValue(this);
    _Meas_IC_2_SpontanFlag = 1;
}
/*@@end*/

/*@@envVar:HMI_Meas_IC_2C:*/
on EnvVar HMI_Meas_IC_2C
{
    _mMeas_IC_2.Meas_IC_2C.phys = getValue(this);
    _Meas_IC_2_SpontanFlag = 1;
}
/*@@end*/

/*@@envVar:HMI_Meas_IC_2B:*/
on EnvVar HMI_Meas_IC_2B
{
    _mMeas_IC_2.Meas_IC_2B.phys = getValue(this);
    _Meas_IC_2_SpontanFlag = 1;
}
/*@@end*/

/*@@envVar:HMI_Meas_IC_2A:*/
on EnvVar HMI_Meas_IC_2A
{
    _mMeas_IC_2.Meas_IC_2A.phys = getValue(this);
    _Meas_IC_2_SpontanFlag = 1;
}
/*@@end*/

/*@@envVar:HMI_Meas_IC_4H:*/
on EnvVar HMI_Meas_IC_4H
{
    _mMeas_IC_4.Meas_IC_4H.phys = getValue(this);
    _Meas_IC_4_SpontanFlag = 1;
}
/*@@end*/

/*@@envVar:HMI_Meas_IC_4G:*/
on EnvVar HMI_Meas_IC_4G
{
    _mMeas_IC_4.Meas_IC_4G.phys = getValue(this);
    _Meas_IC_4_SpontanFlag = 1;
}
/*@@end*/

/*@@envVar:HMI_Meas_IC_4F:*/
on EnvVar HMI_Meas_IC_4F
{
    _mMeas_IC_4.Meas_IC_4F.phys = getValue(this);
    _Meas_IC_4_SpontanFlag = 1;
}
/*@@end*/

/*@@envVar:HMI_Meas_IC_4E:*/
on EnvVar HMI_Meas_IC_4E
{
    _mMeas_IC_4.Meas_IC_4E.phys = getValue(this);
    _Meas_IC_4_SpontanFlag = 1;
}
/*@@end*/

/*@@envVar:HMI_Meas_IC_4D:*/
on EnvVar HMI_Meas_IC_4D
{
    _mMeas_IC_4.Meas_IC_4D.phys = getValue(this);
    _Meas_IC_4_SpontanFlag = 1;
}
/*@@end*/

/*@@envVar:HMI_Meas_IC_4C:*/
on EnvVar HMI_Meas_IC_4C
{

   _mMeas_IC_4.Meas_IC_4C.phys = getValue(this);
    _Meas_IC_4_SpontanFlag = 1;
}
/*@@end*/

/*@@envVar:HMI_Meas_IC_4B:*/
on EnvVar HMI_Meas_IC_4B
{
    _mMeas_IC_4.Meas_IC_4B.phys = getValue(this);
    _Meas_IC_4_SpontanFlag = 1;
}
/*@@end*/

/*@@envVar:HMI_Meas_IC_4A:*/
on EnvVar HMI_Meas_IC_4A
{
    _mMeas_IC_4.Meas_IC_4A.phys = getValue(this);
    _Meas_IC_4_SpontanFlag = 1;
}
/*@@end*/

/*@@envVar:HMI_Meas_IC_1H:*/
on EnvVar HMI_Meas_IC_1H
{
    _mMeas_IC_1.Meas_IC_1H.phys = getValue(this);
    _Meas_IC_1_SpontanFlag = 1;
}
/*@@end*/

/*@@envVar:HMI_Meas_IC_1G:*/
on EnvVar HMI_Meas_IC_1G
{
    _mMeas_IC_1.Meas_IC_1G.phys = getValue(this);
    _Meas_IC_1_SpontanFlag = 1;
}
/*@@end*/

/*@@envVar:HMI_Meas_IC_1F:*/
on EnvVar HMI_Meas_IC_1F
{
    _mMeas_IC_1.Meas_IC_1F.phys = getValue(this);
    _Meas_IC_1_SpontanFlag = 1;
}
/*@@end*/

/*@@envVar:HMI_Meas_IC_1E:*/
on EnvVar HMI_Meas_IC_1E
{
    _mMeas_IC_1.Meas_IC_1E.phys = getValue(this);
    _Meas_IC_1_SpontanFlag = 1;
}
/*@@end*/

/*@@envVar:HMI_Meas_IC_1D:*/
on EnvVar HMI_Meas_IC_1D
{
    _mMeas_IC_1.Meas_IC_1D.phys = getValue(this);
    _Meas_IC_1_SpontanFlag = 1;
}
/*@@end*/

/*@@envVar:HMI_Meas_IC_1C:*/
on EnvVar HMI_Meas_IC_1C
{
    _mMeas_IC_1.Meas_IC_1C.phys = getValue(this);
    _Meas_IC_1_SpontanFlag = 1;
}
/*@@end*/

/*@@envVar:HMI_Meas_IC_1B:*/
on EnvVar HMI_Meas_IC_1B
{
    _mMeas_IC_1.Meas_IC_1B.phys = getValue(this);
    _Meas_IC_1_SpontanFlag = 1;
}
/*@@end*/

/*@@envVar:HMI_Meas_IC_1A:*/
on EnvVar HMI_Meas_IC_1A
{
    _mMeas_IC_1.Meas_IC_1A.phys = getValue(this);
    _Meas_IC_1_SpontanFlag = 1;
}
/*@@end*/

/*@@envVar:HMI_Assyst_VehHndOvr_Trgr:*/
on EnvVar HMI_Assyst_VehHndOvr_Trgr
{
    _mAssyst_Rq_AR.Assyst_VehHndOvr_Trgr.phys = getValue(this);
    _Assyst_Rq_AR_SpontanFlag = 1;
}
/*@@end*/

/*@@envVar:HMI_Assyst_SpServConf_Stat:*/
on EnvVar HMI_Assyst_SpServConf_Stat
{
    _mAssyst_Rq_AR.Assyst_SpServConf_Stat.phys = getValue(this);
    _Assyst_Rq_AR_SpontanFlag = 1;
}
/*@@end*/

/*@@envVar:HMI_TC_Rst_ElectRange_IC:*/
on EnvVar HMI_TC_Rst_ElectRange_ICt
{
    _mAssyst_Rq_AR.TC_Rst_ElectRange_IC.phys = getValue(this);
    _Assyst_Rq_AR_SpontanFlag = 1;
}
/*@@end*/

/*@@envVar:HMI_Assyst_SP3Serv_Trgr:*/
on EnvVar HMI_Assyst_SP3Serv_Trgr
{
   _mAssyst_Rq_AR.Assyst_SP3Serv_Trgr.phys = getValue(this);
    _Assyst_Rq_AR_SpontanFlag = 1;
}
/*@@end*/

/*@@envVar:HMI_Assyst_OilQuantMeas_Trgr:*/
on EnvVar HMI_Assyst_OilQuantMeas_Trgr
{
   _mAssyst_Rq_AR.Assyst_OilQuantMeas_Trgr.phys = getValue(this);
    _Assyst_Rq_AR_SpontanFlag = 1;
}
/*@@end*/

/*@@envVar:HMI_Assyst_CurrOilQual_Para_V2:*/
on EnvVar HMI_Assyst_CurrOilQual_Para_V2
{
   _mAssyst_Rq_AR.Assyst_CurrOilQual_Para_V2.phys = getValue(this);
    _Assyst_Rq_AR_SpontanFlag = 1;
}
/*@@end*/

/*@@envVar:HMI_Assyst_Can_SPServ:*/
on EnvVar HMI_Assyst_Can_SPServ
{
   _mAssyst_Rq_AR.Assyst_Can_SPServ.phys = getValue(this);
    _Assyst_Rq_AR_SpontanFlag = 1;
}
/*@@end*/

/*@@caplFunc:TP_IC_MPM_getValue():*/
void TP_IC_MPM_getValue(void)
{
 /*   _mTP_IC_MPM.byte(0) = getValue( HMI_TP_IC_MPM_0 );
    _mTP_IC_MPM.byte(1) = getValue( HMI_TP_IC_MPM_1 );
    _mTP_IC_MPM.byte(2) = getValue( HMI_TP_IC_MPM_2 );
    _mTP_IC_MPM.byte(3) = getValue( HMI_TP_IC_MPM_3 );
    _mTP_IC_MPM.byte(4) = getValue( HMI_TP_IC_MPM_4 );
    _mTP_IC_MPM.byte(5) = getValue( HMI_TP_IC_MPM_5 );
    _mTP_IC_MPM.byte(6) = getValue( HMI_TP_IC_MPM_6 );
    _mTP_IC_MPM.byte(7) = getValue( HMI_TP_IC_MPM_7 );*/
}
/*@@end*/

/*@@caplFunc:TPA_IC_PARK_TPA_IC_PARK_getValue():*/
/*void TPA_IC_PARK_getValue(void)
{
    _mTPA_IC_PARK.byte(0) = getValue(HMI_TPA_IC_PARK_0);
    _mTPA_IC_PARK.byte(1) = getValue(HMI_TPA_IC_PARK_1);
    _mTPA_IC_PARK.byte(2) = getValue(HMI_TPA_IC_PARK_2);
    _mTPA_IC_PARK.byte(3) = getValue(HMI_TPA_IC_PARK_3);
    _mTPA_IC_PARK.byte(4) = getValue(HMI_TPA_IC_PARK_4);
    _mTPA_IC_PARK.byte(5) = getValue(HMI_TPA_IC_PARK_5);
    _mTPA_IC_PARK.byte(6) = getValue(HMI_TPA_IC_PARK_6);
    _mTPA_IC_PARK.byte(7) = getValue(HMI_TPA_IC_PARK_7);
}*/
/*@@end*/

/*@@caplFunc:DIAG_RS_IC_DIAG_RS_IC_getValue():*/
/*void DIAG_RS_IC_DIAG_RS_IC_getValue(void)
{
    _mDIAG_RS_IC.byte(0) = getValue(HMI_DIAG_RS_IC_0);
    _mDIAG_RS_IC.byte(1) = getValue(HMI_DIAG_RS_IC_1);
    _mDIAG_RS_IC.byte(2) = getValue(HMI_DIAG_RS_IC_2);
    _mDIAG_RS_IC.byte(3) = getValue(HMI_DIAG_RS_IC_3);
    _mDIAG_RS_IC.byte(4) = getValue(HMI_DIAG_RS_IC_4);
    _mDIAG_RS_IC.byte(5) = getValue(HMI_DIAG_RS_IC_5);
    _mDIAG_RS_IC.byte(6) = getValue(HMI_DIAG_RS_IC_6);
    _mDIAG_RS_IC.byte(7) = getValue(HMI_DIAG_RS_IC_7);
}*/
/*@@end*/

/*@@envVar:HMI_UnitTemp_Rq:*/
on EnvVar HMI_UnitTemp_Rq
{
   _mIC_Settings_AR.UnitTemp_Rq.phys = getValue(this);
    _IC_Settings_AR_SpontanFlag = 1;
}
/*@@end*/

/*@@envVar:HMI_UnitPress_Rq:*/
on EnvVar HMI_UnitPress_Rq
{
   _mIC_Settings_AR.UnitPress_Rq.phys = getValue(this);
    _IC_Settings_AR_SpontanFlag = 1;
}
/*@@end*/

/*@@envVar:HMI_Pers_ActvSlotId_Rq:*/
on EnvVar HMI_Pers_ActvSlotId_Rq 
{
   _mIC_Settings_AR.Pers_ActvSlotId_Rq.phys = getValue(this);
    _IC_Settings_AR_SpontanFlag = 1;
}
/*@@end*/

/*@@envVar:HMI_RepairshopMode_Actv:*/
on EnvVar HMI_RepairshopMode_Actv
{
   _mIC_Settings_AR.RepairshopMode_Actv.phys = getValue(this);
    _IC_Settings_AR_SpontanFlag = 1;
}
/*@@end*/

/*@@envVar:HMI_SAplus_SDTR_Md_Stat_IC:*/
on EnvVar HMI_SAplus_SDTR_Md_Stat_IC
{
   _mIC_Settings_AR.SAplus_SDTR_Md_Stat_IC.phys = getValue(this);
    _IC_Settings_AR_SpontanFlag = 1;
}
/*@@end*/

/*@@envVar:HMI_SAplus_TSA_Md_Stat_IC:*/
on EnvVar HMI_SAplus_TSA_Md_Stat_IC
{
   _mIC_Settings_AR.SAplus_TSA_Md_Stat_IC.phys = getValue(this);
    _IC_Settings_AR_SpontanFlag = 1;
}
/*@@end*/

/*@@envVar:HMI_TaxiToneMd_Rq:*/
/*@@end*/

/*@@envVar:HMI_TaxiRoofLmpMd_Rq:*/
/*@@end*/

/*@@envVar:HMI_TaxiMd_Rq:*/
/*@@end*/

/*@@envVar:HMI_TPM_Actv_Rq_V2:*/
on EnvVar HMI_TPM_Actv_Rq_V2
{
   _mIC_Settings_AR.TPM_Actv_Rq_V2.phys = getValue(this);
    _IC_Settings_AR_SpontanFlag = 1;
}
/*@@end*/

/*@@envVar:HMI_SLA_SpdOffset_Rq_D_Val:*/
on EnvVar HMI_SLA_SpdOffset_Rq_D_Val
{
   _mIC_Settings_AR.SLA_SpdOffset_Rq_D_Val.phys = getValue(this);
    _IC_Settings_AR_SpontanFlag = 1;
}
/*@@end*/

/*@@envVar:HMI_SLA_SpdOffset_Rq_D_Unit:*/
on EnvVar HMI_SLA_SpdOffset_Rq_D_Unit
{
   _mIC_Settings_AR.SLA_SpdOffset_Rq_D_Unit.phys = getValue(this);
    _IC_Settings_AR_SpontanFlag = 1;
}
/*@@end*/

/*@@envVar:HMI_ILS_TouristMd_Rq:*/
/*@@end*/

/*@@envVar:HMI_IHC_Md_Rq:*/
on EnvVar HMI_IHC_Md_Rq
{
   _mIC_Settings_AR.IHC_Md_Rq.phys = getValue(this);
    _IC_Settings_AR_SpontanFlag = 1;
}
/*@@end*/

/*@@envVar:HMI_FTW_On_Rq:*/
on EnvVar HMI_FTW_On_Rq
{
   _mIC_Settings_AR.FTW_On_Rq.phys = getValue(this);
    _IC_Settings_AR_SpontanFlag = 1;
}
/*@@end*/

/*@@envVar:HMI_CPD_UsrActn_Rq:*/
on EnvVar HMI_CPD_UsrActn_Rq
{
   _mIC_Settings_AR.CPD_UsrActn_Rq.phys = getValue(this);
    _IC_Settings_AR_SpontanFlag = 1;
}
/*@@end*/

/*@@envVar:HMI_DRLt_On_Rq:*/
/*@@end*/

/*@@envVar:HMI_BSM_Md_Rq:*/
/*@@end*/

/*@@envVar:HMI_ALDW_Md_Rq:*/
/*@@end*/

/*@@envVar:HMI_AFS_Md_Rq:*/
/*@@end*/

/*@@envVar:HMI_ServCode_Country_V2:*/
on EnvVar HMI_ServCode_Country_V2
{
   _mMaintenance2_AR.ServCode_Country_V2.phys = getValue(this);
}
/*@@end*/

/*@@envVar:HMI_ServCode_CRC_Lo:*/
on EnvVar HMI_ServCode_CRC_Lo
{
   _mMaintenance2_AR.ServCode_CRC_Lo.phys = getValue(this);
}
/*@@end*/

/*@@envVar:HMI_ServCode_CRC_Hi:*/
on EnvVar HMI_ServCode_CRC_Hi
{
   _mMaintenance2_AR.ServCode_CRC_Hi.phys = getValue(this);
}
/*@@end*/

/*@@envVar:HMI_ServCode_BitGrp_minus3:*/
on EnvVar HMI_ServCode_BitGrp_minus3
{
   _mMaintenance2_AR.ServCode_BitGrp_minus3.phys = getValue(this);
}
/*@@end*/

/*@@envVar:HMI_ServCode_BitGrp_minus2:*/
on EnvVar HMI_ServCode_BitGrp_minus2
{
   _mMaintenance2_AR.ServCode_BitGrp_minus2.phys = getValue(this);
}
/*@@end*/

/*@@envVar:HMI_ServCode_BitGrp_minus1:*/
on EnvVar HMI_ServCode_BitGrp_minus1
{
   _mMaintenance2_AR.ServCode_BitGrp_minus1.phys = getValue(this);
}
/*@@end*/

/*@@envVar:HMI_ServCode_BitGrp_6:*/
on EnvVar HMI_ServCode_BitGrp_6
{
   _mMaintenance2_AR.ServCode_BitGrp_6.phys = getValue(this);
}
/*@@end*/

/*@@envVar:HMI_ServCode_BitGrp_5:*/
on EnvVar HMI_ServCode_BitGrp_5
{
   _mMaintenance2_AR.ServCode_BitGrp_5.phys = getValue(this);
}
/*@@end*/

/*@@envVar:HMI_ServCode_BitGrp_4:*/
on EnvVar HMI_ServCode_BitGrp_4
{
   _mMaintenance2_AR.ServCode_BitGrp_4.phys = getValue(this);
}
/*@@end*/

/*@@envVar:HMI_ServCode_BitGrp_3:*/
on EnvVar HMI_ServCode_BitGrp_3
{
   _mMaintenance2_AR.ServCode_BitGrp_3.phys = getValue(this);
}
/*@@end*/

/*@@envVar:HMI_ServCode_BitGrp_2:*/
on EnvVar HMI_ServCode_BitGrp_2
{
   _mMaintenance2_AR.ServCode_BitGrp_2.phys = getValue(this);
}
/*@@end*/

/*@@envVar:HMI_ServCode_BitGrp_1:*/
on EnvVar HMI_ServCode_BitGrp_1
{
   _mMaintenance2_AR.ServCode_BitGrp_1.phys = getValue(this);
}
/*@@end*/

/*@@envVar:HMI_ServCode_BitGrp_0:*/
on EnvVar HMI_ServCode_BitGrp_0
{
   _mMaintenance2_AR.ServCode_BitGrp_0.phys = getValue(this);
}
/*@@end*/

/*@@envVar:HMI_Unit_ResDist:*/
on EnvVar HMI_Unit_ResDist
{
   _mMaintenance1_AR.Unit_ResDist.phys = getValue(this);
}
/*@@end*/

/*@@envVar:HMI_SpecServ_Disp_Rq:*/
on EnvVar HMI_SpecServ_Disp_Rq
{
   _mMaintenance1_AR.SpecServ_Disp_Rq.phys = getValue(this);
}
/*@@end*/

/*@@envVar:HMI_ServWarn:*/
on EnvVar HMI_ServWarn
{
   _mMaintenance1_AR.ServWarn.phys = getValue(this);
}
/*@@end*/

/*@@envVar:HMI_ServDispMd:*/
on EnvVar HMI_ServDispMd
{
   _mMaintenance1_AR.ServDispMd.phys = getValue(this);
}
/*@@end*/

/*@@envVar:HMI_ServCont:*/
on EnvVar HMI_ServCont
{
   _mMaintenance1_AR.ServCont.phys = getValue(this);
}
/*@@end*/

/*@@envVar:HMI_ResTm_V2:*/
on EnvVar HMI_ResTm_V2
{
   _mMaintenance1_AR.ResTm_V2.phys = getValue(this);
}
/*@@end*/

/*@@envVar:HMI_ResDist:*/
on EnvVar HMI_ResDist
{
   _mMaintenance1_AR.ResDist.phys = getValue(this);
}
/*@@end*/

/*@@envVar:HMI_Prio_ResDistTm:*/
on EnvVar HMI_Prio_ResDistTm
{
   _mMaintenance1_AR.Prio_ResDistTm.phys = getValue(this);
}
/*@@end*/

/*@@envVar:HMI_MtPckt_7_Due:*/
on EnvVar HMI_MtPckt_7_Due
{
   _mMaintenance1_AR.MtPckt_7_Due.phys = getValue(this);
}
/*@@end*/

/*@@envVar:HMI_MtPckt_6_Due:*/
on EnvVar HMI_MtPckt_6_Due
{
   _mMaintenance1_AR.MtPckt_6_Due.phys = getValue(this);
}
/*@@end*/

/*@@envVar:HMI_MtPckt_5_Due:*/
on EnvVar HMI_MtPckt_5_Due
{
   _mMaintenance1_AR.MtPckt_5_Due.phys = getValue(this);
}
/*@@end*/

/*@@envVar:HMI_MtPckt_4_Due:*/
on EnvVar HMI_MtPckt_4_Due
{
   _mMaintenance1_AR.MtPckt_4_Due.phys = getValue(this);
}
/*@@end*/

/*@@envVar:HMI_MtPckt_3_Due:*/
on EnvVar HMI_MtPckt_3_Due
{
   _mMaintenance1_AR.MtPckt_3_Due.phys = getValue(this);
}
/*@@end*/

/*@@envVar:HMI_MtPckt_2_Due:*/
on EnvVar HMI_MtPckt_2_Due
{
   _mMaintenance1_AR.MtPckt_2_Due.phys = getValue(this);
}
/*@@end*/

/*@@envVar:HMI_MtPckt_1_Due:*/
on EnvVar HMI_MtPckt_1_Due
{
   _mMaintenance1_AR.MtPckt_1_Due.phys = getValue(this);
}
/*@@end*/

/*@@envVar:HMI_MtData_Ok:*/
on EnvVar HMI_MtData_Ok
{
   _mMaintenance1_AR.MtData_Ok.phys = getValue(this);
}
/*@@end*/

/*@@envVar:HMI_TmFormat_IC:*/
/*@@end*/

/*@@envVar:HMI_ICH_HtVn_Rq_IC:*/
on EnvVar HMI_ICH_HtVn_Rq_IC
{
   _mIC_Date_Time_AR.ICH_HtVn_Rq_IC.phys = getValue(this);
}
/*@@end*/

/*@@envVar:HMI_ICH_Dur_Rq:*/
on EnvVar HMI_ICH_Dur_Rq
{
   _mIC_Date_Time_AR.ICH_Dur_Rq.phys = getValue(this);
}
/*@@end*/

/*@@envVar:HMI_DateTmStat:*/
on EnvVar HMI_DateTmStat
{
   _mIC_Date_Time_AR.DateTmStat.phys = getValue(this);
}
/*@@end*/

/*@@envVar:HMI_DateTmYear:*/
on EnvVar HMI_DateTmYear
{
   _mIC_Date_Time_AR.DateTmYear.phys = getValue(this);
}
/*@@end*/

/*@@envVar:HMI_DateTmSecond:*/
on EnvVar HMI_DateTmSecond
{
   _mIC_Date_Time_AR.DateTmSecond.phys = getValue(this);
}
/*@@end*/

/*@@envVar:HMI_DateTmMonth:*/
on EnvVar HMI_DateTmMonth
{
   _mIC_Date_Time_AR.DateTmMonth.phys = getValue(this);
}
/*@@end*/

/*@@envVar:HMI_DateTmMinute:*/
on EnvVar HMI_DateTmMinute
{
   _mIC_Date_Time_AR.DateTmMinute.phys = getValue(this);
    _IC_Date_Time_AR_SpontanFlag = 1;
}
/*@@end*/

/*@@envVar:HMI_DateTmHour:*/
on EnvVar HMI_DateTmHour
{
   _mIC_Date_Time_AR.DateTmHour.phys = getValue(this);
}
/*@@end*/

/*@@envVar:HMI_DateTmDay:*/
on EnvVar HMI_DateTmDay
{
   _mIC_Date_Time_AR.DateTmDay.phys = getValue(this);
}
/*@@end*/

/*@@envVar:HMI_VehSpd_Disp:*/
on EnvVar HMI_VehSpd_Disp
{
   _mIC_BasicInfo_AR.VehSpd_Disp.phys = getValue(this);
    _IC_BasicInfo_AR_SpontanFlag = 1;
}
/*@@end*/

/*@@envVar:HMI_AAS4_DrowWarnDisp_Stat:*/
on EnvVar HMI_AAS4_DrowWarnDisp_Stat
{
   _mIC_BasicInfo_AR.AAS4_DrowWarnDisp_Stat.phys = getValue(this);
    _IC_BasicInfo_AR_SpontanFlag = 1;
}
/*@@end*/

/*@@envVar:HMI_AAS4_DstrctWarn_DispStat:*/
on EnvVar HMI_AAS4_DstrctWarn_DispStat
{
   _mIC_BasicInfo_AR.AAS4_DstrctWarn_DispStat.phys = getValue(this);
    _IC_BasicInfo_AR_SpontanFlag = 1;
}
/*@@end*/

/*@@envVar:HMI_UnitVehSpd:*/
on EnvVar HMI_UnitVehSpd
{
   _mIC_BasicInfo_AR.UnitVehSpd.phys = getValue(this);
}
/*@@end*/

/*@@envVar:HMI_Odo:*/
on EnvVar HMI_Odo
{
   _mIC_BasicInfo_AR.Odo.phys = getValue(this);
}
/*@@end*/

/*@@envVar:HMI_IC_TP_Alive:*/
on EnvVar HMI_IC_TP_Alive
{

   _mIC_BasicInfo_AR.IC_TP_Alive.phys = getValue(this);
}
/*@@end*/

/*@@envVar:HMI_HVAC_Vprzr_DryVnTmr_Stat:*/
on EnvVar HMI_HVAC_Vprzr_DryVnTmr_Stat
{
   _mIC_BasicInfo2_AR.HVAC_Vprzr_DryVnTmr_Stat.phys = getValue(this);
//    _IC_BasicInfo2_AR_SpontanFlag = 1;
}
/*@@end*/

/*@@envVar:HMI_AirTemp_Outsd_Disp:*/
on EnvVar HMI_AirTemp_Outsd_Disp
{

   _mIC_BasicInfo_AR.AirTemp_Outsd_Disp.phys = getValue(this);
}
/*@@end*/

/*@@envVar:HMI_SwIllLvl:*/
on EnvVar HMI_SwIllLvl
{
   _mDimming_Stat_AR.SwIllLvl.phys = getValue(this);
    _Dimming_Stat_AR_SpontanFlag = 1;
}
/*@@end*/

/*@@envVar:HMI_SwIll_NightDay:*/
on EnvVar HMI_SwIll_NightDay
{
   _mDimming_Stat_AR.SwIll_NightDay.phys = getValue(this);
    _Dimming_Stat_AR_SpontanFlag = 1;
}
/*@@end*/

/*@@envVar:HMI_DispBrt_IC:*/
on EnvVar HMI_DispBrt_IC
{
   _mDimming_Stat_AR.DispBrt_IC.phys = getValue(this);
    _Dimming_Stat_AR_SpontanFlag = 1;
}
/*@@end*/

/*@@envVar:HMI_ExtFanTempIC_State:*/
/*@@end*/

/*@@envVar:HMI_DayCnt:*/
on EnvVar HMI_DayCnt
{
   _mIC_BasicInfo2_AR.DayCnt.phys = getValue(this);
}
/*@@end*/

/*@@envVar:HMI_TP_IC_TGW_Tel_0:*/
on EnvVar HMI_TP_IC_TGW_Tel_0
{
    TP_IC_TGW_Tel_getValue();
}
/*@@end*/

/*@@envVar:HMI_TP_IC_TGW_Tel_1:*/
on EnvVar HMI_TP_IC_TGW_Tel_1
{
    TP_IC_TGW_Tel_getValue();
}
/*@@end*/

/*@@envVar:HMI_TP_IC_TGW_Tel_2:*/
on EnvVar HMI_TP_IC_TGW_Tel_2
{
    TP_IC_TGW_Tel_getValue();
}
/*@@end*/

/*@@envVar:HMI_TP_IC_TGW_Tel_3:*/
on EnvVar HMI_TP_IC_TGW_Tel_3
{
    TP_IC_TGW_Tel_getValue();
}
/*@@end*/

/*@@envVar:HMI_TP_IC_TGW_Tel_4:*/
on EnvVar HMI_TP_IC_TGW_Tel_4
{
    TP_IC_TGW_Tel_getValue();
}
/*@@end*/

/*@@envVar:HMI_TP_IC_TGW_Tel_5:*/
on EnvVar HMI_TP_IC_TGW_Tel_5
{
    TP_IC_TGW_Tel_getValue();
}
/*@@end*/

/*@@envVar:HMI_TP_IC_TGW_Tel_6:*/
on EnvVar HMI_TP_IC_TGW_Tel_6
{
    TP_IC_TGW_Tel_getValue();
}
/*@@end*/

/*@@envVar:HMI_TP_IC_TGW_Tel_7:*/
on EnvVar HMI_TP_IC_TGW_Tel_7
{
    TP_IC_TGW_Tel_getValue();
}
/*@@end*/

/*@@caplFunc:TP_IC_TGW_Tel_getValue():*/
void TP_IC_TGW_Tel_getValue(void)
{
    _mTP_IC_TGW_Tel.byte(0) = getValue( HMI_TP_IC_TGW_Tel_0 );
    _mTP_IC_TGW_Tel.byte(1) = getValue( HMI_TP_IC_TGW_Tel_1 );
    _mTP_IC_TGW_Tel.byte(2) = getValue( HMI_TP_IC_TGW_Tel_2 );
    _mTP_IC_TGW_Tel.byte(3) = getValue( HMI_TP_IC_TGW_Tel_3 );
    _mTP_IC_TGW_Tel.byte(4) = getValue( HMI_TP_IC_TGW_Tel_4 );
    _mTP_IC_TGW_Tel.byte(5) = getValue( HMI_TP_IC_TGW_Tel_5 );
    _mTP_IC_TGW_Tel.byte(6) = getValue( HMI_TP_IC_TGW_Tel_6 );
    _mTP_IC_TGW_Tel.byte(7) = getValue( HMI_TP_IC_TGW_Tel_7 );
}
/*@@end*/

/*@@envVar:HMI_TP_IC_TGW_Nav_0:*/
on EnvVar HMI_TP_IC_TGW_Nav_0
{
    TP_IC_TGW_Nav_getValue();
}
/*@@end*/

/*@@envVar:HMI_TP_IC_TGW_Nav_1:*/
on EnvVar HMI_TP_IC_TGW_Nav_1
{
    TP_IC_TGW_Nav_getValue();
}
/*@@end*/

/*@@envVar:HMI_TP_IC_TGW_Nav_2:*/
on EnvVar HMI_TP_IC_TGW_Nav_2
{
    TP_IC_TGW_Nav_getValue();
}
/*@@end*/

/*@@envVar:HMI_TP_IC_TGW_Nav_3:*/
on EnvVar HMI_TP_IC_TGW_Nav_3
{
    TP_IC_TGW_Nav_getValue();
}
/*@@end*/

/*@@envVar:HMI_TP_IC_TGW_Nav_4:*/
on EnvVar HMI_TP_IC_TGW_Nav_4
{
    TP_IC_TGW_Nav_getValue();
}
/*@@end*/

/*@@envVar:HMI_TP_IC_TGW_Nav_5:*/
on EnvVar HMI_TP_IC_TGW_Nav_5
{
    TP_IC_TGW_Nav_getValue();
}
/*@@end*/

/*@@envVar:HMI_TP_IC_TGW_Nav_6:*/
on EnvVar HMI_TP_IC_TGW_Nav_6
{
    TP_IC_TGW_Nav_getValue();
}
/*@@end*/

/*@@envVar:HMI_TP_IC_TGW_Nav_7:*/
on EnvVar HMI_TP_IC_TGW_Nav_7
{
    TP_IC_TGW_Nav_getValue();
}
/*@@end*/

/*@@caplFunc:TP_IC_TGW_Nav_getValue():*/
void TP_IC_TGW_Nav_getValue(void)
{
    _mTP_IC_TGW_Nav.byte(0) = getValue( HMI_TP_IC_TGW_Nav_0 );
    _mTP_IC_TGW_Nav.byte(1) = getValue( HMI_TP_IC_TGW_Nav_1 );
    _mTP_IC_TGW_Nav.byte(2) = getValue( HMI_TP_IC_TGW_Nav_2 );
    _mTP_IC_TGW_Nav.byte(3) = getValue( HMI_TP_IC_TGW_Nav_3 );
    _mTP_IC_TGW_Nav.byte(4) = getValue( HMI_TP_IC_TGW_Nav_4 );
    _mTP_IC_TGW_Nav.byte(5) = getValue( HMI_TP_IC_TGW_Nav_5 );
    _mTP_IC_TGW_Nav.byte(6) = getValue( HMI_TP_IC_TGW_Nav_6 );
    _mTP_IC_TGW_Nav.byte(7) = getValue( HMI_TP_IC_TGW_Nav_7 );
}
/*@@end*/

/*@@envVar:HMI_Odo_IC:*/
on EnvVar HMI_Odo_IC
{

   _mIC_Immobilizer_AR.Odo_IC.phys = getValue(this);
}
/*@@end*/

/*@@envVar:HMI_KeyId_IC_V2:*/
on EnvVar HMI_KeyId_IC_V2
{

   _mIC_Immobilizer_AR.KeyId_IC_V2.phys = getValue(this);
    _IC_Immobilizer_AR_SpontanFlag = 1;
}
/*@@end*/

/*@@envVar:HMI_TP_IC_TGW_Aud_0:*/
on EnvVar HMI_TP_IC_TGW_Aud_0
{

    TP_IC_TGW_Aud_getValue();
}
/*@@end*/

/*@@envVar:HMI_TP_IC_TGW_Aud_1:*/
on EnvVar HMI_TP_IC_TGW_Aud_1
{

    TP_IC_TGW_Aud_getValue();
}
/*@@end*/

/*@@envVar:HMI_TP_IC_TGW_Aud_2:*/
on EnvVar HMI_TP_IC_TGW_Aud_2
{

    TP_IC_TGW_Aud_getValue();
}
/*@@end*/

/*@@envVar:HMI_TP_IC_TGW_Aud_3:*/
on EnvVar HMI_TP_IC_TGW_Aud_3
{

    TP_IC_TGW_Aud_getValue();
}
/*@@end*/

/*@@envVar:HMI_TP_IC_TGW_Aud_4:*/
on EnvVar HMI_TP_IC_TGW_Aud_4
{

    TP_IC_TGW_Aud_getValue();
}
/*@@end*/

/*@@envVar:HMI_TP_IC_TGW_Aud_5:*/
on EnvVar HMI_TP_IC_TGW_Aud_5
{

    TP_IC_TGW_Aud_getValue();
}
/*@@end*/

/*@@envVar:HMI_TP_IC_TGW_Aud_6:*/
on EnvVar HMI_TP_IC_TGW_Aud_6
{

    TP_IC_TGW_Aud_getValue();
}
/*@@end*/

/*@@envVar:HMI_TP_IC_TGW_Aud_7:*/
on EnvVar HMI_TP_IC_TGW_Aud_7
{

    TP_IC_TGW_Aud_getValue();
}
/*@@end*/

/*@@caplFunc:TP_IC_TGW_Aud_getValue():*/
void TP_IC_TGW_Aud_getValue(void)
{
    _mTP_IC_TGW_Aud.byte(0) = getValue( HMI_TP_IC_TGW_Aud_0 );
    _mTP_IC_TGW_Aud.byte(1) = getValue( HMI_TP_IC_TGW_Aud_1 );
    _mTP_IC_TGW_Aud.byte(2) = getValue( HMI_TP_IC_TGW_Aud_2 );
    _mTP_IC_TGW_Aud.byte(3) = getValue( HMI_TP_IC_TGW_Aud_3 );
    _mTP_IC_TGW_Aud.byte(4) = getValue( HMI_TP_IC_TGW_Aud_4 );
    _mTP_IC_TGW_Aud.byte(5) = getValue( HMI_TP_IC_TGW_Aud_5 );
    _mTP_IC_TGW_Aud.byte(6) = getValue( HMI_TP_IC_TGW_Aud_6 );
    _mTP_IC_TGW_Aud.byte(7) = getValue( HMI_TP_IC_TGW_Aud_7 );
}
/*@@end*/

/*@@caplFunc:TPA_IC_TELEAID_TPA_IC_TELEAID_getValue():*/
/*void TPA_IC_TELEAID_getValue(void)
{
    _mTPA_IC_TELEAID.byte(0) = getValue(HMI_TPA_IC_TELEAID_0);
    _mTPA_IC_TELEAID.byte(1) = getValue(HMI_TPA_IC_TELEAID_1);
    _mTPA_IC_TELEAID.byte(2) = getValue(HMI_TPA_IC_TELEAID_2);
    _mTPA_IC_TELEAID.byte(3) = getValue(HMI_TPA_IC_TELEAID_3);
    _mTPA_IC_TELEAID.byte(4) = getValue(HMI_TPA_IC_TELEAID_4);
    _mTPA_IC_TELEAID.byte(5) = getValue(HMI_TPA_IC_TELEAID_5);
    _mTPA_IC_TELEAID.byte(6) = getValue(HMI_TPA_IC_TELEAID_6);
    _mTPA_IC_TELEAID.byte(7) = getValue(HMI_TPA_IC_TELEAID_7);
}*/
/*@@end*/

/*@@caplFunc:BLSM_Disp_Stat_AR_Activity(int):*/
void BLSM_Disp_Stat_AR_Activity(int active)
{
      if (active)
      {
          if (_BLSM_Disp_Stat_AR_SigActivity == 0)
            _BLSM_Disp_Stat_AR_Cnt = 1;
        _BLSM_Disp_Stat_AR_SigActivity++;
      }
      else
    {
        _BLSM_Disp_Stat_AR_SigActivity--;
      }
}
/*@@end*/

/*@@caplFunc:BLSM_Disp_Stat_AR_Change(int,int,int):*/
int BLSM_Disp_Stat_AR_Change(int lastValue, int sigValue, int inActValue)
{
    bActiveHelper = (sigValue != inActValue);
      if (!lastValue && bActiveHelper)
        BLSM_Disp_Stat_AR_Activity(1);
      else if (lastValue && !bActiveHelper)
        BLSM_Disp_Stat_AR_Activity(0);
    return bActiveHelper;
}
/*@@end*/

/*@@envVar:HMI_BrkLnServMd_Up_Psd:*/
on EnvVar HMI_BrkLnServMd_Up_Psd
{

   _mBLSM_Disp_Stat_AR.BrkLnServMd_Up_Psd.phys = getValue(this);
   _BLSM_Disp_Stat_ARBrkLnServMd_Up_PsdLastState = BLSM_Disp_Stat_AR_Change(_BLSM_Disp_Stat_ARBrkLnServMd_Up_PsdLastState, _mBLSM_Disp_Stat_AR.BrkLnServMd_Up_Psd, 0);
}
/*@@end*/

/*@@envVar:HMI_BrkLnServMd_Rt_Psd:*/
on EnvVar HMI_BrkLnServMd_Rt_Psd
{

   _mBLSM_Disp_Stat_AR.BrkLnServMd_Rt_Psd.phys = getValue(this);
   _BLSM_Disp_Stat_ARBrkLnServMd_Rt_PsdLastState = BLSM_Disp_Stat_AR_Change(_BLSM_Disp_Stat_ARBrkLnServMd_Rt_PsdLastState, _mBLSM_Disp_Stat_AR.BrkLnServMd_Rt_Psd, 0);
}
/*@@end*/

/*@@envVar:HMI_BrkLnServMd_Ok_Psd:*/
on EnvVar HMI_BrkLnServMd_Ok_Psd
{

   _mBLSM_Disp_Stat_AR.BrkLnServMd_Ok_Psd.phys = getValue(this);
   _BLSM_Disp_Stat_ARBrkLnServMd_Ok_PsdLastState = BLSM_Disp_Stat_AR_Change(_BLSM_Disp_Stat_ARBrkLnServMd_Ok_PsdLastState, _mBLSM_Disp_Stat_AR.BrkLnServMd_Ok_Psd, 0);
}
/*@@end*/

/*@@envVar:HMI_BrkLnServMd_MsgDisp_Ack:*/
on EnvVar HMI_BrkLnServMd_MsgDisp_Ack
{

   _mBLSM_Disp_Stat_AR.BrkLnServMd_MsgDisp_Ack.phys = getValue(this);
   _BLSM_Disp_Stat_ARBrkLnServMd_MsgDisp_AckLastState = BLSM_Disp_Stat_AR_Change(_BLSM_Disp_Stat_ARBrkLnServMd_MsgDisp_AckLastState, _mBLSM_Disp_Stat_AR.BrkLnServMd_MsgDisp_Ack, 0);
}
/*@@end*/

/*@@envVar:HMI_BrkLnServMd_Lt_Psd:*/
on EnvVar HMI_BrkLnServMd_Lt_Psd
{

   _mBLSM_Disp_Stat_AR.BrkLnServMd_Lt_Psd.phys = getValue(this);
   _BLSM_Disp_Stat_ARBrkLnServMd_Lt_PsdLastState = BLSM_Disp_Stat_AR_Change(_BLSM_Disp_Stat_ARBrkLnServMd_Lt_PsdLastState, _mBLSM_Disp_Stat_AR.BrkLnServMd_Lt_Psd, 0);
}
/*@@end*/

/*@@envVar:HMI_BrkLnServMd_Dn_Psd:*/
on EnvVar HMI_BrkLnServMd_Dn_Psd
{

   _mBLSM_Disp_Stat_AR.BrkLnServMd_Dn_Psd.phys = getValue(this);
   _BLSM_Disp_Stat_ARBrkLnServMd_Dn_PsdLastState = BLSM_Disp_Stat_AR_Change(_BLSM_Disp_Stat_ARBrkLnServMd_Dn_PsdLastState, _mBLSM_Disp_Stat_AR.BrkLnServMd_Dn_Psd, 0);
}
/*@@end*/

/*@@envVar:HMI_BrkLnServMd_Back_Psd:*/
on EnvVar HMI_BrkLnServMd_Back_Psd
{

   _mBLSM_Disp_Stat_AR.BrkLnServMd_Back_Psd.phys = getValue(this);
   _BLSM_Disp_Stat_ARBrkLnServMd_Back_PsdLastState = BLSM_Disp_Stat_AR_Change(_BLSM_Disp_Stat_ARBrkLnServMd_Back_PsdLastState, _mBLSM_Disp_Stat_AR.BrkLnServMd_Back_Psd, 0);
}
/*@@end*/

/*@@envVar:HMI_BrkLnServMd_Actv:*/
on EnvVar HMI_BrkLnServMd_Actv
{

   _mBLSM_Disp_Stat_AR.BrkLnServMd_Actv.phys = getValue(this);
   _BLSM_Disp_Stat_ARBrkLnServMd_ActvLastState = BLSM_Disp_Stat_AR_Change(_BLSM_Disp_Stat_ARBrkLnServMd_ActvLastState, _mBLSM_Disp_Stat_AR.BrkLnServMd_Actv, 0);
}
/*@@end*/

/*@@envVar:HMI__ALLDEF_BLSM_Disp_Stat_AR:*/
on EnvVar HMI__ALLDEF_BLSM_Disp_Stat_AR
{
    if (getValue(this))
    {
        // alle signale auf default einstellen
        putValue(HMI_BrkLnServMd_Up_Psd, 0);
        putValue(HMI_BrkLnServMd_Rt_Psd, 0);
        putValue(HMI_BrkLnServMd_Ok_Psd, 0);
        putValue(HMI_BrkLnServMd_MsgDisp_Ack, 0);
        putValue(HMI_BrkLnServMd_Lt_Psd, 0);
        putValue(HMI_BrkLnServMd_Dn_Psd, 0);
        putValue(HMI_BrkLnServMd_Back_Psd, 0);
        putValue(HMI_BrkLnServMd_Actv, 0);
    }
}
/*@@end*/

/*@@caplFunc:LDC_Disp_Stat_IC_AR_output():*/
/*@@end*/

/*@@envVar:HMI_Rsrv1_LDC_Disp_Stat_IC:*/
on EnvVar HMI_Rsrv1_LDC_Disp_Stat_IC
{

   _mLDC_Disp_Stat_IC_AR.Rsrv1_LDC_Disp_Stat_IC.phys = getValue(this);
    _LDC_Disp_Stat_IC_AR_SpontanFlag = 1;
}
/*@@end*/

/*@@envVar:HMI_LDC_WTSL_Spd_Max:*/
/*@@end*/

/*@@envVar:HMI_LDC_SpdUnit_Rq:*/
on EnvVar HMI_LDC_SpdUnit_Rq
{

   _mLDC_Disp_Stat_IC_AR.LDC_SpdUnit_Rq.phys = getValue(this);
    _LDC_Disp_Stat_IC_AR_SpontanFlag = 1;
}
/*@@end*/

/*@@envVar:HMI_LDC_SPEEDO_SegRing_Avl:*/
on EnvVar HMI_LDC_SPEEDO_SegRing_Avl
{

   _mLDC_Disp_Stat_IC_AR.LDC_SPEEDO_SegRing_Avl.phys = getValue(this);
    _LDC_Disp_Stat_IC_AR_SpontanFlag = 1;
}
/*@@end*/

/*@@envVar:HMI_LDC_SPEEDO_Cal:*/
on EnvVar HMI_LDC_SPEEDO_Cal
{

   _mLDC_Disp_Stat_IC_AR.LDC_SPEEDO_Cal.phys = getValue(this);
    _LDC_Disp_Stat_IC_AR_SpontanFlag = 1;
}
/*@@end*/

/*@@envVar:HMI_LDC_RadarSensMd_Rq:*/
/*@@end*/

/*@@envVar:HMI_LDC_PresfBrkMd_Rq:*/
/*@@end*/

/*@@envVar:HMI_LDC_Ifc_ok_ESP:*/
on EnvVar HMI_LDC_Ifc_ok_ESP
{

   _mLDC_Disp_Stat_IC_AR.LDC_Ifc_ok_ESP.phys = getValue(this);
    _LDC_Disp_Stat_IC_AR_SpontanFlag = 1;
}
/*@@end*/

/*@@envVar:HMI_PreHtIndLmp_Flt:*/
on EnvVar HMI_PreHtIndLmp_Flt
{

   _mIC_DriveAssistSys_AR.PreHtIndLmp_Flt.phys = getValue(this);
}
/*@@end*/

/*@@envVar:HMI_DrowWarnDisp_Stat:*/
on EnvVar HMI_DrowWarnDisp_Stat
{

   _mIC_DriveAssistSys_AR.DrowWarnDisp_Stat.phys = getValue(this);
}
/*@@end*/

/*@@envVar:HMI_DrowDtct_Md_Rq:*/
/*@@end*/

/*@@envVar:HMI_SPCR_Flt_IC:*/
on EnvVar HMI_SPCR_Flt_IC
{

   _mIC_DriveAssistSys_AR.SPCR_Flt_IC.phys = getValue(this);
}
/*@@end*/

/*@@envVar:HMI_SPCR_Conf_IC:*/
on EnvVar HMI_SPCR_Conf_IC
{

   _mIC_DriveAssistSys_AR.SPCR_Conf_IC.phys = getValue(this);
}
/*@@end*/

/*@@envVar:HMI_Rsrv2_RollTestMd_SPCR_Stat_IC:*/
on EnvVar HMI_Rsrv2_RollTestMd_SPCR_Stat_IC
{

   _mIC_DriveAssistSys_AR.Rsrv2_RollTestMd_SPCR_Stat_IC.phys = getValue(this);
}
/*@@end*/

/*@@envVar:HMI_Rsrv1_RollTestMd_SPCR_Stat_IC:*/
on EnvVar HMI_Rsrv1_RollTestMd_SPCR_Stat_IC
{

   _mIC_DriveAssistSys_AR.Rsrv1_RollTestMd_SPCR_Stat_IC.phys = getValue(this);
}
/*@@end*/

/*@@envVar:HMI_RollTestMd_Rq:*/
on EnvVar HMI_RollTestMd_Rq
{

   _mIC_DriveAssistSys_AR.RollTestMd_Rq.phys = getValue(this);
}
/*@@end*/

/*@@envVar:HMI_ESP_Md_Rq:*/
/*@@end*/

/*@@envVar:HMI_StW_SwUp_MPM_Psd:*/
on EnvVar HMI_StW_SwUp_MPM_Psd
{

   _mIC_StWheelSwitches_AR.StW_SwUp_MPM_Psd.phys = getValue(this);
    _IC_StWheelSwitches_AR_SpontanFlag = 1;
}
/*@@end*/

/*@@envVar:HMI_StW_SwSend_HU_Psd:*/
on EnvVar HMI_StW_SwSend_HU_Psd
{

   _mIC_StWheelSwitches_AR.StW_SwSend_HU_Psd.phys = getValue(this);
    _IC_StWheelSwitches_AR_SpontanFlag = 1;
}
/*@@end*/

/*@@envVar:HMI_StW_SwSDS_Start_HU_Psd:*/
on EnvVar HMI_StW_SwSDS_Start_HU_Psd
{

   _mIC_StWheelSwitches_AR.StW_SwSDS_Start_HU_Psd.phys = getValue(this);
    _IC_StWheelSwitches_AR_SpontanFlag = 1;
}
/*@@end*/

/*@@envVar:HMI_StW_SwSDS_Mute_HU_Psd:*/
on EnvVar HMI_StW_SwSDS_Mute_HU_Psd
{

   _mIC_StWheelSwitches_AR.StW_SwSDS_Mute_HU_Psd.phys = getValue(this);
    _IC_StWheelSwitches_AR_SpontanFlag = 1;
}
/*@@end*/

/*@@envVar:HMI_StW_SwSDS_Can_HU_Psd:*/
on EnvVar HMI_StW_SwSDS_Can_HU_Psd
{

   _mIC_StWheelSwitches_AR.StW_SwSDS_Can_HU_Psd.phys = getValue(this);
    _IC_StWheelSwitches_AR_SpontanFlag = 1;
}
/*@@end*/

/*@@envVar:HMI_StW_SwPlus_TELEAID_Psd:*/
on EnvVar HMI_StW_SwPlus_TELEAID_Psd
{

   _mIC_StWheelSwitches_AR.StW_SwPlus_TELEAID_Psd.phys = getValue(this);
    _IC_StWheelSwitches_AR_SpontanFlag = 1;
}
/*@@end*/

/*@@envVar:HMI_StW_SwPlus_MPM_Psd:*/
on EnvVar HMI_StW_SwPlus_MPM_Psd
{

   _mIC_StWheelSwitches_AR.StW_SwPlus_MPM_Psd.phys = getValue(this);
    _IC_StWheelSwitches_AR_SpontanFlag = 1;
}
/*@@end*/

/*@@envVar:HMI_StW_SwPlus_HU_Psd:*/
on EnvVar HMI_StW_SwPlus_HU_Psd
{

   _mIC_StWheelSwitches_AR.StW_SwPlus_HU_Psd.phys = getValue(this);
    _IC_StWheelSwitches_AR_SpontanFlag = 1;
}
/*@@end*/

/*@@envVar:HMI_StW_SwMinus_TELEAID_Psd:*/
on EnvVar HMI_StW_SwMinus_TELEAID_Psd
{

   _mIC_StWheelSwitches_AR.StW_SwMinus_TELEAID_Psd.phys = getValue(this);
    _IC_StWheelSwitches_AR_SpontanFlag = 1;
}
/*@@end*/

/*@@envVar:HMI_StW_SwMinus_MPM_Psd:*/
on EnvVar HMI_StW_SwMinus_MPM_Psd
{

   _mIC_StWheelSwitches_AR.StW_SwMinus_MPM_Psd.phys = getValue(this);
    _IC_StWheelSwitches_AR_SpontanFlag = 1;
}
/*@@end*/

/*@@envVar:HMI_StW_SwMinus_HU_Psd:*/
on EnvVar HMI_StW_SwMinus_HU_Psd
{

   _mIC_StWheelSwitches_AR.StW_SwMinus_HU_Psd.phys = getValue(this);
    _IC_StWheelSwitches_AR_SpontanFlag = 1;
}
/*@@end*/

/*@@envVar:HMI_StW_SwEnd_TELEAID_Psd:*/
on EnvVar HMI_StW_SwEnd_TELEAID_Psd
{

   _mIC_StWheelSwitches_AR.StW_SwEnd_TELEAID_Psd.phys = getValue(this);
    _IC_StWheelSwitches_AR_SpontanFlag = 1;
}
/*@@end*/

/*@@envVar:HMI_StW_SwEnd_HU_Psd:*/
on EnvVar HMI_StW_SwEnd_HU_Psd
{

   _mIC_StWheelSwitches_AR.StW_SwEnd_HU_Psd.phys = getValue(this);
    _IC_StWheelSwitches_AR_SpontanFlag = 1;
}
/*@@end*/

/*@@envVar:HMI_StW_SwDown_MPM_Psd:*/
on EnvVar HMI_StW_SwDown_MPM_Psd
{

   _mIC_StWheelSwitches_AR.StW_SwDown_MPM_Psd.phys = getValue(this);
    _IC_StWheelSwitches_AR_SpontanFlag = 1;
}
/*@@end*/

/*@@timer:_tTC_Dist_AR:*/
on timer _tTC_Dist_AR
{
    putValue( HMI__STMSG_TC_Dist_AR, 0 );
}
/*@@end*/

/*@@timer:_tPark_Disp_Rs_AR:*/
on timer _tPark_Disp_Rs_AR
{
    putValue( HMI__STMSG_Park_Disp_Rs_AR, 0 );
}
/*@@end*/

/*@@timer:_tNV_Rq_IC_AR:*/
on timer _tNV_Rq_IC_AR
{
    putValue( HMI__STMSG_NV_Rq_IC_AR, 0 );
}
/*@@end*/

/*@@timer:_tMaintenance2_AR:*/
on timer _tMaintenance2_AR
{
    putValue( HMI__STMSG_Maintenance2_AR, 0 );
}
/*@@end*/

/*@@timer:_tMaintenance1_AR:*/
on timer _tMaintenance1_AR
{
    putValue( HMI__STMSG_Maintenance1_AR, 0 );
}
/*@@end*/

/*@@timer:_tLDC_Disp_Stat_IC_AR:*/
on timer _tLDC_Disp_Stat_IC_AR
{
    putValue( HMI__STMSG_LDC_Disp_Stat_IC_AR, 0 );
}
/*@@end*/

/*@@timer:_tIC_WIM_AR:*/
on timer _tIC_WIM_AR
{
    putValue( HMI__STMSG_IC_WIM_AR, 0 );
}
/*@@end*/

/*@@timer:_tIC_StWheelSwitches_AR:*/
on timer _tIC_StWheelSwitches_AR
{
    putValue( HMI__STMSG_IC_StWheelSwitches_AR, 0 );
}
/*@@end*/

/*@@timer:_tIC_Settings_AR:*/
on timer _tIC_Settings_AR
{
    putValue( HMI__STMSG_IC_Settings_AR, 0 );
}
/*@@end*/

/*@@timer:_tIC_Immobilizer_AR:*/
on timer _tIC_Immobilizer_AR
{
    putValue( HMI__STMSG_IC_Immobilizer_AR, 0 );
}
/*@@end*/

/*@@timer:_tIC_EnergyMngmnt_Stat_AR:*/
/*on timer _tIC_EnergyMngmnt_Stat_AR
{
  //  putValue( HMI__STMSG_IC_EnergyMngmnt_Stat_AR, 0 );
}*/
/*@@end*/

/*@@timer:_tIC_DriveAssistSys_AR:*/
on timer _tIC_DriveAssistSys_AR
{
    putValue( HMI__STMSG_IC_DriveAssistSys_AR, 0 );
}
/*@@end*/

/*@@timer:_tIC_Date_Time_AR:*/
on timer _tIC_Date_Time_AR
{
    putValue( HMI__STMSG_IC_Date_Time_AR, 0 );
}
/*@@end*/

/*@@timer:_tIC_BasicInfo_AR:*/
on timer _tIC_BasicInfo_AR
{
    putValue( HMI__STMSG_IC_BasicInfo_AR, 0 );
}
/*@@end*/

/*@@timer:_tIC_BasicInfo_AR:*/
on timer _tIC_BasicInfo_AR
{
    putValue( HMI__STMSG_IC_AddDisp_VAN_AR, 0 );
}
/*@@end*/

/*@@timer:_tIC_BasicInfo2_AR:*/
on timer _tIC_BasicInfo2_AR
{
    putValue( HMI__STMSG_IC_BasicInfo2_AR, 0 );
}
/*@@end*/

/*@@timer:_tHUD_Rq_IC_AR:*/
on timer _tHUD_Rq_IC_AR
{
    putValue( HMI__STMSG_HUD_Rq_IC_AR, 0 );
}
/*@@end*/

/*@@timer:_tDimming_Stat_AR:*/
on timer _tDimming_Stat_AR
{
    putValue( HMI__STMSG_Dimming_Stat_AR, 0 );
}
/*@@end*/

/*@@timer:_tBLSM_Disp_Stat_AR:*/
on timer _tBLSM_Disp_Stat_AR
{
    putValue( HMI__STMSG_BLSM_Disp_Stat_AR, 0 );
}
/*@@end*/

/*@@timer:_tAssyst_Rq_AR:*/
on timer _tAssyst_Rq_AR
{
    putValue( HMI__STMSG_Assyst_Rq_AR, 0 );
}
/*@@end*/

/*@@timer:_tTP_IC_TGW_Nav:*/
on timer _tTP_IC_TGW_Nav
{
    putValue( HMI__STMSG_TP_IC_TGW_Nav, 0 );
}
/*@@end*/

/*@@timer:_tTP_IC_TGW_Aud:*/
on timer _tTP_IC_TGW_Aud
{
    putValue( HMI__STMSG_TP_IC_TGW_Aud, 0 );
}
/*@@end*/

/*@@timer:_tTP_IC_TGW_Tel:*/
on timer _tTP_IC_TGW_Tel
{
    putValue( HMI__STMSG_TP_IC_TGW_Tel, 0 );
}
/*@@end*/

/*@@envVar:HMI__STMSG_Assyst_Rq_AR:*/
on EnvVar HMI__STMSG_Assyst_Rq_AR
{
    long tDelay;
    if( getValue( this ) == 2 )
    {
        tDelay = getValue( HMI__STMSGT_Assyst_Rq_AR );
        if (tDelay > 0)    
            setTimer( _tAssyst_Rq_AR, tDelay );
        else
            putValue( HMI__STMSG_Assyst_Rq_AR, 0 );
    }
}
/*@@end*/

/*@@envVar:HMI__STMSG_BLSM_Disp_Stat_AR:*/
on EnvVar HMI__STMSG_BLSM_Disp_Stat_AR
{
    long tDelay;
    if( getValue( this ) == 2 )
    {
        tDelay = getValue( HMI__STMSGT_BLSM_Disp_Stat_AR );
        if (tDelay > 0)    
            setTimer( _tBLSM_Disp_Stat_AR, tDelay );
        else
            putValue( HMI__STMSG_BLSM_Disp_Stat_AR, 0 );
    }
}
/*@@end*/

/*@@envVar:HMI__STMSG_Dimming_Stat_AR:*/
on EnvVar HMI__STMSG_Dimming_Stat_AR
{
    long tDelay;
    if( getValue( this ) == 2 )
    {
        tDelay = getValue( HMI__STMSGT_Dimming_Stat_AR );
        if (tDelay > 0)    
            setTimer( _tDimming_Stat_AR, tDelay );
        else
            putValue( HMI__STMSG_Dimming_Stat_AR, 0 );
    }
}
/*@@end*/

/*@@envVar:HMI__STMSG_HUD_Rq_IC_AR:*/
on EnvVar HMI__STMSG_HUD_Rq_IC_AR
{
    long tDelay;
    if( getValue( this ) == 2 )
    {
        tDelay = getValue( HMI__STMSGT_HUD_Rq_IC_AR );
        if (tDelay > 0)    
            setTimer( _tHUD_Rq_IC_AR, tDelay );
        else
            putValue( HMI__STMSG_HUD_Rq_IC_AR, 0 );
    }
}
/*@@end*/

/*@@caplFunc:ROE_IC_check_output():*/
void ROE_IC_check_output()
{
    if (!getValue( HMI__STMSG_ROE_IC ))
    {
        // Botschaft ROE_IC --- Sendeart cyclicWithRepeatOnDemand --- 
        if( _ROE_IC_Cnt > 0 )
        {
            _ROE_IC_Cnt--;
            if( _ROE_IC_Cnt < 1 )
            {
                // Nachricht wg. abgelaufenem Zyklus ausgeben
                output( _mROE_IC );
                _ROE_IC_MsgRepetitions--;
                if( _ROE_IC_MsgRepetitions > 0 ) _ROE_IC_Cnt = _ROE_IC_CycleCount;
            }
       }
    }
}
/*@@end*/

/*@@caplFunc:ROE_IC_init():*/
ROE_IC_init()
{
    // Botschaft ROE_IC ---- Sendeart cyclicWithRepeatOnDemand ---- 
    _ROE_IC_Cnt = 0;
    _ROE_IC_MsgRepetitions = 0;
    _mROE_IC.ROE_Header_IC.phys = getValue(HMI_ROE_Header_IC);
    _mROE_IC.ROE_DTC_Stat_IC.phys = getValue(HMI_ROE_DTC_Stat_IC);
    _mROE_IC.ROE_DTC_IC.phys = getValue(HMI_ROE_DTC_IC);
}
/*@@end*/

/*@@caplFunc:ROE_IC_restart(int):*/
void ROE_IC_restart(int nNumRepetitions)
{
    if (nNumRepetitions > _ROE_IC_MsgRepetitions)
    {
        if (_ROE_IC_MsgRepetitions < 1)
            _ROE_IC_Cnt = 1;
        _ROE_IC_MsgRepetitions = nNumRepetitions;
    }
}
/*@@end*/

/*@@caplFunc:ROE_IC_saveEnvVars(dword):*/
ROE_IC_saveEnvVars( dword hFile )
{
    filePutString("\n// Knoten ROE_IC\n", 33, hFile );
    snprintf(buffer, elcount(buffer), "0.0000 HMI__STMSG_ROE_IC := %X\n", getValue(HMI__STMSG_ROE_IC ));		filePutString (buffer, elcount(buffer), hFile);
    snprintf(buffer, elcount(buffer), "0.0000 HMI__STMSGT_ROE_IC := %X\n", getValue(HMI__STMSGT_ROE_IC ));		filePutString (buffer, elcount(buffer), hFile);
    snprintf(buffer, elcount(buffer), "0.0000 HMI_ROE_Header_IC := %X\n", getValue( HMI_ROE_Header_IC ) );		filePutString (buffer, elcount(buffer), hFile);
    snprintf(buffer, elcount(buffer), "0.0000 HMI_ROE_DTC_Stat_IC := %X\n", getValue( HMI_ROE_DTC_Stat_IC ) );		filePutString (buffer, elcount(buffer), hFile);
    snprintf(buffer, elcount(buffer), "0.0000 HMI_ROE_DTC_IC := %X\n", getValue( HMI_ROE_DTC_IC ) );		filePutString (buffer, elcount(buffer), hFile);
}
/*@@end*/

/*@@envVar:HMI_ROE_Header_IC:*/
on EnvVar HMI_ROE_Header_IC
{
   _mROE_IC.ROE_Header_IC.phys = getValue(this);
      ROE_IC_restart(1);
}
/*@@end*/

/*@@envVar:HMI_ROE_DTC_Stat_IC:*/
on EnvVar HMI_ROE_DTC_Stat_IC
{
   _mROE_IC.ROE_DTC_Stat_IC.phys = getValue(this);
      ROE_IC_restart(1);
}
/*@@end*/

/*@@envVar:HMI_ROE_DTC_IC:*/
on EnvVar HMI_ROE_DTC_IC
{
   _mROE_IC.ROE_DTC_IC.phys = getValue(this);
      ROE_IC_restart(1);
}
/*@@end*/

/*@@caplFunc:Assyst_Rq_AR_init():*///function
Assyst_Rq_AR_init()
{
    // Botschaft Assyst_Rq_AR ---- Sendeart cyclicAndSpontanWithDelay
    _Assyst_Rq_AR_Cnt = 3;
    _Assyst_Rq_AR_SpontanFlag = 0;
    _mAssyst_Rq_AR.Assyst_Can_SPServ.phys = getValue( HMI_Assyst_Can_SPServ );
    _mAssyst_Rq_AR.Assyst_CurrOilQual_Para_V2.phys = getValue( HMI_Assyst_CurrOilQual_Para_V2 );
    _mAssyst_Rq_AR.Assyst_OilQuantMeas_Trgr.phys = getValue( HMI_Assyst_OilQuantMeas_Trgr );
    _mAssyst_Rq_AR.Assyst_SP3Serv_Trgr.phys = getValue( HMI_Assyst_SP3Serv_Trgr );
    _mAssyst_Rq_AR.Assyst_VehHndOvr_Trgr.phys = getValue( HMI_Assyst_VehHndOvr_Trgr );
    _mAssyst_Rq_AR.Assyst_SpServConf_Stat.phys = getValue( HMI_Assyst_SpServConf_Stat );
    _mAssyst_Rq_AR.TC_Rst_ElectRange_IC.phys = getValue( HMI_TC_Rst_ElectRange_IC );
}
/*@@end*/

/*@@caplFunc:Assyst_Rq_AR_saveEnvVars(dword):*///function
Assyst_Rq_AR_saveEnvVars( dword hFile )
{
        filePutString("\n// Knoten IC: Assyst_Rq_AR\n", 25, hFile);
        snprintf(buffer, elcount(buffer), "0.0000 HMI__STMSG_Assyst_Rq_AR := %X\n", getValue(HMI__STMSG_Assyst_Rq_AR));        filePutString (buffer, elcount(buffer), hFile);
        snprintf(buffer, elcount(buffer), "0.0000 HMI__STMSGT_Assyst_Rq_AR := %X\n", getValue(HMI__STMSGT_Assyst_Rq_AR));        filePutString (buffer, elcount(buffer), hFile);
        snprintf(buffer, elcount(buffer), "0.0000 HMI_Assyst_Can_SPServ := %X\n", getValue( HMI_Assyst_Can_SPServ ) );        filePutString (buffer, elcount(buffer), hFile);
        snprintf(buffer, elcount(buffer), "0.0000 HMI_Assyst_CurrOilQual_Para_V2 := %X\n", getValue( HMI_Assyst_CurrOilQual_Para_V2 ) );        filePutString (buffer, elcount(buffer), hFile);
        snprintf(buffer, elcount(buffer), "0.0000 HMI_Assyst_OilQuantMeas_Trgr := %X\n", getValue( HMI_Assyst_OilQuantMeas_Trgr ) );        filePutString (buffer, elcount(buffer), hFile);
        snprintf(buffer, elcount(buffer), "0.0000 HMI_Assyst_SP3Serv_Trgr := %X\n", getValue( HMI_Assyst_SP3Serv_Trgr ) );        filePutString (buffer, elcount(buffer), hFile);
        snprintf(buffer, elcount(buffer), "0.0000 HMI_Assyst_VehHndOvr_Trgr := %X\n", getValue( HMI_Assyst_VehHndOvr_Trgr ) );        filePutString (buffer, elcount(buffer), hFile);
        snprintf(buffer, elcount(buffer), "0.0000 HMI_Assyst_SpServConf_Stat := %X\n", getValue( HMI_Assyst_SpServConf_Stat ) );        filePutString (buffer, elcount(buffer), hFile);
        snprintf(buffer, elcount(buffer), "0.0000 HMI_TC_Rst_ElectRange_IC := %X\n", getValue( HMI_TC_Rst_ElectRange_IC ) );        filePutString (buffer, elcount(buffer), hFile);
}
/*@@end*/

/*@@caplFunc:Assyst_Rq_AR_check_output():*///function
Assyst_Rq_AR_check_output()
{
      if ( !getValue( HMI__STMSG_Assyst_Rq_AR ) )
    {
        // Botschaft Assyst_Rq --- Sendeart cyclicAndSpontanWithDelay --- Beginn DBKOM-Bewertung
        _Assyst_Rq_AR_Cnt--;
        if ( _Assyst_Rq_AR_Cnt < 1 )
        {
            // Nachricht wg. abgelaufenem Zyklus ausgeben
            output( _mAssyst_Rq_AR );
            _Assyst_Rq_AR_Cnt = _Assyst_Rq_AR_CycleCount; // Zyklus-Zähler zurücksetzen
            _Assyst_Rq_AR_SpontanFlag = 0; // Spontan-Flag zurücksetzen
        }
        else if ( _Assyst_Rq_AR_SpontanFlag )
        {
            // Nachricht wg. spontaner Änderung ausgeben
            output( _mAssyst_Rq_AR );
            _Assyst_Rq_AR_SpontanFlag = 0; // Spontan-Flag zurücksetzen
        }
    }
}
/*@@end*/

/*@@envVar:HMI__STMSG_IC_BasicInfo_AR:*/
on EnvVar HMI__STMSG_IC_BasicInfo_AR
{
    long tDelay;
    if( getValue( this ) == 2 )
    {
        tDelay = getValue( HMI__STMSGT_IC_BasicInfo_AR );
        if (tDelay > 0)    
            setTimer( _tIC_BasicInfo_AR, tDelay );
        else
            putValue( HMI__STMSG_IC_BasicInfo_AR, 0 );
    }
}
/*@@end*/

/*@@envVar:HMI__STMSG_IC_BasicInfo2_AR:*/
on EnvVar HMI__STMSG_IC_BasicInfo2_AR
{
    long tDelay;
    if( getValue( this ) == 2 )
    {
        tDelay = getValue( HMI__STMSGT_IC_BasicInfo2_AR );
        if (tDelay > 0)    
            setTimer( _tIC_BasicInfo2_AR, tDelay );
        else
            putValue( HMI__STMSG_IC_BasicInfo2_AR, 0 );
    }
}
/*@@end*/

/*@@envVar:HMI__STMSG_IC_Date_Time_AR:*/
on EnvVar HMI__STMSG_IC_Date_Time_AR
{
    long tDelay;
    if( getValue( this ) == 2 )
    {
        tDelay = getValue( HMI__STMSGT_IC_Date_Time_AR );
        if (tDelay > 0)    
            setTimer( _tIC_Date_Time_AR, tDelay );
        else
            putValue( HMI__STMSG_IC_Date_Time_AR, 0 );
    }
}
/*@@end*/

/*@@envVar:HMI__STMSG_IC_DriveAssistSys_AR:*/
on EnvVar HMI__STMSG_IC_DriveAssistSys_AR
{
    long tDelay;
    if( getValue( this ) == 2 )
    {
        tDelay = getValue( HMI__STMSGT_IC_DriveAssistSys_AR );
        if (tDelay > 0)    
            setTimer( _tIC_DriveAssistSys_AR, tDelay );
        else
            putValue( HMI__STMSG_IC_DriveAssistSys_AR, 0 );
    }
}
/*@@end*/

/*@@envVar:HMI__STMSG_IC_Immobilizer_AR:*/
on EnvVar HMI__STMSG_IC_Immobilizer_AR
{
    long tDelay;
    if( getValue( this ) == 2 )
    {
        tDelay = getValue( HMI__STMSGT_IC_Immobilizer_AR );
        if (tDelay > 0)    
            setTimer( _tIC_Immobilizer_AR, tDelay );
        else
            putValue( HMI__STMSG_IC_Immobilizer_AR, 0 );
    }
}
/*@@end*/

/*@@envVar:HMI__STMSG_IC_Settings_AR:*/
on EnvVar HMI__STMSG_IC_Settings_AR
{
    long tDelay;
    if( getValue( this ) == 2 )
    {
        tDelay = getValue( HMI__STMSGT_IC_Settings_AR );
        if (tDelay > 0)    
            setTimer( _tIC_Settings_AR, tDelay );
        else
            putValue( HMI__STMSG_IC_Settings_AR, 0 );
    }
}
/*@@end*/

/*@@envVar:HMI__STMSG_IC_StWheelSwitches_AR:*/
on EnvVar HMI__STMSG_IC_StWheelSwitches_AR
{
    long tDelay;
    if( getValue( this ) == 2 )
    {
        tDelay = getValue( HMI__STMSGT_IC_StWheelSwitches_AR );
        if (tDelay > 0)    
            setTimer( _tIC_StWheelSwitches_AR, tDelay );
        else
            putValue( HMI__STMSG_IC_StWheelSwitches_AR, 0 );
    }
}
/*@@end*/

/*@@envVar:HMI__STMSG_IC_WIM_AR:*/
on EnvVar HMI__STMSG_IC_WIM_AR
{
    long tDelay;
    if( getValue( this ) == 2 )
    {
        tDelay = getValue( HMI__STMSGT_IC_WIM_AR );
        if (tDelay > 0)    
            setTimer( _tIC_WIM_AR, tDelay );
        else
            putValue( HMI__STMSG_IC_WIM_AR, 0 );
    }
}
/*@@end*/

/*@@envVar:HMI__STMSG_LDC_Disp_Stat_IC_AR:*/
on EnvVar HMI__STMSG_LDC_Disp_Stat_IC_AR
{
    long tDelay;
    if( getValue( this ) == 2 )
    {
        tDelay = getValue( HMI__STMSGT_LDC_Disp_Stat_IC_AR );
        if (tDelay > 0)    
            setTimer( _tLDC_Disp_Stat_IC_AR, tDelay );
        else
            putValue( HMI__STMSG_LDC_Disp_Stat_IC_AR, 0 );
    }
}
/*@@end*/

/*@@envVar:HMI__STMSG_Maintenance1_AR:*/
on EnvVar HMI__STMSG_Maintenance1_AR
{
    long tDelay;
    if( getValue( this ) == 2 )
    {
        tDelay = getValue( HMI__STMSGT_Maintenance1_AR );
        if (tDelay > 0)    
            setTimer( _tMaintenance1_AR, tDelay );
        else
            putValue( HMI__STMSG_Maintenance1_AR, 0 );
    }
}
/*@@end*/

/*@@envVar:HMI__STMSG_Maintenance2_AR:*/
on EnvVar HMI__STMSG_Maintenance2_AR
{
    long tDelay;
    if( getValue( this ) == 2 )
    {
        tDelay = getValue( HMI__STMSGT_Maintenance2_AR );
        if (tDelay > 0)    
            setTimer( _tMaintenance2_AR, tDelay );
        else
            putValue( HMI__STMSG_Maintenance2_AR, 0 );
    }
}
/*@@end*/

/*@@envVar:HMI__STMSG_NV_Rq_IC_AR:*/
on EnvVar HMI__STMSG_NV_Rq_IC_AR
{
    long tDelay;
    if( getValue( this ) == 2 )
    {
        tDelay = getValue( HMI__STMSGT_NV_Rq_IC_AR );
        if (tDelay > 0)    
            setTimer( _tNV_Rq_IC_AR, tDelay );
        else
            putValue( HMI__STMSG_NV_Rq_IC_AR, 0 );
    }
}
/*@@end*/

/*@@envVar:HMI__STMSG_Park_Disp_Rs_AR:*/
on EnvVar HMI__STMSG_Park_Disp_Rs_AR
{
    long tDelay;
    if( getValue( this ) == 2 )
    {
        tDelay = getValue( HMI__STMSGT_Park_Disp_Rs_AR );
        if (tDelay > 0)    
            setTimer( _tPark_Disp_Rs_AR, tDelay );
        else
            putValue( HMI__STMSG_Park_Disp_Rs_AR, 0 );
    }
}
/*@@end*/

/*@@envVar:HMI__STMSG_TC_Dist_AR:*/
on EnvVar HMI__STMSG_TC_Dist_AR
{
    long tDelay;
    if( getValue( this ) == 2 )
    {
        tDelay = getValue( HMI__STMSGT_TC_Dist_AR );
        if (tDelay > 0)    
            setTimer( _tTC_Dist_AR, tDelay );
        else
            putValue( HMI__STMSG_TC_Dist_AR, 0 );
    }
}
/*@@end*/

/*@@envVar:HMI__STMSG_TP_IC_TGW_Aud:*/
on EnvVar HMI__STMSG_TP_IC_TGW_Aud
{
    long tDelay;
    if( getValue( this ) == 2 )
    {
        tDelay = getValue( HMI__STMSGT_TP_IC_TGW_Aud );
        if (tDelay > 0)    
            setTimer( _tTP_IC_TGW_Aud, tDelay );
        else
            putValue( HMI__STMSG_TP_IC_TGW_Aud, 0 );
    }
}
/*@@end*/

/*@@envVar:HMI__STMSG_TP_IC_TGW_Nav:*/
on EnvVar HMI__STMSG_TP_IC_TGW_Nav
{
    long tDelay;
    if( getValue( this ) == 2 )
    {
        tDelay = getValue( HMI__STMSGT_TP_IC_TGW_Nav );
        if (tDelay > 0)    
            setTimer( _tTP_IC_TGW_Nav, tDelay );
        else
            putValue( HMI__STMSG_TP_IC_TGW_Nav, 0 );
    }
}
/*@@end*/

/*@@envVar:HMI__STMSG_TP_IC_TGW_Tel:*/
on EnvVar HMI__STMSG_TP_IC_TGW_Tel
{
    long tDelay;
    if( getValue( this ) == 2 )
    {
        tDelay = getValue( HMI__STMSGT_TP_IC_TGW_Tel );
        if (tDelay > 0)    
            setTimer( _tTP_IC_TGW_Tel, tDelay );
        else
            putValue( HMI__STMSG_TP_IC_TGW_Tel, 0 );
    }
}
/*@@end*/

/*@@caplFunc:IC_Settings_AR_saveEnvVars(dword):*///function
IC_Settings_AR_saveEnvVars( dword hFile )
{
    filePutString("\n// Knoten IC: IC_Settings_AR\n", 27, hFile);
    snprintf(buffer, elcount(buffer), "0.0000 HMI__STMSG_IC_Settings_AR := %X\n", getValue( HMI__STMSG_IC_Settings_AR ));        filePutString (buffer, elcount(buffer), hFile);
    snprintf(buffer, elcount(buffer), "0.0000 HMI__STMSGT_IC_Settings_AR := %X\n", getValue( HMI__STMSGT_IC_Settings_AR ));        filePutString (buffer, elcount(buffer), hFile);
    snprintf(buffer, elcount(buffer), "0.0000 HMI_ExtFanTempIC_State := %X\n", getValue( HMI_ExtFanTempIC_State ) );        filePutString (buffer, elcount(buffer), hFile);
    snprintf(buffer, elcount(buffer), "0.0000 HMI_CPD_UsrActn_Rq := %X\n", getValue( HMI_CPD_UsrActn_Rq ) );        filePutString (buffer, elcount(buffer), hFile);
    snprintf(buffer, elcount(buffer), "0.0000 HMI_FTW_On_Rq := %X\n", getValue( HMI_FTW_On_Rq ) );        filePutString (buffer, elcount(buffer), hFile);
    snprintf(buffer, elcount(buffer), "0.0000 HMI_IHC_Md_Rq := %X\n", getValue( HMI_IHC_Md_Rq ) );        filePutString (buffer, elcount(buffer), hFile);
    snprintf(buffer, elcount(buffer), "0.0000 HMI_Preview_Md_Rq := %X\n", getValue( HMI_Preview_Md_Rq ) );        filePutString (buffer, elcount(buffer), hFile);
    snprintf(buffer, elcount(buffer), "0.0000 HMI_SLA_SpdOffset_Rq_D_Unit := %X\n", getValue( HMI_SLA_SpdOffset_Rq_D_Unit ) );        filePutString (buffer, elcount(buffer), hFile);
    snprintf(buffer, elcount(buffer), "0.0000 HMI_SLA_SpdOffset_Rq_D_Val := %X\n", getValue( HMI_SLA_SpdOffset_Rq_D_Val ) );        filePutString (buffer, elcount(buffer), hFile);
    snprintf(buffer, elcount(buffer), "0.0000 HMI_TPM_Actv_Rq_V2 := %X\n", getValue( HMI_TPM_Actv_Rq_V2 ) );        filePutString (buffer, elcount(buffer), hFile);
    snprintf(buffer, elcount(buffer), "0.0000 HMI_UnitPress_Rq := %X\n", getValue( HMI_UnitPress_Rq ) );        filePutString (buffer, elcount(buffer), hFile);
    snprintf(buffer, elcount(buffer), "0.0000 HMI_UnitTemp_Rq := %X\n", getValue( HMI_UnitTemp_Rq ) );        filePutString (buffer, elcount(buffer), hFile);
	snprintf(buffer, elcount(buffer), "0.0000 HMI_Pers_ActvSlotId_Rq := %X\n", getValue( HMI_Pers_ActvSlotId_Rq ) );        filePutString (buffer, elcount(buffer), hFile);
	snprintf(buffer, elcount(buffer), "0.0000 HMI_RepairshopMode_Actv := %X\n", getValue( HMI_RepairshopMode_Actv ) );        filePutString (buffer, elcount(buffer), hFile);
	snprintf(buffer, elcount(buffer), "0.0000 HMI_SAplus_SDTR_Md_Stat_IC := %X\n", getValue( HMI_SAplus_SDTR_Md_Stat_IC ) );        filePutString (buffer, elcount(buffer), hFile);
	snprintf(buffer, elcount(buffer), "0.0000 HMI_SAplus_TSA_Md_Stat_IC := %X\n", getValue( HMI_SAplus_TSA_Md_Stat_IC ) );        filePutString (buffer, elcount(buffer), hFile);
}
/*@@end*/

/*@@caplFunc:TP_IC_TGW_Aud_saveEnvVars(dword):*///function
TP_IC_TGW_Aud_saveEnvVars(dword hFile)
{
    filePutString("\n// Knoten IC: TP_IC_TGW_Aud\n", 30, hFile);
    snprintf(buffer, elcount(buffer), "0.0000 HMI__STMSG_TP_IC_TGW_Aud := %X\n", getValue(HMI__STMSG_TP_IC_TGW_Aud));        filePutString (buffer, elcount(buffer), hFile);
    snprintf(buffer, elcount(buffer), "0.0000 HMI__STMSGT_TP_IC_TGW_Aud := %X\n", getValue(HMI__STMSGT_TP_IC_TGW_Aud));        filePutString (buffer, elcount(buffer), hFile);
    snprintf(buffer, elcount(buffer), "0.0000 HMI_TP_IC_TGW_Aud_0 := %X\n", getValue(HMI_TP_IC_TGW_Aud_0));        filePutString (buffer, elcount(buffer), hFile);
    snprintf(buffer, elcount(buffer), "0.0000 HMI_TP_IC_TGW_Aud_1 := %X\n", getValue(HMI_TP_IC_TGW_Aud_1));        filePutString (buffer, elcount(buffer), hFile);
    snprintf(buffer, elcount(buffer), "0.0000 HMI_TP_IC_TGW_Aud_2 := %X\n", getValue(HMI_TP_IC_TGW_Aud_2));        filePutString (buffer, elcount(buffer), hFile);
    snprintf(buffer, elcount(buffer), "0.0000 HMI_TP_IC_TGW_Aud_3 := %X\n", getValue(HMI_TP_IC_TGW_Aud_3));        filePutString (buffer, elcount(buffer), hFile);
    snprintf(buffer, elcount(buffer), "0.0000 HMI_TP_IC_TGW_Aud_4 := %X\n", getValue(HMI_TP_IC_TGW_Aud_4));        filePutString (buffer, elcount(buffer), hFile);
    snprintf(buffer, elcount(buffer), "0.0000 HMI_TP_IC_TGW_Aud_5 := %X\n", getValue(HMI_TP_IC_TGW_Aud_5));        filePutString (buffer, elcount(buffer), hFile);
    snprintf(buffer, elcount(buffer), "0.0000 HMI_TP_IC_TGW_Aud_6 := %X\n", getValue(HMI_TP_IC_TGW_Aud_6));        filePutString (buffer, elcount(buffer), hFile);
    snprintf(buffer, elcount(buffer), "0.0000 HMI_TP_IC_TGW_Aud_7 := %X\n", getValue(HMI_TP_IC_TGW_Aud_7));        filePutString (buffer, elcount(buffer), hFile);
}
/*@@end*/

/*@@caplFunc:NV_Rq_IC_AR_saveEnvVars(dword):*///function
void NV_Rq_IC_AR_saveEnvVars( dword hFile )
{
        filePutString("\n// Knoten IC: NV_Rq_IC_AR\n", 24, hFile);
        snprintf(buffer, elcount(buffer), "0.0000 HMI__STMSG_NV_Rq_IC_AR := %X\n", getValue( HMI__STMSG_NV_Rq_IC_AR ) );        filePutString (buffer, elcount(buffer), hFile);
        snprintf(buffer, elcount(buffer), "0.0000 HMI__STMSGT_NV_Rq_IC_AR := %X\n", getValue( HMI__STMSGT_NV_Rq_IC_AR ) );        filePutString (buffer, elcount(buffer), hFile);
        snprintf(buffer, elcount(buffer), "0.0000 HMI_NVP_Disp_Actv := %X\n", getValue( HMI_NVP_Disp_Actv ) );        filePutString (buffer, elcount(buffer), hFile);
        snprintf(buffer, elcount(buffer), "0.0000 HMI_NVP_DispLnk_Stat := %X\n", getValue( HMI_NVP_DispLnk_Stat ) );        filePutString (buffer, elcount(buffer), hFile);
        snprintf(buffer, elcount(buffer), "0.0000 HMI_NVP_DispMd := %X\n", getValue( HMI_NVP_DispMd ) );        filePutString (buffer, elcount(buffer), hFile);
        snprintf(buffer, elcount(buffer), "0.0000 HMI_NVP_SPL_Md := %X\n", getValue( HMI_NVP_SPL_Md ) );        filePutString (buffer, elcount(buffer), hFile);
}
/*@@end*/

/*@@caplFunc:NV_Rq_IC_AR_init():*///function
NV_Rq_IC_AR_init()
{
    // Botschaft NV_Rq_IC_AR ---- Sendeart cyclicX ---- Beginn Initialisierung
    _NV_Rq_IC_AR_Cnt = 4;
    /* zyklisch */ _mNV_Rq_IC_AR.NVP_Disp_Actv.phys = getValue( HMI_NVP_Disp_Actv );
    /* zyklisch */ _mNV_Rq_IC_AR.NVP_DispLnk_Stat.phys = getValue( HMI_NVP_DispLnk_Stat );
    /* zyklisch */ _mNV_Rq_IC_AR.NVP_DispMd.phys = getValue( HMI_NVP_DispMd );
    /* zyklisch */ _mNV_Rq_IC_AR.NVP_SPL_Md.phys = getValue( HMI_NVP_SPL_Md );
}
/*@@end*/

/*@@caplFunc:TC_Dist_AR_saveEnvVars(dword):*///function
TC_Dist_AR_saveEnvVars( dword hFile )
{
        filePutString("\n// Knoten IC: TC_Dist_AR\n", 23, hFile);
        snprintf(buffer, elcount(buffer), "0.0000 HMI__STMSG_TC_Dist_AR := %X\n", getValue( HMI__STMSG_TC_Dist_AR ) );        filePutString (buffer, elcount(buffer), hFile);
        snprintf(buffer, elcount(buffer), "0.0000 HMI__STMSGT_TC_Dist_AR := %X\n", getValue( HMI__STMSGT_TC_Dist_AR ) );        filePutString (buffer, elcount(buffer), hFile);
//        snprintf(buffer, elcount(buffer), "0.0000 HMI_CNG_FuelMdChg_Rq := %X\n", getValue( HMI_CNG_FuelMdChg_Rq ) );        filePutString (buffer, elcount(buffer), hFile);
        snprintf(buffer, elcount(buffer), "0.0000 HMI_TC_GasFuelDist_Start m0 := %X\n", getValue( HMI_TC_GasFuelDist_Start ) );        filePutString (buffer, elcount(buffer), hFile);
        snprintf(buffer, elcount(buffer), "0.0000 HMI_TC_GasFuelDist_Reset m0 := %X\n", getValue( HMI_TC_GasFuelDist_Reset ) );        filePutString (buffer, elcount(buffer), hFile);
        snprintf(buffer, elcount(buffer), "0.0000 HMI_TC_GasFuelTankLvl m0 := %X\n", getValue( HMI_TC_GasFuelTankLvl ) );        filePutString (buffer, elcount(buffer), hFile);
        snprintf(buffer, elcount(buffer), "0.0000 HMI_TC_FuelType_TC_DIST := %X\n", getValue( HMI_TC_FuelType ) );        filePutString (buffer, elcount(buffer), hFile);
        snprintf(buffer, elcount(buffer), "0.0000 HMI_TC_LiquidFuelDist_Start  := %X\n", getValue( HMI_TC_LiquidFuelDist_Start  ) );        filePutString (buffer, elcount(buffer), hFile);
        snprintf(buffer, elcount(buffer), "0.0000 HMI_TC_LiquidFuelTankLvl := %X\n", getValue( HMI_TC_LiquidFuelTankLvl ) );        filePutString (buffer, elcount(buffer), hFile);
        snprintf(buffer, elcount(buffer), "0.0000 HMI_TC_LiquidFuelDist_Reset := %X\n", getValue( HMI_TC_LiquidFuelDist_Reset ) );        filePutString (buffer, elcount(buffer), hFile);
        snprintf(buffer, elcount(buffer), "0.0000 HMI_TC_LiquidFuelRefillEvent_Dtct := %X\n", getValue( HMI_TC_LiquidFuelRefillEvent_Dtct ) );        filePutString (buffer, elcount(buffer), hFile);
        snprintf(buffer, elcount(buffer), "0.0000 HMI_TC_ElecEnergyDist_Start := %X\n", getValue( HMI_TC_ElecEnergyDist_Start ) );        filePutString (buffer, elcount(buffer), hFile);
        snprintf(buffer, elcount(buffer), "0.0000 HMI_TC_ElecEnergyDist_Reset := %X\n", getValue( HMI_TC_ElecEnergyDist_Reset ) );        filePutString (buffer, elcount(buffer), hFile);
}
/*
CNG_FuelMdChg_Rq
TC_GasFuelDist_Start
TC_GasFuelDist_Reset
TC_GasFuelTankLvl
TC_FuelType_TC_DIST
TC_LiquidFuelDist_Start 
TC_LiquidFuelTankLvl
TC_LiquidFuelDist_Reset
TC_LiquidFuelRefillEvent_Dtct
TC_ElecEnergyDist_Start
TC_ElecEnergyDist_Reset
*/
/*@@end*/

/*@@caplFunc:IC_WIM_AR_saveEnvVars(dword):*///function
IC_WIM_AR_saveEnvVars( dword hFile )
{
        filePutString("\n// Knoten IC: IC_WIM_AR\n", 22, hFile);
        snprintf(buffer, elcount(buffer), "0.0000 HMI__STMSG_IC_WIM_AR := %X\n", getValue( HMI__STMSG_IC_WIM_AR ) );        filePutString (buffer, elcount(buffer), hFile);
        snprintf(buffer, elcount(buffer), "0.0000 HMI__STMSGT_IC_WIM_AR := %X\n", getValue( HMI__STMSGT_IC_WIM_AR ) );        filePutString (buffer, elcount(buffer), hFile);
        snprintf(buffer, elcount(buffer), "0.0000 HMI_AcustWarn_Actv_IC := %X\n", getValue( HMI_AcustWarn_Actv_IC ) );        filePutString (buffer, elcount(buffer), hFile);
        snprintf(buffer, elcount(buffer), "0.0000 HMI_IC_Msg_Disp_Stat := %X\n", getValue( HMI_IC_Msg_Disp_Stat ) );        filePutString (buffer, elcount(buffer), hFile);
        snprintf(buffer, elcount(buffer), "0.0000 HMI_WarnPrio1_Mute_Rq := %X\n", getValue( HMI_WarnPrio1_Mute_Rq ) );        filePutString (buffer, elcount(buffer), hFile);
}
/*@@end*/

/*@@caplFunc:Dimming_Stat_AR_saveEnvVars(dword):*///function
Dimming_Stat_AR_saveEnvVars( dword hFile )
{
        filePutString("\n// Knoten IC: Dimming_Stat_AR\n", 28, hFile);
        snprintf(buffer, elcount(buffer), "0.0000 HMI__STMSG_Dimming_Stat_AR := %X\n", getValue( HMI__STMSG_Dimming_Stat_AR ) );        filePutString (buffer, elcount(buffer), hFile);
        snprintf(buffer, elcount(buffer), "0.0000 HMI__STMSGT_Dimming_Stat_AR := %X\n", getValue( HMI__STMSGT_Dimming_Stat_AR ) );        filePutString (buffer, elcount(buffer), hFile);
        snprintf(buffer, elcount(buffer), "0.0000 HMI_DispBrt_IC := %X\n", getValue( HMI_DispBrt_IC ) );        filePutString (buffer, elcount(buffer), hFile);
        snprintf(buffer, elcount(buffer), "0.0000 HMI_SwIll_NightDay := %X\n", getValue( HMI_SwIll_NightDay ) );        filePutString (buffer, elcount(buffer), hFile);
        snprintf(buffer, elcount(buffer), "0.0000 HMI_SwIllLvl := %X\n", getValue( HMI_SwIllLvl ) );        filePutString (buffer, elcount(buffer), hFile);
}
/*@@end*/

/*@@caplFunc:BLSM_Disp_Stat_AR_saveEnvVars(dword):*///function
BLSM_Disp_Stat_AR_saveEnvVars( dword hFile )
{
        filePutString("\n// Knoten IC: BLSM_Disp_Stat_AR\n", 30, hFile);
        snprintf(buffer, elcount(buffer), "0.0000 HMI__STMSG_BLSM_Disp_Stat_AR := %X\n", getValue( HMI__STMSG_BLSM_Disp_Stat_AR ));        filePutString (buffer, elcount(buffer), hFile);
        snprintf(buffer, elcount(buffer), "0.0000 HMI__STMSGT_BLSM_Disp_Stat_AR := %X\n", getValue( HMI__STMSGT_BLSM_Disp_Stat_AR ));        filePutString (buffer, elcount(buffer), hFile);
        snprintf(buffer, elcount(buffer), "0.0000 HMI_BrkLnServMd_Actv := %X\n", getValue( HMI_BrkLnServMd_Actv ) );        filePutString (buffer, elcount(buffer), hFile);
        snprintf(buffer, elcount(buffer), "0.0000 HMI_BrkLnServMd_Back_Psd := %X\n", getValue( HMI_BrkLnServMd_Back_Psd ) );        filePutString (buffer, elcount(buffer), hFile);
        snprintf(buffer, elcount(buffer), "0.0000 HMI_BrkLnServMd_Dn_Psd := %X\n", getValue( HMI_BrkLnServMd_Dn_Psd ) );        filePutString (buffer, elcount(buffer), hFile);
        snprintf(buffer, elcount(buffer), "0.0000 HMI_BrkLnServMd_Lt_Psd := %X\n", getValue( HMI_BrkLnServMd_Lt_Psd ) );        filePutString (buffer, elcount(buffer), hFile);
        snprintf(buffer, elcount(buffer), "0.0000 HMI_BrkLnServMd_MsgDisp_Ack := %X\n", getValue( HMI_BrkLnServMd_MsgDisp_Ack ) );        filePutString (buffer, elcount(buffer), hFile);
        snprintf(buffer, elcount(buffer), "0.0000 HMI_BrkLnServMd_Ok_Psd := %X\n", getValue( HMI_BrkLnServMd_Ok_Psd ) );        filePutString (buffer, elcount(buffer), hFile);
        snprintf(buffer, elcount(buffer), "0.0000 HMI_BrkLnServMd_Rt_Psd := %X\n", getValue( HMI_BrkLnServMd_Rt_Psd ) );        filePutString (buffer, elcount(buffer), hFile);
        snprintf(buffer, elcount(buffer), "0.0000 HMI_BrkLnServMd_Up_Psd := %X\n", getValue( HMI_BrkLnServMd_Up_Psd ) );        filePutString (buffer, elcount(buffer), hFile);
}
/*@@end*/

/*@@caplFunc:BLSM_Disp_Stat_AR_init():*///function
BLSM_Disp_Stat_AR_init()
{
    // Botschaft BLSM_Disp_Stat_AR ---- Sendeart cyclicIfActive ---- Beginn Initialisierung
    _BLSM_Disp_Stat_AR_Cnt = 2;
    _BLSM_Disp_Stat_AR_SigActivity = 0;
    /* Schnell */ _mBLSM_Disp_Stat_AR.BrkLnServMd_Actv.phys = getValue( HMI_BrkLnServMd_Actv );
    /* Schnell */ _mBLSM_Disp_Stat_AR.BrkLnServMd_Back_Psd.phys = getValue( HMI_BrkLnServMd_Back_Psd );
    /* Schnell */ _mBLSM_Disp_Stat_AR.BrkLnServMd_Dn_Psd.phys = getValue( HMI_BrkLnServMd_Dn_Psd );
    /* Schnell */ _mBLSM_Disp_Stat_AR.BrkLnServMd_Lt_Psd.phys = getValue( HMI_BrkLnServMd_Lt_Psd );
    /* Schnell */ _mBLSM_Disp_Stat_AR.BrkLnServMd_MsgDisp_Ack.phys = getValue( HMI_BrkLnServMd_MsgDisp_Ack );
    /* Schnell */ _mBLSM_Disp_Stat_AR.BrkLnServMd_Ok_Psd.phys = getValue( HMI_BrkLnServMd_Ok_Psd );
    /* Schnell */ _mBLSM_Disp_Stat_AR.BrkLnServMd_Rt_Psd.phys = getValue( HMI_BrkLnServMd_Rt_Psd );
    /* Schnell */ _mBLSM_Disp_Stat_AR.BrkLnServMd_Up_Psd.phys = getValue( HMI_BrkLnServMd_Up_Psd );
                  _BLSM_Disp_Stat_ARBrkLnServMd_ActvLastState = BLSM_Disp_Stat_AR_Change(_BLSM_Disp_Stat_ARBrkLnServMd_ActvLastState, _mBLSM_Disp_Stat_AR.BrkLnServMd_Actv, 0);
                  _BLSM_Disp_Stat_ARBrkLnServMd_Back_PsdLastState = BLSM_Disp_Stat_AR_Change(_BLSM_Disp_Stat_ARBrkLnServMd_Back_PsdLastState, _mBLSM_Disp_Stat_AR.BrkLnServMd_Back_Psd, 0);
                  _BLSM_Disp_Stat_ARBrkLnServMd_Dn_PsdLastState = BLSM_Disp_Stat_AR_Change(_BLSM_Disp_Stat_ARBrkLnServMd_Dn_PsdLastState, _mBLSM_Disp_Stat_AR.BrkLnServMd_Dn_Psd, 0);
                  _BLSM_Disp_Stat_ARBrkLnServMd_Lt_PsdLastState = BLSM_Disp_Stat_AR_Change(_BLSM_Disp_Stat_ARBrkLnServMd_Lt_PsdLastState, _mBLSM_Disp_Stat_AR.BrkLnServMd_Lt_Psd, 0);
                  _BLSM_Disp_Stat_ARBrkLnServMd_MsgDisp_AckLastState = BLSM_Disp_Stat_AR_Change(_BLSM_Disp_Stat_ARBrkLnServMd_MsgDisp_AckLastState, _mBLSM_Disp_Stat_AR.BrkLnServMd_MsgDisp_Ack, 0);
                  _BLSM_Disp_Stat_ARBrkLnServMd_Ok_PsdLastState = BLSM_Disp_Stat_AR_Change(_BLSM_Disp_Stat_ARBrkLnServMd_Ok_PsdLastState, _mBLSM_Disp_Stat_AR.BrkLnServMd_Ok_Psd, 0);
                  _BLSM_Disp_Stat_ARBrkLnServMd_Rt_PsdLastState = BLSM_Disp_Stat_AR_Change(_BLSM_Disp_Stat_ARBrkLnServMd_Rt_PsdLastState, _mBLSM_Disp_Stat_AR.BrkLnServMd_Rt_Psd, 0);
                  _BLSM_Disp_Stat_ARBrkLnServMd_Up_PsdLastState = BLSM_Disp_Stat_AR_Change(_BLSM_Disp_Stat_ARBrkLnServMd_Up_PsdLastState, _mBLSM_Disp_Stat_AR.BrkLnServMd_Up_Psd, 0);
}
/*@@end*/

/*@@caplFunc:BLSM_Disp_Stat_AR_check_output():*///function
BLSM_Disp_Stat_AR_check_output()
{
      if (!getValue( HMI__STMSG_BLSM_Disp_Stat_AR ))
    {
        // Botschaft BLSM_Disp_Stat_AR --- Sendeart 2 cyclicIfActive
 //       _BLSM_Disp_Stat_AR_Cnt--;
//        if ( _BLSM_Disp_Stat_AR_Cnt < 1 )
        {
            // Zyklus abgelaufen, Nachricht senden
            if( _BLSM_Disp_Stat_AR_SigActivity )
                output( _mBLSM_Disp_Stat_AR );
        }
    }
}
/*@@end*/

/*@@caplFunc:Dimming_Stat_AR_init():*///function
Dimming_Stat_AR_init()
{
    // Botschaft Dimming_Stat_AR ---- Sendeart cyclicAndSpontanWithDelay ---- Beginn Initialisierung
    _Dimming_Stat_AR_Cnt = 11;
    _Dimming_Stat_AR_SpontanFlag = 0;
    _Dimming_Stat_AR_DelayCnt = 0;
    /* sofort */ _mDimming_Stat_AR.DispBrt_IC.phys = getValue( HMI_DispBrt_IC );
    /* sofort */ _mDimming_Stat_AR.SwIll_NightDay.phys = getValue( HMI_SwIll_NightDay );
    /* sofort */ _mDimming_Stat_AR.SwIllLvl.phys = getValue( HMI_SwIllLvl );
}
/*@@end*/

/*@@caplFunc:Dimming_Stat_AR_check_output():*///function
Dimming_Stat_AR_check_output()
{
      if ( !getValue( HMI__STMSG_Dimming_Stat_AR ) )
    {
        // Botschaft Dimming_Stat_AR --- Sendeart cyclicAndSpontanWithDelay
        if (_Dimming_Stat_AR_DelayCnt > 0) _Dimming_Stat_AR_DelayCnt--; // Mindestsendeabstand
        _Dimming_Stat_AR_Cnt--;
        if (_Dimming_Stat_AR_Cnt < 1)
        {
            if (_Dimming_Stat_AR_DelayCnt < 1)
            {
                // Nachricht wg. abgelaufenem Zyklus ausgeben (Mindestsendeabstand eingehalten)
                output( _mDimming_Stat_AR );
                 _Dimming_Stat_AR_SpontanFlag = 0; // Spontan-Flag zurücksetzen
                _Dimming_Stat_AR_DelayCnt = _Dimming_Stat_AR_MinDelay;
            }
            else
            {
                // Spontanflag setzen damit nach Ablauf Mindestsendeabstand gesendet wird
                 _Dimming_Stat_AR_SpontanFlag = 1;
            }
            _Dimming_Stat_AR_Cnt = _Dimming_Stat_AR_CycleCount; // Zyklus-Zähler zurücksetzen
        }
        else if ( _Dimming_Stat_AR_SpontanFlag )
        {
            if ( _Dimming_Stat_AR_DelayCnt < 1 )
            {
                // Nachricht wg. spontaner Änderung ausgeben (Mindestsendeabstand eingehalten)
                output( _mDimming_Stat_AR );
                _Dimming_Stat_AR_SpontanFlag = 0; // Spontan-Flag zurücksetzen
                _Dimming_Stat_AR_DelayCnt = _Dimming_Stat_AR_MinDelay;
            }
        }
    }
}
/*@@end*/

/*@@caplFunc:HUD_Rq_IC_AR_check_output():*///function
HUD_Rq_IC_AR_check_output()
{
          if( !getValue( HMI__STMSG_HUD_Rq_IC_AR ) )
        {
            // Botschaft HUD_Rq_IC_AR --- Sendeart cyclicAndSpontanWithDelay --- Beginn DBKOM-Bewertung
            if( _HUD_Rq_IC_AR_DelayCnt > 0 ) _HUD_Rq_IC_AR_DelayCnt--; // Mindestsendeabstand
            _HUD_Rq_IC_AR_Cnt--;
            if( _HUD_Rq_IC_AR_Cnt < 1 )
            {
                if( _HUD_Rq_IC_AR_DelayCnt < 1 )
                {
                    // Nachricht wg. abgelaufenem Zyklus ausgeben (Mindestsendeabstand eingehalten)
                    output( _mHUD_Rq_IC_AR );
                     _HUD_Rq_IC_AR_SpontanFlag = 0; // Spontan-Flag zurücksetzen
                    _HUD_Rq_IC_AR_DelayCnt = _HUD_Rq_IC_AR_MinDelay;
                }
                else
                {
                    // Spontanflag setzen damit nach Ablauf Mindestsendeabstand gesendet wird
                     _HUD_Rq_IC_AR_SpontanFlag = 1;
                }
                _HUD_Rq_IC_AR_Cnt = _HUD_Rq_IC_AR_CycleCount; // Zyklus-Zähler zurücksetzen
            }
            else if ( _HUD_Rq_IC_AR_SpontanFlag )
            {
                if ( _HUD_Rq_IC_AR_DelayCnt < 1 )
                {
                    // Nachricht wg. spontaner Änderung ausgeben (Mindestsendeabstand eingehalten)
                    output( _mHUD_Rq_IC_AR );
                     _HUD_Rq_IC_AR_SpontanFlag = 0; // Spontan-Flag zurücksetzen
                    _HUD_Rq_IC_AR_DelayCnt = _HUD_Rq_IC_AR_MinDelay;
                }
            }
            // Botschaft HUD_Rq_IC_AR --- Sendeart cyclicAndSpontanWithDelay --- Ende DBKOM-Bewertung
        }
}
/*@@end*/

/*@@caplFunc:HUD_Rq_IC_AR_init():*///function
HUD_Rq_IC_AR_init()
{
    // Botschaft HUD_Rq_IC_AR ---- Sendeart cyclicAndSpontanWithDelay ---- Beginn Initialisierung
    _HUD_Rq_IC_AR_Cnt = 11;
    _HUD_Rq_IC_AR_SpontanFlag = 0;
    _HUD_Rq_IC_AR_DelayCnt = 0;
    /* sofort */ _mHUD_Rq_IC_AR.HUD_DispBrt_Rq.phys = getValue( HMI_HUD_DispBrt_Rq );
    /* sofort */ _mHUD_Rq_IC_AR.HUD_Md_Rq.phys = getValue( HMI_HUD_Md_Rq );
    /* sofort */ _mHUD_Rq_IC_AR.HUD_Posn_Rq.phys = getValue( HMI_HUD_Posn_Rq );
}
/*@@end*/

/*@@caplFunc:HUD_Rq_IC_AR_saveEnvVars(dword):*///function
HUD_Rq_IC_AR_saveEnvVars( dword hFile )
{
    filePutString("\n// Knoten IC: TP_IC_TGW_Nav\n", 30, hFile);
    snprintf(buffer, elcount(buffer), "0.0000 HMI__STMSG_HUD_Rq_IC_AR := %X\n", getValue(HMI__STMSG_TP_IC_TGW_Nav));    filePutString (buffer, elcount(buffer), hFile);
    snprintf(buffer, elcount(buffer), "0.0000 HMI__STMSGT_HUD_Rq_IC_AR := %X\n", getValue(HMI__STMSGT_TP_IC_TGW_Nav));    filePutString (buffer, elcount(buffer), hFile);
    snprintf(buffer, elcount(buffer), "0.0000 HMI_HUD_DispBrt_Rq := %X\n", getValue( HMI_HUD_DispBrt_Rq ) );    filePutString (buffer, elcount(buffer), hFile);
    snprintf(buffer, elcount(buffer), "0.0000 HMI_HUD_Md_Rq := %X\n", getValue( HMI_HUD_Md_Rq ) );    filePutString (buffer, elcount(buffer), hFile);
    snprintf(buffer, elcount(buffer), "0.0000 HMI_HUD_Posn_Rq := %X\n", getValue( HMI_HUD_Posn_Rq ) );    filePutString (buffer, elcount(buffer), hFile);
}
/*@@end*/

/*@@caplFunc:IC_BasicInfo2_AR_init():*///function
IC_BasicInfo2_AR_init()
{
    // Botschaft IC_BasicInfo2_AR ---- Sendeart cyclicX ---- Beginn Initialisierung
    _IC_BasicInfo2_AR_Cnt = 250;
    /* zyklisch */ _mIC_BasicInfo2_AR.DayCnt.phys = getValue( HMI_DayCnt );
}
/*@@end*/

/*@@caplFunc:IC_BasicInfo_AR_init():*///function
IC_BasicInfo_AR_init()
{
    // Botschaft IC_BasicInfo_AR ---- Sendeart cyclicAndSpontanWithDelay ---- Beginn Initialisierung
    _IC_BasicInfo_AR_Cnt = 50;
    _IC_BasicInfo_AR_SpontanFlag = 0;
    _IC_BasicInfo_AR_DelayCnt = 5;
    _mIC_BasicInfo_AR.AirTemp_Outsd_Disp.phys = getValue( HMI_AirTemp_Outsd_Disp );
    _mIC_BasicInfo_AR.IC_TP_Alive.phys = getValue( HMI_IC_TP_Alive );
    _mIC_BasicInfo_AR.Odo.phys = getValue( HMI_Odo );
    _mIC_BasicInfo_AR.UnitVehSpd.phys = getValue( HMI_UnitVehSpd );
    _mIC_BasicInfo_AR.VehSpd_Disp.phys = getValue( HMI_VehSpd_Disp );
    _mIC_BasicInfo_AR.AAS4_DrowWarnDisp_Stat.phys = getValue( HMI_AAS4_DrowWarnDisp_Stat );
    _mIC_BasicInfo_AR.AAS4_DstrctWarn_DispStat.phys = getValue( HMI_AAS4_DstrctWarn_DispStat );
}
/*@@end*/

/*@@caplFunc:IC_BasicInfo2_AR_saveEnvVars(dword):*///function
IC_BasicInfo2_AR_saveEnvVars( dword hFile )
{
    filePutString("\n// Knoten IC: IC_BasicInfo2_AR\n", 29, hFile);
    snprintf(buffer, elcount(buffer), "0.0000 HMI__STMSG_IC_BasicInfo2_AR := %X\n", getValue( HMI__STMSG_IC_BasicInfo2_AR ));        filePutString (buffer, elcount(buffer), hFile);
    snprintf(buffer, elcount(buffer), "0.0000 HMI__STMSGT_IC_BasicInfo2_AR := %X\n", getValue( HMI__STMSGT_IC_BasicInfo2_AR ));        filePutString (buffer, elcount(buffer), hFile);
    snprintf(buffer, elcount(buffer), "0.0000 HMI_DayCnt := %X\n", getValue( HMI_DayCnt ) );        filePutString (buffer, elcount(buffer), hFile);
    snprintf(buffer, elcount(buffer), "0.0000 HMI_EngShutOffTm := %f\n", getValue( HMI_EngShutOffTm ) );        filePutString (buffer, elcount(buffer), hFile);
    snprintf(buffer, elcount(buffer), "0.0000 HMI_HVAC_Vprzr_DryVnTmr_Stat := %f\n", getValue( HMI_HVAC_Vprzr_DryVnTmr_Stat ) );        filePutString (buffer, elcount(buffer), hFile);
    snprintf(buffer, elcount(buffer), "0.0000 HMI_PT_ShutOffTm := %f\n", getValue( HMI_PT_ShutOffTm ) );        filePutString (buffer, elcount(buffer), hFile);
}
/*@@end*/

/*@@caplFunc:IC_BasicInfo_AR_saveEnvVars(dword):*///function
IC_BasicInfo_AR_saveEnvVars( dword hFile )
{
    filePutString (buffer, elcount(buffer), hFile);
    filePutString("\n// Knoten IC: IC_BasicInfo_AR\n", 28, hFile);
    snprintf(buffer, elcount(buffer), "0.0000 HMI__STMSG_IC_BasicInfo_AR := %X\n", getValue(HMI__STMSG_IC_BasicInfo_AR ));        filePutString (buffer, elcount(buffer), hFile);
    snprintf(buffer, elcount(buffer), "0.0000 HMI__STMSGT_IC_BasicInfo_AR := %X\n", getValue(HMI__STMSGT_IC_BasicInfo_AR ));        filePutString (buffer, elcount(buffer), hFile);
    snprintf(buffer, elcount(buffer), "0.0000 HMI_AirTemp_Outsd_Disp := %f\n", getValue( HMI_AirTemp_Outsd_Disp ) );        filePutString (buffer, elcount(buffer), hFile);
    snprintf(buffer, elcount(buffer), "0.0000 HMI_IC_TP_Alive := %f\n", getValue( HMI_IC_TP_Alive ) );        filePutString (buffer, elcount(buffer), hFile);
    snprintf(buffer, elcount(buffer), "0.0000 HMI_Odo := %f\n", getValue( HMI_Odo ) );        filePutString (buffer, elcount(buffer), hFile);
    snprintf(buffer, elcount(buffer), "0.0000 HMI_UnitVehSpd := %f\n", getValue( HMI_UnitVehSpd ) );        filePutString (buffer, elcount(buffer), hFile);
    snprintf(buffer, elcount(buffer), "0.0000 HMI_VehSpd_Disp := %f\n", getValue( HMI_VehSpd_Disp ) );        filePutString (buffer, elcount(buffer), hFile);
    snprintf(buffer, elcount(buffer), "0.0000 HMI_AAS4_DrowWarnDisp_Stat := %f\n", getValue( HMI_AAS4_DrowWarnDisp_Stat ) );        filePutString (buffer, elcount(buffer), hFile);
    snprintf(buffer, elcount(buffer), "0.0000 HMI_AAS4_DstrctWarn_DispStat := %f\n", getValue( HMI_AAS4_DstrctWarn_DispStat ) );        filePutString (buffer, elcount(buffer), hFile);
}
/*@@end*/

/*@@caplFunc:IC_Date_Time_AR_init():*///function
IC_Date_Time_AR_init()
{
    // Botschaft IC_Date_Time_AR ---- Sendeart cyclicAndSpontanWithDelay
    _IC_Date_Time_AR_Cnt = 50;
    _IC_Date_Time_AR_SpontanFlag = 0;
    _IC_Date_Time_AR_DelayCnt = 10;
    /* zyklisch */ _mIC_Date_Time_AR.DateTmStat.phys = getValue( HMI_DateTmStat );
    /* zyklisch */ _mIC_Date_Time_AR.DateTmDay.phys = getValue( HMI_DateTmDay );
    /* zyklisch */ _mIC_Date_Time_AR.DateTmHour.phys = getValue( HMI_DateTmHour );
    /* zyklisch */ _mIC_Date_Time_AR.DateTmMinute.phys = getValue( HMI_DateTmMinute );
    /* zyklisch */ _mIC_Date_Time_AR.DateTmMonth.phys = getValue( HMI_DateTmMonth );
    /* zyklisch */ _mIC_Date_Time_AR.DateTmSecond.phys = getValue( HMI_DateTmSecond );
    /* zyklisch */ _mIC_Date_Time_AR.DateTmYear.phys = getValue( HMI_DateTmYear );
    /* zyklisch */ _mIC_Date_Time_AR.ICH_Dur_Rq.phys = getValue( HMI_ICH_Dur_Rq );
    /* zyklisch */ _mIC_Date_Time_AR.ICH_HtVn_Rq_IC.phys = getValue( HMI_ICH_HtVn_Rq_IC );
//    /* zyklisch */ _mIC_Date_Time_AR.TmFormat_IC.phys = getValue( HMI_TmFormat_IC );
}
/*@@end*/

/*@@caplFunc:IC_Date_Time_AR_saveEnvVars(dword):*///function
IC_Date_Time_AR_saveEnvVars( dword hFile )
{
    filePutString("\n// Knoten IC: IC_Date_Time_AR", 28, hFile);
    snprintf(buffer, elcount(buffer), "0.0000 HMI__STMSG_IC_Date_Time_AR %X\n", getValue( HMI__STMSG_IC_Date_Time_AR ));    filePutString (buffer, elcount(buffer), hFile);
    snprintf(buffer, elcount(buffer), "0.0000 HMI__STMSGT_IC_Date_Time_AR %X\n", getValue( HMI__STMSGT_IC_Date_Time_AR ));    filePutString (buffer, elcount(buffer), hFile);
    snprintf(buffer, elcount(buffer), "0.0000 HMI_DateTmDay := %X\n", getValue( HMI_DateTmDay ) );    filePutString (buffer, elcount(buffer), hFile);
    snprintf(buffer, elcount(buffer), "0.0000 HMI_DateTmHour := %X\n", getValue( HMI_DateTmHour ) );    filePutString (buffer, elcount(buffer), hFile);
    snprintf(buffer, elcount(buffer), "0.0000 HMI_DateTmMinute := %X\n", getValue( HMI_DateTmMinute ) );    filePutString (buffer, elcount(buffer), hFile);
    snprintf(buffer, elcount(buffer), "0.0000 HMI_DateTmMonth := %X\n", getValue( HMI_DateTmMonth ) );    filePutString (buffer, elcount(buffer), hFile);
    snprintf(buffer, elcount(buffer), "0.0000 HMI_DateTmSecond := %X\n", getValue( HMI_DateTmSecond ) );    filePutString (buffer, elcount(buffer), hFile);
    snprintf(buffer, elcount(buffer), "0.0000 HMI_DateTmStat := %X\n", getValue( HMI_DateTmStat ) );    filePutString (buffer, elcount(buffer), hFile);
    snprintf(buffer, elcount(buffer), "0.0000 HMI_DateTmWeekday := %X\n", getValue( HMI_DateTmWeekday ) );    filePutString (buffer, elcount(buffer), hFile);
    snprintf(buffer, elcount(buffer), "0.0000 HMI_DateTmYear := %X\n", getValue( HMI_DateTmYear ) );    filePutString (buffer, elcount(buffer), hFile);
    snprintf(buffer, elcount(buffer), "0.0000 HMI_ICH_Dur_Rq := %X\n", getValue( HMI_ICH_Dur_Rq ) );    filePutString (buffer, elcount(buffer), hFile);
    snprintf(buffer, elcount(buffer), "0.0000 HMI_ICH_HtVn_Rq_IC := %X\n", getValue( HMI_ICH_HtVn_Rq_IC ) );    filePutString (buffer, elcount(buffer), hFile);
}
/*@@end*/

/*@@caplFunc:Maintenance1_AR_init():*///function
Maintenance1_AR_init()
{
    // Botschaft Maintenance1_AR ---- Sendeart cyclicX ---- Beginn Initialisierung
    _Maintenance1_AR_Cnt = 250;
    /* zyklisch */ _mMaintenance1_AR.MtData_Ok.phys = getValue( HMI_MtData_Ok );
    /* zyklisch */ _mMaintenance1_AR.MtPckt_1_Due.phys = getValue( HMI_MtPckt_1_Due );
    /* zyklisch */ _mMaintenance1_AR.MtPckt_2_Due.phys = getValue( HMI_MtPckt_2_Due );
    /* zyklisch */ _mMaintenance1_AR.MtPckt_3_Due.phys = getValue( HMI_MtPckt_3_Due );
    /* zyklisch */ _mMaintenance1_AR.MtPckt_4_Due.phys = getValue( HMI_MtPckt_4_Due );
    /* zyklisch */ _mMaintenance1_AR.MtPckt_5_Due.phys = getValue( HMI_MtPckt_5_Due );
    /* zyklisch */ _mMaintenance1_AR.MtPckt_6_Due.phys = getValue( HMI_MtPckt_6_Due );
    /* zyklisch */ _mMaintenance1_AR.MtPckt_7_Due.phys = getValue( HMI_MtPckt_7_Due );
    /* zyklisch */ _mMaintenance1_AR.Prio_ResDistTm.phys = getValue( HMI_Prio_ResDistTm );
    /* zyklisch */ _mMaintenance1_AR.ResDist.phys = getValue( HMI_ResDist );
    /* zyklisch */ _mMaintenance1_AR.ResTm_V2.phys = getValue( HMI_ResTm_V2 );
    /* zyklisch */ _mMaintenance1_AR.ServCode_Digit1.phys = getValue( HMI_ServCode_Digit1 );
    /* zyklisch */ _mMaintenance1_AR.ServCode_Digit2.phys = getValue( HMI_ServCode_Digit2 );
    /* zyklisch */ _mMaintenance1_AR.ServCont.phys = getValue( HMI_ServCont );
    /* zyklisch */ _mMaintenance1_AR.ServDispMd.phys = getValue( HMI_ServDispMd );
    /* zyklisch */ _mMaintenance1_AR.ServWarn.phys = getValue( HMI_ServWarn );
    /* zyklisch */ _mMaintenance1_AR.SpecServ_Disp_Rq.phys = getValue( HMI_SpecServ_Disp_Rq );
    /* zyklisch */ _mMaintenance1_AR.Unit_ResDist.phys = getValue( HMI_Unit_ResDist );
}
/*@@end*/

/*@@caplFunc:IC_DriveAssistSys_AR_init():*///function
IC_DriveAssistSys_AR_init()
{
    // Botschaft Maintenance1_AR ---- Sendeart cyclicX ---- Beginn Initialisierung
//    _Maintenance1_AR_Cnt = 8;
    /* zyklisch */ _mIC_DriveAssistSys_AR.CRC_RollTestMd_SPCR_Stat_IC.phys = getValue( HMI_CRC_RollTestMd_SPCR_Stat_IC );
//    /* zyklisch */ _mIC_DriveAssistSys_AR.DrowDtct_Md_Rq.phys = getValue( HMI_DrowDtct_Md_Rq );
    /* zyklisch */ _mIC_DriveAssistSys_AR.DrowWarnDisp_Stat.phys = getValue( HMI_DrowWarnDisp_Stat );
//    /* zyklisch */ _mIC_DriveAssistSys_AR.ESP_Md_Rq.phys = getValue( HMI_ESP_Md_Rq );
    /* zyklisch */ _mIC_DriveAssistSys_AR.PreHtIndLmp_Flt.phys = getValue( HMI_PreHtIndLmp_Flt );
    /* zyklisch */ _mIC_DriveAssistSys_AR.PTS_Disp_Stat_IC.phys = getValue( HMI_PTS_Disp_Stat_IC );
    /* zyklisch */ _mIC_DriveAssistSys_AR.RollTestMd_Rq.phys = getValue( HMI_RollTestMd_Rq );
    /* zyklisch */ _mIC_DriveAssistSys_AR.RoofLuggMd_Rq.phys = getValue( HMI_RoofLuggMd_Rq );
    /* zyklisch */ _mIC_DriveAssistSys_AR.Rsrv1_RollTestMd_SPCR_Stat_IC.phys = getValue( HMI_Rsrv1_RollTestMd_SPCR_Stat_IC );
    /* zyklisch */ _mIC_DriveAssistSys_AR.Rsrv2_RollTestMd_SPCR_Stat_IC.phys = getValue( HMI_Rsrv2_RollTestMd_SPCR_Stat_IC );
    /* zyklisch */ _mIC_DriveAssistSys_AR.SPCR_Conf_IC.phys = getValue( HMI_SPCR_Conf_IC );
    /* zyklisch */ _mIC_DriveAssistSys_AR.SPCR_Flt_IC.phys = getValue( HMI_SPCR_Flt_IC );
    /* zyklisch */ _mIC_DriveAssistSys_AR.SQC_RollTestMd_SPCR_Stat_IC.phys = getValue( HMI_SQC_RollTestMd_SPCR_Stat_IC );
}
/*@@end*/

/*@@caplFunc:Maintenance1_AR_saveEnvVars(dword):*///function
Maintenance1_AR_saveEnvVars( dword hFile )
{
        filePutString("\n// Knoten IC: Maintenance1_AR\n", 28, hFile);
        snprintf(buffer, elcount(buffer), "0.0000 HMI__STMSG__Maintenance1_AR := %X\n", getValue(HMI__STMSG_Maintenance1_AR ));        filePutString (buffer, elcount(buffer), hFile);
        snprintf(buffer, elcount(buffer), "0.0000 HMI__STMSGT_Maintenance1_AR := %X\n", getValue(HMI__STMSGT_Maintenance1_AR ));        filePutString (buffer, elcount(buffer), hFile);
        snprintf(buffer, elcount(buffer), "0.0000 HMI_MtData_Ok := %X\n", getValue( HMI_MtData_Ok ) );        filePutString (buffer, elcount(buffer), hFile);
        snprintf(buffer, elcount(buffer), "0.0000 HMI_MtPckt_1_Due := %X\n", getValue( HMI_MtPckt_1_Due ) );        filePutString (buffer, elcount(buffer), hFile);
        snprintf(buffer, elcount(buffer), "0.0000 HMI_MtPckt_2_Due := %X\n", getValue( HMI_MtPckt_2_Due ) );        filePutString (buffer, elcount(buffer), hFile);
        snprintf(buffer, elcount(buffer), "0.0000 HMI_MtPckt_3_Due := %X\n", getValue( HMI_MtPckt_3_Due ) );        filePutString (buffer, elcount(buffer), hFile);
        snprintf(buffer, elcount(buffer), "0.0000 HMI_MtPckt_4_Due := %X\n", getValue( HMI_MtPckt_4_Due ) );        filePutString (buffer, elcount(buffer), hFile);
        snprintf(buffer, elcount(buffer), "0.0000 HMI_MtPckt_5_Due := %X\n", getValue( HMI_MtPckt_5_Due ) );        filePutString (buffer, elcount(buffer), hFile);
        snprintf(buffer, elcount(buffer), "0.0000 HMI_MtPckt_6_Due := %X\n", getValue( HMI_MtPckt_6_Due ) );        filePutString (buffer, elcount(buffer), hFile);
        snprintf(buffer, elcount(buffer), "0.0000 HMI_MtPckt_7_Due := %X\n", getValue( HMI_MtPckt_7_Due ) );        filePutString (buffer, elcount(buffer), hFile);
        snprintf(buffer, elcount(buffer), "0.0000 HMI_Prio_ResDistTm := %X\n", getValue( HMI_Prio_ResDistTm ) );        filePutString (buffer, elcount(buffer), hFile);
        snprintf(buffer, elcount(buffer), "0.0000 HMI_ResDist := %X\n", getValue( HMI_ResDist ) );        filePutString (buffer, elcount(buffer), hFile);
        snprintf(buffer, elcount(buffer), "0.0000 HMI_ResTm_V2 := %X\n", getValue( HMI_ResTm_V2 ) );        filePutString (buffer, elcount(buffer), hFile);
        snprintf(buffer, elcount(buffer), "0.0000 HMI_ServCode_Digit1 := %X\n", getValue( HMI_ServCode_Digit1 ) );        filePutString (buffer, elcount(buffer), hFile);
        snprintf(buffer, elcount(buffer), "0.0000 HMI_ServCode_Digit2 := %X\n", getValue( HMI_ServCode_Digit2 ) );        filePutString (buffer, elcount(buffer), hFile);
        snprintf(buffer, elcount(buffer), "0.0000 HMI_ServCont := %X\n", getValue( HMI_ServCont ) );        filePutString (buffer, elcount(buffer), hFile);
        snprintf(buffer, elcount(buffer), "0.0000 HMI_ServDispMd := %X\n", getValue( HMI_ServDispMd ) );        filePutString (buffer, elcount(buffer), hFile);
        snprintf(buffer, elcount(buffer), "0.0000 HMI_ServWarn} := %X\n", getValue( HMI_ServWarn ) );        filePutString (buffer, elcount(buffer), hFile);
        snprintf(buffer, elcount(buffer), "0.0000 HMI_SpecServ_Disp_Rq := %X\n", getValue( HMI_SpecServ_Disp_Rq ) );        filePutString (buffer, elcount(buffer), hFile);
        snprintf(buffer, elcount(buffer), "0.0000 HMI_Unit_ResDist := %X\n", getValue( HMI_Unit_ResDist ) );        filePutString (buffer, elcount(buffer), hFile);
}
/*@@end*/

/*@@caplFunc:TP_IC_TGW_Tel_saveEnvVars(dword):*///function
TP_IC_TGW_Tel_saveEnvVars( dword hFile )
{
    filePutString("\n// Knoten IC: TP_IC_TGW_Tel\n", 30, hFile);
    snprintf(buffer, elcount(buffer), "0.0000 HMI__STMSG_TP_IC_TGW_Tel := %X\n", getValue( HMI__STMSG_TP_IC_TGW_Tel));    filePutString (buffer, elcount(buffer), hFile);
    snprintf(buffer, elcount(buffer), "0.0000 HMI__STMSGT_TP_IC_TGW_Tel := %X\n", getValue( HMI__STMSGT_TP_IC_TGW_Tel));    filePutString (buffer, elcount(buffer), hFile);
    snprintf(buffer, elcount(buffer), "0.0000 HMI_TP_IC_TGW_Tel_0 := %X\n", getValue( HMI_TP_IC_TGW_Tel_0 ) );    filePutString (buffer, elcount(buffer), hFile);
    snprintf(buffer, elcount(buffer), "0.0000 HMI_TP_IC_TGW_Tel_1 := %X\n", getValue( HMI_TP_IC_TGW_Tel_1 ) );    filePutString (buffer, elcount(buffer), hFile);
    snprintf(buffer, elcount(buffer), "0.0000 HMI_TP_IC_TGW_Tel_2 := %X\n", getValue( HMI_TP_IC_TGW_Tel_2 ) );    filePutString (buffer, elcount(buffer), hFile);
    snprintf(buffer, elcount(buffer), "0.0000 HMI_TP_IC_TGW_Tel_3 := %X\n", getValue( HMI_TP_IC_TGW_Tel_3 ) );    filePutString (buffer, elcount(buffer), hFile);
    snprintf(buffer, elcount(buffer), "0.0000 HMI_TP_IC_TGW_Tel_4 := %X\n", getValue( HMI_TP_IC_TGW_Tel_4 ) );    filePutString (buffer, elcount(buffer), hFile);
    snprintf(buffer, elcount(buffer), "0.0000 HMI_TP_IC_TGW_Tel_5 := %X\n", getValue( HMI_TP_IC_TGW_Tel_5 ) );    filePutString (buffer, elcount(buffer), hFile);
    snprintf(buffer, elcount(buffer), "0.0000 HMI_TP_IC_TGW_Tel_6 := %X\n", getValue( HMI_TP_IC_TGW_Tel_6 ) );    filePutString (buffer, elcount(buffer), hFile);
    snprintf(buffer, elcount(buffer), "0.0000 HMI_TP_IC_TGW_Tel_7 := %X\n", getValue( HMI_TP_IC_TGW_Tel_7 ) );    filePutString (buffer, elcount(buffer), hFile);
}
/*@@end*/

/*@@caplFunc:TP_IC_TGW_Nav_saveEnvVars(dword):*///function
TP_IC_TGW_Nav_saveEnvVars( dword hFile )
{
        filePutString("\n// Knoten IC: TP_IC_TGW_Nav\n", 30, hFile);
        snprintf(buffer, elcount(buffer), "0.0000 HMI__STMSG_TP_IC_TGW_Nav := %X\n", getValue( HMI__STMSG_TP_IC_TGW_Nav));        filePutString (buffer, elcount(buffer), hFile);
        snprintf(buffer, elcount(buffer), "0.0000 HMI__STMSGT_TP_IC_TGW_Nav := %X\n", getValue( HMI__STMSGT_TP_IC_TGW_Nav));        filePutString (buffer, elcount(buffer), hFile);
        snprintf(buffer, elcount(buffer), "0.0000 HMI_TP_IC_TGW_Nav_0 := %X\n", getValue( HMI_TP_IC_TGW_Nav_0 ) );        filePutString (buffer, elcount(buffer), hFile);
        snprintf(buffer, elcount(buffer), "0.0000 HMI_TP_IC_TGW_Nav_1 := %X\n", getValue( HMI_TP_IC_TGW_Nav_1 ) );        filePutString (buffer, elcount(buffer), hFile);
        snprintf(buffer, elcount(buffer), "0.0000 HMI_TP_IC_TGW_Nav_2 := %X\n", getValue( HMI_TP_IC_TGW_Nav_2 ) );        filePutString (buffer, elcount(buffer), hFile);
        snprintf(buffer, elcount(buffer), "0.0000 HMI_TP_IC_TGW_Nav_3 := %X\n", getValue( HMI_TP_IC_TGW_Nav_3 ) );        filePutString (buffer, elcount(buffer), hFile);
        snprintf(buffer, elcount(buffer), "0.0000 HMI_TP_IC_TGW_Nav_4 := %X\n", getValue( HMI_TP_IC_TGW_Nav_4 ) );        filePutString (buffer, elcount(buffer), hFile);
        snprintf(buffer, elcount(buffer), "0.0000 HMI_TP_IC_TGW_Nav_5 := %X\n", getValue( HMI_TP_IC_TGW_Nav_5 ) );        filePutString (buffer, elcount(buffer), hFile);
        snprintf(buffer, elcount(buffer), "0.0000 HMI_TP_IC_TGW_Nav_6 := %X\n", getValue( HMI_TP_IC_TGW_Nav_6 ) );        filePutString (buffer, elcount(buffer), hFile);
        snprintf(buffer, elcount(buffer), "0.0000 HMI_TP_IC_TGW_Nav_7 := %X\n", getValue( HMI_TP_IC_TGW_Nav_7 ) );        filePutString (buffer, elcount(buffer), hFile);
}
/*@@end*/

/*@@caplFunc:IC_DriveAssistSys_AR_saveEnvVars(dword):*///function
IC_DriveAssistSys_AR_saveEnvVars( dword hFile )
{
    filePutString("\n// Knoten IC: IC_DriveAssistSys_AR\n", 28, hFile);
    snprintf(buffer, elcount(buffer), "0.0000 HMI__STMSG_DriveAssistSys_AR := %X\n", getValue(HMI__STMSG_Maintenance1_AR ));        filePutString (buffer, elcount(buffer), hFile);
    snprintf(buffer, elcount(buffer), "0.0000 HMI__STMSGT_DriveAssistSys_AR := %X\n", getValue(HMI__STMSGT_Maintenance1_AR ));        filePutString (buffer, elcount(buffer), hFile);
    snprintf(buffer, elcount(buffer), "0.0000 HMI_APM_RaceMd_Rq := %X\n", getValue( HMI_APM_RaceMd_Rq ) );        filePutString (buffer, elcount(buffer), hFile);
    snprintf(buffer, elcount(buffer), "0.0000 HMI_CRC_RollTestMd_SPCR_Stat_IC := %X\n", getValue( HMI_CRC_RollTestMd_SPCR_Stat_IC ) );        filePutString (buffer, elcount(buffer), hFile);
    snprintf(buffer, elcount(buffer), "0.0000 HMI_CRC_RollTestMd_SPCR_Stat_IC_Auto := %X\n", getValue( HMI_CRC_RollTestMd_SPCR_Stat_IC_Auto ) );        filePutString (buffer, elcount(buffer), hFile);
    snprintf(buffer, elcount(buffer), "0.0000 HMI_CRC_RollTestMd_SPCR_Stat_IC_Invalid := %X\n", getValue( HMI_CRC_RollTestMd_SPCR_Stat_IC_Invalid ) );        filePutString (buffer, elcount(buffer), hFile);
    snprintf(buffer, elcount(buffer), "0.0000 HMI_DrowWarnDisp_Stat := %X\n", getValue( HMI_DrowWarnDisp_Stat ) );        filePutString (buffer, elcount(buffer), hFile);
    snprintf(buffer, elcount(buffer), "0.0000 HMI_PreHtIndLmp_Flt := %X\n", getValue( HMI_PreHtIndLmp_Flt ) );        filePutString (buffer, elcount(buffer), hFile);
    snprintf(buffer, elcount(buffer), "0.0000 HMI_PTS_Disp_Stat_IC := %X\n", getValue( HMI_PTS_Disp_Stat_IC ) );        filePutString (buffer, elcount(buffer), hFile);
    snprintf(buffer, elcount(buffer), "0.0000 HMI_RollTestMd_Rq := %X\n", getValue( HMI_RollTestMd_Rq ) );        filePutString (buffer, elcount(buffer), hFile);
    snprintf(buffer, elcount(buffer), "0.0000 HMI_RoofLuggMd_Rq := %X\n", getValue( HMI_RoofLuggMd_Rq ) );        filePutString (buffer, elcount(buffer), hFile);
    snprintf(buffer, elcount(buffer), "0.0000 HMI_Rsrv1_RollTestMd_SPCR_Stat_IC := %X\n", getValue( HMI_Rsrv1_RollTestMd_SPCR_Stat_IC ) );        filePutString (buffer, elcount(buffer), hFile);
    snprintf(buffer, elcount(buffer), "0.0000 HMI_Rsrv2_RollTestMd_SPCR_Stat_IC := %X\n", getValue( HMI_Rsrv2_RollTestMd_SPCR_Stat_IC ) );        filePutString (buffer, elcount(buffer), hFile);
    snprintf(buffer, elcount(buffer), "0.0000 HMI_Rsrv3_RollTestMd_SPCR_Stat_IC := %X\n", getValue( HMI_Rsrv3_RollTestMd_SPCR_Stat_IC ) );        filePutString (buffer, elcount(buffer), hFile);
    snprintf(buffer, elcount(buffer), "0.0000 HMI_SPCR_Conf_IC := %X\n", getValue( HMI_SPCR_Conf_IC ) );        filePutString (buffer, elcount(buffer), hFile);
    snprintf(buffer, elcount(buffer), "0.0000 HMI_SPCR_Flt_IC := %X\n", getValue( HMI_SPCR_Flt_IC ) );        filePutString (buffer, elcount(buffer), hFile);
    snprintf(buffer, elcount(buffer), "0.0000 HMI_SQC_RollTestMd_SPCR_Stat_IC := %X\n", getValue( HMI_SQC_RollTestMd_SPCR_Stat_IC ) );        filePutString (buffer, elcount(buffer), hFile);
    snprintf(buffer, elcount(buffer), "0.0000 HMI_SQC_RollTestMd_SPCR_Stat_IC_Auto := %X\n", getValue( HMI_SQC_RollTestMd_SPCR_Stat_IC_Auto ) );        filePutString (buffer, elcount(buffer), hFile);
}
/*@@end*/

/*@@caplFunc:Meas_IC_3_saveEnvVars(dword):*///function
Meas_IC_3_saveEnvVars( dword hFile )
{
        filePutString("\n// Knoten IC: Meas_IC_3\n", 25, hFile);
        snprintf(buffer, elcount(buffer), "0.0000 HMI__STMSG_IC_Meas_IC_3 := %X\n", getValue( HMI__STMSG_IC_Meas_IC_3));        filePutString (buffer, elcount(buffer), hFile);
        snprintf(buffer, elcount(buffer), "0.0000 HMI__STMSGT_IC_Meas_IC_3 := %X\n", getValue( HMI__STMSGT_IC_Meas_IC_3));        filePutString (buffer, elcount(buffer), hFile);
        snprintf(buffer, elcount(buffer), "0.0000 HMI_Meas_IC_3A := %X\n", getValue( HMI_Meas_IC_3A ) );        filePutString (buffer, elcount(buffer), hFile);
        snprintf(buffer, elcount(buffer), "0.0000 HMI_Meas_IC_3B := %X\n", getValue( HMI_Meas_IC_3B ) );        filePutString (buffer, elcount(buffer), hFile);
        snprintf(buffer, elcount(buffer), "0.0000 HMI_Meas_IC_3C := %X\n", getValue( HMI_Meas_IC_3C ) );        filePutString (buffer, elcount(buffer), hFile);
        snprintf(buffer, elcount(buffer), "0.0000 HMI_Meas_IC_3D := %X\n", getValue( HMI_Meas_IC_3D ) );        filePutString (buffer, elcount(buffer), hFile);
        snprintf(buffer, elcount(buffer), "0.0000 HMI_Meas_IC_3E := %X\n", getValue( HMI_Meas_IC_3E ) );        filePutString (buffer, elcount(buffer), hFile);
        snprintf(buffer, elcount(buffer), "0.0000 HMI_Meas_IC_3F := %X\n", getValue( HMI_Meas_IC_3F ) );        filePutString (buffer, elcount(buffer), hFile);
        snprintf(buffer, elcount(buffer), "0.0000 HMI_Meas_IC_3G := %X\n", getValue( HMI_Meas_IC_3G ) );        filePutString (buffer, elcount(buffer), hFile);
        snprintf(buffer, elcount(buffer), "0.0000 HMI_Meas_IC_3H := %X\n", getValue( HMI_Meas_IC_3H ) );        filePutString (buffer, elcount(buffer), hFile);
}
/*@@end*/

/*@@caplFunc:Meas_IC_2_saveEnvVars(dword):*///function
Meas_IC_2_saveEnvVars( dword hFile )
{
        filePutString("\n// Knoten IC: Meas_IC_2\n", 25, hFile);
        snprintf(buffer, elcount(buffer), "0.0000 HMI__STMSG_IC_Meas_IC_2 := %X\n", getValue( HMI__STMSG_IC_Meas_IC_2 ));        filePutString (buffer, elcount(buffer), hFile);
        snprintf(buffer, elcount(buffer), "0.0000 HMI__STMSGT_IC_Meas_IC_2 := %X\n", getValue( HMI__STMSGT_IC_Meas_IC_2 ));        filePutString (buffer, elcount(buffer), hFile);
        snprintf(buffer, elcount(buffer), "0.0000 HMI_Meas_IC_2A := %X\n", getValue( HMI_Meas_IC_2A ) );        filePutString (buffer, elcount(buffer), hFile);
        snprintf(buffer, elcount(buffer), "0.0000 HMI_Meas_IC_2B := %X\n", getValue( HMI_Meas_IC_2B ) );        filePutString (buffer, elcount(buffer), hFile);
        snprintf(buffer, elcount(buffer), "0.0000 HMI_Meas_IC_2C := %X\n", getValue( HMI_Meas_IC_2C ) );        filePutString (buffer, elcount(buffer), hFile);
        snprintf(buffer, elcount(buffer), "0.0000 HMI_Meas_IC_2D := %X\n", getValue( HMI_Meas_IC_2D ) );        filePutString (buffer, elcount(buffer), hFile);
        snprintf(buffer, elcount(buffer), "0.0000 HMI_Meas_IC_2E := %X\n", getValue( HMI_Meas_IC_2E ) );        filePutString (buffer, elcount(buffer), hFile);
        snprintf(buffer, elcount(buffer), "0.0000 HMI_Meas_IC_2F := %X\n", getValue( HMI_Meas_IC_2F ) );        filePutString (buffer, elcount(buffer), hFile);
        snprintf(buffer, elcount(buffer), "0.0000 HMI_Meas_IC_2G := %X\n", getValue( HMI_Meas_IC_2G ) );        filePutString (buffer, elcount(buffer), hFile);
        snprintf(buffer, elcount(buffer), "0.0000 HMI_Meas_IC_2H := %X\n", getValue( HMI_Meas_IC_2H ) );        filePutString (buffer, elcount(buffer), hFile);
}
/*@@end*/

/*@@caplFunc:Meas_IC_1_saveEnvVars(dword):*///function
Meas_IC_1_saveEnvVars( dword hFile )
{
        filePutString("\n// Knoten IC: Meas_IC_1\n", 25, hFile);
        snprintf(buffer, elcount(buffer), "0.0000 HMI__STMSG_IC_Meas_IC_1 := %X\n", getValue( HMI__STMSG_IC_Meas_IC_1 ));        filePutString (buffer, elcount(buffer), hFile);
        snprintf(buffer, elcount(buffer), "0.0000 HMI__STMSGT_IC_Meas_IC_1 := %X\n", getValue( HMI__STMSGT_IC_Meas_IC_1 ));        filePutString (buffer, elcount(buffer), hFile);
        snprintf(buffer, elcount(buffer), "0.0000 HMI_Meas_IC_1A := %X\n", getValue( HMI_Meas_IC_1A ) );        filePutString (buffer, elcount(buffer), hFile);
        snprintf(buffer, elcount(buffer), "0.0000 HMI_Meas_IC_1B := %X\n", getValue( HMI_Meas_IC_1B ) );        filePutString (buffer, elcount(buffer), hFile);
        snprintf(buffer, elcount(buffer), "0.0000 HMI_Meas_IC_1C := %X\n", getValue( HMI_Meas_IC_1C ) );        filePutString (buffer, elcount(buffer), hFile);
        snprintf(buffer, elcount(buffer), "0.0000 HMI_Meas_IC_1D := %X\n", getValue( HMI_Meas_IC_1D ) );        filePutString (buffer, elcount(buffer), hFile);
        snprintf(buffer, elcount(buffer), "0.0000 HMI_Meas_IC_1E := %X\n", getValue( HMI_Meas_IC_1E ) );        filePutString (buffer, elcount(buffer), hFile);
        snprintf(buffer, elcount(buffer), "0.0000 HMI_Meas_IC_1F := %X\n", getValue( HMI_Meas_IC_1F ) );        filePutString (buffer, elcount(buffer), hFile);
        snprintf(buffer, elcount(buffer), "0.0000 HMI_Meas_IC_1G := %X\n", getValue( HMI_Meas_IC_1G ) );        filePutString (buffer, elcount(buffer), hFile);
        snprintf(buffer, elcount(buffer), "0.0000 HMI_Meas_IC_1H := %X\n", getValue( HMI_Meas_IC_1H ) );        filePutString (buffer, elcount(buffer), hFile);
}
/*@@end*/

/*@@caplFunc:Meas_IC_4_saveEnvVars(dword):*///function
Meas_IC_4_saveEnvVars( dword hFile )
{
        filePutString("\n// Knoten IC: Meas_IC_4\n", 25, hFile);
        snprintf(buffer, elcount(buffer), "0.0000 HMI__STMSG_IC_Meas_IC_4 := %X\n", getValue( HMI__STMSG_IC_Meas_IC_4 ));        filePutString (buffer, elcount(buffer), hFile);
        snprintf(buffer, elcount(buffer), "0.0000 HMI__STMSGT_IC_Meas_IC_4 := %X\n", getValue( HMI__STMSGT_IC_Meas_IC_4 ));        filePutString (buffer, elcount(buffer), hFile);
        snprintf(buffer, elcount(buffer), "0.0000 HMI_Meas_IC_4A := %X\n", getValue( HMI_Meas_IC_4A ) );        filePutString (buffer, elcount(buffer), hFile);
        snprintf(buffer, elcount(buffer), "0.0000 HMI_Meas_IC_4B := %X\n", getValue( HMI_Meas_IC_4B ) );        filePutString (buffer, elcount(buffer), hFile);
        snprintf(buffer, elcount(buffer), "0.0000 HMI_Meas_IC_4C := %X\n", getValue( HMI_Meas_IC_4C ) );        filePutString (buffer, elcount(buffer), hFile);
        snprintf(buffer, elcount(buffer), "0.0000 HMI_Meas_IC_4D := %X\n", getValue( HMI_Meas_IC_4D ) );        filePutString (buffer, elcount(buffer), hFile);
        snprintf(buffer, elcount(buffer), "0.0000 HMI_Meas_IC_4E := %X\n", getValue( HMI_Meas_IC_4E ) );        filePutString (buffer, elcount(buffer), hFile);
        snprintf(buffer, elcount(buffer), "0.0000 HMI_Meas_IC_4F := %X\n", getValue( HMI_Meas_IC_4F ) );        filePutString (buffer, elcount(buffer), hFile);
        snprintf(buffer, elcount(buffer), "0.0000 HMI_Meas_IC_4G := %X\n", getValue( HMI_Meas_IC_4G ) );        filePutString (buffer, elcount(buffer), hFile);
        snprintf(buffer, elcount(buffer), "0.0000 HMI_Meas_IC_4H := %X\n", getValue( HMI_Meas_IC_4H ) );        filePutString (buffer, elcount(buffer), hFile);
}
/*@@end*/

/*@@caplFunc:IC_BasicInfo2_AR_check_output():*///function
IC_BasicInfo2_AR_check_output()
{
      if ( !getValue( HMI__STMSG_IC_BasicInfo2_AR ) )
    {
        // Botschaft IC_BasicInfo2_AR --- Sendeart 0 cyclicX
        _IC_BasicInfo2_AR_Cnt--;
        if ( _IC_BasicInfo2_AR_Cnt < 1 )
        {
            // Nachricht wg. abgelaufenem Zyklus ausgeben
            output( _mIC_BasicInfo2_AR );
            // Zyklus-Zähler zurücksetzen
            _IC_BasicInfo2_AR_Cnt = _IC_BasicInfo2_AR_CycleCount;
        }
    }
}
/*@@end*/

/*@@caplFunc:IC_BasicInfo_AR_check_output():*///function
IC_BasicInfo_AR_check_output()
{
      if (!getValue( HMI__STMSG_IC_BasicInfo_AR ) )
    {
        // Botschaft IC_BasicInfo_AR --- Sendeart cyclicAndSpontanWithDelay --- Beginn DBKOM-Bewertung
        if ( _IC_BasicInfo_AR_DelayCnt > 0 ) _IC_BasicInfo_AR_DelayCnt--; // Mindestsendeabstand
        _IC_BasicInfo_AR_Cnt--;
        if ( _IC_BasicInfo_AR_Cnt < 1)
        {
            if ( _IC_BasicInfo_AR_DelayCnt < 1 )
            {
                // Nachricht wg. abgelaufenem Zyklus ausgeben (Mindestsendeabstand eingehalten)
                output( _mIC_BasicInfo_AR );
                 _IC_BasicInfo_AR_SpontanFlag = 0; // Spontan-Flag zurücksetzen
                _IC_BasicInfo_AR_DelayCnt = _IC_BasicInfo_AR_MinDelay;
            }
            else
            {
                // Spontanflag setzen damit nach Ablauf Mindestsendeabstand gesendet wird
                 _IC_BasicInfo_AR_SpontanFlag = 1;
            }
            _IC_BasicInfo_AR_Cnt = _IC_BasicInfo_AR_CycleCount; // Zyklus-Zähler zurücksetzen
        }
        else if ( _IC_BasicInfo_AR_SpontanFlag )
        {
            if ( _IC_BasicInfo_AR_DelayCnt < 1 )
            {
                // Nachricht wg. spontaner Änderung ausgeben (Mindestsendeabstand eingehalten)
                output( _mIC_BasicInfo_AR );
                _IC_BasicInfo_AR_SpontanFlag = 0; // Spontan-Flag zurücksetzen
                _IC_BasicInfo_AR_DelayCnt = _IC_BasicInfo_AR_MinDelay;
            }
        }
    }
}
/*@@end*/

/*@@caplFunc:Maintenance2_AR_init():*///function
Maintenance2_AR_init()
{
    // Botschaft Maintenance2_AR ---- Sendeart cyclicX ---- Beginn Initialisierung
    _Maintenance2_AR_Cnt = 250;
    /* zyklisch */ _mMaintenance2_AR.ServCode_BitGrp_0.phys = getValue( HMI_ServCode_BitGrp_0 );
    /* zyklisch */ _mMaintenance2_AR.ServCode_BitGrp_1.phys = getValue( HMI_ServCode_BitGrp_1 );
    /* zyklisch */ _mMaintenance2_AR.ServCode_BitGrp_2.phys = getValue( HMI_ServCode_BitGrp_2 );
    /* zyklisch */ _mMaintenance2_AR.ServCode_BitGrp_3.phys = getValue( HMI_ServCode_BitGrp_3 );
    /* zyklisch */ _mMaintenance2_AR.ServCode_BitGrp_4.phys = getValue( HMI_ServCode_BitGrp_4 );
    /* zyklisch */ _mMaintenance2_AR.ServCode_BitGrp_5.phys = getValue( HMI_ServCode_BitGrp_5 );
    /* zyklisch */ _mMaintenance2_AR.ServCode_BitGrp_6.phys = getValue( HMI_ServCode_BitGrp_6 );
    /* zyklisch */ _mMaintenance2_AR.ServCode_BitGrp_minus1.phys = getValue( HMI_ServCode_BitGrp_minus1 );
    /* zyklisch */ _mMaintenance2_AR.ServCode_BitGrp_minus2.phys = getValue( HMI_ServCode_BitGrp_minus2 );
    /* zyklisch */ _mMaintenance2_AR.ServCode_BitGrp_minus3.phys = getValue( HMI_ServCode_BitGrp_minus3 );
    /* zyklisch */ _mMaintenance2_AR.ServCode_Country_V2.phys = getValue( HMI_ServCode_Country_V2 );
    /* zyklisch */ _mMaintenance2_AR.ServCode_CRC_Hi.phys = getValue( HMI_ServCode_CRC_Hi );
    /* zyklisch */ _mMaintenance2_AR.ServCode_CRC_Lo.phys = getValue( HMI_ServCode_CRC_Lo );
}
/*@@end*/

/*@@caplFunc:Maintenance2_AR_saveEnvVars(dword):*///function
Maintenance2_AR_saveEnvVars( dword hFile )
{
    filePutString("\n// Knoten IC: Maintenance2_AR\n", 28, hFile);
    snprintf(buffer, elcount(buffer), "0.0000 HMI__STMSG_Maintenance2_AR := %X\n", getValue(HMI__STMSG_Maintenance2_AR ));        filePutString (buffer, elcount(buffer), hFile);
    snprintf(buffer, elcount(buffer), "0.0000 HMI__STMSGT_Maintenance2_AR := %X\n", getValue(HMI__STMSGT_Maintenance2_AR ));        filePutString (buffer, elcount(buffer), hFile);
    snprintf(buffer, elcount(buffer), "0.0000 HMI_ServCode_BitGrp_0 := %X\n", getValue( HMI_ServCode_BitGrp_0 ) );        filePutString (buffer, elcount(buffer), hFile);
    snprintf(buffer, elcount(buffer), "0.0000 HMI_ServCode_BitGrp_1 := %X\n", getValue( HMI_ServCode_BitGrp_1 ) );        filePutString (buffer, elcount(buffer), hFile);
    snprintf(buffer, elcount(buffer), "0.0000 HMI_ServCode_BitGrp_2 := %X\n", getValue( HMI_ServCode_BitGrp_2 ) );        filePutString (buffer, elcount(buffer), hFile);
    snprintf(buffer, elcount(buffer), "0.0000 HMI_ServCode_BitGrp_3 := %X\n", getValue( HMI_ServCode_BitGrp_3 ) );        filePutString (buffer, elcount(buffer), hFile);
    snprintf(buffer, elcount(buffer), "0.0000 HMI_ServCode_BitGrp_4 := %X\n", getValue( HMI_ServCode_BitGrp_4 ) );        filePutString (buffer, elcount(buffer), hFile);
    snprintf(buffer, elcount(buffer), "0.0000 HMI_ServCode_BitGrp_5 := %X\n", getValue( HMI_ServCode_BitGrp_5 ) );        filePutString (buffer, elcount(buffer), hFile);
    snprintf(buffer, elcount(buffer), "0.0000 HMI_ServCode_BitGrp_6 := %X\n", getValue( HMI_ServCode_BitGrp_6 ) );        filePutString (buffer, elcount(buffer), hFile);
    snprintf(buffer, elcount(buffer), "0.0000 HMI_ServCode_BitGrp_minus1 := %X\n", getValue( HMI_ServCode_BitGrp_minus1 ) );        filePutString (buffer, elcount(buffer), hFile);
    snprintf(buffer, elcount(buffer), "0.0000 HMI_ServCode_BitGrp_minus2 := %X\n", getValue( HMI_ServCode_BitGrp_minus2 ) );        filePutString (buffer, elcount(buffer), hFile);
    snprintf(buffer, elcount(buffer), "0.0000 HMI_ServCode_BitGrp_minus3 := %X\n", getValue( HMI_ServCode_BitGrp_minus3 ) );        filePutString (buffer, elcount(buffer), hFile);
    snprintf(buffer, elcount(buffer), "0.0000 HMI_ServCode_Country_V2 := %X\n", getValue( HMI_ServCode_Country_V2 ) );        filePutString (buffer, elcount(buffer), hFile);
    snprintf(buffer, elcount(buffer), "0.0000 HMI_ServCode_CRC_Hi := %X\n", getValue( HMI_ServCode_CRC_Hi ) );        filePutString (buffer, elcount(buffer), hFile);
    snprintf(buffer, elcount(buffer), "0.0000 HMI_ServCode_CRC_Lo := %X\n", getValue( HMI_ServCode_CRC_Lo ) );        filePutString (buffer, elcount(buffer), hFile);
}
/*@@end*/

/*@@caplFunc:Maintenance1_AR_check_output():*///function
Maintenance1_AR_check_output()
{
      if ( !getValue( HMI__STMSG_Maintenance1_AR ) )
    {
        // Botschaft Maintenance1_AR --- Sendeart 0 cyclicX
        _Maintenance1_AR_Cnt--;
        if ( _Maintenance1_AR_Cnt < 1 )
        {
            // Nachricht wg. abgelaufenem Zyklus ausgeben
            output( _mMaintenance1_AR );
            // Zyklus-Zähler zurücksetzen
            _Maintenance1_AR_Cnt = _Maintenance1_AR_CycleCount;
        }
    }
}
/*@@end*/

/*@@caplFunc:Maintenance2_AR_check_output():*///function
Maintenance2_AR_check_output()
{
      if ( !getValue( HMI__STMSG_Maintenance2_AR ) )
    {
        // Botschaft Maintenance2_AR --- Sendeart 0 cyclicX
        _Maintenance2_AR_Cnt--;
        if ( _Maintenance2_AR_Cnt < 1 )
        {
            // Nachricht wg. abgelaufenem Zyklus ausgeben
            output( _mMaintenance2_AR );
            // Zyklus-Zähler zurücksetzen
            _Maintenance2_AR_Cnt = _Maintenance2_AR_CycleCount;
        }
    }
}
/*@@end*/

/*@@caplFunc:NV_Rq_IC_AR_check_output():*///function
NV_Rq_IC_AR_check_output()
{
      if ( !getValue( HMI__STMSG_NV_Rq_IC_AR ) )
    {
        // Botschaft NV_Rq_IC_AR --- Sendeart 0 cyclicX
        _NV_Rq_IC_AR_Cnt--;
        if ( _NV_Rq_IC_AR_Cnt < 1 )
        {
            // Nachricht wg. abgelaufenem Zyklus ausgeben
            output( _mNV_Rq_IC_AR );
            // Zyklus-Zähler zurücksetzen
            _NV_Rq_IC_AR_Cnt = _NV_Rq_IC_AR_CycleCount;
        }
    }
}
/*@@end*/

/*@@caplFunc:IC_StWheelSwitches_AR_check_output():*///function
IC_StWheelSwitches_AR_check_output()
{
      if ( !getValue( HMI__STMSG_IC_StWheelSwitches_AR ) )
    {
        // Botschaft IC_StWheelSwitches_AR --- Sendeart cyclicAndSpontanWithDelay
        if (_IC_StWheelSwitches_AR_DelayCnt > 0) _IC_StWheelSwitches_AR_DelayCnt--; // Mindestsendeabstand
        _IC_StWheelSwitches_AR_Cnt--;
        if (_IC_StWheelSwitches_AR_Cnt < 1)
        {
            if (_IC_StWheelSwitches_AR_DelayCnt < 1)
            {
                // Nachricht wg. abgelaufenem Zyklus ausgeben (Mindestsendeabstand eingehalten)
                output( _mIC_StWheelSwitches_AR );
                 _IC_StWheelSwitches_AR_SpontanFlag = 0; // Spontan-Flag zurücksetzen
                _IC_StWheelSwitches_AR_DelayCnt = _IC_StWheelSwitches_AR_MinDelay;
            }
            else
            {
                // Spontanflag setzen damit nach Ablauf Mindestsendeabstand gesendet wird
                 _IC_StWheelSwitches_AR_SpontanFlag = 1;
            }
            _IC_StWheelSwitches_AR_Cnt = _IC_StWheelSwitches_AR_CycleCount; // Zyklus-Zähler zurücksetzen
        }
        else if ( _IC_StWheelSwitches_AR_SpontanFlag )
        {
            if ( _IC_StWheelSwitches_AR_DelayCnt < 1 )
            {
                // Nachricht wg. spontaner Änderung ausgeben (Mindestsendeabstand eingehalten)
                output( _mIC_StWheelSwitches_AR );
                _IC_StWheelSwitches_AR_SpontanFlag = 0; // Spontan-Flag zurücksetzen
                _IC_StWheelSwitches_AR_DelayCnt = _IC_StWheelSwitches_AR_MinDelay;
            }
        }
    }
}
/*@@end*/

/*@@caplFunc:IC_StWheelSwitches_AR_init():*///function
IC_StWheelSwitches_AR_init()
{
    // Botschaft IC_StWheelSwitches_AR ---- Sendeart cyclicAndSpontanWithDelay
    _IC_StWheelSwitches_AR_Cnt = 2;
    _IC_StWheelSwitches_AR_SpontanFlag = 0;
    /* sofort */ _mIC_StWheelSwitches_AR.IC_Stat_V2.phys = getValue(HMI_IC_Stat_V2 );
    /* sofort */ _mIC_StWheelSwitches_AR.StW_SwDown_HUD_Psd.phys = getValue(HMI_StW_SwDown_HUD_Psd );
    /* sofort */ _mIC_StWheelSwitches_AR.StW_SwDown_MPM_Psd.phys = getValue(HMI_StW_SwDown_MPM_Psd );
    /* sofort */ _mIC_StWheelSwitches_AR.StW_SwEnd_HU_Psd.phys = getValue(HMI_StW_SwEnd_HU_Psd );
    /* sofort */ _mIC_StWheelSwitches_AR.StW_SwEnd_TELEAID_Psd.phys = getValue(HMI_StW_SwEnd_TELEAID_Psd );
    /* sofort */ _mIC_StWheelSwitches_AR.StW_SwMinus_HU_Psd.phys = getValue(HMI_StW_SwMinus_HU_Psd );
    /* sofort */ _mIC_StWheelSwitches_AR.StW_SwMinus_MPM_Psd.phys = getValue(HMI_StW_SwMinus_MPM_Psd );
    /* sofort */ _mIC_StWheelSwitches_AR.StW_SwMinus_TELEAID_Psd.phys = getValue(HMI_StW_SwMinus_TELEAID_Psd );
    /* sofort */ _mIC_StWheelSwitches_AR.StW_SwMute_MPM_Psd.phys = getValue(HMI_StW_SwMute_MPM_Psd );
    /* sofort */ _mIC_StWheelSwitches_AR.StW_SwOk_MPM_Psd.phys = getValue(HMI_StW_SwOk_MPM_Psd );
    /* sofort */ _mIC_StWheelSwitches_AR.StW_SwPlus_HU_Psd.phys = getValue(HMI_StW_SwPlus_HU_Psd );
    /* sofort */ _mIC_StWheelSwitches_AR.StW_SwPlus_MPM_Psd.phys = getValue(HMI_StW_SwPlus_MPM_Psd );
    /* sofort */ _mIC_StWheelSwitches_AR.StW_SwPlus_TELEAID_Psd.phys = getValue(HMI_StW_SwPlus_TELEAID_Psd );
    /* sofort */ _mIC_StWheelSwitches_AR.StW_SwSDS_Can_HU_Psd.phys = getValue(HMI_StW_SwSDS_Can_HU_Psd );
    /* sofort */ _mIC_StWheelSwitches_AR.StW_SwSDS_Mute_HU_Psd.phys = getValue(HMI_StW_SwSDS_Mute_HU_Psd );
    /* sofort */ _mIC_StWheelSwitches_AR.StW_SwSDS_Start_HU_Psd.phys = getValue(HMI_StW_SwSDS_Start_HU_Psd );
    /* sofort */ _mIC_StWheelSwitches_AR.StW_SwSend_HU_Psd.phys = getValue(HMI_StW_SwSend_HU_Psd );
    /* sofort */ _mIC_StWheelSwitches_AR.StW_SwUp_HUD_Psd.phys = getValue(HMI_StW_SwUp_HUD_Psd );
    /* sofort */ _mIC_StWheelSwitches_AR.StW_SwUp_MPM_Psd.phys = getValue(HMI_StW_SwUp_MPM_Psd );
}
/*@@end*/

/*@@caplFunc:IC_StWheelSwitches_AR_saveEnvVars(dword):*///function
IC_StWheelSwitches_AR_saveEnvVars( dword hFile )
{
    filePutString("\n// Knoten IC: IC_StWheelSwitches_AR\n", 34, hFile);
    snprintf(buffer, elcount(buffer), "0.0000 HMI__STMSG_IC_StWheelSwitches_AR := %X\n", getValue( HMI__STMSG_IC_StWheelSwitches_AR ) );        filePutString (buffer, elcount(buffer), hFile);
    snprintf(buffer, elcount(buffer), "0.0000 HMI__STMSGT_IC_StWheelSwitches_AR := %X\n", getValue( HMI__STMSGT_IC_StWheelSwitches_AR ) );        filePutString (buffer, elcount(buffer), hFile);
    snprintf(buffer, elcount(buffer), "0.0000 HMI_IC_Stat_V2 := %X\n", getValue( HMI_IC_Stat_V2 ) );        filePutString (buffer, elcount(buffer), hFile);
    snprintf(buffer, elcount(buffer), "0.0000 HMI_StW_SwDown_HUD_Psd := %X\n", getValue( HMI_StW_SwDown_HUD_Psd ) );        filePutString (buffer, elcount(buffer), hFile);
    snprintf(buffer, elcount(buffer), "0.0000 HMI_StW_SwDown_MPM_Psd := %X\n", getValue( HMI_StW_SwDown_MPM_Psd ) );        filePutString (buffer, elcount(buffer), hFile);
    snprintf(buffer, elcount(buffer), "0.0000 HMI_StW_SwEnd_HU_Psd := %X\n", getValue( HMI_StW_SwEnd_HU_Psd ) );        filePutString (buffer, elcount(buffer), hFile);
    snprintf(buffer, elcount(buffer), "0.0000 HMI_StW_SwEnd_TELEAID_Psd := %X\n", getValue( HMI_StW_SwEnd_TELEAID_Psd ) );        filePutString (buffer, elcount(buffer), hFile);
    snprintf(buffer, elcount(buffer), "0.0000 HMI_StW_SwMinus_HU_Psd := %X\n", getValue( HMI_StW_SwMinus_HU_Psd ) );        filePutString (buffer, elcount(buffer), hFile);
    snprintf(buffer, elcount(buffer), "0.0000 HMI_StW_SwMinus_MPM_Psd := %X\n", getValue( HMI_StW_SwMinus_MPM_Psd ) );        filePutString (buffer, elcount(buffer), hFile);
    snprintf(buffer, elcount(buffer), "0.0000 HMI_StW_SwMinus_TELEAID_Psd := %X\n", getValue( HMI_StW_SwMinus_TELEAID_Psd ) );        filePutString (buffer, elcount(buffer), hFile);
    snprintf(buffer, elcount(buffer), "0.0000 HMI_StW_SwMute_MPM_Psd := %X\n", getValue( HMI_StW_SwMute_MPM_Psd ) );        filePutString (buffer, elcount(buffer), hFile);
    snprintf(buffer, elcount(buffer), "0.0000 HMI_StW_SwOk_MPM_Psd := %X\n", getValue( HMI_StW_SwOk_MPM_Psd ) );        filePutString (buffer, elcount(buffer), hFile);
    snprintf(buffer, elcount(buffer), "0.0000 HMI_StW_SwPlus_HU_Psd := %X\n", getValue( HMI_StW_SwPlus_HU_Psd ) );        filePutString (buffer, elcount(buffer), hFile);
    snprintf(buffer, elcount(buffer), "0.0000 HMI_StW_SwPlus_MPM_Psd := %X\n", getValue( HMI_StW_SwPlus_MPM_Psd ) );        filePutString (buffer, elcount(buffer), hFile);
    snprintf(buffer, elcount(buffer), "0.0000 HMI_StW_SwPlus_TELEAID_Psd := %X\n", getValue( HMI_StW_SwPlus_TELEAID_Psd ) );        filePutString (buffer, elcount(buffer), hFile);
    snprintf(buffer, elcount(buffer), "0.0000 HMI_StW_SwSDS_Can_HU_Psd := %X\n", getValue( HMI_StW_SwSDS_Can_HU_Psd ) );        filePutString (buffer, elcount(buffer), hFile);
    snprintf(buffer, elcount(buffer), "0.0000 HMI_StW_SwSDS_Mute_HU_Psd := %X\n", getValue( HMI_StW_SwSDS_Mute_HU_Psd ) );        filePutString (buffer, elcount(buffer), hFile);
    snprintf(buffer, elcount(buffer), "0.0000 HMI_StW_SwSDS_Start_HU_Psd := %X\n", getValue( HMI_StW_SwSDS_Start_HU_Psd ) );        filePutString (buffer, elcount(buffer), hFile);
    snprintf(buffer, elcount(buffer), "0.0000 HMI_StW_SwSend_HU_Psd := %X\n", getValue( HMI_StW_SwSend_HU_Psd ) );        filePutString (buffer, elcount(buffer), hFile);
    snprintf(buffer, elcount(buffer), "0.0000 HMI_StW_SwUp_HUD_Psd := %X\n", getValue( HMI_StW_SwUp_HUD_Psd ) );        filePutString (buffer, elcount(buffer), hFile);
    snprintf(buffer, elcount(buffer), "0.0000 HMI_StW_SwUp_MPM_Psd := %X\n", getValue( HMI_StW_SwUp_MPM_Psd ) );        filePutString (buffer, elcount(buffer), hFile);
}
/*@@end*/

/*@@caplFunc:IC_Immobilizer_AR_init():*///function
IC_Immobilizer_AR_init()
{
    // Botschaft IC_Immobilizer_AR ---- Sendeart cyclicAndSpontanWithDelay
//    _IC_Immobilizer_AR_Cnt = 15;
//    _IC_Immobilizer_AR_SpontanFlag = 0;
    /* sofort */ _mIC_Immobilizer_AR.KeyId_IC_V2.phys = getValue(HMI_KeyId_IC_V2);
    /* zyklisch */ _mIC_Immobilizer_AR.Odo_IC.phys = getValue(HMI_Odo_IC);
}
/*@@end*/

/*@@caplFunc:IC_Immobilizer_AR_check_output():*///function
IC_Immobilizer_AR_check_output()
{
      if ( !getValue( HMI__STMSG_IC_Immobilizer_AR ) )
    {
        // Botschaft IC_Immobilizer_AR --- Sendeart cyclicAndSpontanWithDelay --- Beginn DBKOM-Bewertung
        _IC_Immobilizer_AR_Cnt--;
        if ( _IC_Immobilizer_AR_Cnt < 1 )
        {
            // Nachricht wg. abgelaufenem Zyklus ausgeben
            output( _mIC_Immobilizer_AR );
            _IC_Immobilizer_AR_Cnt = _IC_Immobilizer_AR_CycleCount; // Zyklus-Zähler zurücksetzen
            _IC_Immobilizer_AR_SpontanFlag = 0; // Spontan-Flag zurücksetzen
        }
        else if ( _IC_Immobilizer_AR_SpontanFlag )
        {
            // Nachricht wg. spontaner Änderung ausgeben
            output( _mIC_Immobilizer_AR );
            _IC_Immobilizer_AR_SpontanFlag = 0; // Spontan-Flag zurücksetzen
        }
    }
}
/*@@end*/

/*@@caplFunc:IC_Settings_AR_check_output():*///function
IC_Settings_AR_check_output()
{
      if (!getValue( HMI__STMSG_IC_Settings_AR ) )
    {
        // Botschaft IC_Settings_AR --- Sendeart cyclicAndSpontanWithDelay --- Beginn DBKOM-Bewertung
        if ( _IC_Settings_AR_DelayCnt > 0 ) _IC_Settings_AR_DelayCnt--; // Mindestsendeabstand
        _IC_Settings_AR_Cnt--;
        if ( _IC_Settings_AR_Cnt < 1)
        {
            if ( _IC_Settings_AR_DelayCnt < 1 )
            {
                // Nachricht wg. abgelaufenem Zyklus ausgeben (Mindestsendeabstand eingehalten)
                output( _mIC_Settings_AR );
                 _IC_Settings_AR_SpontanFlag = 0; // Spontan-Flag zurücksetzen
                _IC_Settings_AR_DelayCnt = _IC_Settings_AR_MinDelay;
            }
            else
            {
                // Spontanflag setzen damit nach Ablauf Mindestsendeabstand gesendet wird
                 _IC_Settings_AR_SpontanFlag = 1;
            }
            _IC_Settings_AR_Cnt = _IC_Settings_AR_CycleCount; // Zyklus-Zähler zurücksetzen
        }
        else if ( _IC_Settings_AR_SpontanFlag )
        {
            if ( _IC_Settings_AR_DelayCnt < 1 )
            {
                // Nachricht wg. spontaner Änderung ausgeben (Mindestsendeabstand eingehalten)
                output( _mIC_Settings_AR );
                _IC_Settings_AR_SpontanFlag = 0; // Spontan-Flag zurücksetzen
                _IC_Settings_AR_DelayCnt = _IC_Settings_AR_MinDelay;
            }
        }
    }
}
/*@@end*/

/*@@caplFunc:IC_Settings_AR_init():*///function
IC_Settings_AR_init()
{
    // Botschaft IC_Settings_AR ---- Sendeart cyclicAndSpontanWithDelay ---- Beginn Initialisierung
    _IC_Settings_AR_Cnt = 50;
    _IC_Settings_AR_SpontanFlag = 0;
    _IC_Settings_AR_DelayCnt = 5;
    _mIC_Settings_AR.FTW_On_Rq.phys = getValue( HMI_FTW_On_Rq );
    _mIC_Settings_AR.CPD_UsrActn_Rq.phys = getValue( HMI_CPD_UsrActn_Rq );
    _mIC_Settings_AR.IHC_Md_Rq.phys = getValue( HMI_IHC_Md_Rq );
    _mIC_Settings_AR.Preview_Md_Rq.phys = getValue( HMI_Preview_Md_Rq );
    _mIC_Settings_AR.SLA_SpdOffset_Rq_D_Unit.phys = getValue( HMI_SLA_SpdOffset_Rq_D_Unit );
    _mIC_Settings_AR.SLA_SpdOffset_Rq_D_Val.phys = getValue( HMI_SLA_SpdOffset_Rq_D_Val );
    _mIC_Settings_AR.TPM_Actv_Rq_V2.phys = getValue( HMI_TPM_Actv_Rq_V2 );
    _mIC_Settings_AR.UnitPress_Rq.phys = getValue( HMI_UnitPress_Rq );
	_mIC_Settings_AR.Pers_ActvSlotId_Rq.phys = getValue( HMI_Pers_ActvSlotId_Rq );
	_mIC_Settings_AR.RepairshopMode_Actv.phys = getValue( HMI_RepairshopMode_Actv );
	_mIC_Settings_AR.SAplus_SDTR_Md_Stat_IC.phys = getValue( HMI_SAplus_SDTR_Md_Stat_IC );
	_mIC_Settings_AR.SAplus_TSA_Md_Stat_IC.phys = getValue( HMI_SAplus_TSA_Md_Stat_IC );
}
/*@@end*/

/*@@caplFunc:IC_DriveAssistSys_AR_check_output():*///function
IC_DriveAssistSys_AR_check_output()
{
      if ( !getValue( HMI__STMSG_IC_DriveAssistSys_AR ) )
    {
        // Botschaft IC_DriveAssistSys_AR --- Sendeart 0 cyclicX
        _IC_DriveAssistSys_AR_Cnt--;
        if ( _IC_DriveAssistSys_AR_Cnt < 1 )
        {
            // Nachricht wg. abgelaufenem Zyklus ausgeben
            output( _mIC_DriveAssistSys_AR );
            // Zyklus-Zähler zurücksetzen
            _IC_DriveAssistSys_AR_Cnt = _IC_DriveAssistSys_AR_CycleCount;
        }
    }
}
/*@@end*/

/*@@caplFunc:IC_Immobilizer_AR_saveEnvVars(dword):*///function
IC_Immobilizer_AR_saveEnvVars( dword hFile )
{
    filePutString("\n// Knoten IC: IC_Immobilizer_AR\n", 30, hFile );
    snprintf(buffer, elcount(buffer), "0.0000 HMI__STMSG_IC_Immobilizer := %X\n", getValue( HMI__STMSG_IC_Immobilizer_AR ) );        filePutString (buffer, elcount(buffer), hFile);
    snprintf(buffer, elcount(buffer), "0.0000 HMI__STMSGT_IC_Immobilizer := %X\n", getValue( HMI__STMSGT_IC_Immobilizer_AR ) );        filePutString (buffer, elcount(buffer), hFile);
    snprintf(buffer, elcount(buffer), "0.0000 HMI_KeyId_IC_V2 := %X\n", getValue( HMI_KeyId_IC_V2 ) );        filePutString (buffer, elcount(buffer), hFile);
    snprintf(buffer, elcount(buffer), "0.0000 HMI_Odo_IC := %f\n", getValue( HMI_Odo_IC ) );        filePutString (buffer, elcount(buffer), hFile);
}
/*@@end*/

/*@@caplFunc:IC_Date_Time_AR_check_output():*///function
IC_Date_Time_AR_check_output()
{
      if (!getValue( HMI__STMSG_IC_Date_Time_AR ) )
    {
        // Botschaft IC_Date_Time_AR --- Sendeart cyclicAndSpontanWithDelay --- Beginn DBKOM-Bewertung
        if ( _IC_Date_Time_AR_DelayCnt > 0 ) _IC_Date_Time_AR_DelayCnt--; // Mindestsendeabstand
        _IC_Date_Time_AR_Cnt--;
        if ( _IC_Date_Time_AR_Cnt < 1)
        {
            if ( _IC_Date_Time_AR_DelayCnt < 1 )
            {
                // Nachricht wg. abgelaufenem Zyklus ausgeben (Mindestsendeabstand eingehalten)
                output( _mIC_Date_Time_AR );
                 _IC_Date_Time_AR_SpontanFlag = 0; // Spontan-Flag zurücksetzen
                _IC_Date_Time_AR_DelayCnt = _IC_Date_Time_AR_MinDelay;
            }
            else
            {
                // Spontanflag setzen damit nach Ablauf Mindestsendeabstand gesendet wird
                 _IC_Date_Time_AR_SpontanFlag = 1;
            }
            _IC_Date_Time_AR_Cnt = _IC_Date_Time_AR_CycleCount; // Zyklus-Zähler zurücksetzen
        }
        else if ( _IC_Date_Time_AR_SpontanFlag )
        {
            if ( _IC_Date_Time_AR_DelayCnt < 1 )
            {
                // Nachricht wg. spontaner Änderung ausgeben (Mindestsendeabstand eingehalten)
                output( _mIC_Date_Time_AR );
                _IC_Date_Time_AR_SpontanFlag = 0; // Spontan-Flag zurücksetzen
                _IC_Date_Time_AR_DelayCnt = _IC_Date_Time_AR_MinDelay;
            }
        }
    }
}
/*@@end*/

/*@@caplFunc:LDC_Disp_Stat_IC_AR_check_output():*///function
LDC_Disp_Stat_IC_AR_check_output()
{
      if ( !getValue( HMI__STMSG_LDC_Disp_Stat_IC_AR ) )
    {
        // Botschaft LDC_Disp_Stat_IC_AR --- Sendeart cyclicAndSpontanWithDelay --- Beginn DBKOM-Bewertung
        _LDC_Disp_Stat_IC_AR_Cnt--;
        if ( _LDC_Disp_Stat_IC_AR_Cnt < 1 )
        {
            // Nachricht wg. abgelaufenem Zyklus ausgeben
//            LDC_Disp_Stat_IC_AR_output();
            _LDC_Disp_Stat_IC_AR_Cnt = _LDC_Disp_Stat_IC_AR_CycleCount; // Zyklus-Zähler zurücksetzen
            _LDC_Disp_Stat_IC_AR_SpontanFlag = 0; // Spontan-Flag zurücksetzen
        }
        else if ( _LDC_Disp_Stat_IC_AR_SpontanFlag )
        {
            // Nachricht wg. spontaner Änderung ausgeben
//            LDC_Disp_Stat_IC_AR_output();
            _LDC_Disp_Stat_IC_AR_SpontanFlag = 0; // Spontan-Flag zurücksetzen
        }
    }
}
/*@@end*/

/*@@caplFunc:LDC_Disp_Stat_IC_AR_saveEnvVars(dword):*///function
LDC_Disp_Stat_IC_AR_saveEnvVars( dword hFile )
{
    filePutString("\n// Knoten IC: LDC_Disp_Stat_IC_AR\n", 32, hFile);
    snprintf(buffer, elcount(buffer), "0.0000 HMI__STMSG_LDC_Disp_Stat_IC_AR := %X\n", getValue(HMI__STMSG_LDC_Disp_Stat_IC_AR ));        filePutString (buffer, elcount(buffer), hFile);
    snprintf(buffer, elcount(buffer), "0.0000 HMI__STMSGT_LDC_Disp_Stat_IC_AR := %X\n", getValue(HMI__STMSGT_LDC_Disp_Stat_IC_AR ));        filePutString (buffer, elcount(buffer), hFile);
//    snprintf(buffer, elcount(buffer), "0.0000 HMI_CRC_LDC_Disp_Stat_IC := %X\n", getValue( HMI_CRC_LDC_Disp_Stat_IC ) );        filePutString (buffer, elcount(buffer), hFile);
//    snprintf(buffer, elcount(buffer), "0.0000 HMI_CRC_LDC_Disp_Stat_IC_Auto := %X\n", getValue( HMI_CRC_LDC_Disp_Stat_IC_Auto ) );        filePutString (buffer, elcount(buffer), hFile);
    snprintf(buffer, elcount(buffer), "0.0000 HMI_DTQ_DispIfc_ok := %X\n", getValue( HMI_DTQ_DispIfc_ok ) );        filePutString (buffer, elcount(buffer), hFile);
    snprintf(buffer, elcount(buffer), "0.0000 HMI_FCW_Ifc_ok := %X\n", getValue( HMI_FCW_Ifc_ok ) );        filePutString (buffer, elcount(buffer), hFile);
//    snprintf(buffer, elcount(buffer), "0.0000 HMI_FCW_Md_Rq := %X\n", getValue( HMI_FCW_Md_Rq ) );        filePutString (buffer, elcount(buffer), hFile);
    snprintf(buffer, elcount(buffer), "0.0000 HMI_LDC_Ifc_ok_ESP := %X\n", getValue( HMI_LDC_Ifc_ok_ESP ) );        filePutString (buffer, elcount(buffer), hFile);
//    snprintf(buffer, elcount(buffer), "0.0000 HMI_LDC_PresfBrkMd_Rq := %X\n", getValue( HMI_LDC_PresfBrkMd_Rq ) );        filePutString (buffer, elcount(buffer), hFile);
//    snprintf(buffer, elcount(buffer), "0.0000 HMI_LDC_RadarSensMd_Rq := %X\n", getValue( HMI_LDC_RadarSensMd_Rq ) );        filePutString (buffer, elcount(buffer), hFile);
    snprintf(buffer, elcount(buffer), "0.0000 HMI_LDC_SpdUnit_Rq := %X\n", getValue( HMI_LDC_SpdUnit_Rq ) );        filePutString (buffer, elcount(buffer), hFile);
    snprintf(buffer, elcount(buffer), "0.0000 HMI_LDC_SPEEDO_Cal := %X\n", getValue( HMI_LDC_SPEEDO_Cal ) );        filePutString (buffer, elcount(buffer), hFile);
    snprintf(buffer, elcount(buffer), "0.0000 HMI_LDC_SPEEDO_SegRing_Avl := %X\n", getValue( HMI_LDC_SPEEDO_SegRing_Avl ) );        filePutString (buffer, elcount(buffer), hFile);
//    snprintf(buffer, elcount(buffer), "0.0000 HMI_LDC_WTSL_Spd_Max := %X\n", getValue( HMI_LDC_WTSL_Spd_Max ) );        filePutString (buffer, elcount(buffer), hFile);
    snprintf(buffer, elcount(buffer), "0.0000 HMI_Rsrv1_LDC_Disp_Stat_IC := %X\n", getValue( HMI_Rsrv1_LDC_Disp_Stat_IC ) );        filePutString (buffer, elcount(buffer), hFile);
}
/*@@end*/

/*@@caplFunc:LDC_Disp_Stat_IC_AR_init():*///function
LDC_Disp_Stat_IC_AR_init()
{
    // Botschaft LDC_Disp_Stat_IC_AR ---- Sendeart cyclicAndSpontanWithDelay
    _LDC_Disp_Stat_IC_AR_Cnt = 5;
    _LDC_Disp_Stat_IC_AR_SpontanFlag = 0;
    /* sofort */ _mLDC_Disp_Stat_IC_AR.DTQ_DispIfc_ok.phys = getValue( HMI_DTQ_DispIfc_ok );
    /* sofort */ _mLDC_Disp_Stat_IC_AR.FCW_Ifc_ok.phys = getValue( HMI_FCW_Ifc_ok );
//    /* sofort */ _mLDC_Disp_Stat_IC_AR.FCW_Md_Rq.phys = getValue( HMI_FCW_Md_Rq );
    /* sofort */ _mLDC_Disp_Stat_IC_AR.LDC_Ifc_ok_ESP.phys = getValue( HMI_LDC_Ifc_ok_ESP );
//    /* sofort */ _mLDC_Disp_Stat_IC_AR.LDC_PresfBrkMd_Rq.phys = getValue( HMI_LDC_PresfBrkMd_Rq );
//    /* sofort */ _mLDC_Disp_Stat_IC_AR.LDC_RadarSensMd_Rq.phys = getValue( HMI_LDC_RadarSensMd_Rq );
    /* sofort */ _mLDC_Disp_Stat_IC_AR.LDC_SpdUnit_Rq.phys = getValue( HMI_LDC_SpdUnit_Rq );
    /* sofort */ _mLDC_Disp_Stat_IC_AR.LDC_SPEEDO_Cal.phys = getValue( HMI_LDC_SPEEDO_Cal );
    /* sofort */ _mLDC_Disp_Stat_IC_AR.LDC_SPEEDO_SegRing_Avl.phys = getValue( HMI_LDC_SPEEDO_SegRing_Avl );
//    /* sofort */ _mLDC_Disp_Stat_IC_AR.LDC_WTSL_Spd_Max.phys = getValue( HMI_LDC_WTSL_Spd_Max );
    /* sofort */ _mLDC_Disp_Stat_IC_AR.Rsrv1_LDC_Disp_Stat_IC.phys = getValue( HMI_Rsrv1_LDC_Disp_Stat_IC );
}
/*@@end*/

/*@@caplFunc:TC_Dist_AR_check_output():*///function
TC_Dist_AR_check_output()
{
      if ( !getValue( HMI__STMSG_TC_Dist_AR ) )
    {
        // Botschaft TC_Dist_AR --- Sendeart 8 cyclicIfActiveFast
        _TC_Dist_AR_Cnt--;
        if ( _TC_Dist_AR_Cnt < 1 )
        {
            // Zyklus abgelaufen, Nachricht senden
            TC_Dist_AR_next_values();
            if( _TC_Dist_AR_TC_FuelType_ActState == 0 )
            {
                putValue( HMI_TC_FuelType_TC_DISP_RQ, _TC_Dist_AR_TC_FuelType_ActState );
//                _mTC_Dist_AR.CNG_FuelMdChg_Rq.phys = getValue( HMI_CNG_FuelMdChg_Rq );
                _mTC_Dist_AR.TC_GasFuelDist_Start.phys = getValue( HMI_TC_GasFuelDist_Start );
                _mTC_Dist_AR.TC_GasFuelDist_Reset.phys = getValue( HMI_TC_GasFuelDist_Reset );
                _mTC_Dist_AR.TC_GasFuelTankLvl.phys = getValue( HMI_TC_GasFuelTankLvl );
                _mTC_Dist_AR.TC_FuelType_TC_DIST.phys = getValue( HMI_TC_FuelType_TC_DISP_RQ);
            }
            if( _TC_Dist_AR_TC_FuelType_ActState == 1 )
            {
                putValue( HMI_TC_FuelType_TC_DISP_RQ, _TC_Dist_AR_TC_FuelType_ActState );
//                _mTC_Dist_AR.CNG_FuelMdChg_Rq.phys = getValue( HMI_CNG_FuelMdChg_Rq );
                _mTC_Dist_AR.TC_LiquidFuelDist_Start.phys = getValue( HMI_TC_LiquidFuelDist_Start );
                _mTC_Dist_AR.TC_LiquidFuelDist_Reset.phys = getValue( HMI_TC_LiquidFuelDist_Reset );
                _mTC_Dist_AR.TC_LiquidFuelTankLvl.phys = getValue( HMI_TC_LiquidFuelTankLvl );
                _mTC_Dist_AR.TC_LiquidFuelRefillEvent_Dtct.phys = getValue( HMI_TC_LiquidFuelRefillEvent_Dtct );
                _mTC_Dist_AR.TC_FuelType_TC_DIST.phys = getValue( HMI_TC_FuelType_TC_DISP_RQ);
            }
            if( _TC_Dist_AR_TC_FuelType_ActState == 2 )
            {
                putValue( HMI_TC_FuelType_TC_DISP_RQ, _TC_Dist_AR_TC_FuelType_ActState );
//                _mTC_Dist_AR.CNG_FuelMdChg_Rq.phys = getValue( HMI_CNG_FuelMdChg_Rq );
                _mTC_Dist_AR.TC_ElecEnergyDist_Start.phys = getValue( HMI_TC_ElecEnergyDist_Start );
                _mTC_Dist_AR.TC_ElecEnergyDist_Reset.phys = getValue( HMI_TC_ElecEnergyDist_Reset );
                _mTC_Dist_AR.TC_FuelType_TC_DIST.phys = getValue( HMI_TC_FuelType_TC_DISP_RQ);
            }
            if( _TC_Dist_AR_TC_FuelType_ActState == 3 )
            {
                putValue( HMI_TC_FuelType_TC_DISP_RQ, _TC_Dist_AR_TC_FuelType_ActState );
                _mTC_Dist_AR.TC_LiquidFuelTankLvl.phys = 204.7;
                _mTC_Dist_AR.TC_LiquidFuelDist_Start.phys = 1677721.5;
                _mTC_Dist_AR.TC_LiquidFuelDist_Reset.phys = 1677721.5;
                _mTC_Dist_AR.TC_LiquidFuelRefillEvent_Dtct.phys = 0;
                _mTC_Dist_AR.TC_FuelType_TC_DIST.phys = getValue( HMI_TC_FuelType_TC_DISP_RQ);
            }

            output( _mTC_Dist_AR );
            _TC_Dist_AR_Cnt = _TC_Dist_AR_CycleCount;
        }
    }
}
/*@@end*/

/*@@caplFunc:TC_Dist_AR_Activity(int):*///function
void TC_Dist_AR_Activity(int active )
{
      if (active )
      {
          if ( _TC_Dist_AR_SigActivity == 0)
            _TC_Dist_AR_Cnt = 1;
        _TC_Dist_AR_SigActivity++;
      }
    else
    {
        _TC_Dist_AR_SigActivity--;
      }
}
/*@@end*/

/*@@caplFunc:TC_Dist_AR_next_values():*///function
TC_Dist_AR_next_values()
{
    if( ( getValue( HMI_TC_FuelType_TC_DIST_Liquid ) == 0 ) &     // 1
        ( getValue( HMI_TC_FuelType_TC_DIST_Gas    ) == 0 ) &     // 0
        ( getValue( HMI_TC_FuelType_TC_DIST_Elec   ) == 0 )    )   // 2
    {
        _TC_Dist_AR_TC_FuelType_ActState = 3;  //SNA
        return;
    }
    else
    if( _TC_Dist_AR_TC_FuelType_ActState == 3 )  //SNA
        _TC_Dist_AR_TC_FuelType_ActState = 0;

    if( _TC_Dist_AR_TC_FuelType_ActState == 0 )    // Gas
    {
        if( getValue( HMI_TC_FuelType_TC_DIST_Liquid ) == 1 )   // 1
        {
            _TC_Dist_AR_TC_FuelType_ActState = 1;  // Liquid
            return;
        }
        if( getValue( HMI_TC_FuelType_TC_DIST_Elec ) == 1 )     // 2
        {
            _TC_Dist_AR_TC_FuelType_ActState = 2;  // Elec
            return;
        }
        return; // no change, only one type active
    }

    if( _TC_Dist_AR_TC_FuelType_ActState == 1 )    // Liquid
    {
        if( getValue( HMI_TC_FuelType_TC_DIST_Elec ) == 1 )   // 1
        {
            _TC_Dist_AR_TC_FuelType_ActState = 2;  // Elec
            return;
        }
        if( getValue( HMI_TC_FuelType_TC_DIST_Gas ) == 1 )     // 2
        {
            _TC_Dist_AR_TC_FuelType_ActState = 0;  // Gas
            return;
        }
        return; // no change, only one type active
    }
    if( _TC_Dist_AR_TC_FuelType_ActState == 2 )    // Elec
    {
        if( getValue( HMI_TC_FuelType_TC_DIST_Gas ) == 1 )   // 1
        {
            _TC_Dist_AR_TC_FuelType_ActState = 0;  // Gas
            return;
        }
        if( getValue( HMI_TC_FuelType_TC_DIST_Liquid ) == 1 )     // 2
        {
            _TC_Dist_AR_TC_FuelType_ActState = 1;  // Liquid
            return;
        }
        return; // no change, only one type active
    }
}
/*@@end*/

/*@@caplFunc:TC_Dist_AR_init():*///function
TC_Dist_AR_init()
{
    // Botschaft TC_Dist_AR ---- Sendeart cyclicX
    _TC_Dist_AR_Cnt = 6;
//    /* none */ _mTC_Dist_AR.CNG_FuelMdChg_Rq.phys = getValue( HMI_CNG_FuelMdChg_Rq );
    /* none */ _mTC_Dist_AR.TC_GasFuelDist_Start.phys = getValue( HMI_TC_GasFuelDist_Start );
    /* none */ _mTC_Dist_AR.TC_GasFuelDist_Reset.phys = getValue( HMI_TC_GasFuelDist_Reset );
    /* none */ _mTC_Dist_AR.TC_GasFuelTankLvl.phys = getValue( HMI_TC_GasFuelTankLvl );
    /* none */ _mTC_Dist_AR.TC_FuelType_TC_DIST.phys = getValue( HMI_TC_FuelType );
    /* none */ _mTC_Dist_AR.TC_LiquidFuelDist_Start.phys = getValue( HMI_TC_LiquidFuelDist_Start );
    /* none */ _mTC_Dist_AR.TC_LiquidFuelTankLvl.phys = getValue( HMI_TC_LiquidFuelTankLvl );
    /* none */ _mTC_Dist_AR.TC_LiquidFuelDist_Reset.phys = getValue( HMI_TC_LiquidFuelDist_Reset );
    /* none */ _mTC_Dist_AR.TC_LiquidFuelRefillEvent_Dtct.phys = getValue( HMI_TC_LiquidFuelRefillEvent_Dtct );
    /* none */ _mTC_Dist_AR.TC_ElecEnergyDist_Start.phys = getValue( HMI_TC_ElecEnergyDist_Start );
    /* none */ _mTC_Dist_AR.TC_ElecEnergyDist_Reset.phys = getValue( HMI_TC_ElecEnergyDist_Reset );
}
/*@@end*/

/*@@envVar:HMI_CLkS_Akust_Lk_Rq_Enbl:*/
/*@@end*/

/*@@envVar:HMI_PMA_Md_Rq:*/
/*@@end*/

/*@@envVar:HMI_WWA_Md_Rq:*/
/*@@end*/

/*@@caplFunc:Park_Disp_Rs_AR_init():*///function
Park_Disp_Rs_AR_init()
{    // Botschaft Park_Disp_Rs_AR ---- Sendeart 5 cyclicAndSpontanWithDelay
    _Park_Disp_Rs_AR_Cnt = 14;
    _Park_Disp_Rs_AR_SpontanFlag = 0;
    _mPark_Disp_Rs_AR.IC_Err_Stat.phys = getValue( HMI_IC_Err_Stat );
    _mPark_Disp_Rs_AR.IC_Func_Stat.phys = getValue( HMI_IC_Func_Stat );
    _mPark_Disp_Rs_AR.Park_IconDisp_Rs.phys = getValue( HMI_Park_IconDisp_Rs );
    _mPark_Disp_Rs_AR.Park_IconDisp_Stat_IC.phys = getValue( HMI_Park_IconDisp_Stat_IC );
    _mPark_Disp_Rs_AR.Park_Warn1_Disp_Rs.phys = getValue( HMI_Park_Warn1_Disp_Rs );
    _mPark_Disp_Rs_AR.Park_Warn1_Disp_Stat_IC.phys = getValue( HMI_Park_Warn1_Disp_Stat_IC );
}
/*@@end*/

/*@@caplFunc:Park_Disp_Rs_AR_saveEnvVars(dword):*///function
Park_Disp_Rs_AR_saveEnvVars( dword hFile )
{
    filePutString("\n// Knoten EIS: Park_Disp_Rs_AR\n", 33, hFile );
    snprintf( buffer, elcount( buffer ), "0.0000 HMI__STMSG_Park_Disp_Rs_AR := %X\n", getValue( HMI__STMSG_Park_Disp_Rs_AR ) );    filePutString( buffer, elcount( buffer ), hFile );
    snprintf( buffer, elcount( buffer ), "0.0000 HMI__STMSGT_Park_Disp_Rs_AR := %X\n", getValue( HMI__STMSGT_Park_Disp_Rs_AR ) );    filePutString( buffer, elcount( buffer ), hFile );
    snprintf( buffer, elcount( buffer ), "0.0000 HMI_IC_Err_Stat := %X\n", getValue( HMI_IC_Err_Stat ) );    filePutString( buffer, elcount( buffer ), hFile );
    snprintf( buffer, elcount( buffer ), "0.0000 HMI_IC_Func_Stat := %X\n", getValue( HMI_IC_Func_Stat ) );    filePutString( buffer, elcount( buffer ), hFile );
    snprintf( buffer, elcount( buffer ), "0.0000 HMI_Park_IconDisp_Rs := %X\n", getValue( HMI_Park_IconDisp_Rs ) );    filePutString( buffer, elcount( buffer ), hFile );
    snprintf( buffer, elcount( buffer ), "0.0000 HMI_Park_IconDisp_Stat_IC := %X\n", getValue( HMI_Park_IconDisp_Stat_IC ) );    filePutString( buffer, elcount( buffer ), hFile );
    snprintf( buffer, elcount( buffer ), "0.0000 HMI_Park_Warn1_Disp_Rs := %X\n", getValue( HMI_Park_Warn1_Disp_Rs ) );    filePutString( buffer, elcount( buffer ), hFile );
    snprintf( buffer, elcount( buffer ), "0.0000 HMI_Park_Warn1_Disp_Stat_IC := %X\n", getValue( HMI_Park_Warn1_Disp_Stat_IC ) );    filePutString( buffer, elcount( buffer ), hFile );
//    snprintf( buffer, elcount( buffer ), "0.0000 HMI_Parity_Park_DisclmDisp_Rs := %X\n", getValue( HMI_Parity_Park_DisclmDisp_Rs ) );    filePutString( buffer, elcount( buffer ), hFile );
//    snprintf( buffer, elcount( buffer ), "0.0000 HMI_Parity_Park_DisclmDisp_Stat_IC := %X\n", getValue( HMI_Parity_Park_DisclmDisp_Stat_IC ) );    filePutString( buffer, elcount( buffer ), hFile );
//    snprintf( buffer, elcount( buffer ), "0.0000 HMI_Park_DisclmDisp_Rs_Tgl := %X\n", getValue( HMI_Park_DisclmDisp_Rs_Tgl ) );    filePutString( buffer, elcount( buffer ), hFile );
//    snprintf( buffer, elcount( buffer ), "0.0000 HMI_Park_DisclmDisp_Stat_IC_Tgl := %X\n", getValue( HMI_Park_DisclmDisp_Stat_IC_Tgl ) );    filePutString( buffer, elcount( buffer ), hFile );
}
/*@@end*/

/*@@caplFunc:Park_Disp_Rs_AR_check_output():*///function
Park_Disp_Rs_AR_check_output()
{
      if (!getValue( HMI__STMSG_Park_Disp_Rs_AR ) )
    {
        // Botschaft Park_Disp_Rs_AR --- Sendeart 5 cyclicAndSpontanWithDelay
        _Park_Disp_Rs_AR_Cnt--;
        if ( _Park_Disp_Rs_AR_Cnt < 1 )
        {
            // Nachricht wg. abgelaufenem Zyklus ausgeben
//            if( getValue( HMI__VERSISON_IC_Park_Disp_Rs_AR ) )
                output( _mPark_Disp_Rs_AR );
//            else
//                output( _mPark_Disp_Rs_AR_2011_29a );
            _Park_Disp_Rs_AR_Cnt = _Park_Disp_Rs_AR_CycleCount; // Zyklus-Zähler zurücksetzen
            _Park_Disp_Rs_AR_SpontanFlag = 0; // Spontan-Flag zurücksetzen
        }
        else if ( _Park_Disp_Rs_AR_SpontanFlag)
        {
            // Nachricht wg. spontaner Änderung ausgeben
//            if( getValue( HMI__VERSISON_IC_Park_Disp_Rs_AR ) )
                output( _mPark_Disp_Rs_AR );
//            else
//                output( _mPark_Disp_Rs_AR_2011_29a );
            _Park_Disp_Rs_AR_SpontanFlag = 0; // Spontan-Flag zurücksetzen
        }
    }
}
/*@@end*/

Config_IC_AR_check_output()
{
    if( !getValue( HMI__STMSG_Config_IC_AR ) )
    {
    //  message   Config_IC_AR ID: 2427977728 --- Sendeart 5 cyclicAndSpontanWithDelay --- 
        if( _Config_IC_AR_DelayCnt > 0) _Config_IC_AR_DelayCnt--; // Mindestsendeabstand
        _Config_IC_AR_Cnt--;
        if( _Config_IC_AR_Cnt < 1 )
        {
            if( _Config_IC_AR_DelayCnt < 1 )
            {
                Config_IC_AR_output(); // Nachricht wg. abgelaufenem Zyklus ausgeben (Mindestsendeabstand eingehalten)
                 _Config_IC_AR_SpontanFlag = 0; // Spontan-Flag zurücksetzen
                _Config_IC_AR_DelayCnt = _Config_IC_AR_MinDelay;
            }
            else
            {
                 _Config_IC_AR_SpontanFlag = 1; // Spontanflag setzen damit nach Ablauf Mindestsendeabstand gesendet wird
            }
            _Config_IC_AR_Cnt = _Config_IC_AR_CycleCount; // Zyklus-Zähler zurücksetzen
        }
        else if( _Config_IC_AR_SpontanFlag)
        {
            if( _Config_IC_AR_DelayCnt < 1 )
            {
                Config_IC_AR_output(); // Nachricht wg. spontaner Änderung ausgeben (Mindestsendeabstand eingehalten)
                _Config_IC_AR_SpontanFlag = 0; // Spontan-Flag zurücksetzen
                _Config_IC_AR_DelayCnt = _Config_IC_AR_MinDelay;
            }
        }
    }
}

Config_IC_AR_init()
{   /* Botschaft Config_IC_AR ID: 2427977728 --- Sendeart 5 cyclicAndSpontanWithDelay --- 
BA_ "ApplMessage" BO_ 2427977728 0;
BA_ "NmAsrMessage" BO_ 2427977728 0;
BA_ "GenMsgMinAcceptLength" BO_ 2427977728 8;
BA_ "GenMsgILSupport" BO_ 2427977728 1;
BA_ "DiagState" BO_ 2427977728 0;
BA_ "DiagRequest" BO_ 2427977728 0;
BA_ "DiagResponse" BO_ 2427977728 0;
BA_ "GenMsgStartValue" BO_ 2427977728 "0";
BA_ "GenMsgStartDelayTime" BO_ 2427977728 5;
BA_ "GenMsgDelayTime" BO_ 2427977728 20;
BA_ "GenMsgNrOfRepetition" BO_ 2427977728 0;
BA_ "GenMsgCycleTime" BO_ 2427977728 1000;
BA_ "GenMsgSendType" BO_ 2427977728 5;
    */
    _Config_IC_AR_Timebase =               c_tDBKomTimer_20ms;
    _Config_IC_AR_CycleCount =            	1000 / _Config_IC_AR_Timebase;
    _Config_IC_AR_StartDelay =              5 / _Config_IC_AR_Timebase;
    _Config_IC_AR_Cnt = _Config_IC_AR_StartDelay;
    _Config_IC_AR_SpontanFlag = 0;
    _Config_IC_AR_DelayCnt = 0;

    putValue( HMI__STMSGSD_Config_IC_AR, _Config_IC_AR_StartDelay * _Config_IC_AR_Timebase );

    _mConfig_IC_AR.SmartCharge_Rq.phys = getValue( HMI_SmartCharge_Rq );
    _mConfig_IC_AR.StWhlHeat_Actv_Rq_IC.phys = getValue( HMI_StWhlHeat_Actv_Rq_IC );
    _mConfig_IC_AR.StWhlHeat_Coupling_Rq_IC.phys = getValue( HMI_StWhlHeat_Coupling_Rq_IC );
}

Config_IC_AR_output(void)
{
    output( _mConfig_IC_AR );
}

Config_IC_AR_saveEnvVars( dword hFile )
{
    filePutString("\n// Knoten EIS: Config_IC_AR\n", 25, hFile );
    snprintf( buffer, elcount( buffer ), "0.0000 HMI__STMSG_Config_IC_AR := %X\n", getValue( HMI__STMSG_Config_IC_AR ) );        filePutString( buffer, elcount( buffer ), hFile );
    snprintf( buffer, elcount( buffer ), "0.0000 HMI__STMSGT_Config_IC_AR := %X\n", getValue( HMI__STMSGT_Config_IC_AR ) );        filePutString( buffer, elcount( buffer ), hFile );
    snprintf( buffer, elcount( buffer ), "0.0000 HMI_SmartCharge_Rq := %X\n", getValue( HMI_SmartCharge_Rq ) );        filePutString( buffer, elcount( buffer ), hFile );
    snprintf( buffer, elcount( buffer ), "0.0000 HMI_StWhlHeat_Actv_Rq_IC := %X\n", getValue( HMI_StWhlHeat_Actv_Rq_IC ) );        filePutString( buffer, elcount( buffer ), hFile );
    snprintf( buffer, elcount( buffer ), "0.0000 HMI_StWhlHeat_Coupling_Rq_IC := %X\n", getValue( HMI_StWhlHeat_Coupling_Rq_IC ) );        filePutString( buffer, elcount( buffer ), hFile );
}

on timer _tConfig_IC_AR
{
    putValue( HMI__STMSG_Config_IC_AR, 0 );
}

on EnvVar HMI__STMSG_Config_IC_AR
{
    long tDelay;
    if( getValue( this ) == 2 )
    {
        tDelay = getValue( HMI__STMSGT_Config_IC_AR );
        if( tDelay > 0)    
            setTimer( _tConfig_IC_AR, tDelay );
        else
            putValue( HMI__STMSG_Config_IC_AR, 0 );
    }
}

on envVar HMI__STMSG_PO_Config_IC_AR
{
    if( getValue( this ) )
        openPanel("Config_IC_AR");
}

on EnvVar HMI_SmartCharge_Rq
{
    _mConfig_IC_AR.SmartCharge_Rq.phys = getValue(this);
    _Config_IC_AR_SpontanFlag = 1;
}

on EnvVar HMI_StWhlHeat_Actv_Rq_IC
{
    _mConfig_IC_AR.StWhlHeat_Actv_Rq_IC.phys = getValue(this);
    _Config_IC_AR_SpontanFlag = 1;
}

on EnvVar HMI_StWhlHeat_Coupling_Rq_IC
{
    _mConfig_IC_AR.StWhlHeat_Coupling_Rq_IC.phys = getValue(this);
    _Config_IC_AR_SpontanFlag = 1;
}

IC_AddDisp_VAN_AR_check_output()
{
    if( !getValue( HMI__STMSG_IC_AddDisp_VAN_AR ) )
    {
    //  message   IC_AddDisp_VAN_AR ID: 1172 --- Sendeart 5 cyclicAndSpontanWithDelay --- 
        if( _IC_AddDisp_VAN_AR_DelayCnt > 0) _IC_AddDisp_VAN_AR_DelayCnt--; // Mindestsendeabstand
        _IC_AddDisp_VAN_AR_Cnt--;
        if( _IC_AddDisp_VAN_AR_Cnt < 1 )
        {
            if( _IC_AddDisp_VAN_AR_DelayCnt < 1 )
            {
                IC_AddDisp_VAN_AR_output(); // Nachricht wg. abgelaufenem Zyklus ausgeben (Mindestsendeabstand eingehalten)
                 _IC_AddDisp_VAN_AR_SpontanFlag = 0; // Spontan-Flag zurücksetzen
                _IC_AddDisp_VAN_AR_DelayCnt = _IC_AddDisp_VAN_AR_MinDelay;
            }
            else
            {
                 _IC_AddDisp_VAN_AR_SpontanFlag = 1; // Spontanflag setzen damit nach Ablauf Mindestsendeabstand gesendet wird
            }
            _IC_AddDisp_VAN_AR_Cnt = _IC_AddDisp_VAN_AR_CycleCount; // Zyklus-Zähler zurücksetzen
        }
        else if( _IC_AddDisp_VAN_AR_SpontanFlag)
        {
            if( _IC_AddDisp_VAN_AR_DelayCnt < 1 )
            {
                IC_AddDisp_VAN_AR_output(); // Nachricht wg. spontaner Änderung ausgeben (Mindestsendeabstand eingehalten)
                _IC_AddDisp_VAN_AR_SpontanFlag = 0; // Spontan-Flag zurücksetzen
                _IC_AddDisp_VAN_AR_DelayCnt = _IC_AddDisp_VAN_AR_MinDelay;
            }
        }
    }
}

IC_AddDisp_VAN_AR_init()
{   /* Botschaft IC_AddDisp_VAN_AR ID: 1172 --- Sendeart 5 cyclicAndSpontanWithDelay --- 
BA_ "ApplMessage" BO_ 1172 0;
BA_ "NmAsrMessage" BO_ 1172 0;
BA_ "GenMsgMinAcceptLength" BO_ 1172 8;
BA_ "GenMsgILSupport" BO_ 1172 1;
BA_ "DiagState" BO_ 1172 0;
BA_ "DiagRequest" BO_ 1172 0;
BA_ "DiagResponse" BO_ 1172 0;
BA_ "GenMsgStartValue" BO_ 1172 "0";
BA_ "GenMsgStartDelayTime" BO_ 1172 80;
BA_ "GenMsgDelayTime" BO_ 1172 20;
BA_ "GenMsgNrOfRepetition" BO_ 1172 0;
BA_ "GenMsgCycleTime" BO_ 1172 100;
BA_ "GenMsgSendType" BO_ 1172 5;
    */
    _IC_AddDisp_VAN_AR_Timebase =               c_tDBKomTimer_5ms;
    _IC_AddDisp_VAN_AR_CycleCount =            	100 / _IC_AddDisp_VAN_AR_Timebase;
    _IC_AddDisp_VAN_AR_StartDelay =              80 / _IC_AddDisp_VAN_AR_Timebase;
    _IC_AddDisp_VAN_AR_Cnt = _IC_AddDisp_VAN_AR_StartDelay;
    _IC_AddDisp_VAN_AR_SpontanFlag = 0;
    _IC_AddDisp_VAN_AR_DelayCnt = 0;

    putValue( HMI__STMSGSD_IC_AddDisp_VAN_AR, _IC_AddDisp_VAN_AR_StartDelay * _IC_AddDisp_VAN_AR_Timebase );

    _mIC_AddDisp_VAN_AR.DPF_ManRgnrt_Rq.phys = getValue( HMI_DPF_ManRgnrt_Rq );
    _mIC_AddDisp_VAN_AR.VehSpd_TCO.phys = getValue( HMI_VehSpd_TCO );
}

IC_AddDisp_VAN_AR_output(void)
{
    output( _mIC_AddDisp_VAN_AR );
}

IC_AddDisp_VAN_AR_saveEnvVars( dword hFile )
{
    filePutString("\n// Knoten EIS: IC_AddDisp_VAN_AR\n", 25, hFile );
    snprintf( buffer, elcount( buffer ), "0.0000 HMI__STMSG_IC_AddDisp_VAN_AR := %X\n", getValue( HMI__STMSG_IC_AddDisp_VAN_AR ) );        filePutString( buffer, elcount( buffer ), hFile );
    snprintf( buffer, elcount( buffer ), "0.0000 HMI__STMSGT_IC_AddDisp_VAN_AR := %X\n", getValue( HMI__STMSGT_IC_AddDisp_VAN_AR ) );        filePutString( buffer, elcount( buffer ), hFile );
    snprintf( buffer, elcount( buffer ), "0.0000 HMI_DPF_ManRgnrt_Rq := %X\n", getValue( HMI_DPF_ManRgnrt_Rq ) );        filePutString( buffer, elcount( buffer ), hFile );
    snprintf( buffer, elcount( buffer ), "0.0000 HMI_VehSpd_TCO := %X\n", getValue( HMI_VehSpd_TCO ) );        filePutString( buffer, elcount( buffer ), hFile );
}

on timer _tIC_AddDisp_VAN_AR
{
    putValue( HMI__STMSG_IC_AddDisp_VAN_AR, 0 );
}

on EnvVar HMI__STMSG_IC_AddDisp_VAN_AR
{
    long tDelay;
    if( getValue( this ) == 2 )
    {
        tDelay = getValue( HMI__STMSGT_IC_AddDisp_VAN_AR );
        if( tDelay > 0)    
            setTimer( _tIC_AddDisp_VAN_AR, tDelay );
        else
            putValue( HMI__STMSG_IC_AddDisp_VAN_AR, 0 );
    }
}

on envVar HMI__STMSG_PO_IC_AddDisp_VAN_AR
{
    if( getValue( this ) )
        openPanel("IC_AddDisp_VAN_AR");
}

on EnvVar HMI_DPF_ManRgnrt_Rq
{
    _mIC_AddDisp_VAN_AR.DPF_ManRgnrt_Rq.phys = getValue(this);
    _IC_AddDisp_VAN_AR_SpontanFlag = 1;
}

on EnvVar HMI_VehSpd_TCO
{
    _mIC_AddDisp_VAN_AR.VehSpd_TCO.phys = getValue(this);
    _IC_AddDisp_VAN_AR_SpontanFlag = 1;
}

/*@@caplFunc:IC_DispAreaCfg_Stat_AR_check_output():*/
IC_DispAreaCfg_Stat_AR_check_output()
{
    if( !getValue( HMI__STMSG_IC_DispAreaCfg_Stat_AR))
    {
        // Botschaft IC_DispAreaCfg_Stat_AR ID: 1074 --- Sendeart cyclicAndSpontanWithDelay --- 
        _IC_DispAreaCfg_Stat_AR_Cnt--;
        if( _IC_DispAreaCfg_Stat_AR_Cnt < 1 )
        {
            // Nachricht wg. abgelaufenem Zyklus ausgeben
            output( _mIC_DispAreaCfg_Stat_AR );
            _IC_DispAreaCfg_Stat_AR_Cnt = _IC_DispAreaCfg_Stat_AR_CycleCount; // Zyklus-Zähler zurücksetzen
             _IC_DispAreaCfg_Stat_AR_SpontanFlag = 0; // Spontan-Flag zurücksetzen
        }
        else if( _IC_DispAreaCfg_Stat_AR_SpontanFlag)
        {
            // Nachricht wg. spontaner Änderung ausgeben
            output( _mIC_DispAreaCfg_Stat_AR );
             _IC_DispAreaCfg_Stat_AR_SpontanFlag = 0; // Spontan-Flag zurücksetzen
        }
    }
}
/*@@end*/

/*@@caplFunc:IC_DispAreaCfg_Stat_AR_init():*/
IC_DispAreaCfg_Stat_AR_init()
{   /* Botschaft IC_DispAreaCfg_Stat_AR ID: 1072 --- Sendeart cyclicAndSpontanWithDelay --- 
BA_ "ApplMessage" BO_ 1074 0;
BA_ "NmAsrMessage" BO_ 1074 0;
BA_ "GenMsgMinAcceptLength" BO_ 1074 8;
BA_ "GenMsgILSupport" BO_ 1074 0;
BA_ "DiagState" BO_ 1074 0;
BA_ "DiagRequest" BO_ 1074 0;
BA_ "DiagResponse" BO_ 1074 0;
BA_ "GenMsgStartValue" BO_ 1074 "0";
BA_ "GenMsgStartDelayTime" BO_ 1074 205;
BA_ "GenMsgDelayTime" BO_ 1074 100;
BA_ "GenMsgNrOfRepetition" BO_ 1074 0;
BA_ "GenMsgCycleTime" BO_ 1074 1000;
BA_ "GenMsgSendType" BO_ 1074 5;
    */
    _IC_DispAreaCfg_Stat_AR_Timebase =          c_tDBKomTimer_20ms;
    _IC_DispAreaCfg_Stat_AR_CycleCount =      1000 / _IC_DispAreaCfg_Stat_AR_Timebase;
    _IC_DispAreaCfg_Stat_AR_Cnt = 0;
    _IC_DispAreaCfg_Stat_AR_StartDelay =        205 / _IC_DispAreaCfg_Stat_AR_Timebase;
    _IC_DispAreaCfg_Stat_AR_SpontanFlag = 0;

    putValue( HMI__STMSGSD_IC_DispAreaCfg_Stat_AR, _IC_DispAreaCfg_Stat_AR_StartDelay * _IC_DispAreaCfg_Stat_AR_Timebase );

    _mIC_DispAreaCfg_Stat_AR.IC_CDA_Cfg_Stat.phys = getValue( HMI_IC_CDA_Cfg_Stat );
	_mIC_DispAreaCfg_Stat_AR.IC_DispAreaCfg_Stat_MdSel.phys = getValue( HMI_IC_DispAreaCfg_Stat_MdSel );
    _mIC_DispAreaCfg_Stat_AR.IC_SCA1_Cfg_Stat.phys = getValue( HMI_IC_SCA1_Cfg_Stat );
    _mIC_DispAreaCfg_Stat_AR.IC_SCA2_Cfg_Stat.phys = getValue( HMI_IC_SCA2_Cfg_Stat );
    _mIC_DispAreaCfg_Stat_AR.IC_SCA3_Cfg_Stat.phys = getValue( HMI_IC_SCA3_Cfg_Stat );
    _mIC_DispAreaCfg_Stat_AR.IC_SCA5_Cfg_Stat.phys = getValue( HMI_IC_SCA5_Cfg_Stat );
    _mIC_DispAreaCfg_Stat_AR.IC_SCA4_Cfg_Stat.phys = getValue( HMI_IC_SCA4_Cfg_Stat );
    _mIC_DispAreaCfg_Stat_AR.IC_SCA6_Cfg_Stat.phys = getValue( HMI_IC_SCA6_Cfg_Stat );
	_mIC_DispAreaCfg_Stat_AR.IC_SCA7_Cfg_Stat.phys = getValue( HMI_IC_SCA7_Cfg_Stat );
}
/*@@end*/

/*@@caplFunc:IC_DispAreaCfg_Stat_AR_saveEnvVars(dword):*/
IC_DispAreaCfg_Stat_AR_saveEnvVars( dword hFile )
{
    filePutString("\n// Knoten IC: IC_DispAreaCfg_Stat_AR\n", 26, hFile);
    snprintf( buffer, elcount(buffer), "0.0000 HMI__STMSG_IC_DispAreaCfg_Rq := %X\n", getValue( HMI__STMSG_IC_DispAreaCfg_Stat_AR ));        filePutString( buffer, elcount(buffer), hFile);
    snprintf( buffer, elcount(buffer), "0.0000 HMI__STMSGT_IC_DispAreaCfg_Rq := %X\n", getValue( HMI__STMSGT_IC_DispAreaCfg_Stat_AR ));        filePutString( buffer, elcount(buffer), hFile);
	snprintf( buffer, elcount(buffer), "0.0000 HMI_IC_CDA_Cfg_Stat := %X\n", getValue( HMI_IC_CDA_Cfg_Stat ) );        filePutString( buffer, elcount(buffer), hFile);
    snprintf( buffer, elcount(buffer), "0.0000 HMI_IC_DispAreaCfg_Stat_MdSel := %X\n", getValue( HMI_IC_DispAreaCfg_Stat_MdSel ) );        filePutString( buffer, elcount(buffer), hFile);
    snprintf( buffer, elcount(buffer), "0.0000 HMI_IC_SCA1_Cfg_Stat := %X\n", getValue( HMI_IC_SCA1_Cfg_Stat ) );        filePutString( buffer, elcount(buffer), hFile);
    snprintf( buffer, elcount(buffer), "0.0000 HMI_IC_SCA2_Cfg_Stat := %X\n", getValue( HMI_IC_SCA2_Cfg_Stat ) );        filePutString( buffer, elcount(buffer), hFile);
    snprintf( buffer, elcount(buffer), "0.0000 HMI_IC_SCA3_Cfg_Stat := %X\n", getValue( HMI_IC_SCA3_Cfg_Stat ) );        filePutString( buffer, elcount(buffer), hFile);
    snprintf( buffer, elcount(buffer), "0.0000 HMI_IC_SCA5_Cfg_Stat := %X\n", getValue( HMI_IC_SCA5_Cfg_Stat ) );        filePutString( buffer, elcount(buffer), hFile);
    snprintf( buffer, elcount(buffer), "0.0000 HMI_IC_SCA4_Cfg_Stat := %X\n", getValue( HMI_IC_SCA4_Cfg_Stat ) );        filePutString( buffer, elcount(buffer), hFile);
    snprintf( buffer, elcount(buffer), "0.0000 HMI_IC_SCA6_Cfg_Stat := %X\n", getValue( HMI_IC_SCA6_Cfg_Stat ) );        filePutString( buffer, elcount(buffer), hFile);
}
/*@@end*/

/*@@timer:_tIC_DispAreaCfg_Stat_AR:*/
on timer _tIC_DispAreaCfg_Stat_AR
{
    putValue( HMI__STMSG_IC_DispAreaCfg_Stat_AR, 0 );
}
/*@@end*/

/*@@envVar:HMI__STMSG_IC_DispAreaCfg_Stat_AR:*/
on EnvVar HMI__STMSG_IC_DispAreaCfg_Stat_AR
{
    long tDelay;
    if( getValue( this ) == 2 )
    {
        tDelay = getValue( HMI__STMSGT_IC_DispAreaCfg_Stat_AR );
        if( tDelay > 0 )    
            setTimer( _tIC_DispAreaCfg_Stat_AR, tDelay );
        else
            putValue( HMI__STMSG_IC_DispAreaCfg_Stat_AR, 0 );
    }
}
/*@@end*/

/*@@envVar:HMI__STMSG_PO_IC_DispAreaCfg_Stat_AR:*/
on envVar HMI__STMSG_PO_IC_DispAreaCfg_Stat_AR
{
    if( getValue( this ) )
        openPanel("IC_DispAreaCfg_Stat_AR");
}
/*@@end*/

/*@@envVar:HMI_IC_CDA_Cfg_Stat:*/
on EnvVar HMI_IC_CDA_Cfg_Stat
{
    _mIC_DispAreaCfg_Stat_AR.IC_CDA_Cfg_Stat.phys = getValue(this);
    _IC_DispAreaCfg_Stat_AR_SpontanFlag = 1;
}
/*@@end*/

/*@@envVar:HMI_IC_DispAreaCfg_Stat_MdSel:*/
on EnvVar HMI_IC_DispAreaCfg_Stat_MdSel
{
    _mIC_DispAreaCfg_Stat_AR.IC_DispAreaCfg_Stat_MdSel.phys = getValue(this);
    _IC_DispAreaCfg_Stat_AR_SpontanFlag = 1;
}
/*@@end*/

/*@@envVar:HMI_IC_SCA1_Cfg_Stat:*/
on EnvVar HMI_IC_SCA1_Cfg_Stat
{
    _mIC_DispAreaCfg_Stat_AR.IC_SCA1_Cfg_Stat.phys = getValue(this);
    _IC_DispAreaCfg_Stat_AR_SpontanFlag = 1;
}
/*@@end*/

/*@@envVar:HMI_IC_SCA2_Cfg_Stat:*/
on EnvVar HMI_IC_SCA2_Cfg_Stat
{
    _mIC_DispAreaCfg_Stat_AR.IC_SCA2_Cfg_Stat.phys = getValue(this);
    _IC_DispAreaCfg_Stat_AR_SpontanFlag = 1;
}
/*@@end*/

/*@@envVar:HMI_IC_SCA3_Cfg_Stat:*/
on EnvVar HMI_IC_SCA3_Cfg_Stat
{
    _mIC_DispAreaCfg_Stat_AR.IC_SCA3_Cfg_Stat.phys = getValue(this);
    _IC_DispAreaCfg_Stat_AR_SpontanFlag = 1;
}
/*@@end*/

/*@@envVar:HMI_IC_SCA5_Cfg_Stat:*/
on EnvVar HMI_IC_SCA5_Cfg_Stat
{
    _mIC_DispAreaCfg_Stat_AR.IC_SCA5_Cfg_Stat.phys = getValue(this);
    _IC_DispAreaCfg_Stat_AR_SpontanFlag = 1;
}
/*@@end*/

/*@@envVar:HMI_IC_SCA4_Cfg_Stat:*/
on EnvVar HMI_IC_SCA4_Cfg_Stat
{
    _mIC_DispAreaCfg_Stat_AR.IC_SCA4_Cfg_Stat.phys = getValue(this);
    _IC_DispAreaCfg_Stat_AR_SpontanFlag = 1;
}
/*@@end*/

/*@@envVar:HMI_IC_SCA6_Cfg_Stat:*/
on EnvVar HMI_IC_SCA6_Cfg_Stat
{
    _mIC_DispAreaCfg_Stat_AR.IC_SCA6_Cfg_Stat.phys = getValue(this);
    _IC_DispAreaCfg_Stat_AR_SpontanFlag = 1;
}
/*@@end*/

/*@@envVar:HMI_IC_SCA7_Cfg_Stat:*/
on EnvVar HMI_IC_SCA7_Cfg_Stat
{
    _mIC_DispAreaCfg_Stat_AR.IC_SCA7_Cfg_Stat.phys = getValue(this);
    _IC_DispAreaCfg_Stat_AR_SpontanFlag = 1;
}
/*@@end*/
