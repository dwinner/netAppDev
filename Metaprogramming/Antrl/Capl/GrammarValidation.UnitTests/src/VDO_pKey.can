/*@@var:*/
/*
Copyright ( C ) Continental AG 2012

Date of creation :  14.04.2011

Created by :        Daniel Warnicki


Version info
5.06    27.05.2014    DaWa adaptions for OFN
1.10    04.11.2013    HJH  HMI_2013_42a database
1.00       10.2013    DaWa Inital version

*/


variables
{
    msTimer t_EventDutation;            // event dration timer
    long lRecorderEventIndex;            // index of current key

    long lEventIndex;
    byte bDebugOn;                      // RAM value for debug switch to prevent compiler warning
    dword dwWriteTab;                   // Tab ID for write output
    dword dwTimeLastKeyEvent;            // timestamp for last Key event
    char sIniFileName[150];                // ini file
    char sKeyRecordFileName[150];        // filename for KEY recod file

    const byte cboDebugOn = 0;          // 0 -> debug off 
                                        // 1 -> debug on 
    char key_ini_path[10] = "key_data\\";
                                        // 2 -> detail debuging on

      byte bOld_Env_Ign_Switch_State = 0; // old KL15 state

    // internal enumeration for KEY events
    const byte cKey_UP             = 1; // Env_OFN_Up_1_Play   
    const byte cKey_RIGHT          = 2; // Env_OFN_Right_1_Play
    const byte cKey_OK             = 3; // Env_StWhl_Sw_Ok_Psd
    const byte cKey_BACK           = 4; // Env_StWhl_Sw_Back_Psd
    const byte cKey_DOWN           = 5; // Env_OFN_Down_1_Play
    const byte cKey_PLUS           = 6; // HMI_StWhl_Sw_Plus_Psd
    const byte cKey_SEND           = 7; // HMI_StWhl_Sw_TelSend_Psd
    const byte cKey_MUTE           = 8; // HMI_StWhl_Sw_Mute_Psd
    const byte cKey_END            = 9; // HMI_StWhl_Sw_TelEnd_Psd
    const byte cKey_MINUS          = 10;// HMI_StWhl_Sw_Minus_Psd
    const byte cKey_TALK           = 11;// HMI_StWhl_Sw_PTT_Psd
    const byte cKey_LEFT           = 12;// Env_OFN_Left_1_Play

    const byte cKey_DayNight       = 13;
    const byte cKey_NightView      = 14;
    const byte cKey_ExtKi_Init     = 15;
    const byte cKey_ExtKi_List     = 16;
    const byte cKey_ExtKi_Update   = 17;
    const byte cKey_ExtKi_Kategory = 18;
    const byte cKey_DistronicCar   = 19;
    const byte cKey_DistronicRadar = 20;
    const byte cKey_Dimming        = 21;
    const byte cKey_DistronicBegin = 22;
    const byte cKey_DistronicEnd   = 23;
    const byte cKey_ParkLeft       = 24;
    const byte cKey_ParkRight      = 25;
    const byte cKey_KL15           = 26;
    const byte cKey_EngRun         = 27;

    const byte cKey_HMI__STMSG_EL_TurnInd_Rq_AR       = 28;
    const byte cKey_Env_TurnInd_Lt_On                 = 29;
    const byte cKey_Env_TurnInd_Rt_On                 = 30;
    const byte cKey_Env_TurnLmpOnDur                  = 31;
    const byte cKey_HMI_EF_Actv                       = 32;
    const byte cKey_HMI__STMSG_EL_Stat_AR             = 33;
    const byte cKey_HMI_HiBm_IndLmp_On_Rq             = 34;
    const byte cKey_HMI_LoBm_IndLmp_On_Rq             = 35;
    const byte cKey_HMI_PosnLmp_IndLmp_On_Rq          = 36;
    const byte cKey_HMI_FogLmp_Ft_IndLmp_On_Rq        = 37;
    const byte cKey_HMI_FogLmp_R_IndLmp_On_Rq         = 38;
    const byte cKey_HMI__STMSG_EngCtrl_Disp_Rq_AR     = 39;
    const byte cKey_HMI_MIL_On_Rq                     = 40;
    const byte cKey_HMI_PreHtIndLmp_On_Rq             = 41;
    const byte cKey_HMI__STMSG_ORC_Disp_Stat_AR       = 42;
    const byte cKey_HMI_SRS_IndLmp_Rq                 = 43;
    const byte cKey_HMI_Bckl_Sw_D_Stat                = 44;
    const byte cKey_HMI__STMSG_ESP_Disp_Rq_AR         = 45;
    const byte cKey_HMI_ABS_IndLmp_On_Rq              = 46;
    const byte cKey_HMI_ESP_CtrlLmp_Info              = 47;
    const byte cKey_HMI_BrkIndLmp_On_Rq_ESP           = 48;
    const byte cKey_HMI_BrkIndLmp_On_Rq_EPkB          = 49;
    const byte cKey_HMI_RBS_IndLmp_On_Rq              = 50;
    const byte cKey_HMI_ESP_Off_IndLmp_On_Rq          = 51;
    const byte cKey_HMI_PkBrkIndLmp_On_Rq             = 52;
    const byte cKey_HMI_LDC_DTR_IndLmp_On_Rq          = 53;
    const byte cKey_HMI_LDC_DTR_IndLmp_On_Rq_RDU      = 54;
    const byte cKey_HMI_TankLvl_Min                   = 55;
    const byte cKey_HMI_TankCapIndLmp_On_Rq           = 56;

    const byte cKey_Env_EngCoolTemp                   = 57;
    const byte cKey_Env_BS_Raddrehzahlen              = 58;
    const byte cKey_Env_EngRPM                        = 59;
    const byte cKey_HMI_TankLvl                       = 60;
    const byte cKey_HMI_HUD_Sw_Psd                    = 61;
    const byte cKey_Navi_01                           = 62;
    const byte cKey_Style                             = 63;

}
/*@@end*/

/*@@preStart:PreStart:*/
// function      : Initialisation of some variables.
// author        : Daniel Warnicki 10.2010
on preStart
{
    //Create a new tab at the write window
    dwWriteTab= writeCreate("VDO_pKey");                // create tab
    writeclear(dwWriteTab);                             // clear tab content

    bDebugOn = cboDebugOn;                                // set debug switch
    dwTimeLastKeyEvent = timeNow();                        // init last event timer

    snprintf(sIniFileName,50,"key_data\\VDO_KeyV0506.ini");       // set ini filename
    //snprintf(sKeyRecordFileName,50,"Default.krc");    // set record filename
    //getvalue( pKey_Filename,sKeyRecordFileName );       // set record filename
}
/*@@end*/

/*@@startStart:Start:*/
on start
// function      : Initialisation of KEY panel (get last configuration ).
// author        : Daniel Warnicki 10.2010
{
    vIniFileRead(sIniFileName );
    vCheckRecordFile();
    vStopRecorderAndPlayer();
}
/*@@end*/

/*@@stop:StopMeasurement:*/
on stopMeasurement
// function      : Store the last configuration.
// author        : Daniel Warnicki 10.2010
{
    vIniFileWrite(sIniFileName );
    vStopRecorderAndPlayer();
}
/*@@end*/

/*@@timer:t_EventDutation:*/
on timer t_EventDutation
// function      : Duration timer between two key events.
// author        : Daniel Warnicki 10.2010
{
    vCheckNextKey(lEventIndex + 1 );
}
/*@@end*/

/*@@envVar:Env_BS_Raddrehzahlen:*/
on envVar Env_BS_Raddrehzahlen
// function      : Rev event received.
// author        : Daniel Warnicki 05.08.2011
{
    vRecordKeyEvent( cKey_Env_BS_Raddrehzahlen, getvalue( Env_BS_Raddrehzahlen ) );
}
/*@@end*/

/*@@envVar:Env_EngCoolTemp:*/
on envVar Env_EngCoolTemp
// function      : Wtp event received.
// author        : Daniel Warnicki 05.08.2011
{
    vRecordKeyEvent( cKey_Env_EngCoolTemp, getvalue( Env_EngCoolTemp ) );
}
/*@@end*/

/*@@envVar:Env_EngRPM:*/
on envVar Env_EngRPM
// function      : Vel event received.
// author        : Daniel Warnicki 05.08.2011
{
    vRecordKeyEvent( cKey_Env_EngRPM, getvalue( Env_EngRPM ) );
}
/*@@end*/

/*@@envVar:Env_Ign_Switch:*/
on envVar Env_Ign_Switch
// function      : KL15 event received.
// author        : Daniel Warnicki 03.08.2011
{
    vRecordKeyEvent( cKey_KL15, getvalue( Env_Ign_Switch ) );

    if( getvalue( pCheck_RestartAtKl15R ) )
    {// restart player if KL15 >=KL15r is configured
        if( bOld_Env_Ign_Switch_State != getvalue( Env_Ign_Switch ) )
        {// KL15 state was changed
            if( ( bOld_Env_Ign_Switch_State < 2 ) && ( getvalue( Env_Ign_Switch ) >= 2 ) )
            {//restart player now
                if( getvalue( pKey_RecordPlay ) )
                {// player is active
                    // restart player
                    putValue( pKey_RecordPlayTime, 0 );
                    putValue( pKey_RecorderActive, 0 );  // stop recorder
                    putValue( pKey_RecordPlay, 1 );
                    writeLineEx(dwWriteTab, 1 , "KeyPlayer->play back on");
                    vCheckNextKey( 1 );
                }
            }
            // store current state
            bOld_Env_Ign_Switch_State = getvalue( Env_Ign_Switch );
        }
    }
}
/*@@end*/

/*@@envVar:Env_OFN_Down_1_Play:*/
on envVar Env_OFN_Down_1_Play // Key DOWN
// function      : KEY DOWN event received.
// author        : Daniel Warnicki 10.2010
    {
    vRecordKeyEvent( cKey_DOWN, getvalue( Env_OFN_Down_1_Play ) );
    }
/*@@end*/

/*@@envVar:Env_OFN_Left_1_Play:*/
on envVar Env_OFN_Left_1_Play // Key LEFT
// function      : KEY LEFT event received.
// author        : Daniel Warnicki 27.2014
{
    vRecordKeyEvent( cKey_LEFT, getvalue( Env_OFN_Left_1_Play ) );
}
/*@@end*/

/*@@envVar:Env_OFN_Right_1_Play:*/
on envVar Env_OFN_Right_1_Play // Key RIGHT
// function      : KEY RIGHT event received.
// author        : Daniel Warnicki 27.2014
{
    vRecordKeyEvent( cKey_RIGHT, getvalue( Env_OFN_Right_1_Play ) );
}
/*@@end*/

/*@@envVar:Env_OFN_Up_1_Play:*/
on envVar Env_OFN_Up_1_Play // Key UP
// function      : KEY MENU event received.
// author        : Daniel Warnicki 10.2010
    {
	//write("Clicked on UP");
    vRecordKeyEvent( cKey_UP, getvalue( Env_OFN_Up_1_Play ) );
    }
/*@@end*/

/*@@envVar:HMI_StWhl_Sw_Back1_Psd:*/
on envVar HMI_StWhl_Sw_Back1_Psd // Key BACK
// function      : KEY BACK event received.
// author        : Daniel Warnicki 10.2010
    {
    vRecordKeyEvent( cKey_BACK, getvalue( HMI_StWhl_Sw_Back1_Psd ) );
    }
/*@@end*/

/*@@envVar:HMI_StWhl_Sw_Ok1_Psd:*/
on envVar HMI_StWhl_Sw_Ok1_Psd // Key OK
// function      : KEY OK event received.
// author        : Daniel Warnicki 10.2010
    {
	//write("Clicked on OK");
    vRecordKeyEvent( cKey_OK, getvalue( HMI_StWhl_Sw_Ok1_Psd ) );
    }
/*@@end*/

/*@@envVar:Env_TurnInd_Lt_On:*/
on envVar Env_TurnInd_Lt_On
// function      : Indicator event received.
// author        : Daniel Warnicki 04.08.2011
{
    vRecordKeyEvent( cKey_Env_TurnInd_Lt_On, getvalue( Env_TurnInd_Lt_On ) );
}
/*@@end*/

/*@@envVar:Env_TurnInd_Rt_On:*/
on envVar Env_TurnInd_Rt_On
// function      : Indicator event received.
// author        : Daniel Warnicki 04.08.2011
{
    vRecordKeyEvent( cKey_Env_TurnInd_Rt_On, getvalue( Env_TurnInd_Rt_On ) );
}
/*@@end*/

/*@@envVar:Env_TurnLmpOnDur:*/
on envVar Env_TurnLmpOnDur
{
    vRecordKeyEvent( cKey_Env_TurnLmpOnDur, getvalue( Env_TurnLmpOnDur ) );
}
/*@@end*/

/*@@envVar:HMI_ABS_IndLmp_On_Rq:*/
on envVar HMI_ABS_IndLmp_On_Rq
// function      : Indicator event received.
// author        : Daniel Warnicki 04.08.2011
{
    vRecordKeyEvent( cKey_HMI_ABS_IndLmp_On_Rq, getvalue( HMI_ABS_IndLmp_On_Rq) );
}
/*@@end*/

/*@@caplFunc:vIniFileWrite(char[]):*///function
vIniFileWrite ( char sFilename[])
{
    char sFunctionName[40];        // Function name for Ini File
    long lNoWriteError;

    lNoWriteError = 1;

    strncpy(sFunctionName, "Options", 40 );    // Name of functionality

    if( lNoWriteError ) lNoWriteError = writeProfileString(sFunctionName, "pKey_FileName",                sKeyRecordFileName,                        sFilename );
    if( lNoWriteError ) lNoWriteError = writeProfileInt(sFunctionName, "pKey_RecordLoop",                 getValue( pKey_RecordLoop),                sFilename );
    if( lNoWriteError ) lNoWriteError = writeProfileInt(sFunctionName, "pKey_TimeCompression",            getValue( pKey_TimeCompression ),          sFilename );
    if( lNoWriteError ) lNoWriteError = writeProfileInt(sFunctionName, "pKey_All_END",                    getValue( pKey_All_END),                   sFilename );
    if( lNoWriteError ) lNoWriteError = writeProfileInt(sFunctionName, "pKey_All_MINUS",                  getValue( pKey_All_MINUS),                 sFilename );
    if( lNoWriteError ) lNoWriteError = writeProfileInt(sFunctionName, "pKey_All_MUTE",                   getValue( pKey_All_MUTE),                  sFilename );
    if( lNoWriteError ) lNoWriteError = writeProfileInt(sFunctionName, "pKey_All_PLUS",                   getValue( pKey_All_PLUS),                  sFilename );
    if( lNoWriteError ) lNoWriteError = writeProfileInt(sFunctionName, "pKey_All_SEND",                   getValue( pKey_All_SEND),                  sFilename );
    if( lNoWriteError ) lNoWriteError = writeProfileInt(sFunctionName, "pKey_All_TALK",                   getValue( pKey_All_TALK),                  sFilename );
    if( lNoWriteError ) lNoWriteError = writeProfileInt(sFunctionName, "pKey_All_Up",                     getValue( pKey_All_Up),                    sFilename );
    if( lNoWriteError ) lNoWriteError = writeProfileInt(sFunctionName, "pKey_All_BACK",                   getValue( pKey_All_BACK),                  sFilename );
    if( lNoWriteError ) lNoWriteError = writeProfileInt(sFunctionName, "pKey_All_DOWN",                   getValue( pKey_All_DOWN),                  sFilename );
    if( lNoWriteError ) lNoWriteError = writeProfileInt(sFunctionName, "pKey_All_LEFT",                   getValue( pKey_All_LEFT),                  sFilename );
    if( lNoWriteError ) lNoWriteError = writeProfileInt(sFunctionName, "pKey_All_RIGHT",                  getValue( pKey_All_RIGHT),                 sFilename );
    if( lNoWriteError ) lNoWriteError = writeProfileInt(sFunctionName, "pKey_All_MENU",                   getValue( pKey_All_MENU),                  sFilename );
    if( lNoWriteError ) lNoWriteError = writeProfileInt(sFunctionName, "pKey_All_OK",                     getValue( pKey_All_OK),                    sFilename );
    if( lNoWriteError ) lNoWriteError = writeProfileInt(sFunctionName, "pKey_All_CombinationOn",          getValue( pKey_All_CombinationOn ),        sFilename );

    if( lNoWriteError ) lNoWriteError = writeProfileInt(sFunctionName, "pCheck_PlayDemoExtKi",            getValue( pCheck_PlayDemoExtKi),           sFilename );
    if( lNoWriteError ) lNoWriteError = writeProfileInt(sFunctionName, "pCheck_PlayMflKeys",              getValue( pCheck_PlayMflKeys),             sFilename );
    if( lNoWriteError ) lNoWriteError = writeProfileInt(sFunctionName, "pCheck_PlayDemoValues",           getValue( pCheck_PlayDemoValues),          sFilename );
    if( lNoWriteError ) lNoWriteError = writeProfileInt(sFunctionName, "pCheck_PlayKl15",                 getValue( pCheck_PlayKl15),                sFilename );
    if( lNoWriteError ) lNoWriteError = writeProfileInt(sFunctionName, "pCheck_PlayEngRun",               getValue( pCheck_PlayEngRun ),             sFilename );
    if( lNoWriteError ) lNoWriteError = writeProfileInt(sFunctionName, "pCheck_PlayIndicators",           getValue( pCheck_PlayIndicators),          sFilename );

    if( lNoWriteError ) lNoWriteError = writeProfileInt(sFunctionName, "pCheck_PlayRevVelTnkTmp",         getValue( pCheck_PlayRevVelTnkTmp),        sFilename );
    if( lNoWriteError ) lNoWriteError = writeProfileInt(sFunctionName, "pCheck_RestartAtKl15R",           getValue( pCheck_RestartAtKl15R),          sFilename );

    if( lNoWriteError ) lNoWriteError = writeProfileInt(sFunctionName, "pCheck_TimeShiftDisabledEvents",  getValue( pCheck_TimeShiftDisabledEvents), sFilename );

    writeLineEx(dwWriteTab, 1 , "write ini file '%s'",sFilename );
}
/*@@end*/

/*@@caplFunc:vIniFileRead(char[]):*///function
vIniFileRead ( char sFilename[])
{
    char sFunctionName[40];        // Function name for Ini File
    char sFileNameWithoutPath[150];

    strncpy(sFunctionName, "Options", 40 );    // Name of functionality

    getProfileString(sFunctionName, "pKey_FileName", "Default.krc",sKeyRecordFileName, 150,sFilename );
    strncpy(sFileNameWithoutPath,sKeyRecordFileName,elcount(sFileNameWithoutPath ) );

    if( strncmp( sFileNameWithoutPath, key_ini_path, strlen( key_ini_path ) ) == 0 )    
    {
        substr_cpy( sFileNameWithoutPath, sFileNameWithoutPath, strlen( key_ini_path ), -1, elcount( sFileNameWithoutPath ) );
        writeLineEx( dwWriteTab, 1 , "Debug: %s", sFileNameWithoutPath );
    }
//    str_replace(sFileNameWithoutPath,"key_data\\","");

    putvalue( pKey_Filename,sFileNameWithoutPath );

    putvalue( pKey_RecordLoop,               getProfileInt(sFunctionName, "pKey_RecordLoop",                1, sFilename ) );

    putvalue( pKey_TimeCompression,          getProfileInt(sFunctionName, "pKey_TimeCompression",           0, sFilename ) );
    putvalue( pKey_All_END,                  getProfileInt(sFunctionName, "pKey_All_END",                   0, sFilename ) );
    putvalue( pKey_All_MINUS,                getProfileInt(sFunctionName, "pKey_All_MINUS",                 0, sFilename ) );
    putvalue( pKey_All_MUTE,                 getProfileInt(sFunctionName, "pKey_All_MUTE",                  0, sFilename ) );
    putvalue( pKey_All_PLUS,                 getProfileInt(sFunctionName, "pKey_All_PLUS",                  0, sFilename ) );
    putvalue( pKey_All_SEND,                 getProfileInt(sFunctionName, "pKey_All_SEND",                  0, sFilename ) );
    putvalue( pKey_All_TALK,                 getProfileInt(sFunctionName, "pKey_All_TALK",                  0, sFilename ) );
    putvalue( pKey_All_Up,                   getProfileInt(sFunctionName, "pKey_All_Up",                    0, sFilename ) );
    putvalue( pKey_All_BACK,                 getProfileInt(sFunctionName, "pKey_All_BACK",                  0, sFilename ) );
    putvalue( pKey_All_DOWN,                 getProfileInt(sFunctionName, "pKey_All_DOWN",                  0, sFilename ) );
    putvalue( pKey_All_LEFT,                 getProfileInt(sFunctionName, "pKey_All_LEFT",                  0, sFilename ) );
    putvalue( pKey_All_RIGHT,                getProfileInt(sFunctionName, "pKey_All_RIGHT",                 0, sFilename ) );
    putvalue( pKey_All_MENU,                 getProfileInt(sFunctionName, "pKey_All_MENU",                  0, sFilename ) );
    putvalue( pKey_All_OK,                   getProfileInt(sFunctionName, "pKey_All_OK",                    0, sFilename ) );
    putvalue( pKey_All_CombinationOn,        getProfileInt(sFunctionName, "pKey_All_CombinationOn",         0, sFilename ) );

    putvalue( pCheck_PlayDemoExtKi,          getProfileInt(sFunctionName, "pCheck_PlayDemoExtKi",           0, sFilename ) );
    putvalue( pCheck_PlayMflKeys,            getProfileInt(sFunctionName, "pCheck_PlayMflKeys",             0, sFilename ) );
    putvalue( pCheck_PlayDemoValues,         getProfileInt(sFunctionName, "pCheck_PlayDemoValues",          0, sFilename ) );
    putvalue( pCheck_PlayKl15,               getProfileInt(sFunctionName, "pCheck_PlayKl15",                0, sFilename ) );
    putvalue( pCheck_PlayEngRun,             getProfileInt(sFunctionName, "pCheck_PlayEngRun",              0, sFilename ) );
    putvalue( pCheck_PlayIndicators,         getProfileInt(sFunctionName, "pCheck_PlayIndicators",          0, sFilename ) );

    putvalue( pCheck_PlayRevVelTnkTmp,       getProfileInt(sFunctionName,"pCheck_PlayRevVelTnkTmp",         0, sFilename ) );
    putvalue( pCheck_RestartAtKl15R,         getProfileInt(sFunctionName,"pCheck_RestartAtKl15R"  ,         0, sFilename ) );

    putvalue( pCheck_TimeShiftDisabledEvents, getProfileInt(sFunctionName,"pCheck_TimeShiftDisabledEvents" , 0, sFilename ) );

    writeLineEx(dwWriteTab, 1 , "read ini file '%s'",sFilename );
}
/*@@end*/

/*@@envVar:pKey_RecorderActive:*/
on envVar pKey_RecorderActive
{
    char sKeyEventIndex[40];
    long lDuration;

/*
    setControlProperty("VDO_pKey","cmd_SetKeyRecordFile","open",1 );
    writeLineEx(dwWriteTab, 1 , "KeyRecorder->call setControlProperty('VDO_pKey','cmd_SetKeyRecordFile','open',1 )");
*/
    if( getvalue( pKey_RecorderActive ) )
    {// recorder is active
        dwTimeLastKeyEvent = timeNow();                        // init last event timer
        putValue( pKey_RecordPlay,0 );// stop record player
        putValue( pKey_RecordEvents,0 );
        putValue( pKey_RecordTime,0 );
        putValue( pKey_RecordPlayTime, getValue( pKey_RecordTime ) );
        writeLineEx(dwWriteTab, 1 , "KeyRecorder->recording start");
    }
    else
    {// recorder is inactive
        if( getvalue( pKey_RecordEvents) )
        {
            // set previews duration
            snprintf(sKeyEventIndex,40,"KeyEvent_%04d", getvalue( pKey_RecordEvents) );
            lDuration = timeNow()-dwTimeLastKeyEvent;
            writeProfileInt(sKeyEventIndex, "Duration", lDuration, sKeyRecordFileName );
            putValue( pKey_RecordTime, getvalue( pKey_RecordTime )+ (lDuration/100 ) );
            // set end mark
            snprintf(sKeyEventIndex,40,"KeyEvent_%04d", getvalue( pKey_RecordEvents)+1 );
            writeProfileInt(sKeyEventIndex, "Key",      0, sKeyRecordFileName );
            writeProfileInt(sKeyEventIndex, "KeyMode",  0, sKeyRecordFileName );
            writeProfileInt(sKeyEventIndex, "Duration", 0, sKeyRecordFileName );
        }
        vStopRecorderAndPlayer();
    }
}
/*@@end*/

/*@@envVar:pKey_RecordPlay:*/
on envVar pKey_RecordPlay
{
    if( getvalue( pKey_RecordPlay) )
    {// player is active
        if( getvalue( pKey_RecordEvents) )
        {// events availible
            putValue( pKey_RecordPlayTime,0 );
            putValue( pKey_RecorderActive,0 );  // stop recorder
            putValue( pKey_RecordPlay,1 );
            writeLineEx(dwWriteTab, 1 , "KeyPlayer->play back on");
            vCheckNextKey(1 );
        }
        else 
	{
            writeLineEx(dwWriteTab, 1 , "KeyPlayer-> no events defined!");
        }
    } 
    else
    {
        writeLineEx(dwWriteTab, 1 , "KeyPlayer->play back off");
        vStopRecorderAndPlayer();
    }
}
/*@@end*/

/*@@envVar:HMI_StWhl_Sw_Mute_Psd:*/
on envVar HMI_StWhl_Sw_Mute_Psd // Key MUTE
// function      : KEY UP event received.
// author        : Daniel Warnicki 10.2010
{
    vRecordKeyEvent( cKey_MUTE, getvalue( HMI_StWhl_Sw_Mute_Psd ) );
}
/*@@end*/

/*@@envVar:HMI_StWhl_Sw_Plus_Psd:*/
on envVar HMI_StWhl_Sw_Plus_Psd // Key PLUS
// function      : KEY PLUS event received.
// author        : Daniel Warnicki 10.2010
{
    vRecordKeyEvent( cKey_PLUS, getvalue( HMI_StWhl_Sw_Plus_Psd) );
}
/*@@end*/

/*@@envVar:HMI_StWhl_Sw_TelSend_Psd:*/
on envVar HMI_StWhl_Sw_TelSend_Psd // Key SEND
// function      : KEY SEND event received.
// author        : Daniel Warnicki 10.2010
{
    vRecordKeyEvent( cKey_SEND, getvalue( HMI_StWhl_Sw_TelSend_Psd) );
}
/*@@end*/

/*@@envVar:HMI_StWhl_Sw_TelEnd_Psd:*/
on envVar HMI_StWhl_Sw_TelEnd_Psd // Key END
// function      : KEY END event received.
// author        : Daniel Warnicki 10.2010
{
    vRecordKeyEvent( cKey_END, getvalue( HMI_StWhl_Sw_TelEnd_Psd) );
}
/*@@end*/

/*@@envVar:HMI_StWhl_Sw_Minus_Psd:*/
on envVar HMI_StWhl_Sw_Minus_Psd // Key MINUS
// function      : KEY MINUS event received.
// author        : Daniel Warnicki 10.2010
{
    vRecordKeyEvent( cKey_MINUS, getvalue( HMI_StWhl_Sw_Minus_Psd) );
}
/*@@end*/

/*@@envVar:HMI_StWhl_Sw_PTT_Psd:*/
on envVar HMI_StWhl_Sw_PTT_Psd // Key TALK
// function      : KEY TALK event received.
// author        : Daniel Warnicki 10.2010
{
    vRecordKeyEvent( cKey_TALK, getvalue( HMI_StWhl_Sw_PTT_Psd ) );
}
/*@@end*/

/*@@caplFunc:vRecordKeyEvent(long,byte):*///function
vRecordKeyEvent(long lKey,byte bKeyMode )
{
    char sKeyEventIndex[40];
    long lRecodIndex;
    long lDuration;

    if( getvalue( pKey_RecorderActive ) )
    {// recorder is active
        lRecodIndex = getvalue( pKey_RecordEvents);
        lRecodIndex = lRecodIndex + 1;
        putvalue( pKey_RecordEvents,lRecodIndex);

        snprintf(sKeyEventIndex,40,"KeyEvent_%04d",lRecodIndex);
        writeProfileInt(sKeyEventIndex, "Key", lKey, sKeyRecordFileName );
        writeProfileInt(sKeyEventIndex, "KeyMode", bKeyMode, sKeyRecordFileName );

        if( lRecodIndex > 1 )
        {// set duration for previews event
            snprintf(sKeyEventIndex,40,"KeyEvent_%04d",lRecodIndex-1 );
            lDuration = timeNow()-dwTimeLastKeyEvent;
            writeProfileInt(sKeyEventIndex, "Duration", lDuration, sKeyRecordFileName );
            putValue( pKey_RecordTime, getvalue( pKey_RecordTime )+ (lDuration/100 ) );
            putValue( pKey_RecordPlayTime, getValue( pKey_RecordTime )*fGetTimeCompression() );
        }
        dwTimeLastKeyEvent = timeNow();
    }    
}
/*@@end*/

/*@@caplFunc:vPlayEvents(long):*///function
vPlayEvents(long lKeyEventIndex)
{
    char sKeyEventIndex[40];
    long lKey;
    long lMode;
    long lConfigDuration;
    long lDuration;
    float fTimeCompression;

    lEventIndex = lKeyEventIndex;

    putValue( pKey_RecordPlayEvent,lEventIndex);

    snprintf(sKeyEventIndex,40,"KeyEvent_%04d",lEventIndex);
    lKey             = getProfileInt(sKeyEventIndex, "Key", 0, sKeyRecordFileName );
    lMode            = getProfileInt(sKeyEventIndex, "KeyMode", 0, sKeyRecordFileName );
    lConfigDuration  = getProfileInt(sKeyEventIndex, "Duration", 0, sKeyRecordFileName )/100;
    fTimeCompression = fGetTimeCompression();
    lDuration = lConfigDuration * fTimeCompression; // calculate time compression

    putValue( pKey_RecordPlayTime, getValue( pKey_RecordPlayTime ) + lDuration );

    if( bDebugOn > 1 ) writeLineEx(dwWriteTab, 1 , "KeyPlayer->analyse %s -> key:%d mode:%d duration:%dms*%1.2f=%dms",sKeyEventIndex,lKey,lMode,lConfigDuration,fTimeCompression,lDuration );

    vKeyHandle(lKey,lMode,lDuration );// handle key event

    if( lEventIndex > 0 )
        if( lDuration > 1 )
            settimer(t_EventDutation, lDuration );
        else
            settimer(t_EventDutation, 1 );
    else
    {
        vCheckNextKey(lEventIndex);
    }
}
/*@@end*/

/*@@caplFunc:vCheckNextKey(long):*///function
vCheckNextKey(long lKeyEventIndex)
// function      : the function checks the next key for playing
// parameters    : in  -> lKeyEventIndex: player event index
// author        : Daniel Warnicki 12.05.2011
{
    char sKeyEventIndex[40];
    long lNextKey;
    long lEventIndexStart;
    byte boStartEventDetect;

    lEventIndex = lKeyEventIndex;
    snprintf(sKeyEventIndex,40,"KeyEvent_%04d",lEventIndex);
    lNextKey = getProfileInt(sKeyEventIndex, "Key", 0, sKeyRecordFileName );

    if( getvalue( pCheck_TimeShiftDisabledEvents) > 0 )
    {// timeshift for disabled events active
        lEventIndexStart = lEventIndex;
        while (    (getvalue( pKey_RecordPlay) > 0 )
                && (boCheckKeyEnableToPlay(lNextKey) == 0x00 ) )
        {// plyler is active but current key is disables
            if( lNextKey == 0x00 )
            {// end of record detected
                lEventIndex = 1;// goto begin of record
            }
            else
            {
                lEventIndex = lEventIndex + 1; // check next event
            }

            if( lEventIndex == lEventIndexStart)
            {// now we check our start event 
                writeLineEx(dwWriteTab, 1 , "KeyPlayer->stopped no event activated!");
                putValue( pKey_RecordPlay,0 );
            }
            else
            {
                snprintf(sKeyEventIndex,40,"KeyEvent_%04d",lEventIndex);
                lNextKey = getProfileInt(sKeyEventIndex, "Key", 0, sKeyRecordFileName );
            }
        }
    }

    if( getvalue( pKey_RecordPlay) > 0 )
    {// player is active
        if( lNextKey == 0 ) 
        {// no valid key
            if( getvalue( pKey_RecordLoop) > 0 )
            {// repeat
                if( bDebugOn > 1 ) writeLineEx(dwWriteTab, 1 , "KeyPlayer->end of %s detected",sKeyRecordFileName );
                putValue( pKey_RecordPlayTime,0 );
                lEventIndex = 1;
            }
            else
            {// single shoot
                vStopRecorderAndPlayer();
            }
        }
        if( lEventIndex > 0 )
        {
            vPlayEvents(lEventIndex);
        }
    }
}
/*@@end*/

/*@@caplFunc:vStopRecorderAndPlayer():*///function
vStopRecorderAndPlayer ()
{
    lEventIndex = 0;                    // deactivate key toggle
    putValue( pKey_RecordPlayEvent,0 );
    cancelTimer(t_EventDutation );        // stop running timer

    if( getValue( pKey_RecorderActive ) )
    {
        putValue( pKey_RecorderActive,0 );
        writeLineEx(dwWriteTab, 1 , "KeyRecorder->recording start");
    }

    if( getValue( pKey_RecordPlay) )
    {
        putValue( pKey_RecordPlay,0 );
        writeLineEx(dwWriteTab, 1 , "KeyRecorder->play back off");
    }

    putValue( pKey_RecordPlayTime, getValue( pKey_RecordTime )*fGetTimeCompression() );

    // release all buttons
    putValue( HMI_StWhl_Sw_Back1_Psd ,0 );
    putValue( HMI_StWhl_Sw_Back2_Psd ,0 );
    putValue( HMI_StWhl_Sw_Minus_Psd ,0 );
    putValue( HMI_StWhl_Sw_Mute_Psd ,0 );
    putValue( HMI_StWhl_Sw_Ok1_Psd ,0 );
    putValue( HMI_StWhl_Sw_Ok2_Psd ,0 );
    putValue( HMI_StWhl_Sw_Plus_Psd ,0 );
    putValue( HMI_StWhl_Sw_PTT_Psd ,0 );
    putValue( HMI_StWhl_Sw_TelEnd_Psd ,0 );
    putValue( HMI_StWhl_Sw_TelSend_Psd ,0 );
}
/*@@end*/

/*@@caplFunc:vCheckRecordFile():*///function
vCheckRecordFile()
{
    char sKeyEventIndex[40];
    long lKey;
    long lDuration;

    lRecorderEventIndex = 1;
    lDuration = 0;
    snprintf(sKeyEventIndex,40,"KeyEvent_%04d",lRecorderEventIndex);
    lKey = getProfileInt(sKeyEventIndex, "Key", 0, sKeyRecordFileName );
    if( bDebugOn > 1 ) writeLineEx(dwWriteTab, 1 , "analyse input file %s",sKeyRecordFileName );

    while (lKey)
    {
        if( bDebugOn > 1 ) writeLineEx(dwWriteTab, 1 , "%s-> find %04d event(s)",sKeyRecordFileName,lRecorderEventIndex);
        lDuration = lDuration + (getProfileInt(sKeyEventIndex, "Duration", 0, sKeyRecordFileName )/100 );
        lRecorderEventIndex = lRecorderEventIndex + 1;
        snprintf(sKeyEventIndex,40,"KeyEvent_%04d",lRecorderEventIndex);
        lKey = getProfileInt(sKeyEventIndex, "Key", 0, sKeyRecordFileName );
    }
    putValue( pKey_RecordEvents,lRecorderEventIndex-1 );
    putValue( pKey_RecordTime,lDuration );
    putValue( pKey_RecordPlayTime,lDuration );
}
/*@@end*/

/*@@caplFunc:vKeyHandle(long,long,long):*///function
vKeyHandle (long lKey,long lKeyMode,long lDuration )
{    
    if( boCheckKeyEnableToPlay(lKey) != 0 )
    {
        switch(lKey)
        {
            case cKey_UP: 
                    putValue( Env_OFN_Up_1_Play,lKeyMode );
                    if( bDebugOn ) 
                        if( lKeyMode )
                            writeLineEx(dwWriteTab, 1 , "KeyPlayer->press   UP    (duration:%dms)",lDuration );
                        else
                            writeLineEx(dwWriteTab, 1 , "KeyPlayer->release   UP    (duration:%dms)",lDuration );
                    break;
            case cKey_RIGHT: 
                    putValue( Env_OFN_Right_1_Play,lKeyMode );
                    if( bDebugOn ) 
                        if( lKeyMode )
                            writeLineEx(dwWriteTab, 1 , "KeyPlayer->press   RIGHT (duration:%dms)",lDuration );
                        else
                            writeLineEx(dwWriteTab, 1 , "KeyPlayer->release   RIGHT (duration:%dms)",lDuration );
                    break;
            case cKey_OK: 
                    putValue( HMI_StWhl_Sw_Ok1_Psd,lKeyMode );
                    if( bDebugOn ) 
                        if( lKeyMode )
                            writeLineEx(dwWriteTab, 1 , "KeyPlayer->press   OK    (duration:%dms)",lDuration );
                        else
                            writeLineEx(dwWriteTab, 1 , "KeyPlayer->release   OK    (duration:%dms)",lDuration );
                    break;
            case cKey_BACK: 
                    putValue( HMI_StWhl_Sw_Back1_Psd,lKeyMode );
                    if( bDebugOn ) 
                        if( lKeyMode )
                            writeLineEx(dwWriteTab, 1 , "KeyPlayer->press   BACK  (duration:%dms)",lDuration );
                        else
                            writeLineEx(dwWriteTab, 1 , "KeyPlayer->release   BACK  (duration:%dms)",lDuration );
                    break;
            case cKey_DOWN: 
                    putValue( Env_OFN_Down_1_Play,lKeyMode );
                    if( bDebugOn ) 
                        if( lKeyMode )
                            writeLineEx(dwWriteTab, 1 , "KeyPlayer->press   DOWN  (duration:%dms)",lDuration );
                        else
                            writeLineEx(dwWriteTab, 1 , "KeyPlayer->release   DOWN  (duration:%dms)",lDuration );
                    break;
            case cKey_PLUS: 
                    putValue( HMI_StWhl_Sw_Plus_Psd,lKeyMode );
                    if( bDebugOn ) 
                        if( lKeyMode )
                            writeLineEx(dwWriteTab, 1 , "KeyPlayer->press   PLUS  (duration:%dms)",lDuration );
                        else
                            writeLineEx(dwWriteTab, 1 , "KeyPlayer->release   PLUS  (duration:%dms)",lDuration );
                    break;
            case cKey_SEND: 
                    putValue( HMI_StWhl_Sw_TelSend_Psd,lKeyMode );
                    if( bDebugOn ) 
                        if( lKeyMode )
                            writeLineEx(dwWriteTab, 1 , "KeyPlayer->press   SEND  (duration:%dms)",lDuration );
                        else
                            writeLineEx(dwWriteTab, 1 , "KeyPlayer->release   SEND  (duration:%dms)",lDuration );
                    break;
            case cKey_MUTE: 
                    putValue( HMI_StWhl_Sw_Mute_Psd,lKeyMode );
                    if( bDebugOn ) 
                        if( lKeyMode )
                            writeLineEx(dwWriteTab, 1 , "KeyPlayer->press   MUTE  (duration:%dms)",lDuration );
                        else
                            writeLineEx(dwWriteTab, 1 , "KeyPlayer->release   MUTE  (duration:%dms)",lDuration );
                    break;
            case cKey_END: 
                    putValue( HMI_StWhl_Sw_TelEnd_Psd,lKeyMode );
                    if( bDebugOn ) 
                        if( lKeyMode )
                            writeLineEx(dwWriteTab, 1 , "KeyPlayer->press   END   (duration:%dms)",lDuration );
                        else
                            writeLineEx(dwWriteTab, 1 , "KeyPlayer->release   END   (duration:%dms)",lDuration );
                    break;
            case cKey_MINUS: 
                    putValue( HMI_StWhl_Sw_Minus_Psd,lKeyMode );
                    if( bDebugOn ) 
                        if( lKeyMode )
                            writeLineEx(dwWriteTab, 1 , "KeyPlayer->press   MINUS (duration:%dms)",lDuration );
                        else
                            writeLineEx(dwWriteTab, 1 , "KeyPlayer->release   MINUS (duration:%dms)",lDuration );
                    break;
            case cKey_TALK: 
                    putValue( HMI_StWhl_Sw_PTT_Psd,lKeyMode );
                    if( bDebugOn ) 
                        if( lKeyMode )
                            writeLineEx(dwWriteTab, 1 , "KeyPlayer->press   TALK  (duration:%dms)",lDuration );
                        else
                            writeLineEx(dwWriteTab, 1 , "KeyPlayer->release   TALK  (duration:%dms)",lDuration );
                    break;
            case cKey_LEFT: 
                    putValue( Env_OFN_Left_1_Play,lKeyMode );
                    if( bDebugOn ) 
                        if( lKeyMode )
                            writeLineEx(dwWriteTab, 1 , "KeyPlayer->press   LEFT  (duration:%dms)",lDuration );
                        else
                            writeLineEx(dwWriteTab, 1 , "KeyPlayer->release   LEFT  (duration:%dms)",lDuration );
                    break;
            //############################################################################################################
            case cKey_DayNight: 
                    putValue( HMI_LgtSens_Night,lKeyMode );
                    if( bDebugOn ) 
                        if( lKeyMode )
                            writeLineEx(dwWriteTab, 1 , "KeyPlayer->press   Day/Night  (duration:%dms)",lDuration );
                        else
                            writeLineEx(dwWriteTab, 1 , "KeyPlayer->release   Day/Night  (duration:%dms)",lDuration );
                    break;
            case cKey_NightView: 
                    putValue( pDemo_NightView,lKeyMode );
                    if( bDebugOn ) 
                        if( lKeyMode )
                            writeLineEx(dwWriteTab, 1 , "KeyPlayer->press   NightView  (duration:%dms)",lDuration );
                        else
                            writeLineEx(dwWriteTab, 1 , "KeyPlayer->release   NightView  (duration:%dms)",lDuration );
                    break;
            case cKey_DistronicCar: 
                    if( getValue( pCheck_PlayDemoValues) )
                        {
                        putValue( pDemo_DistronicCar,lKeyMode );
                        if( bDebugOn ) 
                            writeLineEx(dwWriteTab, 1 , "KeyPlayer->changed   DistronicCar:%d  (duration:%dms)",lKeyMode,lDuration );
                        }
                    break;
            case cKey_DistronicRadar: 
                    if( getValue( pCheck_PlayDemoValues) )
                        {
                        putValue( pDemo_DistronicRadar,lKeyMode );
                        if( bDebugOn ) 
                            writeLineEx(dwWriteTab, 1 , "KeyPlayer->changed   DistronicRadar:%d  (duration:%dms)",lKeyMode,lDuration );
                        }
                    break;
            case cKey_Dimming: 
                    if( getValue( pCheck_PlayDemoValues) )
                        {
                        putValue( pDemo_Dimming,lKeyMode );
                        if( bDebugOn ) 
                            writeLineEx(dwWriteTab, 1 , "KeyPlayer->changed   Dimming:%d  (duration:%dms)",lKeyMode,lDuration );
                        }
                    break;
            case cKey_DistronicBegin: 
                    if( getValue( pCheck_PlayDemoValues) )
                        {
                        putValue( pDemo_DistronicBegin,lKeyMode );
                        if( bDebugOn ) 
                            writeLineEx(dwWriteTab, 1 , "KeyPlayer->changed   DistronicBegin:%d  (duration:%dms)",lKeyMode,lDuration );
                        }
                    break;
            case cKey_DistronicEnd: 
                    if( getValue( pCheck_PlayDemoValues) )
                        {
                        putValue( pDemo_DistronicEnd,lKeyMode );
                        if( bDebugOn ) 
                            writeLineEx(dwWriteTab, 1 , "KeyPlayer->changed   DistronicEnd:%d  (duration:%dms)",lKeyMode,lDuration );
                        }
                    break;
            case cKey_ParkLeft: 
                    if( getValue( pCheck_PlayDemoValues) )
                        {
                        putValue( pDemo_ParkLeft,lKeyMode );
                        if( bDebugOn ) 
                            writeLineEx(dwWriteTab, 1 , "KeyPlayer->changed   ParkLeft:%d  (duration:%dms)",lKeyMode,lDuration );
                        }
                    break;
            case cKey_ParkRight: 
                    if( getValue( pCheck_PlayDemoValues) )
                        {
                        putValue( pDemo_ParkRight,lKeyMode );
                        if( bDebugOn ) 
                            writeLineEx(dwWriteTab, 1 , "KeyPlayer->changed   ParkRight:%d  (duration:%dms)",lKeyMode,lDuration );
                        }
                    break;
            case cKey_HMI_HUD_Sw_Psd: 
                    if( getValue( pCheck_PlayDemoValues) )
                        {
                        putValue( HMI_HUD_Sw_Psd,lKeyMode );
                        if( bDebugOn ) 
                            writeLineEx(dwWriteTab, 1 , "KeyPlayer->changed   HMI_HUD_Sw_Psd:%d  (duration:%dms)",lKeyMode,lDuration );
                        }
                    break;
            case cKey_Style: 
                    if( getValue( pCheck_PlayDemoValues) )
                        {
                        putValue( pDemo_Style,lKeyMode );
                        if( bDebugOn ) 
                            writeLineEx(dwWriteTab, 1 , "KeyPlayer->changed   pDemo_Style:%d  (duration:%dms)",lKeyMode,lDuration );
                        }
                    break;
            //############################################################################################################
            case cKey_ExtKi_Init: 
                    putValue( pDemo_ADC_InitButton,lKeyMode );
                    if( bDebugOn ) 
                        if( lKeyMode )
                            writeLineEx(dwWriteTab, 1 , "KeyPlayer->press   ExtKi_Init  (duration:%dms)",lDuration );
                        else
                            writeLineEx(dwWriteTab, 1 , "KeyPlayer->release   ExtKi_Init  (duration:%dms)",lDuration );
                    break;
            case cKey_ExtKi_List: 
                    putValue( pDemo_ADC_ListAniButton,lKeyMode );
                    if( bDebugOn ) 
                        if( lKeyMode )
                            writeLineEx(dwWriteTab, 1 , "KeyPlayer->press   ExtKi_List  (duration:%dms)",lDuration );
                        else
                            writeLineEx(dwWriteTab, 1 , "KeyPlayer->release   ExtKi_List  (duration:%dms)",lDuration );
                    break;
            case cKey_ExtKi_Update: 
                    putValue( pDemo_ADC_UpdAniButton,lKeyMode );
                    if( bDebugOn ) 
                        if( lKeyMode )
                            writeLineEx(dwWriteTab, 1 , "KeyPlayer->press   ExtKi_Update  (duration:%dms)",lDuration );
                        else
                            writeLineEx(dwWriteTab, 1 , "KeyPlayer->release   ExtKi_Update  (duration:%dms)",lDuration );
                    break;
            case cKey_ExtKi_Kategory: 
                    putValue( pDemo_ADC_CatJumpButton,lKeyMode );
                    if( bDebugOn ) 
                        if( lKeyMode )
                            writeLineEx(dwWriteTab, 1 , "KeyPlayer->press   ExtKi_Kategory  (duration:%dms)",lDuration );
                        else
                            writeLineEx(dwWriteTab, 1 , "KeyPlayer->release   ExtKi_Kategory  (duration:%dms)",lDuration );
                    break;
            case cKey_Navi_01: 
                    putValue( pDemo_ADC_Navi_01,lKeyMode );
                    if( bDebugOn ) 
                        if( lKeyMode )
                            writeLineEx(dwWriteTab, 1 , "KeyPlayer->press     pDemo_ADC_Navi_01  (duration:%dms)",lDuration );
                        else
                            writeLineEx(dwWriteTab, 1 , "KeyPlayer->release   pDemo_ADC_Navi_01  (duration:%dms)",lDuration );
                    break;
            //############################################################################################################
            case cKey_KL15: 
                    putValue( Env_Ign_Switch,lKeyMode );
                    if( bDebugOn ) 
                        writeLineEx(dwWriteTab, 1 , "KeyPlayer->changed   Kl15:%d  (duration:%dms)",lKeyMode,lDuration );
                    break;
            //############################################################################################################
            case cKey_EngRun: 
                    putValue( HMI_EngRun_Stat,lKeyMode );
                    if( bDebugOn ) 
                        writeLineEx(dwWriteTab, 1 , "KeyPlayer->changed   EngineRun:%d  (duration:%dms)",lKeyMode,lDuration );
                    break;
            //############################################################################################################
            case cKey_HMI__STMSG_EL_TurnInd_Rq_AR: 
                    putValue( HMI__STMSG_EL_TurnInd_Rq_AR,lKeyMode );
                    if( bDebugOn ) 
                        writeLineEx(dwWriteTab, 1 , "KeyPlayer->changed   HMI__STMSG_EL_TurnInd_Rq_AR:%d  (duration:%dms)",lKeyMode,lDuration );
                    break;
            case cKey_Env_TurnInd_Lt_On: 
                    putValue( Env_TurnInd_Lt_On,lKeyMode );
                    if( bDebugOn ) 
                        writeLineEx(dwWriteTab, 1 , "KeyPlayer->changed   Env_TurnInd_Lt_On:%d  (duration:%dms)",lKeyMode,lDuration );
                    break;
            case cKey_Env_TurnInd_Rt_On: 
                    putValue( Env_TurnInd_Rt_On,lKeyMode );
                    if( bDebugOn ) 
                        writeLineEx(dwWriteTab, 1 , "KeyPlayer->changed   Env_TurnInd_Rt_On:%d  (duration:%dms)",lKeyMode,lDuration );
                    break;
            case cKey_Env_TurnLmpOnDur: 
                    putValue( Env_TurnLmpOnDur,lKeyMode );
                    if( bDebugOn ) 
                        writeLineEx(dwWriteTab, 1 , "KeyPlayer->changed   Env_TurnLmpOnDur:%d  (duration:%dms)",lKeyMode,lDuration );
                    break;
            case cKey_HMI_EF_Actv: 
                    putValue( HMI_EF_Actv,lKeyMode );
                    if( bDebugOn ) 
                        writeLineEx(dwWriteTab, 1 , "KeyPlayer->changed   HMI_EF_Actv:%d  (duration:%dms)",lKeyMode,lDuration );
                    break;
            case cKey_HMI__STMSG_EL_Stat_AR: 
                    putValue( HMI__STMSG_EL_Stat_AR,lKeyMode );
                    if( bDebugOn ) 
                        writeLineEx(dwWriteTab, 1 , "KeyPlayer->changed   HMI__STMSG_EL_Stat_AR:%d  (duration:%dms)",lKeyMode,lDuration );
                    break;
            case cKey_HMI_HiBm_IndLmp_On_Rq: 
                    putValue( HMI_HiBm_IndLmp_On_Rq,lKeyMode );
                    if( bDebugOn ) 
                        writeLineEx(dwWriteTab, 1 , "KeyPlayer->changed   HMI_HiBm_IndLmp_On_Rq:%d  (duration:%dms)",lKeyMode,lDuration );
                    break;
            case cKey_HMI_LoBm_IndLmp_On_Rq: 
                    putValue( HMI_LoBm_IndLmp_On_Rq,lKeyMode );
                    if( bDebugOn ) 
                        writeLineEx(dwWriteTab, 1 , "KeyPlayer->changed   HMI_LoBm_IndLmp_On_Rq:%d  (duration:%dms)",lKeyMode,lDuration );
                    break;
            case cKey_HMI_PosnLmp_IndLmp_On_Rq: 
                    putValue( HMI_PosnLmp_IndLmp_On_Rq,lKeyMode );
                    if( bDebugOn ) 
                        writeLineEx(dwWriteTab, 1 , "KeyPlayer->changed   HMI_PosnLmp_IndLmp_On_Rq:%d  (duration:%dms)",lKeyMode,lDuration );
                    break;
            case cKey_HMI_FogLmp_Ft_IndLmp_On_Rq: 
                    putValue( HMI_FogLmp_Ft_IndLmp_On_Rq,lKeyMode );
                    if( bDebugOn ) 
                        writeLineEx(dwWriteTab, 1 , "KeyPlayer->changed   HMI_FogLmp_Ft_IndLmp_On_Rq:%d  (duration:%dms)",lKeyMode,lDuration );
                    break;
            case cKey_HMI_FogLmp_R_IndLmp_On_Rq: 
                    putValue( HMI_FogLmp_R_IndLmp_On_Rq,lKeyMode );
                    if( bDebugOn ) 
                        writeLineEx(dwWriteTab, 1 , "KeyPlayer->changed   HMI_FogLmp_R_IndLmp_On_Rq:%d  (duration:%dms)",lKeyMode,lDuration );
                    break;
            case cKey_HMI__STMSG_EngCtrl_Disp_Rq_AR: 
                    putValue( HMI__STMSG_EngCtrl_Disp_Rq_AR,lKeyMode );
                    if( bDebugOn ) 
                        writeLineEx(dwWriteTab, 1 , "KeyPlayer->changed   HMI__STMSG_EngCtrl_Disp_Rq_AR:%d  (duration:%dms)",lKeyMode,lDuration );
                    break;
            case cKey_HMI_MIL_On_Rq: 
                    putValue( HMI_MIL_On_Rq,lKeyMode );
                    if( bDebugOn ) 
                        writeLineEx(dwWriteTab, 1 , "KeyPlayer->changed   HMI_MIL_On_Rq:%d  (duration:%dms)",lKeyMode,lDuration );
                    break;
            case cKey_HMI_PreHtIndLmp_On_Rq: 
                    putValue( HMI_PreHtIndLmp_On_Rq,lKeyMode );
                    if( bDebugOn ) 
                        writeLineEx(dwWriteTab, 1 , "KeyPlayer->changed   HMI_PreHtIndLmp_On_Rq:%d  (duration:%dms)",lKeyMode,lDuration );
                    break;
            case cKey_HMI__STMSG_ORC_Disp_Stat_AR: 
                    putValue( HMI__STMSG_ORC_Disp_Stat_AR,lKeyMode );
                    if( bDebugOn ) 
                        writeLineEx(dwWriteTab, 1 , "KeyPlayer->changed   HMI__STMSG_ORC_Disp_Stat_AR:%d  (duration:%dms)",lKeyMode,lDuration );
                    break;
            case cKey_HMI_SRS_IndLmp_Rq: 
                    putValue( HMI_SRS_IndLmp_Rq,lKeyMode );
                    if( bDebugOn ) 
                        writeLineEx(dwWriteTab, 1 , "KeyPlayer->changed   HMI_SRS_IndLmp_Rq:%d  (duration:%dms)",lKeyMode,lDuration );
                    break;
            case cKey_HMI_Bckl_Sw_D_Stat: 
                    putValue( HMI_Bckl_Sw_D_Stat,lKeyMode );
                    if( bDebugOn ) 
                        writeLineEx(dwWriteTab, 1 , "KeyPlayer->changed   HMI_Bckl_Sw_D_Stat:%d  (duration:%dms)",lKeyMode,lDuration );
                    break;
            case cKey_HMI__STMSG_ESP_Disp_Rq_AR: 
                    putValue( HMI__STMSG_ESP_Disp_Rq_AR,lKeyMode );
                    if( bDebugOn ) 
                        writeLineEx(dwWriteTab, 1 , "KeyPlayer->changed   HMI__STMSG_ESP_Disp_Rq_AR:%d  (duration:%dms)",lKeyMode,lDuration );
                    break;
            case cKey_HMI_ABS_IndLmp_On_Rq: 
                    putValue( HMI_ABS_IndLmp_On_Rq,lKeyMode );
                    if( bDebugOn ) 
                        writeLineEx(dwWriteTab, 1 , "KeyPlayer->changed   HMI_ABS_IndLmp_On_Rq:%d  (duration:%dms)",lKeyMode,lDuration );
                    break;
            case cKey_HMI_ESP_CtrlLmp_Info: 
                    putValue( HMI_ESP_CtrlLmp_Info,lKeyMode );
                    if( bDebugOn ) 
                        writeLineEx(dwWriteTab, 1 , "KeyPlayer->changed   HMI_ESP_CtrlLmp_Info:%d  (duration:%dms)",lKeyMode,lDuration );
                    break;
            case cKey_HMI_BrkIndLmp_On_Rq_ESP: 
                    putValue( HMI_BrkIndLmp_On_Rq_ESP,lKeyMode );
                    if( bDebugOn ) 
                        writeLineEx(dwWriteTab, 1 , "KeyPlayer->changed   HMI_BrkIndLmp_On_Rq_ESP:%d  (duration:%dms)",lKeyMode,lDuration );
                    break;
            case cKey_HMI_BrkIndLmp_On_Rq_EPkB: 
                    putValue( HMI_BrkIndLmp_On_Rq_EPkB,lKeyMode );
                    if( bDebugOn ) 
                        writeLineEx(dwWriteTab, 1 , "KeyPlayer->changed   HMI_BrkIndLmp_On_Rq_EPkB:%d  (duration:%dms)",lKeyMode,lDuration );
                    break;
            case cKey_HMI_RBS_IndLmp_On_Rq: 
                    putValue( HMI_RBS_IndLmp_On_Rq,lKeyMode );
                    if( bDebugOn ) 
                        writeLineEx(dwWriteTab, 1 , "KeyPlayer->changed   HMI_RBS_IndLmp_On_Rq:%d  (duration:%dms)",lKeyMode,lDuration );
                    break;
            case cKey_HMI_ESP_Off_IndLmp_On_Rq: 
                    putValue( HMI_ESP_Off_IndLmp_On_Rq,lKeyMode );
                    if( bDebugOn ) 
                        writeLineEx(dwWriteTab, 1 , "KeyPlayer->changed   HMI_ESP_Off_IndLmp_On_Rq:%d  (duration:%dms)",lKeyMode,lDuration );
                    break;
            case cKey_HMI_PkBrkIndLmp_On_Rq: 
                    putValue( HMI_PkBrkIndLmp_On_Rq,lKeyMode );
                    if( bDebugOn ) 
                        writeLineEx(dwWriteTab, 1 , "KeyPlayer->changed   HMI_PkBrkIndLmp_On_Rq:%d  (duration:%dms)",lKeyMode,lDuration );
                    break;
            case cKey_HMI_LDC_DTR_IndLmp_On_Rq: 
//                    putValue( HMI_LDC_DTR_IndLmp_On_Rq,lKeyMode );
                    if( bDebugOn ) 
                        writeLineEx(dwWriteTab, 1 , "KeyPlayer->changed   HMI_LDC_DTR_IndLmp_On_Rq:%d  (duration:%dms)",lKeyMode,lDuration );
                    break;
            case cKey_HMI_LDC_DTR_IndLmp_On_Rq_RDU: 
                    putValue( HMI_LDC_DTR_IndLmp_On_Rq_RDU,lKeyMode );
                    if( bDebugOn ) 
                        writeLineEx(dwWriteTab, 1 , "KeyPlayer->changed   HMI_LDC_DTR_IndLmp_On_Rq_RDU:%d  (duration:%dms)",lKeyMode,lDuration );
                    break;
            case cKey_HMI_TankLvl_Min: 
                    putValue( HMI_TankLvl_Min,lKeyMode );
                    if( bDebugOn ) 
                        writeLineEx(dwWriteTab, 1 , "KeyPlayer->changed   HMI_TankLvl_Min:%d  (duration:%dms)",lKeyMode,lDuration );
                    break;
            case cKey_HMI_TankCapIndLmp_On_Rq: 
                    putValue( HMI_TankCapIndLmp_On_Rq,lKeyMode );
                    if( bDebugOn ) 
                        writeLineEx(dwWriteTab, 1 , "KeyPlayer->changed   HMI_TankCapIndLmp_On_Rq:%d  (duration:%dms)",lKeyMode,lDuration );
                    break;
            //############################################################################################################
            case cKey_Env_BS_Raddrehzahlen: 
                    putValue( Env_BS_Raddrehzahlen,lKeyMode );
                    if( bDebugOn ) 
                        writeLineEx(dwWriteTab, 1 , "KeyPlayer->changed   Env_BS_Raddrehzahlen:%d  (duration:%dms)",lKeyMode,lDuration );
                    break;
            case cKey_Env_EngRPM: 
                    putValue( Env_EngRPM,lKeyMode );
                    if( bDebugOn ) 
                        writeLineEx(dwWriteTab, 1 , "KeyPlayer->changed   Env_EngRPM:%d  (duration:%dms)",lKeyMode,lDuration );
                    break;
            case cKey_Env_EngCoolTemp: 
                    putValue( Env_EngCoolTemp,lKeyMode );
                    if( bDebugOn ) 
                        writeLineEx(dwWriteTab, 1 , "KeyPlayer->changed   Env_EngCoolTemp:%d  (duration:%dms)",lKeyMode,lDuration );
                    break;
            case cKey_HMI_TankLvl: 
                    putValue( HMI_TankLvl,lKeyMode );
                    if( bDebugOn ) 
                        writeLineEx(dwWriteTab, 1 , "KeyPlayer->changed   HMI_TankLvl:%d  (duration:%dms)",lKeyMode,lDuration );
                    break;
        }
    }
}
/*@@end*/

/*@@envVar:pKey_All_Combination:*/
// function      : Event for combination key was received.
// author        : Daniel Warnicki 10.2010
on envVar pKey_All_Combination
{
    if( !getvalue( pKey_All_CombinationOn ) ) // combination switch not active
        vCombination(getvalue( pKey_All_Combination ) );
}
/*@@end*/

/*@@envVar:pKey_Filename:*/
on envVar pKey_Filename
{
    getvalue( pKey_Filename,sKeyRecordFileName );// get record filename
    if( strstr(sKeyRecordFileName,"key_data\\") < 0 ) 
    {
        // add path information
        snprintf(sKeyRecordFileName,elcount(sKeyRecordFileName ),"key_data\\%s",sKeyRecordFileName );// set record filename
    }
    vCheckRecordFile();
    vStopRecorderAndPlayer();
}
/*@@end*/

/*@@caplFunc:fGetTimeCompression():*///function
float fGetTimeCompression ()
// function      : the function calculates the timing including the compression configuration
//                out -> fload
// author        : Daniel Warnicki 12.05.2011
{
    long lTimeCompression;
    double fTimeCompression;

    lTimeCompression = getValue( pKey_TimeCompression );
    // calculate time compression
    if( lTimeCompression >= 100 ) lTimeCompression = 99;
    fTimeCompression = 100-lTimeCompression;
    fTimeCompression = fTimeCompression/100;
    return fTimeCompression;
}
/*@@end*/

/*@@envVar:pKey_TimeCompression:*/
on envVar pKey_TimeCompression
{
    if( getValue( pKey_RecordPlay) == 0 )
    {
        putValue( pKey_RecordPlayTime, getValue( pKey_RecordTime )*fGetTimeCompression() );
    }
}
/*@@end*/

/*@@envVar:pKey_All_CombinationOn:*/
// function      : Event for combination key was turned on or off
// author        : Daniel Warnicki 12.05.2011
on envVar pKey_All_CombinationOn
{
    vCombination(getvalue( pKey_All_CombinationOn ) );
}
/*@@end*/

/*@@caplFunc:vCombination(long):*///function
vCombination(long lMode )
{
    if( getValue( pKey_All_END) )   putvalue( HMI_StWhl_Sw_TelEnd_Psd,  lMode );
    if( getValue( pKey_All_SEND) )  putvalue( HMI_StWhl_Sw_TelSend_Psd, lMode );
    if( getValue( pKey_All_PLUS) )  putvalue( HMI_StWhl_Sw_Plus_Psd,    lMode );
    if( getValue( pKey_All_MINUS) ) putvalue( HMI_StWhl_Sw_Minus_Psd,   lMode );
    if( getValue( pKey_All_TALK) )  putvalue( HMI_StWhl_Sw_PTT_Psd,     lMode );
    if( getValue( pKey_All_MUTE) )  putvalue( HMI_StWhl_Sw_Mute_Psd,    lMode );
    if( getValue( pKey_All_Up) )    putvalue( Env_OFN_Up_1_Play,        lMode );
    if( getValue( pKey_All_DOWN) )  putvalue( Env_OFN_Down_1_Play,      lMode );
    if( getValue( pKey_All_LEFT) )  putvalue( Env_OFN_Left_1_Play,      lMode );
    if( getValue( pKey_All_RIGHT) ) putvalue( Env_OFN_Right_1_Play,     lMode );
    if( getValue( pKey_All_BACK) )  putvalue( HMI_StWhl_Sw_Back1_Psd,   lMode );
    if( getValue( pKey_All_OK) )    putvalue( HMI_StWhl_Sw_Ok1_Psd,     lMode );
}
/*@@end*/

/*@@envVar:pKey_All_END:*/
on envVar pKey_All_END
// function      : Event for combination key was turned on or off
// author        : Daniel Warnicki 12.05.2011
{
    if( getvalue( pKey_All_CombinationOn ) )
        putvalue( HMI_StWhl_Sw_TelEnd_Psd, getValue( pKey_All_END ) );
}
/*@@end*/

/*@@envVar:pKey_All_MINUS:*/
on envVar pKey_All_MINUS
// function      : Event for combination key was turned on or off
// author        : Daniel Warnicki 12.05.2011
{
    if( getvalue( pKey_All_CombinationOn ) )
        putvalue( HMI_StWhl_Sw_Minus_Psd, getValue( pKey_All_MINUS ) );
}
/*@@end*/

/*@@envVar:pKey_All_MUTE:*/
on envVar pKey_All_MUTE
// function      : Event for combination key was turned on or off
// author        : Daniel Warnicki 12.05.2011
{
    if( getvalue( pKey_All_CombinationOn ) )
        putvalue( HMI_StWhl_Sw_Mute_Psd, getValue( pKey_All_MUTE ) );
}
/*@@end*/

/*@@envVar:pKey_All_PLUS:*/
on envVar pKey_All_PLUS
// function      : Event for combination key was turned on or off
// author        : Daniel Warnicki 12.05.2011
{
    if( getvalue( pKey_All_CombinationOn ) )
        putvalue( HMI_StWhl_Sw_Plus_Psd, getValue( pKey_All_PLUS ) );
}
/*@@end*/

/*@@envVar:pKey_All_SEND:*/
on envVar pKey_All_SEND
// function      : Event for combination key was turned on or off
// author        : Daniel Warnicki 12.05.2011
{
    if( getvalue( pKey_All_CombinationOn ) )
        putvalue( HMI_StWhl_Sw_TelSend_Psd, getValue( pKey_All_SEND ) );
}
/*@@end*/

/*@@envVar:pKey_All_TALK:*/
on envVar pKey_All_TALK
// function      : Event for combination key was turned on or off
// author        : Daniel Warnicki 12.05.2011
{
    if( getvalue( pKey_All_CombinationOn ) )
        putvalue( HMI_StWhl_Sw_Ok2_Psd, getValue( pKey_All_TALK ) );
}
/*@@end*/

/*@@envVar:pKey_All_Up:*/
// function      : Event for combination key was turned on or off
// author        : Daniel Warnicki 12.05.2011
on envVar pKey_All_Up
{
    if( getvalue( pKey_All_CombinationOn ) )
        putvalue( Env_OFN_Up_1_Play, getValue( pKey_All_Up ) );
}
/*@@end*/

/*@@envVar:pKey_All_BACK:*/
// function      : Event for combination key was turned on or off
// author        : Daniel Warnicki 12.05.2011
on envVar pKey_All_BACK
{
    if( getvalue( pKey_All_CombinationOn ) )
        putvalue( HMI_StWhl_Sw_Back1_Psd, getValue( pKey_All_BACK ) );
}
/*@@end*/

/*@@envVar:pKey_All_DOWN:*/
on envVar pKey_All_DOWN
// function      : Event for combination key was turned on or off
// author        : Daniel Warnicki 12.05.2011
{
    if( getvalue( pKey_All_CombinationOn ) )
        putvalue( Env_OFN_Down_1_Play, getValue( pKey_All_DOWN ) );
}
/*@@end*/

/*@@envVar:pKey_All_LEFT:*/
on envVar pKey_All_LEFT
// function      : Event for combination key was turned on or off
// author        : Daniel Warnicki 12.05.2011
{
    if( getvalue( pKey_All_CombinationOn ) )
        putvalue( Env_OFN_Left_1_Play, getValue( pKey_All_LEFT ) );
}
/*@@end*/

/*@@envVar:pKey_All_RIGHT:*/
on envVar pKey_All_RIGHT
// function      : Event for combination key was turned on or off
// author        : Daniel Warnicki 12.05.2011
{
    if( getvalue( pKey_All_CombinationOn ) )
        putvalue( Env_OFN_Right_1_Play, getValue( pKey_All_RIGHT ) );
}
/*@@end*/

/*@@envVar:pKey_All_MENU:*/
on envVar pKey_All_MENU
// function      : Event for combination key was turned on or off
// author        : Daniel Warnicki 12.05.2011
{
    if( getvalue( pKey_All_CombinationOn ) )
        putvalue( HMI_StWhl_Sw_Ok1_Psd, getValue( pKey_All_MENU ) );
}
/*@@end*/

/*@@envVar:pKey_All_OK:*/
on envVar pKey_All_OK
// function      : Event for combination key was turned on or off
// author        : Daniel Warnicki 12.05.2011
{
    if( getvalue( pKey_All_CombinationOn ) )
        putvalue( HMI_StWhl_Sw_Ok1_Psd, getValue( pKey_All_OK ) );
}
/*@@end*/

/*@@envVar:HMI_LgtSens_Night:*/
on envVar HMI_LgtSens_Night // Key DayNight
// function      : Key Day/Night event received.
// author        : Daniel Warnicki 06.2011
{
    vRecordKeyEvent( cKey_DayNight, getvalue( HMI_LgtSens_Night ) );
}
/*@@end*/

/*@@envVar:pDemo_NightView:*/
on envVar pDemo_NightView // Key NightView
// function      : Key NightView event received.
// author        : Daniel Warnicki 06.2011
{
    vRecordKeyEvent( cKey_NightView, getvalue( pDemo_NightView ) );
}
/*@@end*/

/*@@envVar:pDemo_ADC_InitButton:*/
on envVar pDemo_ADC_InitButton
// function      : Key ExtKi Init button received.
// author        : Daniel Warnicki 28.07.2011
{
    vRecordKeyEvent( cKey_ExtKi_Init, getvalue( pDemo_ADC_InitButton ) );
}
/*@@end*/

/*@@envVar:pDemo_ADC_ListAniButton:*/
on envVar pDemo_ADC_ListAniButton
// function      : Key ExtKi List button received.
// author        : Daniel Warnicki 28.07.2011
{
    vRecordKeyEvent( cKey_ExtKi_List, getvalue( pDemo_ADC_ListAniButton ) );
}
/*@@end*/

/*@@envVar:pDemo_ADC_UpdAniButton:*/
on envVar pDemo_ADC_UpdAniButton
// function      : Key ExtKi Update button received.
// author        : Daniel Warnicki 28.07.2011
{
    vRecordKeyEvent( cKey_ExtKi_Update, getvalue( pDemo_ADC_UpdAniButton ) );
}
/*@@end*/

/*@@envVar:pDemo_ADC_CatJumpButton:*/
on envVar pDemo_ADC_CatJumpButton
// function      : Key ExtKi Kategory button received.
// author        : Daniel Warnicki 28.07.2011
{
    vRecordKeyEvent( cKey_ExtKi_Kategory, getvalue( pDemo_ADC_CatJumpButton ) );
}
/*@@end*/

/*@@envVar:pDemo_DistronicCar:*/
on envVar pDemo_DistronicCar
// function      : DistronicCar event received.
// author        : Daniel Warnicki 29.07.2011
{
    vRecordKeyEvent( cKey_DistronicCar, getvalue( pDemo_DistronicCar ) );
}
/*@@end*/

/*@@envVar:pDemo_DistronicRadar:*/
on envVar pDemo_DistronicRadar
// function      : DistronicRadar event received.
// author        : Daniel Warnicki 29.07.2011
{
    vRecordKeyEvent( cKey_DistronicRadar, getvalue( pDemo_DistronicRadar ) );
}
/*@@end*/

/*@@envVar:pDemo_ParkRight:*/
on envVar pDemo_ParkRight
// function      : ParkRight event received.
// author        : Daniel Warnicki 29.07.2011
{
    vRecordKeyEvent( cKey_ParkRight, getvalue( pDemo_ParkRight) );
}
/*@@end*/

/*@@envVar:pDemo_Dimming:*/
on envVar pDemo_Dimming
// function      : Dimming event received.
// author        : Daniel Warnicki 29.07.2011
{
    vRecordKeyEvent( cKey_Dimming, getvalue( pDemo_Dimming) );
}
/*@@end*/

/*@@envVar:pDemo_DistronicBegin:*/
on envVar pDemo_DistronicBegin
// function      : Dimming event received.
// author        : Daniel Warnicki 29.07.2011
{
    vRecordKeyEvent( cKey_DistronicBegin, getvalue( pDemo_DistronicBegin ) );
}
/*@@end*/

/*@@envVar:pDemo_DistronicEnd:*/
on envVar pDemo_DistronicEnd
// function      : Dimming event received.
// author        : Daniel Warnicki 29.07.2011
{
    vRecordKeyEvent( cKey_DistronicEnd, getvalue( pDemo_DistronicEnd) );
}
/*@@end*/

/*@@envVar:pDemo_ParkLeft:*/
on envVar pDemo_ParkLeft
// function      : ParkLeft event received.
// author        : Daniel Warnicki 29.07.2011
{
    vRecordKeyEvent( cKey_ParkLeft, getvalue( pDemo_ParkLeft) );
}
/*@@end*/

/*@@envVar:HMI_EngRun_Stat:*/
on envVar HMI_EngRun_Stat
// function      : Engine RUN event received.
// author        : Daniel Warnicki 03.08.2011
{
    vRecordKeyEvent( cKey_EngRun, getvalue( HMI_EngRun_Stat ) );
}
/*@@end*/

/*@@envVar:HMI__STMSG_EL_TurnInd_Rq_AR:*/
on envVar HMI__STMSG_EL_TurnInd_Rq_AR
// function      : Indicator event received.
// author        : Daniel Warnicki 04.08.2011
{
    vRecordKeyEvent( cKey_HMI__STMSG_EL_TurnInd_Rq_AR, getvalue( HMI__STMSG_EL_TurnInd_Rq_AR) );
}
/*@@end*/

/*@@envVar:HMI_EF_Actv:*/
on envVar HMI_EF_Actv
// function      : Indicator event received.
// author        : Daniel Warnicki 04.08.2011
{
    vRecordKeyEvent( cKey_HMI_EF_Actv, getvalue( HMI_EF_Actv) );
}
/*@@end*/

/*@@envVar:HMI__STMSG_EL_Stat_AR:*/
on envVar HMI__STMSG_EL_Stat_AR
// function      : Indicator event received.
// author        : Daniel Warnicki 04.08.2011
{
    vRecordKeyEvent( cKey_HMI__STMSG_EL_Stat_AR, getvalue( HMI__STMSG_EL_Stat_AR) );
}
/*@@end*/

/*@@envVar:HMI_HiBm_IndLmp_On_Rq:*/
on envVar HMI_HiBm_IndLmp_On_Rq
// function      : Indicator event received.
// author        : Daniel Warnicki 04.08.2011
{
    vRecordKeyEvent( cKey_HMI_HiBm_IndLmp_On_Rq, getvalue( HMI_HiBm_IndLmp_On_Rq) );
}
/*@@end*/

/*@@envVar:HMI_LoBm_IndLmp_On_Rq:*/
on envVar HMI_LoBm_IndLmp_On_Rq
// function      : Indicator event received.
// author        : Daniel Warnicki 04.08.2011
{
    vRecordKeyEvent( cKey_HMI_LoBm_IndLmp_On_Rq, getvalue( HMI_LoBm_IndLmp_On_Rq) );
}
/*@@end*/

/*@@envVar:HMI_PosnLmp_IndLmp_On_Rq:*/
on envVar HMI_PosnLmp_IndLmp_On_Rq
// function      : Indicator event received.
// author        : Daniel Warnicki 04.08.2011
{
    vRecordKeyEvent( cKey_HMI_PosnLmp_IndLmp_On_Rq, getvalue( HMI_PosnLmp_IndLmp_On_Rq) );
}
/*@@end*/

/*@@envVar:HMI_FogLmp_Ft_IndLmp_On_Rq:*/
on envVar HMI_FogLmp_Ft_IndLmp_On_Rq
// function      : Indicator event received.
// author        : Daniel Warnicki 04.08.2011
{
    vRecordKeyEvent( cKey_HMI_FogLmp_Ft_IndLmp_On_Rq, getvalue( HMI_FogLmp_Ft_IndLmp_On_Rq) );
}
/*@@end*/

/*@@envVar:HMI_FogLmp_R_IndLmp_On_Rq:*/
on envVar HMI_FogLmp_R_IndLmp_On_Rq
// function      : Indicator event received.
// author        : Daniel Warnicki 04.08.2011
{
    vRecordKeyEvent( cKey_HMI_FogLmp_R_IndLmp_On_Rq, getvalue( HMI_FogLmp_R_IndLmp_On_Rq) );
}
/*@@end*/

/*@@envVar:HMI__STMSG_EngCtrl_Disp_Rq_AR:*/
on envVar HMI__STMSG_EngCtrl_Disp_Rq_AR
// function      : Indicator event received.
// author        : Daniel Warnicki 04.08.2011
{
    vRecordKeyEvent( cKey_HMI__STMSG_EngCtrl_Disp_Rq_AR, getvalue( HMI__STMSG_EngCtrl_Disp_Rq_AR) );
}
/*@@end*/

/*@@envVar:HMI_MIL_On_Rq:*/
on envVar HMI_MIL_On_Rq
// function      : Indicator event received.
// author        : Daniel Warnicki 04.08.2011
{
    vRecordKeyEvent( cKey_HMI_MIL_On_Rq, getvalue( HMI_MIL_On_Rq) );
}
/*@@end*/

/*@@envVar:HMI_PreHtIndLmp_On_Rq:*/
on envVar HMI_PreHtIndLmp_On_Rq
// function      : Indicator event received.
// author        : Daniel Warnicki 04.08.2011
{
    vRecordKeyEvent( cKey_HMI_PreHtIndLmp_On_Rq, getvalue( HMI_PreHtIndLmp_On_Rq) );
}
/*@@end*/

/*@@envVar:HMI__STMSG_ORC_Disp_Stat_AR:*/
on envVar HMI__STMSG_ORC_Disp_Stat_AR
// function      : Indicator event received.
// author        : Daniel Warnicki 04.08.2011
{
    vRecordKeyEvent( cKey_HMI__STMSG_ORC_Disp_Stat_AR, getvalue( HMI__STMSG_ORC_Disp_Stat_AR) );
}
/*@@end*/

/*@@envVar:HMI_SRS_IndLmp_Rq:*/
on envVar HMI_SRS_IndLmp_Rq
// function      : Indicator event received.
// author        : Daniel Warnicki 04.08.2011
{
    vRecordKeyEvent( cKey_HMI_SRS_IndLmp_Rq, getvalue( HMI_SRS_IndLmp_Rq) );
}
/*@@end*/

/*@@envVar:HMI_Bckl_Sw_D_Stat:*/
on envVar HMI_Bckl_Sw_D_Stat
// function      : Indicator event received.
// author        : Daniel Warnicki 04.08.2011
{
    vRecordKeyEvent( cKey_HMI_Bckl_Sw_D_Stat, getvalue( HMI_Bckl_Sw_D_Stat) );
}
/*@@end*/

/*@@envVar:HMI__STMSG_ESP_Disp_Rq_AR:*/
on envVar HMI__STMSG_ESP_Disp_Rq_AR
// function      : Indicator event received.
// author        : Daniel Warnicki 04.08.2011
{
    vRecordKeyEvent( cKey_HMI__STMSG_ESP_Disp_Rq_AR, getvalue( HMI__STMSG_ESP_Disp_Rq_AR) );
}
/*@@end*/

/*@@envVar:HMI_ESP_CtrlLmp_Info:*/
on envVar HMI_ESP_CtrlLmp_Info
// function      : Indicator event received.
// author        : Daniel Warnicki 04.08.2011
{
    vRecordKeyEvent( cKey_HMI_ESP_CtrlLmp_Info, getvalue( HMI_ESP_CtrlLmp_Info) );
}
/*@@end*/

/*@@envVar:HMI_BrkIndLmp_On_Rq_ESP:*/
on envVar HMI_BrkIndLmp_On_Rq_ESP
// function      : Indicator event received.
// author        : Daniel Warnicki 04.08.2011
{
    vRecordKeyEvent( cKey_HMI_BrkIndLmp_On_Rq_ESP, getvalue( HMI_BrkIndLmp_On_Rq_ESP) );
}
/*@@end*/

/*@@envVar:HMI_BrkIndLmp_On_Rq_EPkB:*/
on envVar HMI_BrkIndLmp_On_Rq_EPkB
// function      : Indicator event received.
// author        : Daniel Warnicki 04.08.2011
{
    vRecordKeyEvent( cKey_HMI_BrkIndLmp_On_Rq_EPkB, getvalue( HMI_BrkIndLmp_On_Rq_EPkB) );
}
/*@@end*/

/*@@envVar:HMI_RBS_IndLmp_On_Rq:*/
on envVar HMI_RBS_IndLmp_On_Rq
// function      : Indicator event received.
// author        : Daniel Warnicki 04.08.2011
{
    vRecordKeyEvent( cKey_HMI_RBS_IndLmp_On_Rq, getvalue( HMI_RBS_IndLmp_On_Rq) );
}
/*@@end*/

/*@@envVar:HMI_ESP_Off_IndLmp_On_Rq:*/
on envVar HMI_ESP_Off_IndLmp_On_Rq
// function      : Indicator event received.
// author        : Daniel Warnicki 04.08.2011
{
    vRecordKeyEvent( cKey_HMI_ESP_Off_IndLmp_On_Rq, getvalue( HMI_ESP_Off_IndLmp_On_Rq) );
}
/*@@end*/

/*@@envVar:HMI_PkBrkIndLmp_On_Rq:*/
on envVar HMI_PkBrkIndLmp_On_Rq
// function      : Indicator event received.
// author        : Daniel Warnicki 04.08.2011
{
    vRecordKeyEvent( cKey_HMI_PkBrkIndLmp_On_Rq, getvalue( HMI_PkBrkIndLmp_On_Rq) );
}
/*@@end*/

/*@@envVar:HMI_LDC_DTR_IndLmp_On_Rq_RDU:*/
on envVar HMI_LDC_DTR_IndLmp_On_Rq_RDU
// function      : Indicator event received.
// author        : Daniel Warnicki 04.08.2011
{
    vRecordKeyEvent( cKey_HMI_LDC_DTR_IndLmp_On_Rq_RDU, getvalue( HMI_LDC_DTR_IndLmp_On_Rq_RDU) );
}
/*@@end*/

/*@@envVar:HMI_TankLvl_Min:*/
on envVar HMI_TankLvl_Min
// function      : Indicator event received.
// author        : Daniel Warnicki 04.08.2011
{
    vRecordKeyEvent( cKey_HMI_TankLvl_Min, getvalue( HMI_TankLvl_Min ) );
}
/*@@end*/

/*@@envVar:HMI_TankCapIndLmp_On_Rq:*/
on envVar HMI_TankCapIndLmp_On_Rq
// function      : Indicator event received.
// author        : Daniel Warnicki 04.08.2011
{
    vRecordKeyEvent( cKey_HMI_TankCapIndLmp_On_Rq, getvalue( HMI_TankCapIndLmp_On_Rq) );
}
/*@@end*/

/*@@envVar:HMI_TankLvl:*/
on envVar HMI_TankLvl
// function      : Tnk event received.
// author        : Daniel Warnicki 05.08.2011
{
    vRecordKeyEvent( cKey_HMI_TankLvl, getvalue( HMI_TankLvl ) );
}
/*@@end*/

/*@@envVar:HMI_HUD_Sw_Psd:*/
on envVar HMI_HUD_Sw_Psd
// function      : KEY HEadUp event received.
// author        : Daniel Warnicki 31.10.2010
{
    vRecordKeyEvent( cKey_HMI_HUD_Sw_Psd, getvalue( HMI_HUD_Sw_Psd ) );
}
/*@@end*/

/*@@caplFunc:boCheckKeyEnableToPlay(long):*///function
// function      : the function ckecks the play configuration for every key
// parameters    : in  -> lKey: key to check
//                out -> 0x00: key is disabled
//                       0x01: key is enabled
// author        : Daniel Warnicki 12.05.2011
byte boCheckKeyEnableToPlay(long lKey)
{
    byte boReturn;
 
    boReturn = 0;
    if( getValue( pCheck_PlayMflKeys ) > 0 )
    {
        switch(lKey)
        {
            case cKey_UP: 
            case cKey_RIGHT: 
            case cKey_OK: 
            case cKey_BACK: 
            case cKey_DOWN: 
            case cKey_PLUS: 
            case cKey_SEND: 
            case cKey_MUTE: 
            case cKey_END: 
            case cKey_MINUS: 
            case cKey_TALK: 
            case cKey_LEFT:
                    boReturn = 0x01;
                    break;
            default: 
                    break;
        }
    }
    if( getValue( pCheck_PlayDemoValues) > 0 )
    {
        switch(lKey)
        {
            case cKey_DayNight: 
            case cKey_NightView: 
            case cKey_DistronicCar: 
            case cKey_DistronicRadar: 
            case cKey_Dimming: 
            case cKey_DistronicBegin: 
            case cKey_DistronicEnd: 
            case cKey_ParkLeft: 
            case cKey_ParkRight: 
            case cKey_HMI_HUD_Sw_Psd: 
            case cKey_Style: 
                    boReturn = 0x01;
                    break;
            default: 
                    break;
        }
    }
    if( getValue( pCheck_PlayDemoExtKi) > 0 )
    {
        switch(lKey)
        {
            case cKey_ExtKi_Init: 
            case cKey_ExtKi_List: 
            case cKey_ExtKi_Update: 
            case cKey_ExtKi_Kategory:
            case cKey_Navi_01: 
                    boReturn = 0x01;
                    break;
            default: 
                    break;
         }
    }
    if( getValue( pCheck_PlayKl15) > 0 )
    {
        switch(lKey)
        {
            case cKey_KL15: 
                    boReturn = 0x01;
                    break;
            default: 
                    break;
        }
    }
    if( getValue( pCheck_PlayEngRun ) > 0 )
    {
        switch(lKey)
        {
            case cKey_EngRun: 
                    boReturn = 0x01;
                    break;
            default: 
                    break;
        }
    }
    if( getValue( pCheck_PlayIndicators) > 0 )
    {
        switch(lKey)
	{
            case cKey_HMI__STMSG_EL_TurnInd_Rq_AR: 
            case cKey_Env_TurnInd_Lt_On: 
            case cKey_Env_TurnInd_Rt_On: 
            case cKey_Env_TurnLmpOnDur: 
            case cKey_HMI_EF_Actv: 
            case cKey_HMI__STMSG_EL_Stat_AR: 
            case cKey_HMI_HiBm_IndLmp_On_Rq: 
            case cKey_HMI_LoBm_IndLmp_On_Rq: 
            case cKey_HMI_PosnLmp_IndLmp_On_Rq: 
            case cKey_HMI_FogLmp_Ft_IndLmp_On_Rq: 
            case cKey_HMI_FogLmp_R_IndLmp_On_Rq: 
            case cKey_HMI__STMSG_EngCtrl_Disp_Rq_AR: 
            case cKey_HMI_MIL_On_Rq: 
            case cKey_HMI_PreHtIndLmp_On_Rq: 
            case cKey_HMI__STMSG_ORC_Disp_Stat_AR: 
            case cKey_HMI_SRS_IndLmp_Rq: 
            case cKey_HMI_Bckl_Sw_D_Stat: 
            case cKey_HMI__STMSG_ESP_Disp_Rq_AR: 
            case cKey_HMI_ABS_IndLmp_On_Rq: 
            case cKey_HMI_ESP_CtrlLmp_Info: 
            case cKey_HMI_BrkIndLmp_On_Rq_ESP: 
            case cKey_HMI_BrkIndLmp_On_Rq_EPkB: 
            case cKey_HMI_RBS_IndLmp_On_Rq: 
            case cKey_HMI_ESP_Off_IndLmp_On_Rq: 
            case cKey_HMI_PkBrkIndLmp_On_Rq: 
            case cKey_HMI_LDC_DTR_IndLmp_On_Rq: 
            case cKey_HMI_LDC_DTR_IndLmp_On_Rq_RDU: 
            case cKey_HMI_TankLvl_Min: 
            case cKey_HMI_TankCapIndLmp_On_Rq: 
                    boReturn = 0x01;
                    break;
            default: 
                    break;
        }
    }
    if( getValue( pCheck_PlayRevVelTnkTmp) > 0 )
    {
        switch(lKey)
        {
            case cKey_Env_BS_Raddrehzahlen: 
            case cKey_Env_EngRPM: 
            case cKey_Env_EngCoolTemp: 
            case cKey_HMI_TankLvl: 
                    boReturn = 0x01;
                    break;
            default: 
                    break;
        }
    }
    return boReturn;
}
/*@@end*/

/*@@envVar:pDemo_ADC_Navi_01:*/
// function      : Key ExtKi NAVI button received.


// author        : Daniel Warnicki 28.07.2011
on envVar pDemo_ADC_Navi_01
{
    vRecordKeyEvent( cKey_Navi_01, getvalue( pDemo_ADC_Navi_01 ) );
}
/*@@end*/

/*@@envVar:pDemo_Style:*/
// Key NightView
// function      : Key pDemo_Style event received.
// author        : Daniel Warnicki 06.2011
on envVar pDemo_Style
{
    vRecordKeyEvent( cKey_Style, getvalue( pDemo_Style ) );
}
/*@@end*/

