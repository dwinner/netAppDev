/*@!Encoding:1252*/
includes
{
  //  #pragma library ("..\_DLL\BAP170\BAP170.dll")
}

variables
{    
    byte NaviSD_BAP_LaneGuidanceList_Short_case = 0;
    byte NaviSD_BAP_LaneGuidanceList_Long_case = 0;

    const NaviSD_LaneGuidanceList_MAX = 2;

    mstimer Volume_End_Update_Timer;

    mstimer VolumeChange;

    /* Variables used in timer */
    byte LaneGuidance_Long_index = 0, LaneGuidance_Long_rand = 0;
    byte LaneGuidance_Long_func[10];
    byte LaneGuidance_Short_index = 0, LaneGuidance_Short_rand = 0;
    byte LaneGuidance_Short_func[10];

    byte Navi_Long_index = 0, Navi_Long_rand = 0;
    byte Navi_Long_func[10];
    byte Navi_Short_index = 0, Navi_Short_rand = 0;
    byte Navi_Short_func[10];

    byte Ent_Vol_Change = 0;
    byte Nav_Vol_Change = 0;
    byte Phone_Vol_Change = 0;
    byte SDS_Vol_Change = 0;
    byte TA_Vol_Change = 0;

    byte x = 0;

}

on envVar ON_OFF_BAP_Main
{
    if (getValue(this) == 0)
    {
        putValue( ON_OFF_ASG15_2, 0 );    // BC_MFA
        putValue( ON_OFF_ASG17_1, 0 );    // Clock
        putValue( ON_OFF_ASG18_1, 0 );    // SIA
        putValue( ON_OFF_ASG19_4, 0 );    // Unitmaster
//		putValue( ON_OFF_ASG69_1, 0 );    // DisplayConfig
		putValue( env_DisplayConfig_v100_PowerOnOff, 0 );    

		putValue( ON_OFF_FSG4_0, 0 );     // HUD
   //     putValue( ON_OFF_FSG13_0, 0 );    // Doorlocking
        putValue( ON_OFF_FSG25_0, 0 );    // LDW_HCA
        putValue( ON_OFF_FSG26_0, 0 );    // SWA
        putValue( ON_OFF_FSG27_0, 0 );    // AVW
        putValue( ON_OFF_FSG29_0, 0 );    // Hybrid
        putValue( ON_OFF_FSG33_0, 0 );    // VZA
        putValue( ON_OFF_FSG35_0, 0 );    // BC_mE
		putValue( ON_OFF_FSG39_0, 0 );    // StartStopReasons
		putValue( ON_OFF_FSG42_0, 0 );    // OnlineFunctions
        putValue( ON_OFF_FSG52_0, 0 );    // MFL
        putValue( ON_OFF_FSG58_0, 0 );    // PedAssist
        putValue( ON_OFF_FSG60_0, 0 );    // EfficiencyAssist
		putValue( ON_OFF_FSG70_0, 0 );    // SDS
		putValue( env_SDS_v100_PowerOnOff, 0 );
        putValue( ON_OFF_FSG82_0, 0 );    // IAA_PSO

        // Navi
        putValue( ON_OFF_FSG50_0, 0 );
        if (getValue(ON_OFF_FSG50_0) == 0x01)
			putValue( ON_OFF_FSG50_0, 0 );

        if (getValue(env_NaviSD_PowerOnOff) == 0x01)
			putValue( env_NaviSD_PowerOnOff, 0 );
			
		
		
		//Audio
//		if (getValue(ON_OFF_FSG49_0) == 0x01)
//			putValue( ON_OFF_FSG49_0, 0 );
		if (getValue(env_AudioSD_PowerOnOff) == 0x01)
			putValue( env_AudioSD_PowerOnOff, 0 );
			
		
		//Telephone
//		if (getValue(ON_OFF_FSG40_0) == 0x01)
//			putValue( ON_OFF_FSG40_0, 0 );
		if (getValue(env_FSG_Schalter_OnOff) == 0x01)
			putValue( env_FSG_Schalter_OnOff, 0 );
    }
    else
    {
        putValue( ON_OFF_FSG50_0, 1);
        putValue( env_AudioSD_PowerOnOff, 1);
        putValue( env_FSG_Schalter_OnOff, 1);
        putValue( ON_OFF_FSG27_0, 1);
        putValue( ON_OFF_FSG25_0, 1);
        putValue( ON_OFF_FSG26_0, 1);
        putValue( ON_OFF_FSG35_0, 1);
        //IssueList #197
        //putValue( ON_OFF_FSG33, 1);
        putValue( ON_OFF_FSG33_0, 1);
        putValue( ON_OFF_ASG15_2, 1);
        putValue( ON_OFF_ASG17_1, 1);
        putValue( ON_OFF_ASG18_1, 1);
        putValue( ON_OFF_ASG19_4, 1);
//        putValue( ON_OFF_FSG7_0, 1);
        putValue( ON_OFF_FSG52_0, 1);
        //IssueList # 105
        putValue( ON_OFF_FSG29_0, 1);

            //IssueList #186
        putValue( ON_OFF_FSG58_0, 1);
  //      putValue( ON_OFF_FSG13_0, 1);

        //BAP efficiencyAssistant
        putValue( ON_OFF_FSG60_0, 1);
		
		//MR 60374
		putValue( ON_OFF_FSG39_0, 1);
		putValue( ON_OFF_FSG70_0, 1);
		putValue( env_SDS_v100_PowerOnOff, 0 );
		
		//MR 80392 (GIRA:VAGF-1773)
//		putValue( ON_OFF_ASG69_1, 0 );
		putValue( env_DisplayConfig_v100_PowerOnOff, 1);
		
		//BAP Updates
		//Navi V1.22
        putValue( env_NaviSD_PowerOnOff, 1);
//		putValue( ON_OFF_FSG49_0, 1); // Audio_v2.40
		
//		putValue( ON_OFF_FSG41_0, 1); //Telefon2	
		putValue( ON_OFF_FSG82_0, 1); //IAA_PSO
		putValue( ON_OFF_FSG42_0, 1); //Online functions
//		putValue( ON_OFF_FSG80_0, 1); //Info settings
		
//		putValue( ON_OFF_FSG40_0, 1); // Telephone_v2.30
    }
}

void Reset_Systeminfo_01 ()
{
    putValue(eSysteminfo_01_BusActive, 1);
    putValue(eSI_BUS_02S, 0 );
    putValue(eSI_BUS_03S, 0 );    
    putValue(eSI_BUS_05S, 0 );
    putValue(eSI_BUS_07S, 0 );
}

on start
{
    Reset_Systeminfo_01 ();
}

on envVar eSDSVol
{
    if (getValue(this))
    {
        putValue(env_AudioSD_FSGSetup_MaxVol, 20 );

        putValue(env_AudioSD_FSGSetup_SDS, 1);
        putValue(env_AudioSD_FSGSetup_update, 1);   
        
        putValue(env_AudioSD_currentVolume_Change, 0x0 );
        putValue(env_AudioSD_currentVolume_update, 1);
        setTimer(Volume_End_Update_Timer, 100 );      
    }
    else
    {
        putValue(env_AudioSD_FSGSetup_SDS, 0 );
        putValue(env_AudioSD_FSGSetup_update, 1);

        putValue(env_AudioSD_currentVolume_Change, 0x0 );
        putValue(env_AudioSD_currentVolume_update, 1);
        setTimer(Volume_End_Update_Timer, 100 );              
    }
}

on envVar ePhoneVol
{
    if (getValue(this))
    {
        putValue(env_AudioSD_FSGSetup_MaxVol, 20 );

        putValue(env_AudioSD_FSGSetup_Phone, 1);
        putValue(env_AudioSD_FSGSetup_update, 1);  
         
        putValue(env_AudioSD_currentVolume_Change, 0x0 );
        putValue(env_AudioSD_currentVolume_update, 1);
        setTimer(Volume_End_Update_Timer, 100 );         
    }
    else
    {
        putValue(env_AudioSD_FSGSetup_Phone, 0 );
        putValue(env_AudioSD_FSGSetup_update, 1);

        putValue(env_AudioSD_currentVolume_Change, 0x0 );
        putValue(env_AudioSD_currentVolume_update, 1);
        setTimer(Volume_End_Update_Timer, 100 );                 
    }
}

on envVar eTAVol
{
    if (getValue(this))
    {
        putValue(env_AudioSD_FSGSetup_MaxVol, 20 );

        putValue(env_AudioSD_FSGSetup_TA, 1);
        putValue(env_AudioSD_FSGSetup_update, 1);  
             
        putValue(env_AudioSD_currentVolume_Change, 0x0 );
        putValue(env_AudioSD_currentVolume_update, 1);
        setTimer(Volume_End_Update_Timer, 100 );     
    }
    else
    {
        putValue(env_AudioSD_FSGSetup_TA, 0 );
        putValue(env_AudioSD_FSGSetup_update, 1);

        putValue(env_AudioSD_currentVolume_Change, 0x0 );
        putValue(env_AudioSD_currentVolume_update, 1);
        setTimer(Volume_End_Update_Timer, 100 );             
    }
}

on envVar eNaviVol
{
    if (getValue(this))
    {
        putValue(env_AudioSD_FSGSetup_MaxVol, 20 );

        putValue(env_AudioSD_FSGSetup_Nav, 1);
        putValue(env_AudioSD_FSGSetup_update, 1);  
        
        putValue(env_AudioSD_currentVolume_Change, 0x0 );
        putValue(env_AudioSD_currentVolume_update, 1);
        setTimer(Volume_End_Update_Timer, 100 );          
    }
    else
    {
        putValue(env_AudioSD_FSGSetup_Nav, 0 );
        putValue(env_AudioSD_FSGSetup_update, 1);

        putValue(env_AudioSD_currentVolume_Change, 0x0 );
        putValue(env_AudioSD_currentVolume_update, 1);
        setTimer(Volume_End_Update_Timer, 100 );               
    }
}

on envVar eEntVol
{
    if (getValue(this))
    {
        putValue(env_AudioSD_FSGSetup_MaxVol, 20 );

        putValue(env_AudioSD_FSGSetup_entertainm, 1);
        putValue(env_AudioSD_FSGSetup_update, 1);   
        
        putValue(env_AudioSD_currentVolume_Change, 0x0 );
        putValue(env_AudioSD_currentVolume_update, 1);
        setTimer(Volume_End_Update_Timer, 100 );    
    }
    else
    {
        putValue(env_AudioSD_FSGSetup_entertainm, 0 );
        putValue(env_AudioSD_FSGSetup_update, 1);   
        
        putValue(env_AudioSD_currentVolume_Change, 0x0 );
        putValue(env_AudioSD_currentVolume_update, 1);        
        setTimer(Volume_End_Update_Timer, 100 );            
    }
}

on envVar eAllVol
{
    if (getValue(this))
    {
        putValue(eEntVol, 1);
        putValue(eNaviVol, 1);
        putValue(ePhoneVol, 1);
        putValue(eSDSVol, 1);
        putValue(eTAVol, 1);    
    }
    else
    {
        putValue(eEntVol, 0 );
        putValue(eNaviVol, 0 );
        putValue(ePhoneVol, 0 );
        putValue(eSDSVol, 0 );
        putValue(eTAVol, 0 );  
    }
}

on timer Volume_End_Update_Timer
{
    putValue(env_AudioSD_FSGSetup_update, 0 );  
    putValue(env_AudioSD_currentVolume_update, 0 );    
    cancelTimer (Volume_End_Update_Timer);    

    if (Ent_Vol_Change == 1)
    {
        putValue(env_AudioSD_FSGSetup_entertainm, 1);
        putValue(env_AudioSD_FSGSetup_update, 1);   

        putValue(env_AudioSD_currentVolume_Change, 0x1);
        putValue(env_AudioSD_currentVolume_update, 1);                              
        Ent_Vol_Change = 0;        
    }
    else if (Nav_Vol_Change == 1)
    {
        putValue(env_AudioSD_FSGSetup_Nav, 1);
        putValue(env_AudioSD_FSGSetup_update, 1); 

        putValue(env_AudioSD_currentVolume_Change, 0x2);        
        putValue(env_AudioSD_currentVolume_update, 1);
        Nav_Vol_Change = 0;        
    }
    else if (Phone_Vol_Change == 1)
    {
        putValue(env_AudioSD_FSGSetup_Phone, 1);
        putValue(env_AudioSD_FSGSetup_update, 1);  

        putValue(env_AudioSD_currentVolume_Change, 0x8);        
        putValue(env_AudioSD_currentVolume_update, 1);
        Phone_Vol_Change = 0;        
    }
    else if (SDS_Vol_Change == 1)
    {
        putValue(env_AudioSD_FSGSetup_SDS, 1);
        putValue(env_AudioSD_FSGSetup_update, 1);

        putValue(env_AudioSD_currentVolume_Change, 0x10 );
        putValue(env_AudioSD_currentVolume_update, 1);
        SDS_Vol_Change = 0;        
    }
    else if (TA_Vol_Change == 1)
    {
        putValue(env_AudioSD_FSGSetup_TA, 1);
        putValue(env_AudioSD_FSGSetup_update, 1);  

        putValue(env_AudioSD_currentVolume_Change, 0x4);
        putValue(env_AudioSD_currentVolume_update, 1);
        TA_Vol_Change = 0;        
    }
    setTimer(Volume_End_Update_Timer, 100 );
}

on envVar env_AudioSD_currentVolume_EntVol
{
    if (getValue(eEntVol))
    {              
        putValue(env_AudioSD_FSGSetup_entertainm, 0 );
        putValue(env_AudioSD_FSGSetup_update, 1);                      
        putValue(env_AudioSD_currentVolume_Change, 0 );
        putValue(env_AudioSD_currentVolume_update, 1);         
        Ent_Vol_Change = 1;
        setTimer(Volume_End_Update_Timer, 100 );        
    }    
    
}

on envVar env_AudioSD_currentVolume_NavVol
{
    if (getValue(eNaviVol))
    {         
        putValue(env_AudioSD_FSGSetup_Nav, 0 );
        putValue(env_AudioSD_FSGSetup_update, 1);            
        putValue(env_AudioSD_currentVolume_Change, 0 );        
        putValue(env_AudioSD_currentVolume_update, 1);
        Nav_Vol_Change = 1;
        setTimer(Volume_End_Update_Timer, 100 );        
    }    
}

on envVar env_AudioSD_currentVolume_TaVol
{
    if (getValue(eTAVol))
    {                                               
        putValue(env_AudioSD_FSGSetup_TA, 0 );
        putValue(env_AudioSD_FSGSetup_update, 1);               
        putValue(env_AudioSD_currentVolume_Change, 0 );
        putValue(env_AudioSD_currentVolume_update, 1);
        TA_Vol_Change = 1;
        setTimer(Volume_End_Update_Timer, 100 );
    }  
}

on envVar env_AudioSD_currentVolume_PhoVol
{
    if (getValue(ePhoneVol))
    {                         
        putValue(env_AudioSD_FSGSetup_Phone, 0 );
        putValue(env_AudioSD_FSGSetup_update, 1);      
        putValue(env_AudioSD_currentVolume_Change, 0 );        
        putValue(env_AudioSD_currentVolume_update, 1);
        Phone_Vol_Change = 1;
        setTimer(Volume_End_Update_Timer, 100 );
    }  
}

on envVar env_AudioSD_currentVolume_SdsVol
{
    if (getValue(eSDSVol))
    {              
        putValue(env_AudioSD_FSGSetup_SDS, 0 );
        putValue(env_AudioSD_FSGSetup_update, 1);                       
        putValue(env_AudioSD_currentVolume_Change, 0 );
        putValue(env_AudioSD_currentVolume_update, 1);
        SDS_Vol_Change = 1;
        setTimer(Volume_End_Update_Timer, 100 );
    }  
}

//Audio
on timer VolumeChange
{
    putValue(env_AudioSD_currentVolume_Change,0 );
    putValue(env_AudioSD_currentVolume_update,1);
}

on envVar ON_OFF_FSG50_0
{
	if (getValue(this))
	putValue(env_NaviSD_PowerOnOff,0 );
}

on envVar env_NaviSD_PowerOnOff
{
	if (getValue(this))
	putValue(ON_OFF_FSG50_0,0 );
}

//DisplayConfig
on envVar ON_OFF_ASG69_1
{
  if (getValue(this))
  {
    putValue(env_DisplayConfig_v100_PowerOnOff,0 );
    @sysvar::DisplayConfig_ASG::control_OnOff = 0;
  }
}

on envVar env_DisplayConfig_v100_PowerOnOff
{
  if (getValue(this))
  {
    putValue(ON_OFF_ASG69_1,0 );
    @sysvar::DisplayConfig_ASG::control_OnOff = 1;
  }
  else
  {
    @sysvar::DisplayConfig_ASG::control_OnOff = 0;
  }
}

//SDS
on envVar ON_OFF_FSG70_0
{
  if (getValue(this))
  {
    putValue(env_SDS_v100_PowerOnOff,0 );
    @sysvar::SDS_SD_FSG::control_OnOff = 0;
  }
}

on envVar env_SDS_v100_PowerOnOff
{
  if (getValue(this))
  {
    putValue(ON_OFF_FSG70_0,0 );
    @sysvar::SDS_SD_FSG::control_OnOff = 1;
  }
  else
  {
    @sysvar::SDS_SD_FSG::control_OnOff = 0;
  }
}

//Telephone
