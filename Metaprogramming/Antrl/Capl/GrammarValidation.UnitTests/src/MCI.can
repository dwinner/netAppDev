/*@!Encoding:1252*/
variables
{
  // BC MFA
  mstimer tP_ASG_15_1_0_15Get_BTN;
  mstimer tP_ASG_15_1_0_16SetGet_BTN;
  mstimer tM_ASG_15_1_0_17StartResult_BTN;
  mstimer tP_ASG_15_1_0_18SetGet_BTN;
  
  // SIA
  mstimer tP_ASG_18_1_0_15Get_BTN;
  mstimer tP_ASG_18_1_0_16Get_BTN;
  mstimer tP_ASG_18_1_0_17Get_BTN;
  mstimer tP_ASG_18_1_0_18Get_BTN;
  mstimer tP_ASG_18_1_0_19Get_BTN;
  mstimer tM_ASG_18_1_0_20StartResult_BTN;
  
  // Unit Master
  mstimer tP_ASG_19_1_0_15Get_BTN;
  mstimer tP_ASG_19_1_0_16SetGet_BTN;
  mstimer tP_ASG_19_1_0_17SetGet_BTN;
  mstimer tP_ASG_19_1_0_18SetGet_BTN;
  mstimer tP_ASG_19_1_0_19SetGet_BTN;
  mstimer tP_ASG_19_1_0_20SetGet_BTN;
  mstimer tP_ASG_19_1_0_21SetGet_BTN;
  mstimer tP_ASG_19_1_0_22SetGet_BTN;
  mstimer tP_ASG_19_1_0_23SetGet_BTN;
  mstimer tP_ASG_19_1_0_24SetGet_BTN;
  mstimer tP_ASG_19_1_0_25Get_BTN;
  mstimer tP_ASG_19_1_0_26Get_BTN;
  
  // VZA
  mstimer tP_FSG_33_0_0_15Status_BTN;
  mstimer tP_FSG_33_0_0_16Status_BTN;
  mstimer tP_FSG_33_0_0_17Status_BTN;
  mstimer tP_FSG_33_0_0_18Status_BTN;
  mstimer tP_FSG_33_0_0_19Status_BTN;
  
  // Telefon
  mstimer tP_FSG_40_0_0_14Status_BTN;
  mstimer tP_FSG_40_0_0_15Status_BTN;
  mstimer tP_FSG_40_0_0_16Status_BTN;
  mstimer tP_FSG_40_0_0_17Status_BTN;
  mstimer tP_FSG_40_0_0_18Status_BTN;
  mstimer tP_FSG_40_0_0_19Status_BTN;
  mstimer tP_FSG_40_0_0_20Status_BTN;
  mstimer tP_FSG_40_0_0_21Status_BTN;
  mstimer tP_FSG_40_0_0_22Status_BTN;
  mstimer tP_FSG_40_0_0_23Status_BTN;
  mstimer tP_FSG_40_0_0_24Status_BTN;
  mstimer tP_FSG_40_0_0_25Status_BTN;
  mstimer tP_FSG_40_0_0_33Status_BTN;
  mstimer tP_FSG_40_0_0_34Status_BTN;
  mstimer tP_FSG_40_0_0_42Status_BTN;
  mstimer tP_FSG_40_0_0_43Status_BTN;
  mstimer tP_FSG_40_0_0_44Status_BTN;
  mstimer tP_FSG_40_0_0_45Status_BTN;
  mstimer tP_FSG_40_0_0_51Status_BTN;
  mstimer tP_FSG_40_0_0_55Status_BTN;
  mstimer tP_FSG_40_0_0_56Status_BTN;
  mstimer tP_FSG_40_0_0_57Status_BTN;
  mstimer tP_FSG_40_0_0_58Status_BTN;
  mstimer tP_FSG_40_0_0_59Status_BTN;
  
  // Telefon2
  mstimer tP_FSG_41_0_0_15Status_BTN;
  mstimer tP_FSG_41_0_0_16Status_BTN;
  mstimer tP_FSG_41_0_0_17Status_BTN;
  mstimer tP_FSG_41_0_0_18Status_BTN;
  mstimer tP_FSG_41_0_0_19Status_BTN;
  mstimer tP_FSG_41_0_0_20Status_BTN;
  mstimer tP_FSG_41_0_0_21Status_BTN;
  mstimer tP_FSG_41_0_0_22Status_BTN;
  mstimer tP_FSG_41_0_0_23Status_BTN;
  mstimer tP_FSG_41_0_0_24Status_BTN;
  mstimer tP_FSG_41_0_0_25Status_BTN;
  mstimer tP_FSG_41_0_0_26Status_BTN;
  
  // Audio
  mstimer tP_FSG_49_0_0_14Status_BTN;
  mstimer tP_FSG_49_0_0_15Status_BTN;
  mstimer tP_FSG_49_0_0_16Status_BTN;
  mstimer tP_FSG_49_0_0_17Status_BTN;
  mstimer tP_FSG_49_0_0_18Status_BTN;
  mstimer tP_FSG_49_0_0_19Status_BTN;
  mstimer tP_FSG_49_0_0_20Status_BTN;
  mstimer tP_FSG_49_0_0_21Status_BTN;
  mstimer tP_FSG_49_0_0_22Status_BTN;
  mstimer tP_FSG_49_0_0_25Status_BTN;
  mstimer tP_FSG_49_0_0_26Status_BTN;
  mstimer tP_FSG_49_0_0_28Status_BTN;
  mstimer tP_FSG_49_0_0_30Status_BTN;
  mstimer tP_FSG_49_0_0_31Status_BTN;
  mstimer tP_FSG_49_0_0_35Status_BTN;
  mstimer tP_FSG_49_0_0_37Status_BTN;
  mstimer tP_FSG_49_0_0_40Status_BTN;
  mstimer tP_FSG_49_0_0_41Status_BTN;
  mstimer tP_FSG_49_0_0_42Status_BTN;
  mstimer tP_FSG_49_0_0_43Status_BTN;
  mstimer tP_FSG_49_0_0_46Status_BTN;
  mstimer tP_FSG_49_0_0_47Status_BTN;
  mstimer tP_FSG_49_0_0_48Status_BTN;
  mstimer tP_FSG_49_0_0_49Status_BTN;
  
  // Navigation
  mstimer tP_FSG_50_0_0_15Status_BTN;
  mstimer tP_FSG_50_0_0_16Status_BTN;
  mstimer tP_FSG_50_0_0_17Status_BTN;
  mstimer tP_FSG_50_0_0_18Status_BTN;
  mstimer tP_FSG_50_0_0_19Status_BTN;
  mstimer tP_FSG_50_0_0_20Status_BTN;
  mstimer tP_FSG_50_0_0_21Status_BTN;
  mstimer tP_FSG_50_0_0_22Status_BTN;
  mstimer tP_FSG_50_0_0_23Status_BTN;
  mstimer tP_FSG_50_0_0_25Status_BTN;
  mstimer tP_FSG_50_0_0_26Status_BTN;
  mstimer tP_FSG_50_0_0_27Status_BTN;
  mstimer tP_FSG_50_0_0_28Status_BTN;
  mstimer tP_FSG_50_0_0_31Status_BTN;
  mstimer tP_FSG_50_0_0_36Status_BTN;
  mstimer tP_FSG_50_0_0_37Status_BTN;
  mstimer tP_FSG_50_0_0_38Status_BTN;
  mstimer tP_FSG_50_0_0_39Status_BTN;
  mstimer tP_FSG_50_0_0_40Status_BTN;
  mstimer tP_FSG_50_0_0_43Status_BTN;
  mstimer tP_FSG_50_0_0_44Status_BTN;
  mstimer tP_FSG_50_0_0_45Status_BTN;
  mstimer tP_FSG_50_0_0_46Status_BTN;
  mstimer tP_FSG_50_0_0_47Status_BTN;
  mstimer tP_FSG_50_0_0_48Status_BTN;
  mstimer tP_FSG_50_0_0_49Status_BTN;
  mstimer tP_FSG_50_0_0_50Status_BTN;
  
  // MFL
  mstimer tP_FSG_52_0_0_15Status_BTN;
  mstimer tP_FSG_52_0_0_16Status_BTN;
  mstimer tP_FSG_52_0_0_17Status_BTN;
  mstimer tP_FSG_52_0_0_18Status_BTN;
  
  // OnlineFunctions
  mstimer tP_FSG_42_0_0_15Status_BTN;
  mstimer tP_FSG_42_0_0_16Status_BTN;
  mstimer tP_FSG_42_0_0_17Status_BTN;
  mstimer tP_FSG_42_0_0_18Status_BTN;
  mstimer tP_FSG_42_0_0_19Status_BTN;
  
  mstimer Busruhe;
  
  mstimer mciTA_SaveImage_Reset;
}







/////////////////////////// Klemmen & Netzwerkmangement \\\\\\\\\\\\\\\\\\\\\\\\\\\

on envVar mci_CAN_Clamp_S       { putvalue(EnvZAS_Kl_S, getvalue(this));        }
on envVar EnvZAS_Kl_S           { putvalue(mci_CAN_Clamp_S, getvalue(this));    }

on envVar mci_CAN_Clamp_15      { putvalue(EnvZAS_Kl_15, getvalue(this));       }
on envVar EnvZAS_Kl_15          { putvalue(mci_CAN_Clamp_15, getvalue(this));   }

on envVar mci_CAN_NMH_KCAN      { putvalue(Env_GlobalNMH, getvalue(this));      }
on envVar Env_GlobalNMH         { putvalue(mci_CAN_NMH_KCAN, getvalue(this));   }

on envVar mci_CAN_APPMSG        { putvalue(Env_GlobalAppl, getvalue(this));     }
on envVar Env_GlobalAppl        { putvalue(mci_CAN_APPMSG, getvalue(this));     }




//////////////// MFL ////////////////


on envVar mci_TasteSkipZur
{
    putvalue(EnvTasteSkipZur, getvalue(this)); 
}

on envVar mci_TasteSkipVor
{
    putvalue(EnvTasteSkipVor, getvalue(this)); 
}

on envVar mci_TasteZurueck
{
    putvalue(EnvTasteZurueck, getvalue(this)); 
}

on envVar mci_TasteView
{
    putvalue(EnvTasteView, getvalue(this)); 
}

on envVar mci_TasteMenuRechts
{
    putvalue(EnvTasteMenuRechts, getvalue(this)); 
}

on envVar mci_TasteMenuLinks
{
    putvalue(EnvTasteMenuLinks, getvalue(this)); 
}

on envVar mci_TasteRechts
{
    putvalue(EnvTasteRechts, getvalue(this)); 
}

on envVar mci_TasteLinks
{
    putvalue(EnvTasteLinks, getvalue(this)); 
}

on envVar mci_TasteINav
{
    putvalue(EnvTasteINav, getvalue(this)); 
}

on envVar mci_TasteWalzeHochRechts
{
    putvalue(EnvTasteWalzeHochRechts, getvalue(this)); 
}

on envVar mci_TasteWalzeRunterRechts
{
    putvalue(EnvTasteWalzeRunterRechts, getvalue(this)); 
}

on envVar mci_TasteWalzeRechts
{
    putvalue(EnvTasteWalzeRechts, getvalue(this)); 
}

on envVar mci_TasteSDS
{
    putvalue(EnvTasteSDS, getvalue(this)); 
}

on envVar mci_TasteWalzeRunterLinks
{
    putvalue(EnvTasteWalzeRunterLinks, getvalue(this)); 
}

on envVar mci_TasteWalzeHochLinks
{
    putvalue(EnvTasteWalzeHochLinks, getvalue(this)); 
}

on envVar mci_TasteWalzeLinks
{
    putvalue(EnvTasteWalzeLinks, getvalue(this)); 
}

on envVar mci_TasteMainMenu
{
    putvalue(EnvTasteMenu, getvalue(this)); 
}

on envVar mci_TasteContextMenu
{
    putvalue(EnvTasteContextMenu, getvalue(this)); 
}


//////////////// BCMFA ////////////////


on envVar mci_BCMFA_FSGOperationState_GetBTN
{
  if (@this == 1)
  {
    putvalue(P_ASG_15_1_0_15Get_BTN, 1);
    setTimer(tP_ASG_15_1_0_15Get_BTN, 100);
  }
}

on timer tP_ASG_15_1_0_15Get_BTN
{
  putvalue(P_ASG_15_1_0_15Get_BTN, 0);
  putvalue(mci_BCMFA_FSGOperationState_GetBTN, 0);
  cancelTimer(tP_ASG_15_1_0_15Get_BTN);
}

on envVar mci_BCMFA_FSGOperationState_OPState
{
  putvalue(P_ASG_15_1_0_15_1, getvalue(this));
}

on envVar mci_BCMFA_DisplayConfiguration_SetGetBTN
{
  if (@this == 1)
  {
    putvalue(P_ASG_15_1_0_16SetGet_BTN, 1);
    setTimer(tP_ASG_15_1_0_16SetGet_BTN, 100);
  }
}

on timer tP_ASG_15_1_0_16SetGet_BTN
{
  putvalue(P_ASG_15_1_0_16SetGet_BTN, 0);
  putvalue(mci_BCMFA_DisplayConfiguration_SetGetBTN, 0);
  cancelTimer(tP_ASG_15_1_0_16SetGet_BTN);
}

on envVar mci_BCMFA_DisplayConfiguration_ShortTermMenue
{
  putvalue(P_ASG_15_1_0_16_1, getvalue(this));
}

on envVar mci_BCMFA_DisplayConfiguration_LongTermMenue
{
  putvalue(P_ASG_15_1_0_16_2, getvalue(this));
}

on envVar mci_BCMFA_DisplayConfiguration_CycleMenue
{
  putvalue(P_ASG_15_1_0_16_3, getvalue(this));
}

on envVar mci_BCMFA_DisplayConfiguration_ExtendedMenue
{
  putvalue(P_ASG_15_1_0_16_4, getvalue(this));
}

on envVar mci_BCMFA_Reset_StartResultBTN
{
  if (@this == 1)
  {
    putvalue(M_ASG_15_1_0_17StartResult_BTN, 1);
    setTimer(tM_ASG_15_1_0_17StartResult_BTN, 100);
  }
}

on timer tM_ASG_15_1_0_17StartResult_BTN
{
  putvalue(M_ASG_15_1_0_17StartResult_BTN, 0);
  putvalue(mci_BCMFA_Reset_StartResultBTN, 0);
  cancelTimer(tM_ASG_15_1_0_17StartResult_BTN);
}

on envVar mci_BCMFA_Reset_Menue
{
  putvalue(M_ASG_15_1_0_17_Start_1, getvalue(this));
}

on envVar mci_BCMFA_SpeedWarning_SetGetBTN
{
  if (@this == 1)
  {
    putvalue(P_ASG_15_1_0_18SetGet_BTN, 1);
    setTimer(tP_ASG_15_1_0_18SetGet_BTN, 100);
  }
}

on timer tP_ASG_15_1_0_18SetGet_BTN
{
  putvalue(P_ASG_15_1_0_18SetGet_BTN, 0);
  putvalue(mci_BCMFA_SpeedWarning_SetGetBTN, 0);
  cancelTimer(tP_ASG_15_1_0_18SetGet_BTN);
}

on envVar mci_BCMFA_SpeedWarning_State
{
  putvalue(P_ASG_15_1_0_18_1, getvalue(this));
}

on envVar mci_BCMFA_SpeedWarning_SpeedValue
{
  putvalue(P_ASG_15_1_0_18_2, getvalue(this));
}

on envVar mci_BCMFA_SpeedWarning_SpeedUnit
{
  putvalue(P_ASG_15_1_0_18_3, getvalue(this));
}





//////////////// SIA ////////////////

on envVar mci_SIA_FSGOperationState_GetBTN
{
  if (@this == 1)
  {
    putvalue(P_ASG_18_1_0_15Get_BTN, 1);
    setTimer(tP_ASG_18_1_0_15Get_BTN, 100);
  }
}

on timer tP_ASG_18_1_0_15Get_BTN
{
  putvalue(P_ASG_18_1_0_15Get_BTN, 0);
  putvalue(mci_SIA_FSGOperationState_GetBTN, 0);
  cancelTimer(tP_ASG_18_1_0_15Get_BTN);
}

on envVar mci_SIA_FSGOperationState_OPState
{
  putvalue(P_ASG_18_1_0_15_1, getvalue(this));
}

on envVar mci_SIA_DistanceOil_GetBTN
{
  if (@this == 1)
  {
    putvalue(P_ASG_18_1_0_16Get_BTN, 1);
    setTimer(tP_ASG_18_1_0_16Get_BTN, 100);
  }
}

on timer tP_ASG_18_1_0_16Get_BTN
{
  putvalue(P_ASG_18_1_0_16Get_BTN, 0);
  putvalue(mci_SIA_DistanceOil_GetBTN, 0);
  cancelTimer(tP_ASG_18_1_0_16Get_BTN);
}

on envVar mci_SIA_DistanceOil_DistanceStatus
{
  putvalue(P_ASG_18_1_0_16_1, getvalue(this));
}

on envVar mci_SIA_DistanceOil_DistanceUnit
{
  putvalue(P_ASG_18_1_0_16_2, getvalue(this));
}

on envVar mci_SIA_DistanceOil_Distance
{
  putvalue(P_ASG_18_1_0_16_3, getvalue(this));
}

on envVar mci_SIA_TimeOil_GetBTN
{
  if (@this == 1)
  {
    putvalue(P_ASG_18_1_0_17Get_BTN, 1);
    setTimer(tP_ASG_18_1_0_17Get_BTN, 100);
  }
}

on timer tP_ASG_18_1_0_17Get_BTN
{
  putvalue(P_ASG_18_1_0_17Get_BTN, 0);
  putvalue(mci_SIA_TimeOil_GetBTN, 0);
  cancelTimer(tP_ASG_18_1_0_17Get_BTN);
}

on envVar mci_SIA_TimeOil_TimeStatus
{
  putvalue(P_ASG_18_1_0_17_1, getvalue(this));
}

on envVar mci_SIA_TimeOil_Time
{
  putvalue(P_ASG_18_1_0_17_2, getvalue(this));
}

on envVar mci_SIA_InspectionDistance_GetBTN
{
  if (@this == 1)
  {
    putvalue(P_ASG_18_1_0_18Get_BTN, 1);
    setTimer(tP_ASG_18_1_0_18Get_BTN, 100);
  }
}

on timer tP_ASG_18_1_0_18Get_BTN
{
  putvalue(P_ASG_18_1_0_18Get_BTN, 0);
  putvalue(mci_SIA_InspectionDistance_GetBTN, 0);
  cancelTimer(tP_ASG_18_1_0_18Get_BTN);
}

on envVar mci_SIA_InspectionDistance_DistanceStatus
{
  putvalue(P_ASG_18_1_0_18_1, getvalue(this));
}

on envVar mci_SIA_InspectionDistance_DistanceUnit
{
  putvalue(P_ASG_18_1_0_18_2, getvalue(this));
}

on envVar mci_SIA_InspectionDistance_Distance
{
  putvalue(P_ASG_18_1_0_18_3, getvalue(this));
}

on envVar mci_SIA_InspectionTime_GetBTN
{
  if (@this == 1)
  {
    putvalue(P_ASG_18_1_0_19Get_BTN, 1);
    setTimer(tP_ASG_18_1_0_19Get_BTN, 100);
  }
}

on timer tP_ASG_18_1_0_19Get_BTN
{
  putvalue(P_ASG_18_1_0_19Get_BTN, 0);
  putvalue(mci_SIA_InspectionTime_GetBTN, 0);
  cancelTimer(tP_ASG_18_1_0_19Get_BTN);
}

on envVar mci_SIA_InspectionTime_TimeStatus
{
  putvalue(P_ASG_18_1_0_19_1, getvalue(this));
}

on envVar mci_SIA_InspectionTime_Time
{
  putvalue(P_ASG_18_1_0_19_2, getvalue(this));
}

on envVar mci_SIA_Reset_StartResultBTN
{
  if (@this == 1)
  {
    putvalue(M_ASG_18_1_0_20StartResult_BTN, 1);
    setTimer(tM_ASG_18_1_0_20StartResult_BTN, 100);
  }
}

on timer tM_ASG_18_1_0_20StartResult_BTN
{
  putvalue(M_ASG_18_1_0_20StartResult_BTN, 0);
  putvalue(mci_SIA_Reset_StartResultBTN, 0);
  cancelTimer(tM_ASG_18_1_0_20StartResult_BTN);
}

on envVar mci_SIA_Reset_Menue
{
  putvalue(M_ASG_18_1_0_20_Start_1, getvalue(this));
}



//////////////// Unit Master ////////////////

on envVar mci_UnitMaster_Panel
{
  putvalue(ON_OFF_ASG19_1, 1);
}

on envVar mci_UnitMaster_FSGOperationState_GetBTN
{
  if (@this == 1)
  {
    putvalue(P_ASG_19_1_0_15Get_BTN, 1);
    setTimer(tP_ASG_19_1_0_15Get_BTN, 100);
  }
}

on timer tP_ASG_19_1_0_15Get_BTN
{
  putvalue(P_ASG_19_1_0_15Get_BTN, 0);
  putvalue(mci_UnitMaster_FSGOperationState_GetBTN, 0);
  cancelTimer(tP_ASG_19_1_0_15Get_BTN);
}

on envVar mci_UnitMaster_FSGOperationState_OPState
{
  putvalue(P_ASG_19_1_0_15_1, getvalue(this));
}

on envVar mci_UnitMaster_Language_SetGetBTN
{
  if (@this == 1)
  {
    putvalue(P_ASG_19_1_0_16SetGet_BTN, 1);
    setTimer(tP_ASG_19_1_0_16SetGet_BTN, 100);
  }
}

on timer tP_ASG_19_1_0_16SetGet_BTN
{
  putvalue(P_ASG_19_1_0_16SetGet_BTN, 0);
  putvalue(mci_UnitMaster_Language_SetGetBTN, 0);
  cancelTimer(tP_ASG_19_1_0_16SetGet_BTN);
}

on envVar mci_UnitMaster_Language_Language
{
  putvalue(P_ASG_19_1_0_16_1, getvalue(this));
}

on envVar mci_UnitMaster_TemperatureUnit_SetGetBTN
{
  if (@this == 1)
  {
    putvalue(P_ASG_19_1_0_17SetGet_BTN, 1);
    setTimer(tP_ASG_19_1_0_17SetGet_BTN, 100);
  }
}

on timer tP_ASG_19_1_0_17SetGet_BTN
{
  putvalue(P_ASG_19_1_0_17SetGet_BTN, 0);
  putvalue(mci_UnitMaster_TemperatureUnit_SetGetBTN, 0);
  cancelTimer(tP_ASG_19_1_0_17SetGet_BTN);
}

on envVar mci_UnitMaster_TemperatureUnit_Unit
{
  putvalue(P_ASG_19_1_0_17_1, getvalue(this));
}

on envVar mci_UnitMaster_DistanceSpeedUnit_SetGetBTN
{
  if (@this == 1)
  {
    putvalue(P_ASG_19_1_0_18SetGet_BTN, 1);
    setTimer(tP_ASG_19_1_0_18SetGet_BTN, 100);
  }
}

on timer tP_ASG_19_1_0_18SetGet_BTN
{
  putvalue(P_ASG_19_1_0_18SetGet_BTN, 0);
  putvalue(mci_UnitMaster_DistanceSpeedUnit_SetGetBTN, 0);
  cancelTimer(tP_ASG_19_1_0_18SetGet_BTN);
}

on envVar mci_UnitMaster_DistanceSpeedUnit_Distance
{
  putvalue(P_ASG_19_1_0_18_1, getvalue(this));
}

on envVar mci_UnitMaster_DistanceSpeedUnit_Speed
{
  putvalue(P_ASG_19_1_0_18_2, getvalue(this));
}

on envVar mci_UnitMaster_PressureUnit_SetGetBTN
{
  if (@this == 1)
  {
    putvalue(P_ASG_19_1_0_19SetGet_BTN, 1);
    setTimer(tP_ASG_19_1_0_19SetGet_BTN, 100);
  }
}

on timer tP_ASG_19_1_0_19SetGet_BTN
{
  putvalue(P_ASG_19_1_0_19SetGet_BTN, 0);
  putvalue(mci_UnitMaster_PressureUnit_SetGetBTN, 0);
  cancelTimer(tP_ASG_19_1_0_19SetGet_BTN);
}

on envVar mci_UnitMaster_PressureUnit_Unit
{
  putvalue(P_ASG_19_1_0_19_1, getvalue(this));
}

on envVar mci_UnitMaster_VolumeUnit_SetGetBTN
{
  if (@this == 1)
  {
    putvalue(P_ASG_19_1_0_20SetGet_BTN, 1);
    setTimer(tP_ASG_19_1_0_20SetGet_BTN, 100);
  }
}

on timer tP_ASG_19_1_0_20SetGet_BTN
{
  putvalue(P_ASG_19_1_0_20SetGet_BTN, 0);
  putvalue(mci_UnitMaster_VolumeUnit_SetGetBTN, 0);
  cancelTimer(tP_ASG_19_1_0_20SetGet_BTN);
}

on envVar mci_UnitMaster_VolumeUnit_Unit
{
  putvalue(P_ASG_19_1_0_20_1, getvalue(this));
}

on envVar mci_UnitMaster_ClockDate_SetGetBTN
{
  if (@this == 1)
  {
    putvalue(P_ASG_19_1_0_21SetGet_BTN, 1);
    setTimer(tP_ASG_19_1_0_21SetGet_BTN, 100);
  }
}

on timer tP_ASG_19_1_0_21SetGet_BTN
{
  putvalue(P_ASG_19_1_0_21SetGet_BTN, 0);
  putvalue(mci_UnitMaster_ClockDate_SetGetBTN, 0);
  cancelTimer(tP_ASG_19_1_0_21SetGet_BTN);
}

on envVar mci_UnitMaster_ClockDate_DateFormat
{
  putvalue(P_ASG_19_1_0_21_1, getvalue(this));
}

on envVar mci_UnitMaster_ClockDate_ClockFormat
{
  putvalue(P_ASG_19_1_0_21_2, getvalue(this));
}

on envVar mci_UnitMaster_ConsumptionUnitLiquid_SetGetBTN
{
  if (@this == 1)
  {
    putvalue(P_ASG_19_1_0_22SetGet_BTN, 1);
    setTimer(tP_ASG_19_1_0_22SetGet_BTN, 100);
  }
}

on timer tP_ASG_19_1_0_22SetGet_BTN
{
  putvalue(P_ASG_19_1_0_22SetGet_BTN, 0);
  putvalue(mci_UnitMaster_ConsumptionUnitLiquid_SetGetBTN, 0);
  cancelTimer(tP_ASG_19_1_0_22SetGet_BTN);
}

on envVar mci_UnitMaster_ConsumptionUnitLiquid_UnitLiquid
{
  putvalue(P_ASG_19_1_0_22_1, getvalue(this));
}

on envVar mci_UnitMaster_ConsumptionUnitGaseous_SetGetBTN
{
  if (@this == 1)
  {
    putvalue(P_ASG_19_1_0_23SetGet_BTN, 1);
    setTimer(tP_ASG_19_1_0_23SetGet_BTN, 100);
  }
}

on timer tP_ASG_19_1_0_23SetGet_BTN
{
  putvalue(P_ASG_19_1_0_23SetGet_BTN, 0);
  putvalue(mci_UnitMaster_ConsumptionUnitGaseous_SetGetBTN, 0);
  cancelTimer(tP_ASG_19_1_0_23SetGet_BTN);
}

on envVar mci_UnitMaster_ConsumptionUnitGaseous_UnitGaseous
{
  putvalue(P_ASG_19_1_0_23_1, getvalue(this));
}

on envVar mci_UnitMaster_ConsumptionUnitElectrical_SetGetBTN
{
  if (@this == 1)
  {
    putvalue(P_ASG_19_1_0_24SetGet_BTN, 1);
    setTimer(tP_ASG_19_1_0_24SetGet_BTN, 100);
  }
}

on timer tP_ASG_19_1_0_24SetGet_BTN
{
  putvalue(P_ASG_19_1_0_24SetGet_BTN, 0);
  putvalue(mci_UnitMaster_ConsumptionUnitElectrical_SetGetBTN, 0);
  cancelTimer(tP_ASG_19_1_0_24SetGet_BTN);
}

on envVar mci_UnitMaster_ConsumptionUnitElectrical_UnitElectrical
{
  putvalue(P_ASG_19_1_0_24_1, getvalue(this));
}

on envVar mci_UnitMaster_SkinConfig_GetBTN
{
  if (@this == 1)
  {
    putvalue(P_ASG_19_1_0_25Get_BTN, 1);
    setTimer(tP_ASG_19_1_0_25Get_BTN, 100);
  }
}

on timer tP_ASG_19_1_0_25Get_BTN
{
  putvalue(P_ASG_19_1_0_25Get_BTN, 0);
  putvalue(mci_UnitMaster_SkinConfig_GetBTN, 0);
  cancelTimer(tP_ASG_19_1_0_25Get_BTN);
}

on envVar mci_UnitMaster_SkinConfig_SupportedSkins
{
  putvalue(P_ASG_19_1_0_25_1, getvalue(this));
}

on envVar mci_UnitMaster_Skin_GetBTN
{
  if (@this == 1)
  {
    putvalue(P_ASG_19_1_0_26Get_BTN, 1);
    setTimer(tP_ASG_19_1_0_26Get_BTN, 100);
  }
}

on timer tP_ASG_19_1_0_26Get_BTN
{
  putvalue(P_ASG_19_1_0_26Get_BTN, 0);
  putvalue(mci_UnitMaster_Skin_GetBTN, 0);
  cancelTimer(tP_ASG_19_1_0_26Get_BTN);
}

on envVar mci_UnitMaster_Skin_ActiveSkin
{
  putvalue(P_ASG_19_1_0_26_1, getvalue(this));
}

on envVar mci_UnitMaster_Skin_ModificationReason
{
  putvalue(P_ASG_19_1_0_26_2, getvalue(this));
}

on envVar mci_UnitMaster_Skin_ModificationState
{
  putvalue(P_ASG_19_1_0_26_3, getvalue(this));
}





///////////// VZA /////////////

on envVar mci_VZA_Panel
{
  putvalue(ON_OFF_FSG33_0, getvalue(this));
}

on envVar mci_VZA_FSGOperationState_StatusBTN
{
  if (@this == 1)
  {
    putvalue(P_FSG_33_0_0_15Status_BTN, 1);
    setTimer(tP_FSG_33_0_0_15Status_BTN, 100);
  }
}

on timer tP_FSG_33_0_0_15Status_BTN
{
  putvalue(P_FSG_33_0_0_15Status_BTN, 0);
  putvalue(mci_VZA_FSGOperationState_StatusBTN, 0);
  cancelTimer(tP_FSG_33_0_0_15Status_BTN);
}

on envVar mci_VZA_FSGOperationState_OPState
{
    putvalue(P_FSG_33_0_0_15_1, getvalue(this));
}

on envVar mci_VZA_RoadSign_StatusBTN
{
  if (@this == 1)
  {
    putvalue(P_FSG_33_0_0_16Status_BTN, 1);
    setTimer(tP_FSG_33_0_0_16Status_BTN, 100);
  }
}

on timer tP_FSG_33_0_0_16Status_BTN
{
  putvalue(P_FSG_33_0_0_16Status_BTN, 0);
  putvalue(mci_VZA_RoadSign_StatusBTN, 0);
  cancelTimer(tP_FSG_33_0_0_16Status_BTN);
}

on envVar mci_VZA_RoadSign_Sign1
{
  putvalue(P_FSG_33_0_0_16_1, getvalue(this));
}

on envVar mci_VZA_RoadSign_Sign1_DynamicValue
{
  putvalue(P_FSG_33_0_0_16_2, getvalue(this));
}

on envVar mci_VZA_RoadSign_AdditionalSign1
{
  putvalue(P_FSG_33_0_0_16_3, getvalue(this));
}

on envVar mci_VZA_RoadSign_AdditionalSign1_DynamicValue
{
  int i=0;
  char ctmp[126];
  byte btmp[126];
  int len;
  len = getvaluesize(this)-1;
  getvalue(this, ctmp);
  for(i=0; i<126; i++) {
    if(i>=len)
      btmp[i] = 0;
    else
      btmp[i] = (byte)ctmp[i];
  }
  putvalue(P_FSG_33_0_0_16_4, btmp, len);
}

on envVar mci_VZA_RoadSign_Sign1_Info
{
  putvalue(P_FSG_33_0_0_16_5, getvalue(this));
}

on envVar mci_VZA_RoadSign_Sign2
{
  putvalue(P_FSG_33_0_0_16_6, getvalue(this));
}

on envVar mci_VZA_RoadSign_Sign2_DynamicValue
{
  putvalue(P_FSG_33_0_0_16_7, getvalue(this));
}

on envVar mci_VZA_RoadSign_AdditionalSign2
{
  putvalue(P_FSG_33_0_0_16_8, getvalue(this));
}

on envVar mci_VZA_RoadSign_AdditionalSign2_DynamicValue
{
  int i=0;
  char ctmp[126];
  byte btmp[126];
  int len;
  len = getvaluesize(this)-1;
  getvalue(this, ctmp);
  for(i=0; i<126; i++) {
    if(i>=len)
      btmp[i] = 0;
    else
      btmp[i] = (byte)ctmp[i];
  }
  putvalue(P_FSG_33_0_0_16_9, btmp, len);
}

on envVar mci_VZA_RoadSign_Sign2_Info
{
  putvalue(P_FSG_33_0_0_16_10, getvalue(this));
}

on envVar mci_VZA_RoadSign_Sign3
{
  putvalue(P_FSG_33_0_0_16_11, getvalue(this));
}

on envVar mci_VZA_RoadSign_Sign3_DynamicValue
{
  putvalue(P_FSG_33_0_0_16_12, getvalue(this));
}

on envVar mci_VZA_RoadSign_AdditionalSign3
{
  putvalue(P_FSG_33_0_0_16_13, getvalue(this));
}

on envVar mci_VZA_RoadSign_AdditionalSign3_DynamicValue
{
  int i=0;
  char ctmp[126];
  byte btmp[126];
  int len;
  len = getvaluesize(this)-1;
  getvalue(this, ctmp);
  for(i=0; i<126; i++) {
    if(i>=len)
      btmp[i] = 0;
    else
      btmp[i] = (byte)ctmp[i];
  }
  putvalue(P_FSG_33_0_0_16_14, btmp, len);
}

on envVar mci_VZA_RoadSign_Sign3_Info
{
  putvalue(P_FSG_33_0_0_16_15, getvalue(this));
}

on envVar mci_VZA_RoadSignFilter_StatusBTN
{
  if (@this == 1)
  {
    putvalue(P_FSG_33_0_0_17Status_BTN, 1);
    setTimer(tP_FSG_33_0_0_17Status_BTN, 100);
  }
}

on timer tP_FSG_33_0_0_17Status_BTN
{
  putvalue(P_FSG_33_0_0_17Status_BTN, 0);
  putvalue(mci_VZA_RoadSignFilter_StatusBTN, 0);
  cancelTimer(tP_FSG_33_0_0_17Status_BTN);
}

on envVar mci_VZA_RoadSignFilter_FilterMain
{
  putvalue(P_FSG_33_0_0_17_1, getvalue(this));
}

on envVar mci_VZA_RoadSignFilter_FilterAdditional
{
  putvalue(P_FSG_33_0_0_17_2, getvalue(this));
}

on envVar mci_VZA_TrailerMode_StatusBTN
{
  if (@this == 1)
  {
    putvalue(P_FSG_33_0_0_18Status_BTN, 1);
    setTimer(tP_FSG_33_0_0_18Status_BTN, 100);
  }
}

on timer tP_FSG_33_0_0_18Status_BTN
{
  putvalue(P_FSG_33_0_0_18Status_BTN, 0);
  putvalue(mci_VZA_TrailerMode_StatusBTN, 0);
  cancelTimer(tP_FSG_33_0_0_18Status_BTN);
}

on envVar mci_VZA_TrailerMode_TrailerConfiguration
{
  putvalue(P_FSG_33_0_0_18_1, getvalue(this));
}

on envVar mci_VZA_SystemMessages_StatusBTN
{
  if (@this == 1)
  {
    putvalue(P_FSG_33_0_0_19Status_BTN, 1);
    setTimer(tP_FSG_33_0_0_19Status_BTN, 100);
  }
}

on timer tP_FSG_33_0_0_19Status_BTN
{
  putvalue(P_FSG_33_0_0_19Status_BTN, 0);
  putvalue(mci_VZA_SystemMessages_StatusBTN, 0);
  cancelTimer(tP_FSG_33_0_0_19Status_BTN);
}

on envVar mci_VZA_SystemMessages_Message
{
  putvalue(P_FSG_33_0_0_19_1, getvalue(this));
}







//////////////// Telefon ////////////////

on envVar mci_Telephone1_Panel
{
    putvalue(ON_OFF_FSG40_0, getvalue(this)); 
}

on envVar mci_Telephone_FSGSetup_StatusBTN
{
  if (@this == 1)
  {
    putvalue(P_FSG_40_0_0_14Status_BTN, 1);
    setTimer(tP_FSG_40_0_0_14Status_BTN, 100);
  }
}

on timer tP_FSG_40_0_0_14Status_BTN
{
  putvalue(P_FSG_40_0_0_14Status_BTN, 0);
  putvalue(mci_Telephone_FSGSetup_StatusBTN, 0);
  cancelTimer(tP_FSG_40_0_0_14Status_BTN);
}

on envVar mci_Telephone_FSGSetup_PhoneCharacteristics
{
  putvalue(P_FSG_40_0_0_14_1, getvalue(this));
}

on envVar mci_Telephone_FSGSetup_MobileConnectionType
{
  putvalue(P_FSG_40_0_0_14_2, getvalue(this));
}

on envVar mci_Telephone_FSGOperationState_StatusBTN
{
  if (@this == 1)
  {
    putvalue(P_FSG_40_0_0_15Status_BTN, 1);
    setTimer(tP_FSG_40_0_0_15Status_BTN, 100);
  }
}

on timer tP_FSG_40_0_0_15Status_BTN
{
  putvalue(P_FSG_40_0_0_15Status_BTN, 0);
  putvalue(mci_Telephone_FSGOperationState_StatusBTN, 0);
  cancelTimer(tP_FSG_40_0_0_15Status_BTN);
}

on envVar mci_Telephone_FSGOperationState_OPState
{
  putvalue(P_FSG_40_0_0_15_1, getvalue(this));
}

on envVar mci_Telephone_FSGOperationState_TelState
{
  putvalue(P_FSG_40_0_0_15_2, getvalue(this));
}

on envVar mci_Telephone_FSGOperationState_PrivacyMode
{
  putvalue(P_FSG_40_0_0_15_3, getvalue(this));
}

on envVar mci_Telephone_MobileServiceSupport_StatusBTN
{
  if (@this == 1)
  {
    putvalue(P_FSG_40_0_0_16Status_BTN, 1);
    setTimer(tP_FSG_40_0_0_16Status_BTN, 100);
  }
}

on timer tP_FSG_40_0_0_16Status_BTN
{
  putvalue(P_FSG_40_0_0_16Status_BTN, 0);
  putvalue(mci_Telephone_MobileServiceSupport_StatusBTN, 0);
  cancelTimer(tP_FSG_40_0_0_16Status_BTN);
}

on envVar mci_Telephone_MobileServiceSupport_FctList
{
  int i=0;
  char ctmp[8];
  byte btmp[8];
  int len;
  len = getvaluesize(this)-1;
  getvalue(this, ctmp);
  for(i=0; i<8; i++) {
    if(i>=len)
      btmp[i] = 0;
    else
      btmp[i] = (byte)ctmp[i];
  }
  putvalue(P_FSG_40_0_0_16_1, btmp, len);
}

on envVar mci_Telephone_ActiveUser_StatusBTN
{
  if (@this == 1)
  {
    putvalue(P_FSG_40_0_0_17Status_BTN, 1);
    setTimer(tP_FSG_40_0_0_17Status_BTN, 100);
  }
}

on timer tP_FSG_40_0_0_17Status_BTN
{
  putvalue(P_FSG_40_0_0_17Status_BTN, 0);
  putvalue(mci_Telephone_ActiveUser_StatusBTN, 0);
  cancelTimer(tP_FSG_40_0_0_17Status_BTN);
}

on envVar mci_Telephone_ActiveUser_UserName
{
  int i=0;
  char ctmp[50];
  byte btmp[50];
  int len;
  len = getvaluesize(this)-1;
  getvalue(this, ctmp);
  for(i=0; i<50; i++) {
    if(i>=len)
      btmp[i] = 0;
    else
      btmp[i] = (byte)ctmp[i];
  }
  putvalue(P_FSG_40_0_0_17_1, btmp, len);
}

on envVar mci_Telephone_RegisterState_StatusBTN
{
  if (@this == 1)
  {
    putvalue(P_FSG_40_0_0_18Status_BTN, 1);
    setTimer(tP_FSG_40_0_0_18Status_BTN, 100);
  }
}

on timer tP_FSG_40_0_0_18Status_BTN
{
  putvalue(P_FSG_40_0_0_18Status_BTN, 0);
  putvalue(mci_Telephone_RegisterState_StatusBTN, 0);
  cancelTimer(tP_FSG_40_0_0_18Status_BTN);
}

on envVar mci_Telephone_RegisterState_RegisterState
{
  putvalue(P_FSG_40_0_0_18_1, getvalue(this));
}

on envVar mci_Telephone_RegisterState_NetworkType
{
  putvalue(P_FSG_40_0_0_18_2, getvalue(this));
}

on envVar mci_Telephone_RegisterState_PacketDataNetworkType
{
  putvalue(P_FSG_40_0_0_18_3, getvalue(this));
}

on envVar mci_Telephone_LockState_StatusBTN
{
  if (@this == 1)
  {
    putvalue(P_FSG_40_0_0_19Status_BTN, 1);
    setTimer(tP_FSG_40_0_0_19Status_BTN, 100);
  }
}

on timer tP_FSG_40_0_0_19Status_BTN
{
  putvalue(P_FSG_40_0_0_19Status_BTN, 0);
  putvalue(mci_Telephone_LockState_StatusBTN, 0);
  cancelTimer(tP_FSG_40_0_0_19Status_BTN);
}

on envVar mci_Telephone_LockState_LockState
{
  putvalue(P_FSG_40_0_0_19_1, getvalue(this));
}

on envVar mci_Telephone_NetworkProvider_StatusBTN
{
  if (@this == 1)
  {
    putvalue(P_FSG_40_0_0_20Status_BTN, 1);
    setTimer(tP_FSG_40_0_0_20Status_BTN, 100);
  }
}

on timer tP_FSG_40_0_0_20Status_BTN
{
  putvalue(P_FSG_40_0_0_20Status_BTN, 0);
  putvalue(mci_Telephone_NetworkProvider_StatusBTN, 0);
  cancelTimer(tP_FSG_40_0_0_20Status_BTN);
}

on envVar mci_Telephone_NetworkProvider_NetworkProviderState
{
  putvalue(P_FSG_40_0_0_20_1, getvalue(this));
}

on envVar mci_Telephone_NetworkProvider_NetworkProviderName
{
  int i=0;
  char ctmp[82];
  byte btmp[82];
  int len;
  len = getvaluesize(this)-1;
  getvalue(this, ctmp);
  for(i=0; i<82; i++) {
    if(i>=len)
      btmp[i] = 0;
    else
      btmp[i] = (byte)ctmp[i];
  }
  putvalue(P_FSG_40_0_0_20_2, btmp, len);
}

on envVar mci_Telephone_NetworkProvider_ServiceProviderState
{
  putvalue(P_FSG_40_0_0_20_3, getvalue(this));
}

on envVar mci_Telephone_NetworkProvider_ServiceProviderName
{
  int i=0;
  char ctmp[82];
  byte btmp[82];
  int len;
  len = getvaluesize(this)-1;
  getvalue(this, ctmp);
  for(i=0; i<82; i++) {
    if(i>=len)
      btmp[i] = 0;
    else
      btmp[i] = (byte)ctmp[i];
  }
  putvalue(P_FSG_40_0_0_20_4, btmp, len);
}

on envVar mci_Telephone_SignalQuality_StatusBTN
{
  if (@this == 1)
  {
    putvalue(P_FSG_40_0_0_21Status_BTN, 1);
    setTimer(tP_FSG_40_0_0_21Status_BTN, 100);
  }
}

on timer tP_FSG_40_0_0_21Status_BTN
{
  putvalue(P_FSG_40_0_0_21Status_BTN, 0);
  putvalue(mci_Telephone_SignalQuality_StatusBTN, 0);
  cancelTimer(tP_FSG_40_0_0_21Status_BTN);
}

on envVar mci_Telephone_SignalQuality_Quality
{
  putvalue(P_FSG_40_0_0_21_1, getvalue(this));
}

on envVar mci_Telephone_CallState_StatusBTN
{
  if (@this == 1)
  {
    putvalue(P_FSG_40_0_0_22Status_BTN, 1);
    setTimer(tP_FSG_40_0_0_22Status_BTN, 100);
  }
}

on timer tP_FSG_40_0_0_22Status_BTN
{
  putvalue(P_FSG_40_0_0_22Status_BTN, 0);
  putvalue(mci_Telephone_CallState_StatusBTN, 0);
  cancelTimer(tP_FSG_40_0_0_22Status_BTN);
}

on envVar mci_Telephone_CallState_CallState0
{
  putvalue(P_FSG_40_0_0_22_1, getvalue(this));
}

on envVar mci_Telephone_CallState_CallType0
{
  putvalue(P_FSG_40_0_0_22_2, getvalue(this));
}

on envVar mci_Telephone_CallState_CallOptions0
{
  putvalue(P_FSG_40_0_0_22_3, getvalue(this));
}

on envVar mci_Telephone_CallState_CallState1
{
  putvalue(P_FSG_40_0_0_22_4, getvalue(this));
}

on envVar mci_Telephone_CallState_CallType1
{
  putvalue(P_FSG_40_0_0_22_5, getvalue(this));
}

on envVar mci_Telephone_CallState_CallOptions1
{
  putvalue(P_FSG_40_0_0_22_6, getvalue(this));
}

on envVar mci_Telephone_CallState_CallState2
{
  putvalue(P_FSG_40_0_0_22_7, getvalue(this));
}

on envVar mci_Telephone_CallState_CallType2
{
  putvalue(P_FSG_40_0_0_22_8, getvalue(this));
}

on envVar mci_Telephone_CallState_CallOptions2
{
  putvalue(P_FSG_40_0_0_22_9, getvalue(this));
}

on envVar mci_Telephone_CallState_CallState3
{
  putvalue(P_FSG_40_0_0_22_10, getvalue(this));
}

on envVar mci_Telephone_CallState_CallType3
{
  putvalue(P_FSG_40_0_0_22_11, getvalue(this));
}

on envVar mci_Telephone_CallState_CallOptions3
{
  putvalue(P_FSG_40_0_0_22_12, getvalue(this));
}

on envVar mci_Telephone_CallState_CallState4
{
  putvalue(P_FSG_40_0_0_22_13, getvalue(this));
}

on envVar mci_Telephone_CallState_CallType4
{
  putvalue(P_FSG_40_0_0_22_14, getvalue(this));
}

on envVar mci_Telephone_CallState_CallOptions4
{
  putvalue(P_FSG_40_0_0_22_15, getvalue(this));
}

on envVar mci_Telephone_CallState_CallState5
{
  putvalue(P_FSG_40_0_0_22_16, getvalue(this));
}

on envVar mci_Telephone_CallState_CallType5
{
  putvalue(P_FSG_40_0_0_22_17, getvalue(this));
}

on envVar mci_Telephone_CallState_CallOptions5
{
  putvalue(P_FSG_40_0_0_22_18, getvalue(this));
}

on envVar mci_Telephone_CallState_CallState6
{
  putvalue(P_FSG_40_0_0_22_19, getvalue(this));
}

on envVar mci_Telephone_CallState_CallType6
{
  putvalue(P_FSG_40_0_0_22_20, getvalue(this));
}

on envVar mci_Telephone_CallState_CallOptions6
{
  putvalue(P_FSG_40_0_0_22_21, getvalue(this));
}

on envVar mci_Telephone_CallState_CallInComingDiverted
{
  putvalue(P_FSG_40_0_0_22_22, getvalue(this));
}

on envVar mci_Telephone_CallState_CallOutgoingDivertedeCallConfirmationPending
{
  putvalue(P_FSG_40_0_0_22_23, getvalue(this));
}

on envVar mci_Telephone_CallInfo_StatusBTN
{
  if (@this == 1)
  {
    putvalue(P_FSG_40_0_0_23Status_BTN, 1);
    setTimer(tP_FSG_40_0_0_23Status_BTN, 100);
  }
}

on timer tP_FSG_40_0_0_23Status_BTN
{
  putvalue(P_FSG_40_0_0_23Status_BTN, 0);
  putvalue(mci_Telephone_CallInfo_StatusBTN, 0);
  cancelTimer(tP_FSG_40_0_0_23Status_BTN);
}

on envVar mci_Telephone_CallInfo_PbName0
{
  int i=0;
  char ctmp[994];
  byte btmp[994];
  int len;
  len = getvaluesize(this)-1;
  getvalue(this, ctmp);
  for(i=0; i<994; i++) {
    if(i>=len)
      btmp[i] = 0;
    else
      btmp[i] = (byte)ctmp[i];
  }
  putvalue(P_FSG_40_0_0_23_1, btmp, len);
}

on envVar mci_Telephone_CallInfo_TelNumber0
{
  int i=0;
  char ctmp[994];
  byte btmp[994];
  int len;
  len = getvaluesize(this)-1;
  getvalue(this, ctmp);
  for(i=0; i<994; i++) {
    if(i>=len)
      btmp[i] = 0;
    else
      btmp[i] = (byte)ctmp[i];
  }
  putvalue(P_FSG_40_0_0_23_2, btmp, len);
}

on envVar mci_Telephone_CallInfo_Category0
{
  putvalue(P_FSG_40_0_0_23_3, getvalue(this));
}

on envVar mci_Telephone_CallInfo_PbName1
{
  int i=0;
  char ctmp[994];
  byte btmp[994];
  int len;
  len = getvaluesize(this)-1;
  getvalue(this, ctmp);
  for(i=0; i<994; i++) {
    if(i>=len)
      btmp[i] = 0;
    else
      btmp[i] = (byte)ctmp[i];
  }
  putvalue(P_FSG_40_0_0_23_4, btmp, len);
}

on envVar mci_Telephone_CallInfo_TelNumber1
{
  int i=0;
  char ctmp[994];
  byte btmp[994];
  int len;
  len = getvaluesize(this)-1;
  getvalue(this, ctmp);
  for(i=0; i<994; i++) {
    if(i>=len)
      btmp[i] = 0;
    else
      btmp[i] = (byte)ctmp[i];
  }
  putvalue(P_FSG_40_0_0_23_5, btmp, len);
}

on envVar mci_Telephone_CallInfo_Category1
{
  putvalue(P_FSG_40_0_0_23_6, getvalue(this));
}

on envVar mci_Telephone_CallInfo_PbName2
{
  int i=0;
  char ctmp[994];
  byte btmp[994];
  int len;
  len = getvaluesize(this)-1;
  getvalue(this, ctmp);
  for(i=0; i<994; i++) {
    if(i>=len)
      btmp[i] = 0;
    else
      btmp[i] = (byte)ctmp[i];
  }
  putvalue(P_FSG_40_0_0_23_7, btmp, len);
}

on envVar mci_Telephone_CallInfo_TelNumber2
{
  int i=0;
  char ctmp[994];
  byte btmp[994];
  int len;
  len = getvaluesize(this)-1;
  getvalue(this, ctmp);
  for(i=0; i<994; i++) {
    if(i>=len)
      btmp[i] = 0;
    else
      btmp[i] = (byte)ctmp[i];
  }
  putvalue(P_FSG_40_0_0_23_8, btmp, len);
}

on envVar mci_Telephone_CallInfo_Category2
{
  putvalue(P_FSG_40_0_0_23_9, getvalue(this));
}

on envVar mci_Telephone_CallInfo_PbName3
{
  int i=0;
  char ctmp[994];
  byte btmp[994];
  int len;
  len = getvaluesize(this)-1;
  getvalue(this, ctmp);
  for(i=0; i<994; i++) {
    if(i>=len)
      btmp[i] = 0;
    else
      btmp[i] = (byte)ctmp[i];
  }
  putvalue(P_FSG_40_0_0_23_10, btmp, len);
}

on envVar mci_Telephone_CallInfo_TelNumber3
{
  int i=0;
  char ctmp[994];
  byte btmp[994];
  int len;
  len = getvaluesize(this)-1;
  getvalue(this, ctmp);
  for(i=0; i<994; i++) {
    if(i>=len)
      btmp[i] = 0;
    else
      btmp[i] = (byte)ctmp[i];
  }
  putvalue(P_FSG_40_0_0_23_11, btmp, len);
}

on envVar mci_Telephone_CallInfo_Category3
{
  putvalue(P_FSG_40_0_0_23_12, getvalue(this));
}

on envVar mci_Telephone_CallInfo_PbName4
{
  int i=0;
  char ctmp[994];
  byte btmp[994];
  int len;
  len = getvaluesize(this)-1;
  getvalue(this, ctmp);
  for(i=0; i<994; i++) {
    if(i>=len)
      btmp[i] = 0;
    else
      btmp[i] = (byte)ctmp[i];
  }
  putvalue(P_FSG_40_0_0_23_13, btmp, len);
}

on envVar mci_Telephone_CallInfo_TelNumber4
{
  int i=0;
  char ctmp[994];
  byte btmp[994];
  int len;
  len = getvaluesize(this)-1;
  getvalue(this, ctmp);
  for(i=0; i<994; i++) {
    if(i>=len)
      btmp[i] = 0;
    else
      btmp[i] = (byte)ctmp[i];
  }
  putvalue(P_FSG_40_0_0_23_14, btmp, len);
}

on envVar mci_Telephone_CallInfo_Category4
{
  putvalue(P_FSG_40_0_0_23_15, getvalue(this));
}

on envVar mci_Telephone_CallInfo_PbName5
{
  int i=0;
  char ctmp[994];
  byte btmp[994];
  int len;
  len = getvaluesize(this)-1;
  getvalue(this, ctmp);
  for(i=0; i<994; i++) {
    if(i>=len)
      btmp[i] = 0;
    else
      btmp[i] = (byte)ctmp[i];
  }
  putvalue(P_FSG_40_0_0_23_16, btmp, len);
}

on envVar mci_Telephone_CallInfo_TelNumber5
{
  int i=0;
  char ctmp[994];
  byte btmp[994];
  int len;
  len = getvaluesize(this)-1;
  getvalue(this, ctmp);
  for(i=0; i<994; i++) {
    if(i>=len)
      btmp[i] = 0;
    else
      btmp[i] = (byte)ctmp[i];
  }
  putvalue(P_FSG_40_0_0_23_17, btmp, len);
}

on envVar mci_Telephone_CallInfo_Category5
{
  putvalue(P_FSG_40_0_0_23_18, getvalue(this));
}

on envVar mci_Telephone_CallInfo_PbName6
{
  int i=0;
  char ctmp[994];
  byte btmp[994];
  int len;
  len = getvaluesize(this)-1;
  getvalue(this, ctmp);
  for(i=0; i<994; i++) {
    if(i>=len)
      btmp[i] = 0;
    else
      btmp[i] = (byte)ctmp[i];
  }
  putvalue(P_FSG_40_0_0_23_19, btmp, len);
}

on envVar mci_Telephone_CallInfo_TelNumber6
{
  int i=0;
  char ctmp[994];
  byte btmp[994];
  int len;
  len = getvaluesize(this)-1;
  getvalue(this, ctmp);
  for(i=0; i<994; i++) {
    if(i>=len)
      btmp[i] = 0;
    else
      btmp[i] = (byte)ctmp[i];
  }
  putvalue(P_FSG_40_0_0_23_20, btmp, len);
}

on envVar mci_Telephone_CallInfo_Category6
{
  putvalue(P_FSG_40_0_0_23_21, getvalue(this));
}

on envVar mci_Telephone_CallDurationSync_StatusBTN
{
  if (@this == 1)
  {
    putvalue(P_FSG_40_0_0_24Status_BTN, 1);
    setTimer(tP_FSG_40_0_0_24Status_BTN, 100);
  }
}

on timer tP_FSG_40_0_0_24Status_BTN
{
  putvalue(P_FSG_40_0_0_24Status_BTN, 0);
  putvalue(mci_Telephone_CallDurationSync_StatusBTN, 0);
  cancelTimer(tP_FSG_40_0_0_24Status_BTN);
}

on envVar mci_Telephone_CallDurationSync_TimeStampCall0
{
  putvalue(P_FSG_40_0_0_24_1, getvalue(this));
}

on envVar mci_Telephone_CallDurationSync_TimeStampCall1
{
  putvalue(P_FSG_40_0_0_24_2, getvalue(this));
}

on envVar mci_Telephone_CallDurationSync_TimeStampCall2
{
  putvalue(P_FSG_40_0_0_24_3, getvalue(this));
}

on envVar mci_Telephone_CallDurationSync_TimeStampCall3
{
  putvalue(P_FSG_40_0_0_24_4, getvalue(this));
}

on envVar mci_Telephone_CallDurationSync_TimeStampCall4
{
  putvalue(P_FSG_40_0_0_24_5, getvalue(this));
}

on envVar mci_Telephone_CallDurationSync_TimeStampCall5
{
  putvalue(P_FSG_40_0_0_24_6, getvalue(this));
}

on envVar mci_Telephone_CallDurationSync_TimeStampCall6
{
  putvalue(P_FSG_40_0_0_24_7, getvalue(this));
}

on envVar mci_Telephone_DisconnectReason_StatusBTN
{
  if (@this == 1)
  {
    putvalue(P_FSG_40_0_0_25Status_BTN, 1);
    setTimer(tP_FSG_40_0_0_25Status_BTN, 100);
  }
}

on timer tP_FSG_40_0_0_25Status_BTN
{
  putvalue(P_FSG_40_0_0_25Status_BTN, 0);
  putvalue(mci_Telephone_DisconnectReason_StatusBTN, 0);
  cancelTimer(tP_FSG_40_0_0_25Status_BTN);
}

on envVar mci_Telephone_DisconnectReason_DisconnectReason
{
  putvalue(P_FSG_40_0_0_25_1, getvalue(this));
}

on envVar mci_Telephone_HandsFreeOnOff_StatusBTN
{
  if (@this == 1)
  {
    putvalue(P_FSG_40_0_0_33Status_BTN, 1);
    setTimer(tP_FSG_40_0_0_33Status_BTN, 100);
  }
}

on timer tP_FSG_40_0_0_33Status_BTN
{
  putvalue(P_FSG_40_0_0_33Status_BTN, 0);
  putvalue(mci_Telephone_HandsFreeOnOff_StatusBTN, 0);
  cancelTimer(tP_FSG_40_0_0_33Status_BTN);
}

on envVar mci_Telephone_HandsFreeOnOff_HandsFreeOnOff
{
  putvalue(P_FSG_40_0_0_33_1, getvalue(this));
}

on envVar mci_Telephone_MicroMuteOnOff_StatusBTN
{
  if (@this == 1)
  {
    putvalue(P_FSG_40_0_0_34Status_BTN, 1);
    setTimer(tP_FSG_40_0_0_34Status_BTN, 100);
  }
}

on timer tP_FSG_40_0_0_34Status_BTN
{
  putvalue(P_FSG_40_0_0_34Status_BTN, 0);
  putvalue(mci_Telephone_MicroMuteOnOff_StatusBTN, 0);
  cancelTimer(tP_FSG_40_0_0_34Status_BTN);
}

on envVar mci_Telephone_MicroMuteOnOff_MicroMuteOnOff
{
  putvalue(P_FSG_40_0_0_34_1, getvalue(this));
}

on envVar mci_Telephone_Keypad_StatusBTN
{
  if (@this == 1)
  {
    putvalue(P_FSG_40_0_0_42Status_BTN, 1);
    setTimer(tP_FSG_40_0_0_42Status_BTN, 100);
  }
}

on timer tP_FSG_40_0_0_42Status_BTN
{
  putvalue(P_FSG_40_0_0_42Status_BTN, 0);
  putvalue(mci_Telephone_Keypad_StatusBTN, 0);
  cancelTimer(tP_FSG_40_0_0_42Status_BTN);
}

on envVar mci_Telephone_Keypad_KeyStatus
{
  putvalue(P_FSG_40_0_0_42_1, getvalue(this));
}

on envVar mci_Telephone_MobileBatteryLevel_StatusBTN
{
  if (@this == 1)
  {
    putvalue(P_FSG_40_0_0_43Status_BTN, 1);
    setTimer(tP_FSG_40_0_0_43Status_BTN, 100);
  }
}

on timer tP_FSG_40_0_0_43Status_BTN
{
  putvalue(P_FSG_40_0_0_43Status_BTN, 0);
  putvalue(mci_Telephone_MobileBatteryLevel_StatusBTN, 0);
  cancelTimer(tP_FSG_40_0_0_43Status_BTN);
}

on envVar mci_Telephone_MobileBatteryLevel_ChargeLevelMobile1
{
  putvalue(P_FSG_40_0_0_43_1, getvalue(this));
}

on envVar mci_Telephone_MobileBatteryLevel_ChargeLevelMobile2
{
  putvalue(P_FSG_40_0_0_43_2, getvalue(this));
}

on envVar mci_Telephone_MobileBatteryLevel_ChargeLevelHandset1
{
  putvalue(P_FSG_40_0_0_43_3, getvalue(this));
}

on envVar mci_Telephone_MobileBatteryLevel_ChargeLevelHandset2
{
  putvalue(P_FSG_40_0_0_43_4, getvalue(this));
}

on envVar mci_Telephone_MobileBatteryLevel_WarningLevel
{
  putvalue(P_FSG_40_0_0_43_5, getvalue(this));
}

on envVar mci_Telephone_DataConnectionIndication_StatusBTN
{
  if (@this == 1)
  {
    putvalue(P_FSG_40_0_0_44Status_BTN, 1);
    setTimer(tP_FSG_40_0_0_44Status_BTN, 100);
  }
}

on timer tP_FSG_40_0_0_44Status_BTN
{
  putvalue(P_FSG_40_0_0_44Status_BTN, 0);
  putvalue(mci_Telephone_DataConnectionIndication_StatusBTN, 0);
  cancelTimer(tP_FSG_40_0_0_44Status_BTN);
}

on envVar mci_Telephone_DataConnectionIndication_ConnectionIndication
{
  putvalue(P_FSG_40_0_0_44_1, getvalue(this));
}

on envVar mci_Telephone_DataConnectionIndication_DataVolumeUplink
{
  putvalue(P_FSG_40_0_0_44_2, getvalue(this));
}

on envVar mci_Telephone_DataConnectionIndication_DataVolumeDownlink
{
  putvalue(P_FSG_40_0_0_44_3, getvalue(this));
}

on envVar mci_Telephone_MissedCallIndication_StatusBTN
{
  if (@this == 1)
  {
    putvalue(P_FSG_40_0_0_45Status_BTN, 1);
    setTimer(tP_FSG_40_0_0_45Status_BTN, 100);
  }
}

on timer tP_FSG_40_0_0_45Status_BTN
{
  putvalue(P_FSG_40_0_0_45Status_BTN, 0);
  putvalue(mci_Telephone_MissedCallIndication_StatusBTN, 0);
  cancelTimer(tP_FSG_40_0_0_45Status_BTN);
}

on envVar mci_Telephone_MissedCallIndication_MissedCalls
{
  putvalue(P_FSG_40_0_0_45_1, getvalue(this));
}

on envVar mci_Telephone_MissedCallIndication_MissedNumbers
{
  putvalue(P_FSG_40_0_0_45_2, getvalue(this));
}

on envVar mci_Telephone_PbState_StatusBTN
{
  if (@this == 1)
  {
    putvalue(P_FSG_40_0_0_51Status_BTN, 1);
    setTimer(tP_FSG_40_0_0_51Status_BTN, 100);
  }
}

on timer tP_FSG_40_0_0_51Status_BTN
{
  putvalue(P_FSG_40_0_0_51Status_BTN, 0);
  putvalue(mci_Telephone_PbState_StatusBTN, 0);
  cancelTimer(tP_FSG_40_0_0_51Status_BTN);
}

on envVar mci_Telephone_PbState_DownloadState
{
  putvalue(P_FSG_40_0_0_51_1, getvalue(this));
}

on envVar mci_Telephone_PbState_PbEntriesUHV
{
  putvalue(P_FSG_40_0_0_51_2, getvalue(this));
}

on envVar mci_Telephone_SMSState_StatusBTN
{
  if (@this == 1)
  {
    putvalue(P_FSG_40_0_0_55Status_BTN, 1);
    setTimer(tP_FSG_40_0_0_55Status_BTN, 100);
  }
}

on timer tP_FSG_40_0_0_55Status_BTN
{
  putvalue(P_FSG_40_0_0_55Status_BTN, 0);
  putvalue(mci_Telephone_SMSState_StatusBTN, 0);
  cancelTimer(tP_FSG_40_0_0_55Status_BTN);
}

on envVar mci_Telephone_SMSState_SIMReady
{
  putvalue(P_FSG_40_0_0_55_1, getvalue(this));
}

on envVar mci_Telephone_SMSState_StorageState
{
  putvalue(P_FSG_40_0_0_55_2, getvalue(this));
}

on envVar mci_Telephone_SMSState_NumberOfNewSMS
{
  putvalue(P_FSG_40_0_0_55_3, getvalue(this));
}

on envVar mci_Telephone_RingToneMuteOnOff_StatusBTN
{
  if (@this == 1)
  {
    putvalue(P_FSG_40_0_0_56Status_BTN, 1);
    setTimer(tP_FSG_40_0_0_56Status_BTN, 100);
  }
}

on timer tP_FSG_40_0_0_56Status_BTN
{
  putvalue(P_FSG_40_0_0_56Status_BTN, 0);
  putvalue(mci_Telephone_RingToneMuteOnOff_StatusBTN, 0);
  cancelTimer(tP_FSG_40_0_0_56Status_BTN);
}

on envVar mci_Telephone_RingToneMuteOnOff_RingToneMuteOnOff
{
  putvalue(P_FSG_40_0_0_56_1, getvalue(this));
}

on envVar mci_Telephone_AutomaticRedial_StatusBTN
{
  if (@this == 1)
  {
    putvalue(P_FSG_40_0_0_57Status_BTN, 1);
    setTimer(tP_FSG_40_0_0_57Status_BTN, 100);
  }
}

on timer tP_FSG_40_0_0_57Status_BTN
{
  putvalue(P_FSG_40_0_0_57Status_BTN, 0);
  putvalue(mci_Telephone_AutomaticRedial_StatusBTN, 0);
  cancelTimer(tP_FSG_40_0_0_57Status_BTN);
}

on envVar mci_Telephone_AutomaticRedial_AutomaticRedialState
{
  putvalue(P_FSG_40_0_0_57_1, getvalue(this));
}

on envVar mci_Telephone_AutomaticRedialExtendedInfo_StatusBTN
{
  if (@this == 1)
  {
    putvalue(P_FSG_40_0_0_58Status_BTN, 1);
    setTimer(tP_FSG_40_0_0_58Status_BTN, 100);
  }
}

on timer tP_FSG_40_0_0_58Status_BTN
{
  putvalue(P_FSG_40_0_0_58Status_BTN, 0);
  putvalue(mci_Telephone_AutomaticRedialExtendedInfo_StatusBTN, 0);
  cancelTimer(tP_FSG_40_0_0_58Status_BTN);
}

on envVar mci_Telephone_AutomaticRedialExtendedInfo_RedialTimeStamp
{
  putvalue(P_FSG_40_0_0_58_1, getvalue(this));
}

on envVar mci_Telephone_AutomaticRedialExtendedInfo_PbName
{
  int i=0;
  char ctmp[144];
  byte btmp[144];
  int len;
  len = getvaluesize(this)-1;
  getvalue(this, ctmp);
  for(i=0; i<144; i++) {
    if(i>=len)
      btmp[i] = 0;
    else
      btmp[i] = (byte)ctmp[i];
  }
  putvalue(P_FSG_40_0_0_58_2, btmp, len);
}

on envVar mci_Telephone_AutomaticRedialExtendedInfo_TelNumber
{
  int i=0;
  char ctmp[144];
  byte btmp[144];
  int len;
  len = getvaluesize(this)-1;
  getvalue(this, ctmp);
  for(i=0; i<144; i++) {
    if(i>=len)
      btmp[i] = 0;
    else
      btmp[i] = (byte)ctmp[i];
  }
  putvalue(P_FSG_40_0_0_58_3, btmp, len);
}

on envVar mci_Telephone_AutomaticRedialExtendedInfo_Category
{
  putvalue(P_FSG_40_0_0_58_4, getvalue(this));
}

on envVar mci_Telephone_SupportedServiceNumbers_StatusBTN
{
  if (@this == 1)
  {
    putvalue(P_FSG_40_0_0_59Status_BTN, 1);
    setTimer(tP_FSG_40_0_0_59Status_BTN, 100);
  }
}

on timer tP_FSG_40_0_0_59Status_BTN
{
  putvalue(P_FSG_40_0_0_59Status_BTN, 0);
  putvalue(mci_Telephone_SupportedServiceNumbers_StatusBTN, 0);
  cancelTimer(tP_FSG_40_0_0_59Status_BTN);
}

on envVar mci_Telephone_SupportedServiceNumbers_ServiceNumbers
{
  putvalue(P_FSG_40_0_0_59_1, getvalue(this));
}




//////////////// Telefon2 ////////////////


on envVar mci_Telephone2_Panel
{
    putvalue(ON_OFF_FSG41_0, getvalue(this)); 
}

on envVar mci_Telephone2_FSGOperationState_StatusBTN
{
  if (@this == 1)
  {
    putvalue(P_FSG_41_0_0_15Status_BTN, 1);
    setTimer(tP_FSG_41_0_0_15Status_BTN, 100);
  }
}

on timer tP_FSG_41_0_0_15Status_BTN
{
  putvalue(P_FSG_41_0_0_15Status_BTN, 0);
  putvalue(mci_Telephone2_FSGOperationState_StatusBTN, 0);
  cancelTimer(tP_FSG_41_0_0_15Status_BTN);
}

on envVar mci_Telephone2_FSGOperationState_OPState
{
  putvalue(P_FSG_41_0_0_15_1, getvalue(this));
}

on envVar mci_Telephone2_MobileServiceSupport_StatusBTN
{
  if (@this == 1)
  {
    putvalue(P_FSG_41_0_0_16Status_BTN, 1);
    setTimer(tP_FSG_41_0_0_16Status_BTN, 100);
  }
}

on timer tP_FSG_41_0_0_16Status_BTN
{
  putvalue(P_FSG_41_0_0_16Status_BTN, 0);
  putvalue(mci_Telephone2_MobileServiceSupport_StatusBTN, 0);
  cancelTimer(tP_FSG_41_0_0_16Status_BTN);
}

on envVar mci_Telephone2_MobileServiceSupport_FctList
{
  int i=0;
  char ctmp[8];
  byte btmp[8];
  int len;
  len = getvaluesize(this)-1;
  getvalue(this, ctmp);
  for(i=0; i<8; i++) {
    if(i>=len)
      btmp[i] = 0;
    else
      btmp[i] = (byte)ctmp[i];
  }
  putvalue(P_FSG_41_0_0_16_1, btmp, len);
}

on envVar mci_Telephone2_RegisterState2_StatusBTN
{
  if (@this == 1)
  {
    putvalue(P_FSG_41_0_0_17Status_BTN, 1);
    setTimer(tP_FSG_41_0_0_17Status_BTN, 100);
  }
}

on timer tP_FSG_41_0_0_17Status_BTN
{
  putvalue(P_FSG_41_0_0_17Status_BTN, 0);
  putvalue(mci_Telephone2_RegisterState2_StatusBTN, 0);
  cancelTimer(tP_FSG_41_0_0_17Status_BTN);
}

on envVar mci_Telephone2_RegisterState2_RegisterState
{
  putvalue(P_FSG_41_0_0_17_1, getvalue(this));
}

on envVar mci_Telephone2_RegisterState2_NetworkType
{
  putvalue(P_FSG_41_0_0_17_2, getvalue(this));
}

on envVar mci_Telephone2_RegisterState2_PacketDataNetworkType
{
  putvalue(P_FSG_41_0_0_17_3, getvalue(this));
}

on envVar mci_Telephone2_LockState2_StatusBTN
{
  if (@this == 1)
  {
    putvalue(P_FSG_41_0_0_18Status_BTN, 1);
    setTimer(tP_FSG_41_0_0_18Status_BTN, 100);
  }
}

on timer tP_FSG_41_0_0_18Status_BTN
{
  putvalue(P_FSG_41_0_0_18Status_BTN, 0);
  putvalue(mci_Telephone2_LockState2_StatusBTN, 0);
  cancelTimer(tP_FSG_41_0_0_18Status_BTN);
}

on envVar mci_Telephone2_LockState2_LockState
{
  putvalue(P_FSG_41_0_0_18_1, getvalue(this));
}

on envVar mci_Telephone2_NetworkProvider2_StatusBTN
{
  if (@this == 1)
  {
    putvalue(P_FSG_41_0_0_19Status_BTN, 1);
    setTimer(tP_FSG_41_0_0_19Status_BTN, 100);
  }
}

on timer tP_FSG_41_0_0_19Status_BTN
{
  putvalue(P_FSG_41_0_0_19Status_BTN, 0);
  putvalue(mci_Telephone2_NetworkProvider2_StatusBTN, 0);
  cancelTimer(tP_FSG_41_0_0_19Status_BTN);
}

on envVar mci_Telephone2_NetworkProvider2_NetworkProviderState
{
  putvalue(P_FSG_41_0_0_19_1, getvalue(this));
}

on envVar mci_Telephone2_NetworkProvider2_NetworkProviderName
{
  int i=0;
  char ctmp[82];
  byte btmp[82];
  int len;
  len = getvaluesize(this)-1;
  getvalue(this, ctmp);
  for(i=0; i<82; i++) {
    if(i>=len)
      btmp[i] = 0;
    else
      btmp[i] = (byte)ctmp[i];
  }
  putvalue(P_FSG_41_0_0_19_2, btmp, len);
}

on envVar mci_Telephone2_NetworkProvider2_ServiceProviderState
{
  putvalue(P_FSG_41_0_0_19_3, getvalue(this));
}

on envVar mci_Telephone2_NetworkProvider2_ServiceProviderName
{
  int i=0;
  char ctmp[82];
  byte btmp[82];
  int len;
  len = getvaluesize(this)-1;
  getvalue(this, ctmp);
  for(i=0; i<82; i++) {
    if(i>=len)
      btmp[i] = 0;
    else
      btmp[i] = (byte)ctmp[i];
  }
  putvalue(P_FSG_41_0_0_19_4, btmp, len);
}

on envVar mci_Telephone2_SignalQuality2_StatusBTN
{
  if (@this == 1)
  {
    putvalue(P_FSG_41_0_0_20Status_BTN, 1);
    setTimer(tP_FSG_41_0_0_20Status_BTN, 100);
  }
}

on timer tP_FSG_41_0_0_20Status_BTN
{
  putvalue(P_FSG_41_0_0_20Status_BTN, 0);
  putvalue(mci_Telephone2_SignalQuality2_StatusBTN, 0);
  cancelTimer(tP_FSG_41_0_0_20Status_BTN);
}

on envVar mci_Telephone2_SignalQuality2_Quality
{
  putvalue(P_FSG_41_0_0_20_1, getvalue(this));
}

on envVar mci_Telephone2_DataConnectionIndication2_StatusBTN
{
  if (@this == 1)
  {
    putvalue(P_FSG_41_0_0_21Status_BTN, 1);
    setTimer(tP_FSG_41_0_0_21Status_BTN, 100);
  }
}

on timer tP_FSG_41_0_0_21Status_BTN
{
  putvalue(P_FSG_41_0_0_21Status_BTN, 0);
  putvalue(mci_Telephone2_DataConnectionIndication2_StatusBTN, 0);
  cancelTimer(tP_FSG_41_0_0_21Status_BTN);
}

on envVar mci_Telephone2_DataConnectionIndication2_ConnectionIndication
{
  putvalue(P_FSG_41_0_0_21_1, getvalue(this));
}

on envVar mci_Telephone2_DataConnectionIndication2_DataVolumeUplink
{
  putvalue(P_FSG_41_0_0_21_2, getvalue(this));
}

on envVar mci_Telephone2_DataConnectionIndication2_DataVolumeDownlink
{
  putvalue(P_FSG_41_0_0_21_3, getvalue(this));
}

on envVar mci_Telephone2_EmailState_StatusBTN
{
  if (@this == 1)
  {
    putvalue(P_FSG_41_0_0_22Status_BTN, 1);
    setTimer(tP_FSG_41_0_0_22Status_BTN, 100);
  }
}

on timer tP_FSG_41_0_0_22Status_BTN
{
  putvalue(P_FSG_41_0_0_22Status_BTN, 0);
  putvalue(mci_Telephone2_EmailState_StatusBTN, 0);
  cancelTimer(tP_FSG_41_0_0_22Status_BTN);
}

on envVar mci_Telephone2_EmailState_StorageState
{
  putvalue(P_FSG_41_0_0_22_1, getvalue(this));
}

on envVar mci_Telephone2_EmailState_NumberOfNewEmail
{
  putvalue(P_FSG_41_0_0_22_2, getvalue(this));
}

on envVar mci_Telephone2_PhoneModuleState_StatusBTN
{
  if (@this == 1)
  {
    putvalue(P_FSG_41_0_0_23Status_BTN, 1);
    setTimer(tP_FSG_41_0_0_23Status_BTN, 100);
  }
}

on timer tP_FSG_41_0_0_23Status_BTN
{
  putvalue(P_FSG_41_0_0_23Status_BTN, 0);
  putvalue(mci_Telephone2_PhoneModuleState_StatusBTN, 0);
  cancelTimer(tP_FSG_41_0_0_23Status_BTN);
}

on envVar mci_Telephone2_PhoneModuleState_ModuleState
{
  putvalue(P_FSG_41_0_0_23_1, getvalue(this));
}

on envVar mci_Telephone2_PhoneModuleState_ModuleSupportedServices
{
  putvalue(P_FSG_41_0_0_23_2, getvalue(this));
}

on envVar mci_Telephone2_PhoneModuleState_ModuleActiveServices
{
  putvalue(P_FSG_41_0_0_23_3, getvalue(this));
}

on envVar mci_Telephone2_PhoneModuleState_SIMState
{
  putvalue(P_FSG_41_0_0_23_4, getvalue(this));
}

on envVar mci_Telephone2_ConnectionState_StatusBTN
{
  if (@this == 1)
  {
    putvalue(P_FSG_41_0_0_24Status_BTN, 1);
    setTimer(tP_FSG_41_0_0_24Status_BTN, 100);
  }
}

on timer tP_FSG_41_0_0_24Status_BTN
{
  putvalue(P_FSG_41_0_0_24Status_BTN, 0);
  putvalue(mci_Telephone2_ConnectionState_StatusBTN, 0);
  cancelTimer(tP_FSG_41_0_0_24Status_BTN);
}

on envVar mci_Telephone2_ConnectionState_BluetoothState
{
  putvalue(P_FSG_41_0_0_24_1, getvalue(this));
}

on envVar mci_Telephone2_ConnectionState_BluetoothVisibility
{
  putvalue(P_FSG_41_0_0_24_2, getvalue(this));
}

on envVar mci_Telephone2_ConnectionState_BluetoothConnections
{
  putvalue(P_FSG_41_0_0_24_3, getvalue(this));
}

on envVar mci_Telephone2_ConnectionState_WLANState
{
  putvalue(P_FSG_41_0_0_24_4, getvalue(this));
}

on envVar mci_Telephone2_ConnectionState_WLANVisibility
{
  putvalue(P_FSG_41_0_0_24_5, getvalue(this));
}

on envVar mci_Telephone2_ConnectionState_WLANConnections
{
  putvalue(P_FSG_41_0_0_24_6, getvalue(this));
}

on envVar mci_Telephone2_AutomaticCallForwarding_StatusBTN
{
  if (@this == 1)
  {
    putvalue(P_FSG_41_0_0_25Status_BTN, 1);
    setTimer(tP_FSG_41_0_0_25Status_BTN, 100);
  }
}

on timer tP_FSG_41_0_0_25Status_BTN
{
  putvalue(P_FSG_41_0_0_25Status_BTN, 0);
  putvalue(mci_Telephone2_AutomaticCallForwarding_StatusBTN, 0);
  cancelTimer(tP_FSG_41_0_0_25Status_BTN);
}

on envVar mci_Telephone2_AutomaticCallForwarding_DivertState
{
  putvalue(P_FSG_41_0_0_25_1, getvalue(this));
}

on envVar mci_Telephone2_PhonebookDownloadProgress_StatusBTN
{
  if (@this == 1)
  {
    putvalue(P_FSG_41_0_0_26Status_BTN, 1);
    setTimer(tP_FSG_41_0_0_26Status_BTN, 100);
  }
}

on timer tP_FSG_41_0_0_26Status_BTN
{
  putvalue(P_FSG_41_0_0_26Status_BTN, 0);
  putvalue(mci_Telephone2_PhonebookDownloadProgress_StatusBTN, 0);
  cancelTimer(tP_FSG_41_0_0_26Status_BTN);
}

on envVar mci_Telephone2_PhonebookDownloadProgress_DownloadState
{
  putvalue(P_FSG_41_0_0_26_1, getvalue(this));
}

on envVar mci_Telephone2_PhonebookDownloadProgress_ProgressPhonebookDownload
{
  putvalue(P_FSG_41_0_0_26_2, getvalue(this));
}

on envVar mci_Telephone2_PhonebookDownloadProgress_TotalPbEntries
{
  putvalue(P_FSG_41_0_0_26_3, getvalue(this));
}

on envVar mci_Telephone2_PhonebookDownloadProgress_CurrentlyLoadedPbEntries
{
  putvalue(P_FSG_41_0_0_26_4, getvalue(this));
}



//////////////// Audio ////////////////

on envVar mci_Audio_Panel
{
   putvalue(ON_OFF_FSG49_0, getvalue(this)); 
}

on envVar mci_AudioSD_FSGSetup_StatusBTN
{
  if (@this == 1)
  {
    putvalue(P_FSG_49_0_0_14Status_BTN, 1);
    setTimer(tP_FSG_49_0_0_14Status_BTN, 100);
  }
}

on timer tP_FSG_49_0_0_14Status_BTN
{
  putvalue(P_FSG_49_0_0_14Status_BTN, 0);
  putvalue(mci_AudioSD_FSGSetup_StatusBTN, 0);
  cancelTimer(tP_FSG_49_0_0_14Status_BTN);
}

on envVar mci_AudioSD_FSGSetup_maxVolume
{
  putvalue(P_FSG_49_0_0_14_1, getvalue(this));
}

on envVar mci_AudioSD_FSGSetup_supportedVolumeTypes
{
  putvalue(P_FSG_49_0_0_14_2, getvalue(this));
}

on envVar mci_AudioSD_FSGSetup_SetupExtensions
{
  putvalue(P_FSG_49_0_0_14_3, getvalue(this));
}

on envVar mci_AudioSD_FSGOperationState_StatusBTN
{
  if (@this == 1)
  {
    putvalue(P_FSG_49_0_0_15Status_BTN, 1);
    setTimer(tP_FSG_49_0_0_15Status_BTN, 100);
  }
}

on timer tP_FSG_49_0_0_15Status_BTN
{
  putvalue(P_FSG_49_0_0_15Status_BTN, 0);
  putvalue(mci_AudioSD_FSGOperationState_StatusBTN, 0);
  cancelTimer(tP_FSG_49_0_0_15Status_BTN);
}

on envVar mci_AudioSD_FSGOperationState_OPState
{
  putvalue(P_FSG_49_0_0_15_1, getvalue(this));
}

on envVar mci_AudioSD_FSGOperationState_HMIState
{
  putvalue(P_FSG_49_0_0_15_2, getvalue(this));
}

on envVar mci_AudioSD_ActiveSource_StatusBTN
{
  if (@this == 1)
  {
    putvalue(P_FSG_49_0_0_16Status_BTN, 1);
    setTimer(tP_FSG_49_0_0_16Status_BTN, 100);
  }
}

on timer tP_FSG_49_0_0_16Status_BTN
{
  putvalue(P_FSG_49_0_0_16Status_BTN, 0);
  putvalue(mci_AudioSD_ActiveSource_StatusBTN, 0);
  cancelTimer(tP_FSG_49_0_0_16Status_BTN);
}

on envVar mci_AudioSD_ActiveSource_SourceType
{
  putvalue(P_FSG_49_0_0_16_1, getvalue(this));
}

on envVar mci_AudioSD_ActiveSource_SourceListReference
{
  putvalue(P_FSG_49_0_0_16_2, getvalue(this));
}

on envVar mci_AudioSD_ActiveSource_TypeOfNumber
{
  putvalue(P_FSG_49_0_0_16_3, getvalue(this));
}

on envVar mci_AudioSD_ActiveSource_ListAvailable
{
  putvalue(P_FSG_49_0_0_16_4, getvalue(this));
}

on envVar mci_AudioSD_ActiveSource_ListState
{
  putvalue(P_FSG_49_0_0_16_5, getvalue(this));
}

on envVar mci_AudioSD_ActiveSource_Extention1
{
  putvalue(P_FSG_49_0_0_16_6, getvalue(this));
}

on envVar mci_AudioSD_ActiveSource_Number
{
  putvalue(P_FSG_49_0_0_16_7, getvalue(this));
}

on envVar mci_AudioSD_ActiveSourceName_StatusBTN
{
  if (@this == 1)
  {
    putvalue(P_FSG_49_0_0_17Status_BTN, 1);
    setTimer(tP_FSG_49_0_0_17Status_BTN, 100);
  }
}

on timer tP_FSG_49_0_0_17Status_BTN
{
  putvalue(P_FSG_49_0_0_17Status_BTN, 0);
  putvalue(mci_AudioSD_ActiveSourceName_StatusBTN, 0);
  cancelTimer(tP_FSG_49_0_0_17Status_BTN);
}

on envVar mci_AudioSD_ActiveSourceName_SourceName
{
  int i=0;
  char ctmp[61];
  byte btmp[61];
  int len;
  len = getvaluesize(this)-1;
  getvalue(this, ctmp);
  for(i=0; i<61; i++) {
    if(i>=len)
      btmp[i] = 0;
    else
      btmp[i] = (byte)ctmp[i];
  }
  putvalue(P_FSG_49_0_0_17_1, btmp, len);
}

on envVar mci_AudioSD_CurrentVolume_StatusBTN
{
  if (@this == 1)
  {
    putvalue(P_FSG_49_0_0_18Status_BTN, 1);
    setTimer(tP_FSG_49_0_0_18Status_BTN, 100);
  }
}

on timer tP_FSG_49_0_0_18Status_BTN
{
  putvalue(P_FSG_49_0_0_18Status_BTN, 0);
  putvalue(mci_AudioSD_CurrentVolume_StatusBTN, 0);
  cancelTimer(tP_FSG_49_0_0_18Status_BTN);
}

on envVar mci_AudioSD_CurrentVolume_EntertainmentVolume
{
  putvalue(P_FSG_49_0_0_18_1, getvalue(this));
}

on envVar mci_AudioSD_CurrentVolume_NavigationVolume
{
  putvalue(P_FSG_49_0_0_18_2, getvalue(this));
}

on envVar mci_AudioSD_CurrentVolume_TaVolume
{
  putvalue(P_FSG_49_0_0_18_3, getvalue(this));
}

on envVar mci_AudioSD_CurrentVolume_PhoneVolume
{
  putvalue(P_FSG_49_0_0_18_4, getvalue(this));
}

on envVar mci_AudioSD_CurrentVolume_SdsVolume
{
  putvalue(P_FSG_49_0_0_18_5, getvalue(this));
}

on envVar mci_AudioSD_CurrentVolume_ChangingVolumeType
{
  putvalue(P_FSG_49_0_0_18_6, getvalue(this));
}

on envVar mci_AudioSD_Mute_StatusBTN
{
  if (@this == 1)
  {
    putvalue(P_FSG_49_0_0_19Status_BTN, 1);
    setTimer(tP_FSG_49_0_0_19Status_BTN, 100);
  }
}

on timer tP_FSG_49_0_0_19Status_BTN
{
  putvalue(P_FSG_49_0_0_19Status_BTN, 0);
  putvalue(mci_AudioSD_Mute_StatusBTN, 0);
  cancelTimer(tP_FSG_49_0_0_19Status_BTN);
}

on envVar mci_AudioSD_Mute_MuteState
{
  putvalue(P_FSG_49_0_0_19_1, getvalue(this));
}

on envVar mci_AudioSD_SourceState_StatusBTN
{
  if (@this == 1)
  {
    putvalue(P_FSG_49_0_0_20Status_BTN, 1);
    setTimer(tP_FSG_49_0_0_20Status_BTN, 100);
  }
}

on timer tP_FSG_49_0_0_20Status_BTN
{
  putvalue(P_FSG_49_0_0_20Status_BTN, 0);
  putvalue(mci_AudioSD_SourceState_StatusBTN, 0);
  cancelTimer(tP_FSG_49_0_0_20Status_BTN);
}

on envVar mci_AudioSD_SourceState_StateInfo
{
  putvalue(P_FSG_49_0_0_20_1, getvalue(this));
}

on envVar mci_AudioSD_SourceState_StateInfoScope
{
  putvalue(P_FSG_49_0_0_20_2, getvalue(this));
}

on envVar mci_AudioSD_CurrentStationInfo_StatusBTN
{
  if (@this == 1)
  {
    putvalue(P_FSG_49_0_0_21Status_BTN, 1);
    setTimer(tP_FSG_49_0_0_21Status_BTN, 100);
  }
}

on timer tP_FSG_49_0_0_21Status_BTN
{
  putvalue(P_FSG_49_0_0_21Status_BTN, 0);
  putvalue(mci_AudioSD_CurrentStationInfo_StatusBTN, 0);
  cancelTimer(tP_FSG_49_0_0_21Status_BTN);
}

on envVar mci_AudioSD_CurrentStationInfo_PrimaryInformation
{
  int i=0;
  char ctmp[302];
  byte btmp[302];
  int len;
  len = getvaluesize(this)-1;
  getvalue(this, ctmp);
  for(i=0; i<302; i++) {
    if(i>=len)
      btmp[i] = 0;
    else
      btmp[i] = (byte)ctmp[i];
  }
  putvalue(P_FSG_49_0_0_21_1, btmp, len);
}

on envVar mci_AudioSD_CurrentStationInfo_PIType
{
  putvalue(P_FSG_49_0_0_21_2, getvalue(this));
}

on envVar mci_AudioSD_CurrentStationInfo_PIID
{
  putvalue(P_FSG_49_0_0_21_3, getvalue(this));
}

on envVar mci_AudioSD_CurrentStationInfo_SecondaryInformation
{
  int i=0;
  char ctmp[302];
  byte btmp[302];
  int len;
  len = getvaluesize(this)-1;
  getvalue(this, ctmp);
  for(i=0; i<302; i++) {
    if(i>=len)
      btmp[i] = 0;
    else
      btmp[i] = (byte)ctmp[i];
  }
  putvalue(P_FSG_49_0_0_21_4, btmp, len);
}

on envVar mci_AudioSD_CurrentStationInfo_SIType
{
  putvalue(P_FSG_49_0_0_21_5, getvalue(this));
}

on envVar mci_AudioSD_CurrentStationInfo_TertiaryInformation
{
  int i=0;
  char ctmp[302];
  byte btmp[302];
  int len;
  len = getvaluesize(this)-1;
  getvalue(this, ctmp);
  for(i=0; i<302; i++) {
    if(i>=len)
      btmp[i] = 0;
    else
      btmp[i] = (byte)ctmp[i];
  }
  putvalue(P_FSG_49_0_0_21_6, btmp, len);
}

on envVar mci_AudioSD_CurrentStationInfo_TIType
{
  putvalue(P_FSG_49_0_0_21_7, getvalue(this));
}

on envVar mci_AudioSD_CurrentStationInfo_QuaternaryInformation
{
  int i=0;
  char ctmp[302];
  byte btmp[302];
  int len;
  len = getvaluesize(this)-1;
  getvalue(this, ctmp);
  for(i=0; i<302; i++) {
    if(i>=len)
      btmp[i] = 0;
    else
      btmp[i] = (byte)ctmp[i];
  }
  putvalue(P_FSG_49_0_0_21_8, btmp, len);
}

on envVar mci_AudioSD_CurrentStationInfo_QIType
{
  putvalue(P_FSG_49_0_0_21_9, getvalue(this));
}

on envVar mci_AudioSD_CurrentStationInfo_StationInfoSwitches
{
  putvalue(P_FSG_49_0_0_21_10, getvalue(this));
}

on envVar mci_AudioSD_CurrentStationInfo_StationProperties
{
  putvalue(P_FSG_49_0_0_21_11, getvalue(this));
}

on envVar mci_AudioSD_CurrentStationInfo_ChannelID
{
  putvalue(P_FSG_49_0_0_21_12, getvalue(this));
}

on envVar mci_AudioSD_CurrentStationHandle_StatusBTN
{
  if (@this == 1)
  {
    putvalue(P_FSG_49_0_0_22Status_BTN, 1);
    setTimer(tP_FSG_49_0_0_22Status_BTN, 100);
  }
}

on timer tP_FSG_49_0_0_22Status_BTN
{
  putvalue(P_FSG_49_0_0_22Status_BTN, 0);
  putvalue(mci_AudioSD_CurrentStationHandle_StatusBTN, 0);
  cancelTimer(tP_FSG_49_0_0_22Status_BTN);
}

on envVar mci_AudioSD_CurrentStationHandle_FsgHandle
{
  putvalue(P_FSG_49_0_0_22_1, getvalue(this));
}

on envVar mci_AudioSD_CurrentStationHandle_FsgHandleabsolutePosition
{
  putvalue(P_FSG_49_0_0_22_2, getvalue(this));
}

on envVar mci_AudioSD_CurrentStationHandle_PresetListRef
{
  putvalue(P_FSG_49_0_0_22_3, getvalue(this));
}

on envVar mci_AudioSD_CurrentStationHandle_PresetListabsolutePosition
{
  putvalue(P_FSG_49_0_0_22_4, getvalue(this));
}

on envVar mci_AudioSD_CurrentStationHandle_DABEnsembleHandle
{
  putvalue(P_FSG_49_0_0_22_5, getvalue(this));
}

on envVar mci_AudioSD_CurrentStationHandle_DABEnsembleabsolutePosition
{
  putvalue(P_FSG_49_0_0_22_6, getvalue(this));
}

on envVar mci_AudioSD_GeneralInfoSwitches_StatusBTN
{
  if (@this == 1)
  {
    putvalue(P_FSG_49_0_0_25Status_BTN, 1);
    setTimer(tP_FSG_49_0_0_25Status_BTN, 100);
  }
}

on timer tP_FSG_49_0_0_25Status_BTN
{
  putvalue(P_FSG_49_0_0_25Status_BTN, 0);
  putvalue(mci_AudioSD_GeneralInfoSwitches_StatusBTN, 0);
  cancelTimer(tP_FSG_49_0_0_25Status_BTN);
}

on envVar mci_AudioSD_GeneralInfoSwitches_OnOffSwitches
{
  putvalue(P_FSG_49_0_0_25_1, getvalue(this));
}

on envVar mci_AudioSD_GeneralInfoSwitches_Modification
{
  putvalue(P_FSG_49_0_0_25_2, getvalue(this));
}

on envVar mci_AudioSD_TpMemoInfo_StatusBTN
{
  if (@this == 1)
  {
    putvalue(P_FSG_49_0_0_26Status_BTN, 1);
    setTimer(tP_FSG_49_0_0_26Status_BTN, 100);
  }
}

on timer tP_FSG_49_0_0_26Status_BTN
{
  putvalue(P_FSG_49_0_0_26Status_BTN, 0);
  putvalue(mci_AudioSD_TpMemoInfo_StatusBTN, 0);
  cancelTimer(tP_FSG_49_0_0_26Status_BTN);
}

on envVar mci_AudioSD_TpMemoInfo_TpCounters_CurrentMsgNumber
{
  putvalue(P_FSG_49_0_0_26_1_CurrentMsgNumber, getvalue(this));
}

on envVar mci_AudioSD_TpMemoInfo_TpCounters_TotalMsgNumber
{
  putvalue(P_FSG_49_0_0_26_1_TotalMsgNumber, getvalue(this));
}

on envVar mci_AudioSD_TpMemoInfo_MessageTime_Hour
{
  putvalue(P_FSG_49_0_0_26_2_Hour, getvalue(this));
}

on envVar mci_AudioSD_TpMemoInfo_MessageTime_Minute
{
  putvalue(P_FSG_49_0_0_26_2_Minute, getvalue(this));
}

on envVar mci_AudioSD_TpMemoInfo_StationName
{
  int i=0;
  char ctmp[53];
  byte btmp[53];
  int len;
  len = getvaluesize(this)-1;
  getvalue(this, ctmp);
  for(i=0; i<53; i++) {
    if(i>=len)
      btmp[i] = 0;
    else
      btmp[i] = (byte)ctmp[i];
  }
  putvalue(P_FSG_49_0_0_26_3, btmp, len);
}

on envVar mci_AudioSD_AnnouncementInfo_StatusBTN
{
  if (@this == 1)
  {
    putvalue(P_FSG_49_0_0_28Status_BTN, 1);
    setTimer(tP_FSG_49_0_0_28Status_BTN, 100);
  }
}

on timer tP_FSG_49_0_0_28Status_BTN
{
  putvalue(P_FSG_49_0_0_28Status_BTN, 0);
  putvalue(mci_AudioSD_AnnouncementInfo_StatusBTN, 0);
  cancelTimer(tP_FSG_49_0_0_28Status_BTN);
}

on envVar mci_AudioSD_AnnouncementInfo_AnnouncementType
{
  putvalue(P_FSG_49_0_0_28_1, getvalue(this));
}

on envVar mci_AudioSD_AnnouncementInfo_StationName
{
  int i=0;
  char ctmp[50];
  byte btmp[50];
  int len;
  len = getvaluesize(this)-1;
  getvalue(this, ctmp);
  for(i=0; i<50; i++) {
    if(i>=len)
      btmp[i] = 0;
    else
      btmp[i] = (byte)ctmp[i];
  }
  putvalue(P_FSG_49_0_0_28_2, btmp, len);
}

on envVar mci_AudioSD_InfoStates_StatusBTN
{
  if (@this == 1)
  {
    putvalue(P_FSG_49_0_0_30Status_BTN, 1);
    setTimer(tP_FSG_49_0_0_30Status_BTN, 100);
  }
}

on timer tP_FSG_49_0_0_30Status_BTN
{
  putvalue(P_FSG_49_0_0_30Status_BTN, 0);
  putvalue(mci_AudioSD_InfoStates_StatusBTN, 0);
  cancelTimer(tP_FSG_49_0_0_30Status_BTN);
}

on envVar mci_AudioSD_InfoStates_States
{
  putvalue(P_FSG_49_0_0_30_1, getvalue(this));
}

on envVar mci_AudioSD_ReceptionListType_StatusBTN
{
  if (@this == 1)
  {
    putvalue(P_FSG_49_0_0_31Status_BTN, 1);
    setTimer(tP_FSG_49_0_0_31Status_BTN, 100);
  }
}

on timer tP_FSG_49_0_0_31Status_BTN
{
  putvalue(P_FSG_49_0_0_31Status_BTN, 0);
  putvalue(mci_AudioSD_ReceptionListType_StatusBTN, 0);
  cancelTimer(tP_FSG_49_0_0_31Status_BTN);
}

on envVar mci_AudioSD_ReceptionListType_Type
{
  putvalue(P_FSG_49_0_0_31_1, getvalue(this));
}

on envVar mci_AudioSD_MediaBrowserFolderLevel_StatusBTN
{
  if (@this == 1)
  {
    putvalue(P_FSG_49_0_0_35Status_BTN, 1);
    setTimer(tP_FSG_49_0_0_35Status_BTN, 100);
  }
}

on timer tP_FSG_49_0_0_35Status_BTN
{
  putvalue(P_FSG_49_0_0_35Status_BTN, 0);
  putvalue(mci_AudioSD_MediaBrowserFolderLevel_StatusBTN, 0);
  cancelTimer(tP_FSG_49_0_0_35Status_BTN);
}

on envVar mci_AudioSD_MediaBrowserFolderLevel_FolderLevel
{
  putvalue(P_FSG_49_0_0_35_1, getvalue(this));
}

on envVar mci_AudioSD_MediaBrowserFolderLevel_RefMediaBrowser
{
  putvalue(P_FSG_49_0_0_35_2, getvalue(this));
}

on envVar mci_AudioSD_MediaBrowserFolderLevel_RefMediaBrowserabsolutePosition
{
  putvalue(P_FSG_49_0_0_35_3, getvalue(this));
}

on envVar mci_AudioSD_MediaPath_StatusBTN
{
  if (@this == 1)
  {
    putvalue(P_FSG_49_0_0_37Status_BTN, 1);
    setTimer(tP_FSG_49_0_0_37Status_BTN, 100);
  }
}

on timer tP_FSG_49_0_0_37Status_BTN
{
  putvalue(P_FSG_49_0_0_37Status_BTN, 0);
  putvalue(mci_AudioSD_MediaPath_StatusBTN, 0);
  cancelTimer(tP_FSG_49_0_0_37Status_BTN);
}

on envVar mci_AudioSD_MediaPath_FolderType
{
  putvalue(P_FSG_49_0_0_37_1, getvalue(this));
}

on envVar mci_AudioSD_MediaPath_Path
{
  int i=0;
  char ctmp[153];
  byte btmp[153];
  int len;
  len = getvaluesize(this)-1;
  getvalue(this, ctmp);
  for(i=0; i<153; i++) {
    if(i>=len)
      btmp[i] = 0;
    else
      btmp[i] = (byte)ctmp[i];
  }
  putvalue(P_FSG_49_0_0_37_2, btmp, len);
}

on envVar mci_AudioSD_PreferredList_StatusBTN
{
  if (@this == 1)
  {
    putvalue(P_FSG_49_0_0_40Status_BTN, 1);
    setTimer(tP_FSG_49_0_0_40Status_BTN, 100);
  }
}

on timer tP_FSG_49_0_0_40Status_BTN
{
  putvalue(P_FSG_49_0_0_40Status_BTN, 0);
  putvalue(mci_AudioSD_PreferredList_StatusBTN, 0);
  cancelTimer(tP_FSG_49_0_0_40Status_BTN);
}

on envVar mci_AudioSD_PreferredList_List
{
  putvalue(P_FSG_49_0_0_40_1, getvalue(this));
}

on envVar mci_AudioSD_SDSState_StatusBTN
{
  if (@this == 1)
  {
    putvalue(P_FSG_49_0_0_41Status_BTN, 1);
    setTimer(tP_FSG_49_0_0_41Status_BTN, 100);
  }
}

on timer tP_FSG_49_0_0_41Status_BTN
{
  putvalue(P_FSG_49_0_0_41Status_BTN, 0);
  putvalue(mci_AudioSD_SDSState_StatusBTN, 0);
  cancelTimer(tP_FSG_49_0_0_41Status_BTN);
}

on envVar mci_AudioSD_SDSState_State
{
  putvalue(P_FSG_49_0_0_41_1, getvalue(this));
}

on envVar mci_AudioSD_FunctionSynchronisation_StatusBTN
{
  if (@this == 1)
  {
    putvalue(P_FSG_49_0_0_42Status_BTN, 1);
    setTimer(tP_FSG_49_0_0_42Status_BTN, 100);
  }
}

on timer tP_FSG_49_0_0_42Status_BTN
{
  putvalue(P_FSG_49_0_0_42Status_BTN, 0);
  putvalue(mci_AudioSD_FunctionSynchronisation_StatusBTN, 0);
  cancelTimer(tP_FSG_49_0_0_42Status_BTN);
}

on envVar mci_AudioSD_FunctionSynchronisation_FctList1
{
  int i=0;
  char ctmp[6];
  byte btmp[6];
  int len;
  len = getvaluesize(this)-1;
  getvalue(this, ctmp);
  for(i=0; i<6; i++) {
    if(i>=len)
      btmp[i] = 0;
    else
      btmp[i] = (byte)ctmp[i];
  }
  putvalue(P_FSG_49_0_0_42_1, btmp, len);
}

on envVar mci_AudioSD_FunctionSynchronisation_FctList2
{
  putvalue(P_FSG_49_0_0_42_2, getvalue(this));
}

on envVar mci_AudioSD_FunctionSynchronisation_FctList3
{
  putvalue(P_FSG_49_0_0_42_3, getvalue(this));
}

on envVar mci_AudioSD_ASGCapabilities_StatusBTN
{
  if (@this == 1)
  {
    putvalue(P_FSG_49_0_0_43Status_BTN, 1);
    setTimer(tP_FSG_49_0_0_43Status_BTN, 100);
  }
}

on timer tP_FSG_49_0_0_43Status_BTN
{
  putvalue(P_FSG_49_0_0_43Status_BTN, 0);
  putvalue(mci_AudioSD_ASGCapabilities_StatusBTN, 0);
  cancelTimer(tP_FSG_49_0_0_43Status_BTN);
}

on envVar mci_AudioSD_ASGCapabilities_PresentationCapabilities
{
  putvalue(P_FSG_49_0_0_43_1, getvalue(this));
}

on envVar mci_AudioSD_MediaImportState_StatusBTN
{
  if (@this == 1)
  {
    putvalue(P_FSG_49_0_0_46Status_BTN, 1);
    setTimer(tP_FSG_49_0_0_46Status_BTN, 100);
  }
}

on timer tP_FSG_49_0_0_46Status_BTN
{
  putvalue(P_FSG_49_0_0_46Status_BTN, 0);
  putvalue(mci_AudioSD_MediaImportState_StatusBTN, 0);
  cancelTimer(tP_FSG_49_0_0_46Status_BTN);
}

on envVar mci_AudioSD_MediaImportState_SourceType
{
  putvalue(P_FSG_49_0_0_46_1, getvalue(this));
}

on envVar mci_AudioSD_MediaImportState_InstanceID
{
  putvalue(P_FSG_49_0_0_46_2, getvalue(this));
}

on envVar mci_AudioSD_CurrentVolumeExtended_StatusBTN
{
  if (@this == 1)
  {
    putvalue(P_FSG_49_0_0_47Status_BTN, 1);
    setTimer(tP_FSG_49_0_0_47Status_BTN, 100);
  }
}

on timer tP_FSG_49_0_0_47Status_BTN
{
  putvalue(P_FSG_49_0_0_47Status_BTN, 0);
  putvalue(mci_AudioSD_CurrentVolumeExtended_StatusBTN, 0);
  cancelTimer(tP_FSG_49_0_0_47Status_BTN);
}

on envVar mci_AudioSD_CurrentVolumeExtended_ChangingVolumeType
{
  putvalue(P_FSG_49_0_0_47_1, getvalue(this));
}

on envVar mci_AudioSD_CurrentVolumeExtended_VolumeState
{
  putvalue(P_FSG_49_0_0_47_2_0, getvalue(this));
}

on envVar mci_AudioSD_CurrentVolumeExtended_maxVolume
{
  putvalue(P_FSG_49_0_0_47_3, getvalue(this));
}

on envVar mci_AudioSD_CurrentVolumeExtended_GenericVolume
{
  putvalue(P_FSG_49_0_0_47_4, getvalue(this));
}

on envVar mci_AudioSD_CustomerDownloadState_StatusBTN
{
  if (@this == 1)
  {
    putvalue(P_FSG_49_0_0_48Status_BTN, 1);
    setTimer(tP_FSG_49_0_0_48Status_BTN, 100);
  }
}

on timer tP_FSG_49_0_0_48Status_BTN
{
  putvalue(P_FSG_49_0_0_48Status_BTN, 0);
  putvalue(mci_AudioSD_CustomerDownloadState_StatusBTN, 0);
  cancelTimer(tP_FSG_49_0_0_48Status_BTN);
}

on envVar mci_AudioSD_CustomerDownloadState_CustomerDownloadState
{
  putvalue(P_FSG_49_0_0_48_1, getvalue(this));
}

on envVar mci_AudioSD_OnlineMusicState_State
{
  putvalue(P_FSG_49_0_0_49_1, getvalue(this));
}

on envVar mci_AudioSD_OnlineMusicState_BufferLevel
{
  putvalue(P_FSG_49_0_0_49_2, getvalue(this));
}

on envVar mci_AudioSD_OnlineMusicState_StatusBTN
{
  if (@this == 1)
  {
    putvalue(P_FSG_49_0_0_49Status_BTN, getvalue(this));
    setTimer(tP_FSG_49_0_0_49Status_BTN, 100);
  }
}

on timer tP_FSG_49_0_0_49Status_BTN
{
  putvalue(P_FSG_49_0_0_49Status_BTN, 0);
  putvalue(mci_AudioSD_OnlineMusicState_StatusBTN, 0);
  cancelTimer(tP_FSG_49_0_0_49Status_BTN);
}



//////////////// Navi ////////////////


on envVar mci_Navigation_Panel
{
    putvalue(ON_OFF_FSG50_0, getvalue(this)); 
}

on envVar mci_NavigationSD_FSGOperationState_StatusBTN
{
  if (@this == 1)
  {
    putvalue(P_FSG_50_0_0_15Status_BTN, 1);
    setTimer(tP_FSG_50_0_0_15Status_BTN, 100);
  }
}

on timer tP_FSG_50_0_0_15Status_BTN
{
  putvalue(P_FSG_50_0_0_15Status_BTN, 0);
  putvalue(mci_NavigationSD_FSGOperationState_StatusBTN, 0);
  cancelTimer(tP_FSG_50_0_0_15Status_BTN);
}

on envVar mci_NavigationSD_FSGOperationState_OPState
{
  putvalue(P_FSG_50_0_0_15_1, getvalue(this));
}

on envVar mci_NavigationSD_CompassInfo_StatusBTN
{
  if (@this == 1)
  {
    putvalue(P_FSG_50_0_0_16Status_BTN, 1);
    setTimer(tP_FSG_50_0_0_16Status_BTN, 100);
  }
}

on timer tP_FSG_50_0_0_16Status_BTN
{
  putvalue(P_FSG_50_0_0_16Status_BTN, 0);
  putvalue(mci_NavigationSD_CompassInfo_StatusBTN, 0);
  cancelTimer(tP_FSG_50_0_0_16Status_BTN);
}

on envVar mci_NavigationSD_CompassInfo_DirectionSymbolic
{
  putvalue(P_FSG_50_0_0_16_1, getvalue(this));
}

on envVar mci_NavigationSD_CompassInfo_DirectionAngle
{
  putvalue(P_FSG_50_0_0_16_2, getvalue(this));
}

on envVar mci_NavigationSD_RGStatus_StatusBTN
{
  if (@this == 1)
  {
    putvalue(P_FSG_50_0_0_17Status_BTN, 1);
    setTimer(tP_FSG_50_0_0_17Status_BTN, 100);
  }
}

on timer tP_FSG_50_0_0_17Status_BTN
{
  putvalue(P_FSG_50_0_0_17Status_BTN, 0);
  putvalue(mci_NavigationSD_RGStatus_StatusBTN, 0);
  cancelTimer(tP_FSG_50_0_0_17Status_BTN);
}

on envVar mci_NavigationSD_RGStatus_RGStatus
{
  putvalue(P_FSG_50_0_0_17_1, getvalue(this));
}

on envVar mci_NavigationSD_DistanceToNextManeuver_StatusBTN
{
  if (@this == 1)
  {
    putvalue(P_FSG_50_0_0_18Status_BTN, 1);
    setTimer(tP_FSG_50_0_0_18Status_BTN, 100);
  }
}

on timer tP_FSG_50_0_0_18Status_BTN
{
  putvalue(P_FSG_50_0_0_18Status_BTN, 0);
  putvalue(mci_NavigationSD_DistanceToNextManeuver_StatusBTN, 0);
  cancelTimer(tP_FSG_50_0_0_18Status_BTN);
}

on envVar mci_NavigationSD_DistanceToNextManeuver_DistanceToNextManeuver_Distance
{
  putvalue(P_FSG_50_0_0_18_1_Distance, getvalue(this));
}

on envVar mci_NavigationSD_DistanceToNextManeuver_DistanceToNextManeuver_Unit
{
  putvalue(P_FSG_50_0_0_18_1_Unit, getvalue(this));
}

on envVar mci_NavigationSD_DistanceToNextManeuver_BargraphInfo_BargraphOnOff
{
  putvalue(P_FSG_50_0_0_18_2_BargraphOnOff, getvalue(this));
}

on envVar mci_NavigationSD_DistanceToNextManeuver_BargraphInfo_Bargraph
{
  putvalue(P_FSG_50_0_0_18_2_Bargraph, getvalue(this));
}

on envVar mci_NavigationSD_DistanceToNextManeuver_ValidityInformation
{
  putvalue(P_FSG_50_0_0_18_3, getvalue(this));
}

on envVar mci_NavigationSD_CurrentPositionInfo_StatusBTN
{
  if (@this == 1)
  {
    putvalue(P_FSG_50_0_0_19Status_BTN, 1);
    setTimer(tP_FSG_50_0_0_19Status_BTN, 100);
  }
}

on timer tP_FSG_50_0_0_19Status_BTN
{
  putvalue(P_FSG_50_0_0_19Status_BTN, 0);
  putvalue(mci_NavigationSD_CurrentPositionInfo_StatusBTN, 0);
  cancelTimer(tP_FSG_50_0_0_19Status_BTN);
}

on envVar mci_NavigationSD_CurrentPositionInfo_PositionInfo
{
  int i=0;
  char ctmp[97];
  byte btmp[97];
  int len;
  len = getvaluesize(this)-1;
  getvalue(this, ctmp);
  for(i=0; i<97; i++) {
    if(i>=len)
      btmp[i] = 0;
    else
      btmp[i] = (byte)ctmp[i];
  }
  putvalue(P_FSG_50_0_0_19_1, btmp, len);
}

on envVar mci_NavigationSD_TurnToInfo_StatusBTN
{
  if (@this == 1)
  {
    putvalue(P_FSG_50_0_0_20Status_BTN, 1);
    setTimer(tP_FSG_50_0_0_20Status_BTN, 100);
  }
}

on timer tP_FSG_50_0_0_20Status_BTN
{
  putvalue(P_FSG_50_0_0_20Status_BTN, 0);
  putvalue(mci_NavigationSD_TurnToInfo_StatusBTN, 0);
  cancelTimer(tP_FSG_50_0_0_20Status_BTN);
}

on envVar mci_NavigationSD_TurnToInfo_TurnToInfo
{
  int i=0;
  char ctmp[107];
  byte btmp[107];
  int len;
  len = getvaluesize(this)-1;
  getvalue(this, ctmp);
  for(i=0; i<107; i++) {
    if(i>=len)
      btmp[i] = 0;
    else
      btmp[i] = (byte)ctmp[i];
  }
  putvalue(P_FSG_50_0_0_20_1, btmp, len);
}

on envVar mci_NavigationSD_TurnToInfo_SignPost
{
  int i=0;
  char ctmp[107];
  byte btmp[107];
  int len;
  len = getvaluesize(this)-1;
  getvalue(this, ctmp);
  for(i=0; i<107; i++) {
    if(i>=len)
      btmp[i] = 0;
    else
      btmp[i] = (byte)ctmp[i];
  }
  putvalue(P_FSG_50_0_0_20_2, btmp, len);
}

on envVar mci_NavigationSD_DistanceToDestination_StatusBTN
{
  if (@this == 1)
  {
    putvalue(P_FSG_50_0_0_21Status_BTN, 1);
    setTimer(tP_FSG_50_0_0_21Status_BTN, 100);
  }
}

on timer tP_FSG_50_0_0_21Status_BTN
{
  putvalue(P_FSG_50_0_0_21Status_BTN, 0);
  putvalue(mci_NavigationSD_DistanceToDestination_StatusBTN, 0);
  cancelTimer(tP_FSG_50_0_0_21Status_BTN);
}

on envVar mci_NavigationSD_DistanceToDestination_DistanceToDestination_Distance
{
  putvalue(P_FSG_50_0_0_21_1_Distance, getvalue(this));
}

on envVar mci_NavigationSD_DistanceToDestination_DistanceToDestination_Unit
{
  putvalue(P_FSG_50_0_0_21_1_Unit, getvalue(this));
}

on envVar mci_NavigationSD_DistanceToDestination_ValidityInformation
{
  putvalue(P_FSG_50_0_0_21_2, getvalue(this));
}

on envVar mci_NavigationSD_TimeToDestination_StatusBTN
{
  if (@this == 1)
  {
    putvalue(P_FSG_50_0_0_22Status_BTN, 1);
    setTimer(tP_FSG_50_0_0_22Status_BTN, 100);
  }
}

on timer tP_FSG_50_0_0_22Status_BTN
{
  putvalue(P_FSG_50_0_0_22Status_BTN, 0);
  putvalue(mci_NavigationSD_TimeToDestination_StatusBTN, 0);
  cancelTimer(tP_FSG_50_0_0_22Status_BTN);
}

on envVar mci_NavigationSD_TimeToDestination_TimeInfo_TimeInfoType
{
  putvalue(P_FSG_50_0_0_22_1_TimeInfoType, getvalue(this));
}

on envVar mci_NavigationSD_TimeToDestination_TimeInfo_NavigationTimeFormat
{
  putvalue(P_FSG_50_0_0_22_1_NavigationTimeFormat, getvalue(this));
}

on envVar mci_NavigationSD_TimeToDestination_TimeInfo_Minute
{
  putvalue(P_FSG_50_0_0_22_1_Minute, getvalue(this));
}

on envVar mci_NavigationSD_TimeToDestination_TimeInfo_Hour
{
  putvalue(P_FSG_50_0_0_22_1_Hour, getvalue(this));
}

on envVar mci_NavigationSD_TimeToDestination_TimeInfo_Day
{
  putvalue(P_FSG_50_0_0_22_1_Day, getvalue(this));
}

on envVar mci_NavigationSD_TimeToDestination_TimeInfo_Month
{
  putvalue(P_FSG_50_0_0_22_1_Month, getvalue(this));
}

on envVar mci_NavigationSD_TimeToDestination_TimeInfo_Year
{
  putvalue(P_FSG_50_0_0_22_1_Year, getvalue(this));
}

on envVar mci_NavigationSD_TimeToDestination_ValidityInformation
{
  putvalue(P_FSG_50_0_0_22_2, getvalue(this));
}

on envVar mci_NavigationSD_ManeuverDescriptor_StatusBTN
{
  if (@this == 1)
  {
    putvalue(P_FSG_50_0_0_23Status_BTN, 1);
    setTimer(tP_FSG_50_0_0_23Status_BTN, 100);
  }
}

on timer tP_FSG_50_0_0_23Status_BTN
{
  putvalue(P_FSG_50_0_0_23Status_BTN, 0);
  putvalue(mci_NavigationSD_ManeuverDescriptor_StatusBTN, 0);
  cancelTimer(tP_FSG_50_0_0_23Status_BTN);
}

on envVar mci_NavigationSD_ManeuverDescriptor_Maneuver1_MainElement
{
  putvalue(P_FSG_50_0_0_23_1_MainElement, getvalue(this));
}

on envVar mci_NavigationSD_ManeuverDescriptor_Maneuver1_Direction
{
  putvalue(P_FSG_50_0_0_23_1_Direction, getvalue(this));
}

on envVar mci_NavigationSD_ManeuverDescriptor_Maneuver1_ZLevelGuidance
{
  putvalue(P_FSG_50_0_0_23_1_Z_LevelGuidance, getvalue(this));
}

/*on envVar mci_NavigationSD_ManeuverDescriptor_Maneuver1_Sidestreets
{
  int i=0;
  char ctmp[60];
  byte btmp[60];
  int len;
  len = getvaluesize(this)-1;
  getvalue(this, ctmp);
  for(i=0; i<60; i++) {
    if(i>=len)
      btmp[i] = 0;
    else
      btmp[i] = (byte)ctmp[i];
  }
  putvalue(P_FSG_50_0_0_23_1_Sidestreets, btmp, len);
}*/


on envVar mci_NavigationSD_ManeuverDescriptor_Maneuver1_Sidestreets
{
  int i=0,j=0;
  char ctmp[120];
  byte btmp[120];
  int len;
  
  // String auslesen
  getvalue(this, ctmp);
  
  //Länge auslesen
  len = getvaluesize(this);
 
  // String auswerten
  if (len !=0)
  {
    for (i=0;i<=len;i++)
    {
      // 0...9
      if (ctmp[i] >= 0x30 && ctmp[i] <= 0x39) 
      {
        if(ctmp[i+1] == 0x30)
          {
            btmp[j++] = (ctmp[i]-48)*16;
          }
          
        else
          {
            btmp[j++] = (ctmp[i]-48)*16 + (ctmp[i+1]-48);
          }
          
        i++;
      }
      
      // A...F
      if (ctmp[i] >= 0x41 && ctmp[i] <= 0x46)
      {
        if(ctmp[i+1] == 0x30)
          {
            btmp[j++] = ((ctmp[i]-55)*16);
          }
          
        else
          {
            btmp[j++] = ((ctmp[i]-55)*16) + (ctmp[i+1]-48);
          }
          
        i++;
         
      }
      
      // a...f
      if (ctmp[i] >= 0x61 && ctmp[i] <= 0x66)
      {
        if(ctmp[i+1] == 0x30)
          {
            btmp[j++] = ((ctmp[i]-87)*16);
          }
          
        else
          {
            btmp[j++] = ((ctmp[i]-87)*16) + (ctmp[i+1]-87);
          }
          
        i++;
      }
    }
  }
  putvalue(P_FSG_50_0_0_23_1_Sidestreets, btmp, (len-1)/2);
  j=0;
}

on envVar mci_NavigationSD_ManeuverDescriptor_Maneuver2_MainElement
{
  putvalue(P_FSG_50_0_0_23_2_MainElement, getvalue(this));
}

on envVar mci_NavigationSD_ManeuverDescriptor_Maneuver2_Direction
{
  putvalue(P_FSG_50_0_0_23_2_Direction, getvalue(this));
}

on envVar mci_NavigationSD_ManeuverDescriptor_Maneuver2_ZLevelGuidance
{
  putvalue(P_FSG_50_0_0_23_2_Z_LevelGuidance, getvalue(this));
}

on envVar mci_NavigationSD_ManeuverDescriptor_Maneuver2_Sidestreets
{
  int i=0;
  char ctmp[60];
  byte btmp[60];
  int len;
  len = getvaluesize(this)-1;
  getvalue(this, ctmp);
  for(i=0; i<60; i++) {
    if(i>=len)
      btmp[i] = 0;
    else
      btmp[i] = (byte)ctmp[i];
  }
  putvalue(P_FSG_50_0_0_23_2_Sidestreets, btmp, len);
}

on envVar mci_NavigationSD_ManeuverDescriptor_Maneuver3_MainElement
{
  putvalue(P_FSG_50_0_0_23_3_MainElement, getvalue(this));
}

on envVar mci_NavigationSD_ManeuverDescriptor_Maneuver3_Direction
{
  putvalue(P_FSG_50_0_0_23_3_Direction, getvalue(this));
}

on envVar mci_NavigationSD_ManeuverDescriptor_Maneuver3_ZLevelGuidance
{
  putvalue(P_FSG_50_0_0_23_3_Z_LevelGuidance, getvalue(this));
}

on envVar mci_NavigationSD_ManeuverDescriptor_Maneuver3_Sidestreets
{
  int i=0;
  char ctmp[60];
  byte btmp[60];
  int len;
  len = getvaluesize(this)-1;
  getvalue(this, ctmp);
  for(i=0; i<60; i++) {
    if(i>=len)
      btmp[i] = 0;
    else
      btmp[i] = (byte)ctmp[i];
  }
  putvalue(P_FSG_50_0_0_23_3_Sidestreets, btmp, len);
}

on envVar mci_NavigationSD_TMCInfo_StatusBTN
{
  if (@this == 1)
  {
    putvalue(P_FSG_50_0_0_25Status_BTN, 1);
    setTimer(tP_FSG_50_0_0_25Status_BTN, 100);
  }
}

on timer tP_FSG_50_0_0_25Status_BTN
{
  putvalue(P_FSG_50_0_0_25Status_BTN, 0);
  putvalue(mci_NavigationSD_TMCInfo_StatusBTN, 0);
  cancelTimer(tP_FSG_50_0_0_25Status_BTN);
}

on envVar mci_NavigationSD_TMCInfo_MessageID
{
  putvalue(P_FSG_50_0_0_25_1, getvalue(this));
}

on envVar mci_NavigationSD_TMCInfo_MessageStatus
{
  putvalue(P_FSG_50_0_0_25_2, getvalue(this));
}

on envVar mci_NavigationSD_TMCInfo_MessageWaitingIndication
{
  putvalue(P_FSG_50_0_0_25_3, getvalue(this));
}

on envVar mci_NavigationSD_TMCInfo_TMCInfo_Priority
{
  putvalue(P_FSG_50_0_0_25_4_Priority, getvalue(this));
}

on envVar mci_NavigationSD_TMCInfo_TMCInfo_StreetName
{
  int i=0;
  char ctmp[252];
  byte btmp[252];
  int len;
  len = getvaluesize(this)-1;
  getvalue(this, ctmp);
  for(i=0; i<252; i++) {
    if(i>=len)
      btmp[i] = 0;
    else
      btmp[i] = (byte)ctmp[i];
  }
  putvalue(P_FSG_50_0_0_25_4_StreetName, btmp, len);
}

on envVar mci_NavigationSD_TMCInfo_TMCInfo_Location
{
  int i=0;
  char ctmp[252];
  byte btmp[252];
  int len;
  len = getvaluesize(this)-1;
  getvalue(this, ctmp);
  for(i=0; i<252; i++) {
    if(i>=len)
      btmp[i] = 0;
    else
      btmp[i] = (byte)ctmp[i];
  }
  putvalue(P_FSG_50_0_0_25_4_Location, btmp, len);
}

on envVar mci_NavigationSD_TMCInfo_TMCInfo_Infotext
{
  int i=0;
  char ctmp[252];
  byte btmp[252];
  int len;
  len = getvaluesize(this)-1;
  getvalue(this, ctmp);
  for(i=0; i<252; i++) {
    if(i>=len)
      btmp[i] = 0;
    else
      btmp[i] = (byte)ctmp[i];
  }
  putvalue(P_FSG_50_0_0_25_4_Infotext, btmp, len);
}

on envVar mci_NavigationSD_TMCInfo_TMCInfo_LengthValidity
{
  putvalue(P_FSG_50_0_0_25_4_Length_Validity, getvalue(this));
}

on envVar mci_NavigationSD_TMCInfo_TMCInfo_LengthValue
{
  putvalue(P_FSG_50_0_0_25_4_Length_Value, getvalue(this));
}

on envVar mci_NavigationSD_TMCInfo_TMCInfo_LengthUnit
{
  putvalue(P_FSG_50_0_0_25_4_Length_Unit, getvalue(this));
}

on envVar mci_NavigationSD_MagnetFieldZone_StatusBTN
{
  if (@this == 1)
  {
    putvalue(P_FSG_50_0_0_26Status_BTN, 1);
    setTimer(tP_FSG_50_0_0_26Status_BTN, 100);
  }
}

on timer tP_FSG_50_0_0_26Status_BTN
{
  putvalue(P_FSG_50_0_0_26Status_BTN, 0);
  putvalue(mci_NavigationSD_MagnetFieldZone_StatusBTN, 0);
  cancelTimer(tP_FSG_50_0_0_26Status_BTN);
}

on envVar mci_NavigationSD_MagnetFieldZone_Zone
{
  putvalue(P_FSG_50_0_0_26_1, getvalue(this));
}

on envVar mci_NavigationSD_Calibration_StatusBTN
{
  if (@this == 1)
  {
    putvalue(P_FSG_50_0_0_27Status_BTN, 1);
    setTimer(tP_FSG_50_0_0_27Status_BTN, 100);
  }
}

on timer tP_FSG_50_0_0_27Status_BTN
{
  putvalue(P_FSG_50_0_0_27Status_BTN, 0);
  putvalue(mci_NavigationSD_Calibration_StatusBTN, 0);
  cancelTimer(tP_FSG_50_0_0_27Status_BTN);
}

on envVar mci_NavigationSD_Calibration_CalibrationState
{
  putvalue(P_FSG_50_0_0_27_1, getvalue(this));
}

on envVar mci_NavigationSD_ASGCapabilities_StatusBTN
{
  if (@this == 1)
  {
    putvalue(P_FSG_50_0_0_28Status_BTN, 1);
    setTimer(tP_FSG_50_0_0_28Status_BTN, 100);
  }
}

on timer tP_FSG_50_0_0_28Status_BTN
{
  putvalue(P_FSG_50_0_0_28Status_BTN, 0);
  putvalue(mci_NavigationSD_ASGCapabilities_StatusBTN, 0);
  cancelTimer(tP_FSG_50_0_0_28Status_BTN);
}

on envVar mci_NavigationSD_ASGCapabilities_PresentationCapabilities
{
  putvalue(P_FSG_50_0_0_28_1, getvalue(this));
}

on envVar mci_NavigationSD_ASGCapabilities_FurtherCapabilities
{
  putvalue(P_FSG_50_0_0_28_2, getvalue(this));
}

on envVar mci_NavigationSD_PreferredDestList_StatusBTN
{
  if (@this == 1)
  {
    putvalue(P_FSG_50_0_0_31Status_BTN, 1);
    setTimer(tP_FSG_50_0_0_31Status_BTN, 100);
  }
}

on timer tP_FSG_50_0_0_31Status_BTN
{
  putvalue(P_FSG_50_0_0_31Status_BTN, 0);
  putvalue(mci_NavigationSD_PreferredDestList_StatusBTN, 0);
  cancelTimer(tP_FSG_50_0_0_31Status_BTN);
}

on envVar mci_NavigationSD_PreferredDestList_ListType
{
  putvalue(P_FSG_50_0_0_31_1, getvalue(this));
}

on envVar mci_NavigationSD_VoiceGuidance_StatusBTN
{
  if (@this == 1)
  {
    putvalue(P_FSG_50_0_0_36Status_BTN, 1);
    setTimer(tP_FSG_50_0_0_36Status_BTN, 100);
  }
}

on timer tP_FSG_50_0_0_36Status_BTN
{
  putvalue(P_FSG_50_0_0_36Status_BTN, 0);
  putvalue(mci_NavigationSD_VoiceGuidance_StatusBTN, 0);
  cancelTimer(tP_FSG_50_0_0_36Status_BTN);
}

on envVar mci_NavigationSD_VoiceGuidance_VoiceGuidanceState
{
  putvalue(P_FSG_50_0_0_36_1, getvalue(this));
}

on envVar mci_NavigationSD_FunctionSynchronisation_StatusBTN
{
  if (@this == 1)
  {
    putvalue(P_FSG_50_0_0_37Status_BTN, 1);
    setTimer(tP_FSG_50_0_0_37Status_BTN, 100);
  }
}

on timer tP_FSG_50_0_0_37Status_BTN
{
  putvalue(P_FSG_50_0_0_37Status_BTN, 0);
  putvalue(mci_NavigationSD_FunctionSynchronisation_StatusBTN, 0);
  cancelTimer(tP_FSG_50_0_0_37Status_BTN);
}

on envVar mci_NavigationSD_FunctionSynchronisation_FctList1
{
  int i=0;
  char ctmp[6];
  byte btmp[6];
  int len;
  len = getvaluesize(this)-1;
  getvalue(this, ctmp);
  for(i=0; i<6; i++) {
    if(i>=len)
      btmp[i] = 0;
    else
      btmp[i] = (byte)ctmp[i];
  }
  putvalue(P_FSG_50_0_0_37_1, btmp, len);
}

on envVar mci_NavigationSD_FunctionSynchronisation_FctList2
{
  putvalue(P_FSG_50_0_0_37_2, getvalue(this));
}

on envVar mci_NavigationSD_FunctionSynchronisation_FctList3
{
  putvalue(P_FSG_50_0_0_37_3, getvalue(this));
}

on envVar mci_NavigationSD_InfoStates_StatusBTN
{
  if (@this == 1)
  {
    putvalue(P_FSG_50_0_0_38Status_BTN, 1);
    setTimer(tP_FSG_50_0_0_38Status_BTN, 100);
  }
}

on timer tP_FSG_50_0_0_38Status_BTN
{
  putvalue(P_FSG_50_0_0_38Status_BTN, 0);
  putvalue(mci_NavigationSD_InfoStates_StatusBTN, 0);
  cancelTimer(tP_FSG_50_0_0_38Status_BTN);
}

on envVar mci_NavigationSD_InfoStates_States
{
  putvalue(P_FSG_50_0_0_38_1, getvalue(this));
}

on envVar mci_NavigationSD_ActiveRgType_StatusBTN
{
  if (@this == 1)
  {
    putvalue(P_FSG_50_0_0_39Status_BTN, 1);
    setTimer(tP_FSG_50_0_0_39Status_BTN, 100);
  }
}

on timer tP_FSG_50_0_0_39Status_BTN
{
  putvalue(P_FSG_50_0_0_39Status_BTN, 0);
  putvalue(mci_NavigationSD_ActiveRgType_StatusBTN, 0);
  cancelTimer(tP_FSG_50_0_0_39Status_BTN);
}

on envVar mci_NavigationSD_ActiveRgType_RGType
{
  putvalue(P_FSG_50_0_0_39_1, getvalue(this));
}

on envVar mci_NavigationSD_TrafficBlockIndication_StatusBTN
{
  if (@this == 1)
  {
    putvalue(P_FSG_50_0_0_40Status_BTN, 1);
    setTimer(tP_FSG_50_0_0_40Status_BTN, 100);
  }
}

on timer tP_FSG_50_0_0_40Status_BTN
{
  putvalue(P_FSG_50_0_0_40Status_BTN, 0);
  putvalue(mci_NavigationSD_TrafficBlockIndication_StatusBTN, 0);
  cancelTimer(tP_FSG_50_0_0_40Status_BTN);
}

on envVar mci_NavigationSD_TrafficBlockIndication_TMCSymbol
{
  putvalue(P_FSG_50_0_0_40_1, getvalue(this));
}

on envVar mci_NavigationSD_MapColorAndType_StatusBTN
{
  if (@this == 1)
  {
    putvalue(P_FSG_50_0_0_43Status_BTN, 1);
    setTimer(tP_FSG_50_0_0_43Status_BTN, 100);
  }
}

on timer tP_FSG_50_0_0_43Status_BTN
{
  putvalue(P_FSG_50_0_0_43Status_BTN, 0);
  putvalue(mci_NavigationSD_MapColorAndType_StatusBTN, 0);
  cancelTimer(tP_FSG_50_0_0_43Status_BTN);
}

on envVar mci_NavigationSD_MapColorAndType_Colour
{
  putvalue(P_FSG_50_0_0_43_1, getvalue(this));
}

on envVar mci_NavigationSD_MAPViewAndOrientation_StatusBTN
{
  if (@this == 1)
  {
    putvalue(P_FSG_50_0_0_44Status_BTN, 1);
    setTimer(tP_FSG_50_0_0_44Status_BTN, 100);
  }
}

on timer tP_FSG_50_0_0_44Status_BTN
{
  putvalue(P_FSG_50_0_0_44Status_BTN, 0);
  putvalue(mci_NavigationSD_MAPViewAndOrientation_StatusBTN, 0);
  cancelTimer(tP_FSG_50_0_0_44Status_BTN);
}

on envVar mci_NavigationSD_MAPViewAndOrientation_MapView
{
  putvalue(P_FSG_50_0_0_44_1, getvalue(this));
}

on envVar mci_NavigationSD_MAPViewAndOrientation_SupplementaryMapView
{
  putvalue(P_FSG_50_0_0_44_2, getvalue(this));
}

on envVar mci_NavigationSD_MapScale_StatusBTN
{
  if (@this == 1)
  {
    putvalue(P_FSG_50_0_0_45Status_BTN, 1);
    setTimer(tP_FSG_50_0_0_45Status_BTN, 100);
  }
}

on timer tP_FSG_50_0_0_45Status_BTN
{
  putvalue(P_FSG_50_0_0_45Status_BTN, 0);
  putvalue(mci_NavigationSD_MapScale_StatusBTN, 0);
  cancelTimer(tP_FSG_50_0_0_45Status_BTN);
}

on envVar mci_NavigationSD_MapScale_Steps
{
  putvalue(P_FSG_50_0_0_45_1, getvalue(this));
}

on envVar mci_NavigationSD_MapScale_Scale
{
  putvalue(P_FSG_50_0_0_45_2, getvalue(this));
}

on envVar mci_NavigationSD_DestinationInfo_StatusBTN
{
  if (@this == 1)
  {
    putvalue(P_FSG_50_0_0_46Status_BTN, 1);
    setTimer(tP_FSG_50_0_0_46Status_BTN, 100);
  }
}

on timer tP_FSG_50_0_0_46Status_BTN
{
  putvalue(P_FSG_50_0_0_46Status_BTN, 0);
  putvalue(mci_NavigationSD_DestinationInfo_StatusBTN, 0);
  cancelTimer(tP_FSG_50_0_0_46Status_BTN);
}

on envVar mci_NavigationSD_DestinationInfo_Position_Latitude
{
  putvalue(P_FSG_50_0_0_46_1_Latitude, getvalue(this));
}

on envVar mci_NavigationSD_DestinationInfo_Position_Longitude
{
  putvalue(P_FSG_50_0_0_46_1_Longitude, getvalue(this));
}

on envVar mci_NavigationSD_Altitude_StatusBTN
{
  if (@this == 1)
  {
    putvalue(P_FSG_50_0_0_47Status_BTN, 1);
    setTimer(tP_FSG_50_0_0_47Status_BTN, 100);
  }
}

on timer tP_FSG_50_0_0_47Status_BTN
{
  putvalue(P_FSG_50_0_0_47Status_BTN, 0);
  putvalue(mci_NavigationSD_Altitude_StatusBTN, 0);
  cancelTimer(tP_FSG_50_0_0_47Status_BTN);
}

on envVar mci_NavigationSD_Altitude_Altitude
{
  putvalue(P_FSG_50_0_0_47_1, getvalue(this));
}

on envVar mci_NavigationSD_Altitude_Unit
{
  putvalue(P_FSG_50_0_0_47_2, getvalue(this));
}

on envVar mci_NavigationSD_OnlineNavigationState_StatusBTN
{
  if (@this == 1)
  {
    putvalue(P_FSG_50_0_0_48Status_BTN, 1);
    setTimer(tP_FSG_50_0_0_48Status_BTN, 100);
  }
}

on timer tP_FSG_50_0_0_48Status_BTN
{
  putvalue(P_FSG_50_0_0_48Status_BTN, 0);
  putvalue(mci_NavigationSD_OnlineNavigationState_StatusBTN, 0);
  cancelTimer(tP_FSG_50_0_0_48Status_BTN);
}

on envVar mci_NavigationSD_OnlineNavigationState_State
{
  putvalue(P_FSG_50_0_0_48_1, getvalue(this));
}

on envVar mci_NavigationSD_OnlineNavigationState_Progress
{
  putvalue(P_FSG_50_0_0_48_2, getvalue(this));
}

on envVar mci_NavigationSD_OnlineNavigationState_OnlineNavigationSystem
{
  putvalue(P_FSG_50_0_0_48_3, getvalue(this));
}

on envVar mci_NavigationSD_Exitview_StatusBTN
{
  if (@this == 1)
  {
    putvalue(P_FSG_50_0_0_49Status_BTN, 1);
    setTimer(tP_FSG_50_0_0_49Status_BTN, 100);
  }
}

on timer tP_FSG_50_0_0_49Status_BTN
{
  putvalue(P_FSG_50_0_0_49Status_BTN, 0);
  putvalue(mci_NavigationSD_Exitview_StatusBTN, 0);
  cancelTimer(tP_FSG_50_0_0_49Status_BTN);
}

on envVar mci_NavigationSD_Exitview_Variant
{
  putvalue(P_FSG_50_0_0_49_1, getvalue(this));
}

on envVar mci_NavigationSD_Exitview_ExitviewID
{
  putvalue(P_FSG_50_0_0_49_2, getvalue(this));
}

on envVar mci_NavigationSD_SemidynamicRouteGuidance_StatusBTN
{
  if (@this == 1)
  {
    putvalue(P_FSG_50_0_0_50Status_BTN, 1);
    setTimer(tP_FSG_50_0_0_50Status_BTN, 100);
  }
}

on timer tP_FSG_50_0_0_50Status_BTN
{
  putvalue(P_FSG_50_0_0_50Status_BTN, 0);
  putvalue(mci_NavigationSD_SemidynamicRouteGuidance_StatusBTN, 0);
  cancelTimer(tP_FSG_50_0_0_50Status_BTN);
}

on envVar mci_NavigationSD_SemidynamicRouteGuidance_TrafficImpact
{
  putvalue(P_FSG_50_0_0_50_1, getvalue(this));
}

on envVar mci_NavigationSD_SemidynamicRouteGuidance_Delay_Minute
{
  putvalue(P_FSG_50_0_0_50_2_Minute, getvalue(this));
}

on envVar mci_NavigationSD_SemidynamicRouteGuidance_Delay_Hour
{
  putvalue(P_FSG_50_0_0_50_2_Hour, getvalue(this));
}



//////////////// MFL ////////////////

on envVar mci_MFLConfig_Panel
{
    putvalue(ON_OFF_FSG52_0, getvalue(this)); 
}

on envVar mci_MFLConfig_FSGOperationState_StatusBTN
{
  if (@this == 1)
  {
    putvalue(P_FSG_52_0_0_15Status_BTN, 1);
    setTimer(tP_FSG_52_0_0_15Status_BTN, 100);
  }
}

on timer tP_FSG_52_0_0_15Status_BTN
{
  putvalue(P_FSG_52_0_0_15Status_BTN, 0);
  putvalue(mci_MFLConfig_FSGOperationState_StatusBTN, 0);
  cancelTimer(tP_FSG_52_0_0_15Status_BTN);
}

on envVar mci_MFLConfig_FSGOperationState_OPState
{
  putvalue(P_FSG_52_0_0_15_1, getvalue(this));
}

on envVar mci_MFLConfig_InstrumentClusterFunctions_StatusBTN
{
  if (@this == 1)
  {
    putvalue(P_FSG_52_0_0_16Status_BTN, 1);
    setTimer(tP_FSG_52_0_0_16Status_BTN, 100);
  }
}

on timer tP_FSG_52_0_0_16Status_BTN
{
  putvalue(P_FSG_52_0_0_16Status_BTN, 0);
  putvalue(mci_MFLConfig_InstrumentClusterFunctions_StatusBTN, 0);
  cancelTimer(tP_FSG_52_0_0_16Status_BTN);
}

on envVar mci_MFLConfig_InstrumentClusterFunctions_ConfigurationOptions
{
  putvalue(P_FSG_52_0_0_16_1, getvalue(this));
}

on envVar mci_MFLConfig_KeyConfiguration_StatusBTN
{
  if (@this == 1)
  {
    putvalue(P_FSG_52_0_0_17Status_BTN, 1);
    setTimer(tP_FSG_52_0_0_17Status_BTN, 100);
  }
}

on timer tP_FSG_52_0_0_17Status_BTN
{
  putvalue(P_FSG_52_0_0_17Status_BTN, 0);
  putvalue(mci_MFLConfig_KeyConfiguration_StatusBTN, 0);
  cancelTimer(tP_FSG_52_0_0_17Status_BTN);
}

on envVar mci_MFLConfig_KeyConfiguration_ConfigKey1
{
  putvalue(P_FSG_52_0_0_17_1, getvalue(this));
}

on envVar mci_MFLConfig_KeyConfiguration_ConfigKey2
{
  putvalue(P_FSG_52_0_0_17_2, getvalue(this));
}

on envVar mci_MFLConfig_KeyConfiguration_ConfigKey3
{
  putvalue(P_FSG_52_0_0_17_3, getvalue(this));
}

on envVar mci_MFLConfig_KeyConfiguration_ConfigKey4
{
  putvalue(P_FSG_52_0_0_17_4, getvalue(this));
}

on envVar mci_MFLConfig_KeyConfiguration_ConfigKey5
{
  putvalue(P_FSG_52_0_0_17_5, getvalue(this));
}

on envVar mci_MFLConfig_KeyAction_StatusBTN
{
  if (@this == 1)
  {
    putvalue(P_FSG_52_0_0_18Status_BTN, 1);
    setTimer(tP_FSG_52_0_0_18Status_BTN, 100);
  }
}

on timer tP_FSG_52_0_0_18Status_BTN
{
  putvalue(P_FSG_52_0_0_18Status_BTN, 0);
  putvalue(mci_MFLConfig_KeyAction_StatusBTN, 0);
  cancelTimer(tP_FSG_52_0_0_18Status_BTN);
}

on envVar mci_MFLConfig_KeyAction_FSGActionKey1
{
  putvalue(P_FSG_52_0_0_18_1, getvalue(this));
}

on envVar mci_MFLConfig_KeyAction_FSGActionKey2
{
  putvalue(P_FSG_52_0_0_18_2, getvalue(this));
}

on envVar mci_MFLConfig_KeyAction_FSGKeyNoFunc
{
  putvalue(P_FSG_52_0_0_18_3, getvalue(this));
}






//////////////// Online Functions ////////////////

on envVar mci_OnlineFunctions_FSGOperationState_StatusBTN
{
  if (@this == 1)
  {
    putvalue(P_FSG_42_0_0_15Status_BTN, 1);
    setTimer(tP_FSG_42_0_0_15Status_BTN, 100);
  }
}

on timer tP_FSG_42_0_0_15Status_BTN
{
  putvalue(P_FSG_42_0_0_15Status_BTN, 0);
  putvalue(mci_OnlineFunctions_FSGOperationState_StatusBTN, 0);
  cancelTimer(tP_FSG_42_0_0_15Status_BTN);
}

on envVar mci_OnlineFunctions_FSGOperationState_OPState
{
  putvalue(P_FSG_42_0_0_15_1, getvalue(this));
}

on envVar mci_OnlineFunctions_TrafficLightOnlineInfo_StatusBTN
{
  if (@this == 1)
  {
    putvalue(P_FSG_42_0_0_16Status_BTN, 1);
    setTimer(tP_FSG_42_0_0_16Status_BTN, 100);
  }
}

on timer tP_FSG_42_0_0_16Status_BTN
{
  putvalue(P_FSG_42_0_0_16Status_BTN, 0);
  putvalue(mci_OnlineFunctions_TrafficLightOnlineInfo_StatusBTN, 0);
  cancelTimer(tP_FSG_42_0_0_16Status_BTN);
}

on envVar mci_OnlineFunctions_TrafficLightOnlineInfo_TrafficState
{
  putvalue(P_FSG_42_0_0_16_1, getvalue(this));
}

on envVar mci_OnlineFunctions_TrafficLightOnlineInfo_MainDirection
{
  putvalue(P_FSG_42_0_0_16_2, getvalue(this));
}

on envVar mci_OnlineFunctions_TrafficLightOnlineInfo_Sidestreets
{
  int i=0,j=0;
  char ctmp[120];
  byte btmp[120];
  int len;
  byte high, low;
  
  // String auslesen
  getvalue(this, ctmp);
  
  //Länge auslesen
  len = getvaluesize(this);
 
  // String auswerten
  if (len !=0)
  {
   for (i=0;i<=len;i++)
    {
      // high nibble
      if (ctmp[i] >= 0x30 && ctmp[i] <= 0x39) // 0...9
      {
        high = (ctmp[i]-0x30);
      }
      if (ctmp[i] >= 0x41 && ctmp[i] <= 0x46) // A...F
      {
        high = (ctmp[i]-0x37);
      }
      if (ctmp[i] >= 0x61 && ctmp[i] <= 0x66) // a...f
      {
        high = (ctmp[i]-0x57);
      }
      // low nibble
      if (ctmp[i+1] >= 0x30 && ctmp[i+1] <= 0x39) // 0...9
      {
        low = (ctmp[i+1]-0x30) & 0x0F;
      }
      if (ctmp[i+1] >= 0x41 && ctmp[i+1] <= 0x46) // A...F
      {
        low = (ctmp[i+1]-0x37) & 0x0F;
      }
      if (ctmp[i+1] >= 0x61 && ctmp[i+1] <= 0x66) // a...f
      {
        low = (ctmp[i+1]-0x57) & 0x0F;
      }
      
      //writelineex(4,0,"high: %x / low: %x",high,low);
      btmp[j++] = (high * 16) + low;
        
      i++;
    }
  }
  putvalue(P_FSG_42_0_0_16_3, btmp, (len-1)/2);
  j=0;
}

on envVar mci_OnlineFunctions_TrafficLightOnlineInfo_TrafficLightWarnings
{
  putvalue(P_FSG_42_0_0_16_4, getvalue(this));
}

on envVar mci_OnlineFunctions_TrafficLightOnlineInfo_TrafficLightLayout
{
  putvalue(P_FSG_42_0_0_16_5, getvalue(this));
}

on envVar mci_OnlineFunctions_TrafficLightOnlineSpeed_StatusBTN
{
  if (@this == 1)
  {
    putvalue(P_FSG_42_0_0_17Status_BTN, 1);
    setTimer(tP_FSG_42_0_0_17Status_BTN, 100);
  }
}

on timer tP_FSG_42_0_0_17Status_BTN
{
  putvalue(P_FSG_42_0_0_17Status_BTN, 0);
  putvalue(mci_OnlineFunctions_TrafficLightOnlineSpeed_StatusBTN, 0);
  cancelTimer(tP_FSG_42_0_0_17Status_BTN);
}

on envVar mci_OnlineFunctions_TrafficLightOnlineSpeed_RecommendedSpeed
{
  putvalue(P_FSG_42_0_0_17_1, getvalue(this));
}

on envVar mci_OnlineFunctions_TrafficLightOnlineSpeed_Unit
{
  putvalue(P_FSG_42_0_0_17_2, getvalue(this));
}

on envVar mci_OnlineFunctions_TrafficLightOnlineSpeed_ValidityInformation
{
  putvalue(P_FSG_42_0_0_17_3, getvalue(this));
}

on envVar mci_OnlineFunctions_TrafficLightOnlineTime_StatusBTN
{
  if (@this == 1)
  {
    putvalue(P_FSG_42_0_0_18Status_BTN, 1);
    setTimer(tP_FSG_42_0_0_18Status_BTN, 100);
  }
}

on timer tP_FSG_42_0_0_18Status_BTN
{
  putvalue(P_FSG_42_0_0_18Status_BTN, 0);
  putvalue(mci_OnlineFunctions_TrafficLightOnlineTime_StatusBTN, 0);
  cancelTimer(tP_FSG_42_0_0_18Status_BTN);
}

on envVar mci_OnlineFunctions_TrafficLightOnlineTime_TimeToGreen
{
  putvalue(P_FSG_42_0_0_18_1, getvalue(this));
}

on envVar mci_OnlineFunctions_TrafficLightOnlineTime_ValidityInformation
{
  putvalue(P_FSG_42_0_0_18_2, getvalue(this));
}

on envVar mci_OnlineFunctions_OnlineServiceSupport_StatusBTN
{
  if (@this == 1)
  {
    putvalue(P_FSG_42_0_0_19Status_BTN, 1);
    setTimer(tP_FSG_42_0_0_19Status_BTN, 100);
  }
}

on timer tP_FSG_42_0_0_19Status_BTN
{
  putvalue(P_FSG_42_0_0_19Status_BTN, 0);
  putvalue(mci_OnlineFunctions_OnlineServiceSupport_StatusBTN, 0);
  cancelTimer(tP_FSG_42_0_0_19Status_BTN);
}

on envVar mci_OnlineFunctions_OnlineServiceSupport_FctList_1
{
  putvalue(P_FSG_42_0_0_19_1, getvalue(this));
}





/////////////// Bus-Timeout ///////////////

on start
{
  settimer (Busruhe,2000);
}

on message CAN1.*
{
  canceltimer(Busruhe);
  settimer(Busruhe,2000);
  putvalue(mci_Busruhe,0);
}

on timer Busruhe
{
  putvalue(mci_Busruhe,1);
}


/////////////// Anzeige-Geschwindigkeit ///////////////

on EnvVar mci_KBI_angez_Geschw_soll
{
  putvalue(EnvKBI_V_Digital_soll,getvalue(this));
}








on key F12
{
  @mciTA_SaveImage = 1;
  settimer (mciTA_SaveImage_Reset,100);
}

on timer mciTA_SaveImage_Reset
{
  @mciTA_SaveImage = 0;
}





/////////////// Verbrauch / Rekuperation ///////////////

on EnvVar mci_Verbrauch_BMS       { @Env_Verbrauch_BMS      = @this; }
on EnvVar mci_Verbrauch_BMS_1     { @Env_Verbrauch_BMS_1    = @this; }
on EnvVar mci_Verbrauch_BMS_2     { @Env_Verbrauch_BMS_2    = @this; }
on EnvVar mci_Rekuperation_BMS    { @Env_Rekuperation_BMS   = @this; }
on EnvVar mci_Rekuperation_BMS_1  { @Env_Rekuperation_BMS_1 = @this; }
on EnvVar mci_Rekuperation_BMS_2  { @Env_Rekuperation_BMS_2 = @this; }