variables
{
    msTimer myTimer; // creates a millisecond timer    
    msTimer timer1; // define timer1
}

on key 'a' // when the 'a' key is pressed
{
    setTimer(myTimer,20); // set myTimer to 20 ms
    setTimer(timer1, 100); // initialize timer to run for 100 msec
}

on timer myTimer // when myTimer expires (after 20 ms)
{    
    setTimer(timer1, 100); // reset the timer
}