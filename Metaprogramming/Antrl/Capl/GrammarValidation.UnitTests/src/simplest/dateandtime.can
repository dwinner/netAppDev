/*@@var:*/
variables
{
mstimer systemtimetimer;




}
/*@@end*/

/*@@startStart:Start:*/
on start
{
char date [7];
char systemtime [7];
long datetime[9];
int i;
char temp[3];

	for(i=0;i<3;i++)
		temp[i]=0;

	getlocaltime(datetime);

//**************date***************************
	datetime[4]++;	//increment month
	if(datetime[5]>=100)	//later than millenium
		datetime[5]=datetime[5]-100;
	
	//day
	ltoa(datetime[3], temp, 10);
	if(datetime[3]<10){
		date[0]='0';
		date[1]=temp[0];
	}
	else{
		date[0]=temp[0];
		date[1]=temp[1];
	}
	
	//month
	for(i=0;i<3;i++)
		temp[i]=0;
	
	ltoa(datetime[4], temp, 10);
	if(datetime[4]<10){
		date[2]='0';
		date[3]=temp[0];
	}
	else{
		date[2]=temp[0];
		date[3]=temp[1];
	}

	//year
	for(i=0;i<3;i++)
		temp[i]=0;
	
	ltoa(datetime[5], temp, 10);
	if(datetime[5]<10){
		date[4]='0';
		date[5]=temp[0];
	}
	else{
		date[4]=temp[0];
		date[5]=temp[1];
	}

	//write("%s", date);
	putvalue(env_FSG_date, date);;
		
//*********************************************


//******************time***********************
	settimer(systemtimetimer, 100);









}
/*@@end*/

/*@@timer:systemtimetimer:*/
on timer systemtimetimer
{
char systemtime [7];
long datetime[9];
int i;
char temp[3];

	settimer(systemtimetimer, 1000);

	for(i=0;i<3;i++)
		temp[i]=0;

	getlocaltime(datetime);	

	//hours
	ltoa(datetime[2], temp, 10);

	if(datetime[2]<10){
		systemtime[0]='0';
		systemtime[1]=temp[0];
	}
	else{
		systemtime[0]=temp[0];
		systemtime[1]=temp[1];
	}

	//minutes
	for(i=0;i<3;i++)
		temp[i]=0;

	ltoa(datetime[1], temp, 10);

	if(datetime[1]<10){
		systemtime[2]='0';
		systemtime[3]=temp[0];
	}
	else{
		systemtime[2]=temp[0];
		systemtime[3]=temp[1];
	}

	//seconds
	for(i=0;i<3;i++)
		temp[i]=0;

	ltoa(datetime[0], temp, 10);

	if(datetime[0]<10){
		systemtime[4]='0';
		systemtime[5]=temp[0];
	}
	else{
		systemtime[4]=temp[0];
		systemtime[5]=temp[1];
	}

	//write("time: %s", systemtime);
	putvalue(env_FSG_time, systemtime);



}
/*@@end*/

