/*@@var:*/
variables 
{
/*
    ImmoTest.can  fuer  MQB
  
    V1.0  30.06.2010  A. Rexroth    Auswertung Schlüssel-ID ueber Messwert
                                    Basis "Fremdmuster-Version"
  
    V2.0  06.07.2010  A. Rexroth    Auswertung Freischaltung 
                                    - Basis Version V2.3 für (AB2, D3, RM) von Werner Sechser
                                    - Anpassung auf MQB (restl. Projekte entfernt)
                                    IS4: KL15-Wechsel nur alle 5s da solange
                                         die Schuesselberechtigung gespeichert wird!!
                                    IS5: Schluessel wird nach KL15aus sofort verworfen

*/
  char SW_version[10]="V2.0";

  // Zykluszeit KL15-Botschaft Audi und Meßzyklus Parallelport
  word zyklus = 100;                 // KL15-Zyklus [ms]
  
  // maximale Zeit für Freischaltung
  //   Zeit beginnt ab KL15ein. 
  //   Nach dieser Zeit wird die letzte Freischalt-/Schlüssel-Info übernommen.
  word timeout_freischaltung; 

  // KL15-Auswertung_CAN
  //   0: Einlesen des KL15-Status über Parallelport (für EMV-Messung SiemensVDO)
  //      und Versenden der KL15-Botschaft (0x3C0)
  //   1: Auswertung der KL15-Botschaft (0x3c0)
  byte KL15_Auswertung_CAN;

  // Zähler für Statistik
  word gut;
  word schlecht;

  // Schalter für MSG-Simulation
  byte MSG_simulation = 0;         // Freischaltanfrage simulieren!
  byte ZyklusAnfrage = 50;         // Abstand der Freischaltanfragen [ms]
  byte RndToggle=0;                // togglen der RandomNumber bei der Anfrage

  byte freischaltung = 0;          // Response = Ergebnis auf die Freischaltanfrage
  byte zyklus_laeuft = 0;

  // Portadressen Parallelport
  word adr_out = 0x378;
  word adr_in  = 0x379;
  byte maske_input = 0x40;   // /Ack
  byte output_ok   = 0x01;   // D0=1, Ausgabewert bei Freischaltung
  byte output_nok  = 0x00;   // D0=0, Ausgabewert bei fehlender Freischaltung

  byte KL15ein = 1;
  byte KL15ein_alt = 1;


  // KL15-Botschaften :
  message 0x3c0 KL15_MQB    = {DLC=4};
  message 0x010 Anfrage     = {DLC=8};

  // Timer für KL15-Botschaft
  mstimer TimerKL15;

  // Timer für MSG-Simulation
  mstimer TimerAnfrage;

  // Timer für Messzyklus
  mstimer TimerMesszyklus;

//  byte counter = 0;          // nur für Port-Test
}
/*@@end*/

/*@@startStart:Start:*/
on start
{
  write("");
  write("*************************************");
  write("*** EMV-ImmoTest    MQB           ***");
  write("*************************************");
  write("");
  write("Bitte beachten:");
  write("---------------");
  write("IS4: KL15ein-Phase muss min. 5s betragen!!");
  write("Grund: Schuesselberechtigung wird 5s gespeichert!");
  write("");
  write("IS5: keine Wartezeit notwendig! ");
  write("     (Schluessel wir mit KL15aus verworfen)");
  write("");
  write("");

  settimer(TimerKL15,zyklus);
  outport(adr_out,output_ok);

  // Vorinitialisieren der Randbedingungen
  // Beachte: hier werden Werte aus DBC gesetzt
  gut           = getValue(Env_Anzahl_iO_emv);
  schlecht      = getValue(Env_Anzahl_niO_emv);

  KL15_Auswertung_CAN         = getValue(Env_Kl15_Auswertung_CAN_emv);
  timeout_freischaltung       = getValue(Env_Freischalt_timeout_emv);

  MSG_simulation = getValue(Env_MSG_Simulation_emv);

  update();

}
/*@@end*/

/*@@msg:0x11:*/
on message 0x11 
{ // Response des KI auf Anfrage des MSG

  freischaltung = (this.byte(7) & 0x1f) == 0x1f;

  if (freischaltung)
  {
    Messzyklus_Stop();  // Ende des Messzyklus mit Gutfall!
  }

}
/*@@end*/

/*@@msg:0x3C0:*/
on message 0x3C0
{
  if (KL15_Auswertung_CAN)
    KL15ein = (this.byte(2) & 0x02) > 0;
}
/*@@end*/

/*@@timer:TimerKL15:*/
on timer TimerKL15
{
  byte in;

  if (!KL15_Auswertung_CAN)             // Auswertung Parallelport
  {
    in = inport( adr_in );
    KL15ein = (in & maske_input) != 0;  // Ack auf <>0 abfragen !  
   }

  if (!KL15ein_alt && KL15ein)
  { // steigende Flanke KL15
    Messzyklus_Start();
    if (MSG_simulation)
    { 
      settimer(TimerAnfrage,ZyklusAnfrage);
    }
  }

  if (KL15ein_alt && !KL15ein)
  {
    // fallende Flanke KL15
    Messzyklus_Stop();
  }

  if (!KL15_Auswertung_CAN)    // Auswertung über Parallelport ?
  {   
    KL15_senden();
  }

  settimer(TimerKL15,zyklus);

  KL15ein_alt = KL15ein;

    //  Port-Test :
/*
    ++counter;
    outport( adr_out , counter );
    if (counter & 0x1)
      outport( adr_out, output_ok );
    else
      outport( adr_out, output_nok );
    in = inport( adr_in );
    write("counter=%3d  inp =%2X busy=%d KL15=%d ",
          counter, in, (in & maske_input)>0, KL15ein );
//    write("in = %3X   KL15 = %d ", in, KL15ein );
*/
}
/*@@end*/

/*@@timer:TimerMesszyklus:*/
on timer TimerMesszyklus
{
  Messzyklus_Stop();
}
/*@@end*/

/*@@timer:TimerAnfrage:*/
on timer TimerAnfrage
{
  if ( RndToggle )
  {
    Anfrage.byte(0) = 0x01;
    Anfrage.byte(1) = 0x02;
    Anfrage.byte(2) = 0x03;
    Anfrage.byte(3) = 0x04;
    Anfrage.byte(4) = 0xF4;
    Anfrage.byte(5) = 0x28;
    Anfrage.byte(6) = 0x1D;
    Anfrage.byte(7) = 0x8E;
    output(Anfrage);
    settimer(TimerAnfrage,ZyklusAnfrage);
    RndToggle=0;
  }
  else
  {
    Anfrage.byte(0) = 0x01;
    Anfrage.byte(1) = 0x02;
    Anfrage.byte(2) = 0x03;
    Anfrage.byte(3) = 0x05;
    Anfrage.byte(4) = 0x4A;
    Anfrage.byte(5) = 0xB6;
    Anfrage.byte(6) = 0x08;
    Anfrage.byte(7) = 0xDF;
    output(Anfrage);
    settimer(TimerAnfrage,ZyklusAnfrage);
    RndToggle=1;
  }
}
/*@@end*/

/*@@envVar:Env_Kl15_Auswertung_CAN_emv:*/
on envVar Env_Kl15_Auswertung_CAN_emv
{
  KL15_Auswertung_CAN = getValue(this);
  update();
}
/*@@end*/

/*@@envVar:Env_MSG_Simulation_emv:*/
on envVar Env_MSG_Simulation_emv
{
  MSG_simulation = getValue(this);
  // update();
}
/*@@end*/

/*@@envVar:Env_Freischalt_timeout_emv:*/
//21.01.2013 Replacing ImmoTest with ImmoTest_EMV
on envVar Env_Freischalt_timeout_emv
//on envVar Env_Freischalt_timeout
{
  timeout_freischaltung = getValue(this);
}
/*@@end*/

/*@@caplFunc:KL15_senden():*/
KL15_senden()
{

  // KL15-Botschaft senden : MQB
  if (KL15ein)
    KL15_MQB.byte(2) = 2;
  else
    KL15_MQB.byte(2) = 0;
  output(KL15_MQB);
}
/*@@end*/

/*@@caplFunc:Messzyklus_Start():*/
Messzyklus_Start()
{
  // Flags zurücksetzen :
  freischaltung = 0;

  zyklus_laeuft = 1;

  settimer(TimerMesszyklus,timeout_freischaltung);
}
/*@@end*/

/*@@caplFunc:Update():*/
Update()
{
  putValue(Env_Version_emv, SW_version);

  if  (KL15_Auswertung_CAN == 0)  
    putValue(Env_Kl15_Auswertung_CAN_sEmv, "Parallelport ");
  else                        
    putValue(Env_Kl15_Auswertung_CAN_sEmv, "CAN ");

  // putValue(Env_MSG_Simulation, MSG_simulation);
  // write("MSG = %d ", MSG_simulation );
}
/*@@end*/

/*@@caplFunc:Messzyklus_Stop():*/
Messzyklus_Stop()
{
  // Timer stoppen, falls fallende Flanke (bei Auswertung Parallelport)
  cancelTimer(TimerMesszyklus);
  cancelTimer(TimerAnfrage);


  if (zyklus_laeuft)  // nur einmal auswerten !
  {
    if ( freischaltung )
    {
      ++gut;
      putValue(Env_Anzahl_iO_emv, gut);
      outport(adr_out,output_ok);        // löschen des Ausgabeports
      msgbeep(4);
      //21.01.2013 Replacing ImmoTest with ImmoTest_EMV
      //putValue(Env_EMV_Ergebnis,1);
      putValue(Env_EMV_Ergebnis_emv,1);
      // write("++++++++++++++++ %4d gut, %4d schlecht ",gut,schlecht);
    }
    else
    {
      ++schlecht;
      msgbeep(2);
      putValue(Env_Anzahl_niO_emv, schlecht);
      outport(adr_out,output_nok);       // setzten des Ausgabeports
      //21.01.2013 Replacing ImmoTest with ImmoTest_EMV
      //putValue(Env_EMV_Ergebnis,0);
      putValue(Env_EMV_Ergebnis_emv,0);
      // write("---------------- %4d gut, %4d schlecht ",gut,schlecht);
    }
  }
    
  freischaltung = 0;

  zyklus_laeuft = 0;
}
/*@@end*/

