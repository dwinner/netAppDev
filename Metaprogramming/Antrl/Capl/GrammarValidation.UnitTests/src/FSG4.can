/*@!Encoding:1252*/
includes
{
    #include "..\..\..\_DLL\latest_BAP_DLL.cin"
}

variables
{
	char  dbcan_path[255] = "BAP\\_DBC\\BAP_V9.04F.dbc";
	char  xml_path[255]   = "BAP\\HUD_P30DF36_v1.61_FSG04\\FSG04\\bapxml\\BAP_SW16_HUD_P30DF36_V1.61_FSG.xml";

	//@BAPSIMGEN_VAR_SECTION_BEGIN

	/***************************************************/
	/*            BapSimGen FSG template               */
	/***************************************************/

	/************** Ausgabe Konsole (Traces) ***********/
	dword gBAP_Trace;
	dword gError_Trace;

	/************** Node Verwaltung ***************/
	//Power on/off
	byte gSG_PowerOnOff=0x01;     // wird mit Power_off/on gesetzt
	byte gBAP_Init=0;             // schon mal initialisiert?

	const Power_off = 0x00;	
	const Power_on	= 0x01;

	mstimer TaskTimer;				//real communication timer

	/************** Request **************/
	const Requestbuffer_lines = 19;
	const dword BAP_buffer_size = 85;

	/************ Speichern von Requests im "Ringbuffer" ***********/
	int   gBAP_Requestbuffer_status	[Requestbuffer_lines];		             // 0: kein Eintrag, 1: pending
	dword gBAP_Request_header		[Requestbuffer_lines] [6];				 // beinhaltet auch skalare Daten
	dword gBAP_Request_data         [Requestbuffer_lines] [BAP_buffer_size]; // Ringbuffer fuer BAP-Request


	/************** Indication **************/
	// enthaelt die derzeitige Indication
	dword gBAP_Indication_header[6];	
	byte  gBAP_Indication_data[BAP_buffer_size];		

	/************** Konstanten ****************/

	//BAP Data Type 
	const Bap_void				=0;
	const Bap_uint8				=1;
	const Bap_uint16			=2;
	const Bap_uint32			=3;
	const Bap_byteSequence		=4;
    const Bap_fixedByteSequence =4;
    const Bap_error				=5;
    const Bap_acknowledge		=6;

	char Datatype_Text[7][20] =
	{
		"void", "uint8", "uint16", "uint32", "byteSequence", "error", "acknowledge"
	};
	
	//BAP request types
	const DataSetGet_REQ	= 0x00;
	const DataSet_REQ		= 0x01;
	const DataGet_REQ		= 0x02;
	const Data_REQ			= 0x03;
	const Changed_REQ		= 0x04;
	const Start_REQ			= 0x05;
	const StartResult_REQ	= 0x06;
	const AbortResult_REQ	= 0x07;
	const Processing_REQ	= 0x08;
	const Result_REQ		= 0x09;
	const DataAck_REQ       = 0x0A;
	const Ack_REQ           = 0x0B;
	const Invalid_REQ    	= 0x1F; // Kennzeichnung fuer einen ungueltigen Request
	const Error_REQ         = 0x20;

	char Requesttype_Text[33][30] =
	{
		"DataSetGet_REQ", "DataSet_REQ", "DataGet_REQ", "Data_REQ",			/* 00 .. 03 */
		"Changed_REQ", "Start_REQ", "StartResult_REQ", "AbortResult_REQ",   /* 04 .. 07 */
		"Processing_REQ", "Result_REQ", "DataAck_REQ", "Ack_REQ", 		/* 08 .. 0b */
		"Invalid_REQ", "Invalid_REQ", "Invalid_REQ", "Invalid_REQ",  		/* 0c .. 0f */
		"Invalid_REQ", "Invalid_REQ", "Invalid_REQ", "Invalid_REQ",  		/* 10 .. 13 */
		"Invalid_REQ", "Invalid_REQ", "Invalid_REQ", "Invalid_REQ",  		/* 14 .. 17 */
		"Invalid_REQ", "Invalid_REQ", "Invalid_REQ", "Invalid_REQ", 		/* 18 .. 1b */
		"Invalid_REQ", "Invalid_REQ", "Invalid_REQ", "Invalid_REQ",  		/* 1c .. 1f */
		"Error_REQ"	  														/* 20 */
	};
	
	//BAP indication types
	const Data_IND				= 0x00;
	const Reset_IND				= 0x01;
	const DataAck_IND			= 0x02;
	const Result_IND			= 0x03;
	const Processing_IND	    = 0x04;
	const Changed_IND			= 0x05;
	const DataSetGet_IND	    = 0x06;
	const DataSet_IND			= 0x07;
	const DataGet_IND			= 0x08;
	const Ack_IND				= 0x09;
	const Processing_CNF_IND	= 0x0A;
	const Start_IND				= 0x0B;
	const StartResult_IND		= 0x0C;
	const AbortResult_IND		= 0x0D;
	const Invalid_IND			= 0x1F; // Kennzeichnung fuer eine ungueltige Indication
	const Error_IND             = 0x20;

	char Indicationtype_Text[33][30] =
	{
		"Data_IND", "Reset_IND", "DataAck_IND", "Result_IND",				/* 00 .. 03 */
		"Processing_IND", "Changed_IND", "DataSetGet_IND", "DataSet_IND",	/* 04 .. 07 */
		"DataGet_IND", "Ack_IND", "Processing_CNF_IND", "Start_REQ",		/* 08 .. 0b */
		"StartResult_REQ", "AbortResult_REQ", "Invalid_REQ", "Invalid_REQ", /* 0c .. 0f */
		"Invalid_REQ", "Invalid_REQ", "Invalid_REQ", "Invalid_REQ",			/* 10 .. 13 */
		"Invalid_REQ", "Invalid_REQ", "Invalid_REQ", "Invalid_REQ",			/* 14 .. 17 */
		"Invalid_REQ", "Invalid_REQ", "Invalid_REQ", "Invalid_REQ",			/* 18 .. 1b */
		"Invalid_REQ", "Invalid_REQ", "Invalid_REQ", "Invalid_REQ",			/* 1c .. 1f */
		"Error_REQ"	  														/* 20 */
	};	
	
	char Acknowledgetype_Text[24][30] =
	{
		"Property_SetGet_ACK", "Array_SetGet_ACK", "Property_Set_ACK", "Array_Set_ACK",				/* 00 .. 03 */
		"Method_Start_ACK", "Method_StartResult_ACK", "Method_AbortResult_ACK", "Property_Get_ACK",	/* 04 .. 07 */
		"Array_Get_ACK", "Cache_GetAll_ACK", "Property_Ack_ACK", "Property_Status_ACK",	   			/* 08 .. 0b */
		"Property_StatusAck_ACK", "Property_Error_ACK", "Array_Status_ACK", "Array_Changed_ACK",	/* 0c .. 0f */
		"Array_Error_ACK", "Method_Processing_ACK", "Method_Result_ACK", "Method_Error_ACK",  		/* 10 .. 13 */
		"Unknown_ACK", "Unknown_ACK", "Unknown_ACK", "Unknown_ACK"									/* 14 .. 17 */
	};

	/**************************** Global Function-ID's ******************************/

	byte already_pressed = 0;

	const FctID_GetAll									= 0x01;
	const FctID_BAP_Config								= 0x02;
	const FctID_FunctionList							= 0x03;
	const FctID_HeartBeat								= 0x04;
    
    char SGtype[4]="FSG";


	//// Begin: konfigurationsabhýngige Variablen, die als BAPCONFIG_VARS in Template definiert sind
	
	dword NODE_INDEX                =  0;
	char  NODE_NAME[100]            = "HeadUpDisplay";
	const LSGID                     = 4;
	char  panel_name[100]           = "FSG4_0";
	char  bapconfig_panel_name[100]    = "panel4";
	char  common_panel_name[100]    = "panel2";
	const TaskTime                  = 10;
	 const C_FSG_4_0_0_1_ID = 1;
	 char gCheckbox1[100] = "checkbox_C_FSG_4_0_0_1";
	 char gErrField1[100] = "errfield_C_FSG_4_0_0_1";
	 byte gC_FSG_4_0_0_1_ErrCode = 1;
	 const P_FSG_4_0_0_2_ID = 2;
	 byte P_FSG_4_0_0_2Reset_BTN_already_pressed = 0;
	 char gCheckbox2[100] = "checkbox_P_FSG_4_0_0_2";
	 char gErrField2[100] = "errfield_P_FSG_4_0_0_2";
	 byte gP_FSG_4_0_0_2_ErrCode = 1;
	 const P_FSG_4_0_0_3_ID = 3;
	 byte P_FSG_4_0_0_3Status_BTN_already_pressed = 0;
	 char gCheckbox3[100] = "checkbox_P_FSG_4_0_0_3";
	 char gErrField3[100] = "errfield_P_FSG_4_0_0_3";
	 byte gP_FSG_4_0_0_3_ErrCode = 1;
	 const P_FSG_4_0_0_4_ID = 4;
	 byte P_FSG_4_0_0_4Status_BTN_already_pressed = 0;
	 char gCheckbox4[100] = "checkbox_P_FSG_4_0_0_4";
	 char gErrField4[100] = "errfield_P_FSG_4_0_0_4";
	 byte gP_FSG_4_0_0_4_ErrCode = 1;
	 const P_FSG_4_0_0_13_ID = 13;
	 byte P_FSG_4_0_0_13Status_BTN_already_pressed = 0;
	 char gCheckbox13[100] = "checkbox_P_FSG_4_0_0_13";
	 char gErrField13[100] = "errfield_P_FSG_4_0_0_13";
	 byte gP_FSG_4_0_0_13_ErrCode = 1;
	 char gPanel13[100] = "panel_P_FSG_4_0_0_13";
	 const P_FSG_4_0_0_14_ID = 14;
	 byte P_FSG_4_0_0_14Status_BTN_already_pressed = 0;
	 char gCheckbox14[100] = "checkbox_P_FSG_4_0_0_14";
	 char gErrField14[100] = "errfield_P_FSG_4_0_0_14";
	 byte gP_FSG_4_0_0_14_ErrCode = 1;
	 char gPanel14[100] = "panel_P_FSG_4_0_0_14";
	 const P_FSG_4_0_0_15_ID = 15;
	 byte P_FSG_4_0_0_15Status_BTN_already_pressed = 0;
	 char gCheckbox15[100] = "checkbox_P_FSG_4_0_0_15";
	 char gErrField15[100] = "errfield_P_FSG_4_0_0_15";
	 byte gP_FSG_4_0_0_15_ErrCode = 1;
	 char gPanel15[100] = "panel_P_FSG_4_0_0_15";
	 const P_FSG_4_0_0_16_ID = 16;
	 byte P_FSG_4_0_0_16Status_BTN_already_pressed = 0;
	 char gCheckbox16[100] = "checkbox_P_FSG_4_0_0_16";
	 char gErrField16[100] = "errfield_P_FSG_4_0_0_16";
	 byte gP_FSG_4_0_0_16_ErrCode = 1;
	 char gPanel16[100] = "panel_P_FSG_4_0_0_16";
	 const P_FSG_4_0_0_17_ID = 17;
	 byte P_FSG_4_0_0_17Status_BTN_already_pressed = 0;
	 char gCheckbox17[100] = "checkbox_P_FSG_4_0_0_17";
	 char gErrField17[100] = "errfield_P_FSG_4_0_0_17";
	 byte gP_FSG_4_0_0_17_ErrCode = 1;
	 char gPanel17[100] = "panel_P_FSG_4_0_0_17";
	 const P_FSG_4_0_0_18_ID = 18;
	 byte P_FSG_4_0_0_18Status_BTN_already_pressed = 0;
	 char gCheckbox18[100] = "checkbox_P_FSG_4_0_0_18";
	 char gErrField18[100] = "errfield_P_FSG_4_0_0_18";
	 byte gP_FSG_4_0_0_18_ErrCode = 1;
	 char gPanel18[100] = "panel_P_FSG_4_0_0_18";
	 const P_FSG_4_0_0_19_ID = 19;
	 byte P_FSG_4_0_0_19Status_BTN_already_pressed = 0;
	 char gCheckbox19[100] = "checkbox_P_FSG_4_0_0_19";
	 char gErrField19[100] = "errfield_P_FSG_4_0_0_19";
	 byte gP_FSG_4_0_0_19_ErrCode = 1;
	 char gPanel19[100] = "panel_P_FSG_4_0_0_19";
	 const P_FSG_4_0_0_20_ID = 20;
	 byte P_FSG_4_0_0_20Status_BTN_already_pressed = 0;
	 char gCheckbox20[100] = "checkbox_P_FSG_4_0_0_20";
	 char gErrField20[100] = "errfield_P_FSG_4_0_0_20";
	 byte gP_FSG_4_0_0_20_ErrCode = 1;
	 char gPanel20[100] = "panel_P_FSG_4_0_0_20";
	 const P_FSG_4_0_0_21_ID = 21;
	 byte P_FSG_4_0_0_21Status_BTN_already_pressed = 0;
	 char gCheckbox21[100] = "checkbox_P_FSG_4_0_0_21";
	 char gErrField21[100] = "errfield_P_FSG_4_0_0_21";
	 byte gP_FSG_4_0_0_21_ErrCode = 1;
	 char gPanel21[100] = "panel_P_FSG_4_0_0_21";
	 const P_FSG_4_0_0_22_ID = 22;
	 byte P_FSG_4_0_0_22Status_BTN_already_pressed = 0;
	 char gCheckbox22[100] = "checkbox_P_FSG_4_0_0_22";
	 char gErrField22[100] = "errfield_P_FSG_4_0_0_22";
	 byte gP_FSG_4_0_0_22_ErrCode = 1;
	 char gPanel22[100] = "panel_P_FSG_4_0_0_22";
	 const P_FSG_4_0_0_23_ID = 23;
	 byte P_FSG_4_0_0_23Status_BTN_already_pressed = 0;
	 char gCheckbox23[100] = "checkbox_P_FSG_4_0_0_23";
	 char gErrField23[100] = "errfield_P_FSG_4_0_0_23";
	 byte gP_FSG_4_0_0_23_ErrCode = 1;
	 char gPanel23[100] = "panel_P_FSG_4_0_0_23";
	 const P_FSG_4_0_0_24_ID = 24;
	 byte P_FSG_4_0_0_24Status_BTN_already_pressed = 0;
	 char gCheckbox24[100] = "checkbox_P_FSG_4_0_0_24";
	 char gErrField24[100] = "errfield_P_FSG_4_0_0_24";
	 byte gP_FSG_4_0_0_24_ErrCode = 1;
	 char gPanel24[100] = "panel_P_FSG_4_0_0_24";
	 const A_FSG_4_0_0_25_ID = 25;
	 byte A_FSG_4_0_0_25Changed_BTN_already_pressed = 0;
	 byte A_FSG_4_0_0_25Status_BTN_already_pressed = 0;
	 char gCheckbox25[100] = "checkbox_A_FSG_4_0_0_25";
	 char gErrField25[100] = "errfield_A_FSG_4_0_0_25";
	 byte gA_FSG_4_0_0_25_ErrCode = 1;
	 char gPanel25[100] = "panel_A_FSG_4_0_0_25";
	 byte A_FSG_4_0_0_25_DataIndex_Decr_already_pressed = 0;
	 byte A_FSG_4_0_0_25_DataIndex_Incr_already_pressed = 0;
	 byte A_FSG_4_0_0_25_DataIndex_SetGet_Decr_already_pressed = 0;
	 byte A_FSG_4_0_0_25_DataIndex_SetGet_Incr_already_pressed = 0;
	 byte A_FSG_4_0_0_25_generateData_Btn_already_pressed = 0;
	 byte A_FSG_4_0_0_25_loadArray_Btn_already_pressed = 0;
	 _align(1) struct A_FSG_4_0_0_25_ArrayDataStruct {
		 byte Param1;
		 byte Param2;
		 byte Param3;
		 byte Param4;
		 byte Param5;
		 byte Param6;
		 byte Param7;
		 byte Param8;
		 byte Param9;
		 byte Param10;
	 };
	 struct A_FSG_4_0_0_25_ArrayDataStruct A_FSG_4_0_0_25_ArrayDataList[8];
	 const A_FSG_4_0_0_25_ArrayDataList_Length = 8;
	 const P_FSG_4_0_0_26_ID = 26;
	 byte P_FSG_4_0_0_26Status_BTN_already_pressed = 0;
	 char gCheckbox26[100] = "checkbox_P_FSG_4_0_0_26";
	 char gErrField26[100] = "errfield_P_FSG_4_0_0_26";
	 byte gP_FSG_4_0_0_26_ErrCode = 1;
	 char gPanel26[100] = "panel_P_FSG_4_0_0_26";
	 const A_FSG_4_0_0_27_ID = 27;
	 byte A_FSG_4_0_0_27Changed_BTN_already_pressed = 0;
	 byte A_FSG_4_0_0_27Status_BTN_already_pressed = 0;
	 char gCheckbox27[100] = "checkbox_A_FSG_4_0_0_27";
	 char gErrField27[100] = "errfield_A_FSG_4_0_0_27";
	 byte gA_FSG_4_0_0_27_ErrCode = 1;
	 char gPanel27[100] = "panel_A_FSG_4_0_0_27";
	 byte A_FSG_4_0_0_27_DataIndex_Decr_already_pressed = 0;
	 byte A_FSG_4_0_0_27_DataIndex_Incr_already_pressed = 0;
	 byte A_FSG_4_0_0_27_DataIndex_SetGet_Decr_already_pressed = 0;
	 byte A_FSG_4_0_0_27_DataIndex_SetGet_Incr_already_pressed = 0;
	 byte A_FSG_4_0_0_27_generateData_Btn_already_pressed = 0;
	 byte A_FSG_4_0_0_27_loadArray_Btn_already_pressed = 0;
	 _align(1) struct A_FSG_4_0_0_27_ArrayDataStruct {
		 dword Param1;
		 byte Param2;
		 byte Param3;
		 byte Param4[5];
		 dword Param4_Length;
	 };
	 struct A_FSG_4_0_0_27_ArrayDataStruct A_FSG_4_0_0_27_ArrayDataList[30];
	 const A_FSG_4_0_0_27_ArrayDataList_Length = 30;
	 long A_FSG_4_0_0_27_Data_4_LenList[30];
	 byte A_FSG_4_0_0_27_Data_4_CntList[30];
	 long A_FSG_4_0_0_27_Data_4_SetGet_LenList[30];
	 byte A_FSG_4_0_0_27_Data_4_SetGet_CntList[30];
	 const P_FSG_4_0_0_28_ID = 28;
	 byte P_FSG_4_0_0_28Status_BTN_already_pressed = 0;
	 char gCheckbox28[100] = "checkbox_P_FSG_4_0_0_28";
	 char gErrField28[100] = "errfield_P_FSG_4_0_0_28";
	 byte gP_FSG_4_0_0_28_ErrCode = 1;
	 char gPanel28[100] = "panel_P_FSG_4_0_0_28";
	 const P_FSG_4_0_0_29_ID = 29;
	 byte P_FSG_4_0_0_29Status_BTN_already_pressed = 0;
	 char gCheckbox29[100] = "checkbox_P_FSG_4_0_0_29";
	 char gErrField29[100] = "errfield_P_FSG_4_0_0_29";
	 byte gP_FSG_4_0_0_29_ErrCode = 1;
	 char gPanel29[100] = "panel_P_FSG_4_0_0_29";


	//// End konfigurationsabhýngige Variablen 
	
	/// Begin: Definition der BUS-Schnittstellen
	
	// FLEXRAY NOT ENABLED!
	
	// ETHERNET NOT ENABLED! 
	
	//// End Bus Schnittstellen

}

on preStart
{
    char Version[200];

    /***** Erzeugen der Ausgabeconsolen *****/  
    gBAP_Trace=writecreate("BAP-Trace");        //write-window for BAP-cummunication
    writeclear(gBAP_Trace);                     //clear BAP-window in write-window
    
    gError_Trace=writecreate("Error");          //error-window for BAP-cummunication
    writeclear(gError_Trace);                   //clear error-window in write-window
    
    writeclear(1);                              //clear CAPL-window in write-window
    
    /**** Versionsstring von DLL holen und auf Bildschirm ausgeben ***/ 
    BAP150_GetVersions(Version, 200);
    writelineEx(gBAP_Trace, 0, "Versionx:%s", Version);
                                            
    NODE_INDEX = BAP150_CreateNode();
    writelineEx(gBAP_Trace, 0, "FSG %d Nodeindex:%d", LSGID, Version);
    
    // FLEXRAY NOT ENABLED!
}

DisableFctCtrl ()
{
  	EnableControl(panel_name, common_panel_name, 0);
	EnableControl(panel_name,gErrField1,0);
	EnableControl(panel_name,gErrField2,0);
	EnableControl(panel_name,gErrField3,0);
	EnableControl(panel_name,gErrField4,0);
	EnableControl(panel_name,gErrField13,0);
	EnableControl(panel_name,gPanel13,0);
	EnableControl(panel_name,"panel_P_FSG_4_0_0_13",0);
	EnableControl(panel_name,gErrField14,0);
	EnableControl(panel_name,gPanel14,0);
	EnableControl(panel_name,"panel_P_FSG_4_0_0_14",0);
	EnableControl(panel_name,gErrField15,0);
	EnableControl(panel_name,gPanel15,0);
	EnableControl(panel_name,"panel_P_FSG_4_0_0_15",0);
	EnableControl(panel_name,gErrField16,0);
	EnableControl(panel_name,gPanel16,0);
	EnableControl(panel_name,"panel_P_FSG_4_0_0_16",0);
	EnableControl(panel_name,gErrField17,0);
	EnableControl(panel_name,gPanel17,0);
	EnableControl(panel_name,"panel_P_FSG_4_0_0_17",0);
	EnableControl(panel_name,gErrField18,0);
	EnableControl(panel_name,gPanel18,0);
	EnableControl(panel_name,"panel_P_FSG_4_0_0_18",0);
	EnableControl(panel_name,gErrField19,0);
	EnableControl(panel_name,gPanel19,0);
	EnableControl(panel_name,"panel_P_FSG_4_0_0_19",0);
	EnableControl(panel_name,gErrField20,0);
	EnableControl(panel_name,gPanel20,0);
	EnableControl(panel_name,"panel_P_FSG_4_0_0_20",0);
	EnableControl(panel_name,gErrField21,0);
	EnableControl(panel_name,gPanel21,0);
	EnableControl(panel_name,"panel_P_FSG_4_0_0_21",0);
	EnableControl(panel_name,gErrField22,0);
	EnableControl(panel_name,gPanel22,0);
	EnableControl(panel_name,"panel_P_FSG_4_0_0_22",0);
	EnableControl(panel_name,gErrField23,0);
	EnableControl(panel_name,gPanel23,0);
	EnableControl(panel_name,"panel_P_FSG_4_0_0_23",0);
	EnableControl(panel_name,gErrField24,0);
	EnableControl(panel_name,gPanel24,0);
	EnableControl(panel_name,"panel_P_FSG_4_0_0_24",0);
	EnableControl(panel_name,gErrField25,0);
	EnableControl(panel_name,gPanel25,0);
	EnableControl(panel_name,"panel_A_FSG_4_0_0_25",0);
	EnableControl(panel_name,"panel_A_FSG_4_0_0_25_Status",0);
	EnableControl(panel_name,"panel_A_FSG_4_0_0_25_Changed",0);
	EnableControl(panel_name,"panel_A_FSG_4_0_0_25_SetGet",0);
	EnableControl(panel_name,gErrField26,0);
	EnableControl(panel_name,gPanel26,0);
	EnableControl(panel_name,"panel_P_FSG_4_0_0_26",0);
	EnableControl(panel_name,gErrField27,0);
	EnableControl(panel_name,gPanel27,0);
	EnableControl(panel_name,"panel_A_FSG_4_0_0_27",0);
	EnableControl(panel_name,"panel_A_FSG_4_0_0_27_Status",0);
	EnableControl(panel_name,"panel_A_FSG_4_0_0_27_Changed",0);
	EnableControl(panel_name,"panel_A_FSG_4_0_0_27_SetGet",0);
	EnableControl(panel_name,gErrField28,0);
	EnableControl(panel_name,gPanel28,0);
	EnableControl(panel_name,"panel_P_FSG_4_0_0_28",0);
	EnableControl(panel_name,gErrField29,0);
	EnableControl(panel_name,gPanel29,0);
	EnableControl(panel_name,"panel_P_FSG_4_0_0_29",0);

}

EnableFctCtrl ()
{
  	EnableControl(panel_name, common_panel_name, 1);
	if(getValue(P_FSG_4_0_0_13_FctLstItemEn)){
		 EnableControl(panel_name,gPanel13,1);
		 EnableControl(panel_name,gErrField13,1);
	}
	if(getValue(P_FSG_4_0_0_14_FctLstItemEn)){
		 EnableControl(panel_name,gPanel14,1);
		 EnableControl(panel_name,gErrField14,1);
	}
	if(getValue(P_FSG_4_0_0_15_FctLstItemEn)){
		 EnableControl(panel_name,gPanel15,1);
		 EnableControl(panel_name,gErrField15,1);
	}
	if(getValue(P_FSG_4_0_0_16_FctLstItemEn)){
		 EnableControl(panel_name,gPanel16,1);
		 EnableControl(panel_name,gErrField16,1);
	}
	if(getValue(P_FSG_4_0_0_17_FctLstItemEn)){
		 EnableControl(panel_name,gPanel17,1);
		 EnableControl(panel_name,gErrField17,1);
	}
	if(getValue(P_FSG_4_0_0_18_FctLstItemEn)){
		 EnableControl(panel_name,gPanel18,1);
		 EnableControl(panel_name,gErrField18,1);
	}
	if(getValue(P_FSG_4_0_0_19_FctLstItemEn)){
		 EnableControl(panel_name,gPanel19,1);
		 EnableControl(panel_name,gErrField19,1);
	}
	if(getValue(P_FSG_4_0_0_20_FctLstItemEn)){
		 EnableControl(panel_name,gPanel20,1);
		 EnableControl(panel_name,gErrField20,1);
	}
	if(getValue(P_FSG_4_0_0_21_FctLstItemEn)){
		 EnableControl(panel_name,gPanel21,1);
		 EnableControl(panel_name,gErrField21,1);
	}
	if(getValue(P_FSG_4_0_0_22_FctLstItemEn)){
		 EnableControl(panel_name,gPanel22,1);
		 EnableControl(panel_name,gErrField22,1);
	}
	if(getValue(P_FSG_4_0_0_23_FctLstItemEn)){
		 EnableControl(panel_name,gPanel23,1);
		 EnableControl(panel_name,gErrField23,1);
	}
	if(getValue(P_FSG_4_0_0_24_FctLstItemEn)){
		 EnableControl(panel_name,gPanel24,1);
		 EnableControl(panel_name,gErrField24,1);
	}
	if(getValue(A_FSG_4_0_0_25_FctLstItemEn)){
		 EnableControl(panel_name,gPanel25,1);
	EnableControl(panel_name,"panel_A_FSG_4_0_0_25_Status",1);
		 EnableControl(panel_name,gErrField25,1);
	}
	if(getValue(P_FSG_4_0_0_26_FctLstItemEn)){
		 EnableControl(panel_name,gPanel26,1);
		 EnableControl(panel_name,gErrField26,1);
	}
	if(getValue(A_FSG_4_0_0_27_FctLstItemEn)){
		 EnableControl(panel_name,gPanel27,1);
	EnableControl(panel_name,"panel_A_FSG_4_0_0_27_Status",1);
		 EnableControl(panel_name,gErrField27,1);
	}
	if(getValue(P_FSG_4_0_0_28_FctLstItemEn)){
		 EnableControl(panel_name,gPanel28,1);
		 EnableControl(panel_name,gErrField28,1);
	}
	if(getValue(P_FSG_4_0_0_29_FctLstItemEn)){
		 EnableControl(panel_name,gPanel29,1);
		 EnableControl(panel_name,gErrField29,1);
	}

}

DisableConfigCtrl ()
{
  	EnableControl(panel_name, bapconfig_panel_name, 0);
	EnableControl(panel_name, bapconfig_panel_name, 0);
	EnableControl(panel_name, "panel4_edit", 0);
//	EnableControl(panel_name,gCheckbox1,0);
//	if(!getValue(C_FSG_4_0_0_1_FctLstItemEn)){
//		 SetControlBackColor(panel_name,gCheckbox1,MakeRGB(200,200,200));
//	}
//	EnableControl(panel_name,gCheckbox2,0);
//	if(!getValue(P_FSG_4_0_0_2_FctLstItemEn)){
//		 SetControlBackColor(panel_name,gCheckbox2,MakeRGB(200,200,200));
//	}
//	EnableControl(panel_name,gCheckbox3,0);
//	if(!getValue(P_FSG_4_0_0_3_FctLstItemEn)){
//		 SetControlBackColor(panel_name,gCheckbox3,MakeRGB(200,200,200));
//	}
	EnableControl(panel_name, "panel_P_FSG_4_0_0_4", 0);
//	EnableControl(panel_name,gCheckbox4,0);
//	if(!getValue(P_FSG_4_0_0_4_FctLstItemEn)){
//		 SetControlBackColor(panel_name,gCheckbox4,MakeRGB(200,200,200));
//	}
//	EnableControl(panel_name,gCheckbox13,0);
//	if(!getValue(P_FSG_4_0_0_13_FctLstItemEn)){
//		 SetControlBackColor(panel_name,gCheckbox13,MakeRGB(200,200,200));
//	}
//	EnableControl(panel_name,gCheckbox14,0);
//	if(!getValue(P_FSG_4_0_0_14_FctLstItemEn)){
//		 SetControlBackColor(panel_name,gCheckbox14,MakeRGB(200,200,200));
//	}
//	EnableControl(panel_name,gCheckbox15,0);
//	if(!getValue(P_FSG_4_0_0_15_FctLstItemEn)){
//		 SetControlBackColor(panel_name,gCheckbox15,MakeRGB(200,200,200));
//	}
//	EnableControl(panel_name,gCheckbox16,0);
//	if(!getValue(P_FSG_4_0_0_16_FctLstItemEn)){
//		 SetControlBackColor(panel_name,gCheckbox16,MakeRGB(200,200,200));
//	}
//	EnableControl(panel_name,gCheckbox17,0);
//	if(!getValue(P_FSG_4_0_0_17_FctLstItemEn)){
//		 SetControlBackColor(panel_name,gCheckbox17,MakeRGB(200,200,200));
//	}
//	EnableControl(panel_name,gCheckbox18,0);
//	if(!getValue(P_FSG_4_0_0_18_FctLstItemEn)){
//		 SetControlBackColor(panel_name,gCheckbox18,MakeRGB(200,200,200));
//	}
//	EnableControl(panel_name,gCheckbox19,0);
//	if(!getValue(P_FSG_4_0_0_19_FctLstItemEn)){
//		 SetControlBackColor(panel_name,gCheckbox19,MakeRGB(200,200,200));
//	}
//	EnableControl(panel_name,gCheckbox20,0);
//	if(!getValue(P_FSG_4_0_0_20_FctLstItemEn)){
//		 SetControlBackColor(panel_name,gCheckbox20,MakeRGB(200,200,200));
//	}
//	EnableControl(panel_name,gCheckbox21,0);
//	if(!getValue(P_FSG_4_0_0_21_FctLstItemEn)){
//		 SetControlBackColor(panel_name,gCheckbox21,MakeRGB(200,200,200));
//	}
//	EnableControl(panel_name,gCheckbox22,0);
//	if(!getValue(P_FSG_4_0_0_22_FctLstItemEn)){
//		 SetControlBackColor(panel_name,gCheckbox22,MakeRGB(200,200,200));
//	}
//	EnableControl(panel_name,gCheckbox23,0);
//	if(!getValue(P_FSG_4_0_0_23_FctLstItemEn)){
//		 SetControlBackColor(panel_name,gCheckbox23,MakeRGB(200,200,200));
//	}
//	EnableControl(panel_name,gCheckbox24,0);
//	if(!getValue(P_FSG_4_0_0_24_FctLstItemEn)){
//		 SetControlBackColor(panel_name,gCheckbox24,MakeRGB(200,200,200));
//	}
//	EnableControl(panel_name,gCheckbox25,0);
//	if(!getValue(A_FSG_4_0_0_25_FctLstItemEn)){
//		 SetControlBackColor(panel_name,gCheckbox25,MakeRGB(200,200,200));
//	}
//	EnableControl(panel_name,gCheckbox26,0);
//	if(!getValue(P_FSG_4_0_0_26_FctLstItemEn)){
//		 SetControlBackColor(panel_name,gCheckbox26,MakeRGB(200,200,200));
//	}
//	EnableControl(panel_name,gCheckbox27,0);
//	if(!getValue(A_FSG_4_0_0_27_FctLstItemEn)){
//		 SetControlBackColor(panel_name,gCheckbox27,MakeRGB(200,200,200));
//	}
//	EnableControl(panel_name,gCheckbox28,0);
//	if(!getValue(P_FSG_4_0_0_28_FctLstItemEn)){
//		 SetControlBackColor(panel_name,gCheckbox28,MakeRGB(200,200,200));
//	}
//	EnableControl(panel_name,gCheckbox29,0);
//	if(!getValue(P_FSG_4_0_0_29_FctLstItemEn)){
//		 SetControlBackColor(panel_name,gCheckbox29,MakeRGB(200,200,200));
//	}

}

EnableConfigCtrl ()
{
  	EnableControl(panel_name, bapconfig_panel_name, 1);
	EnableControl(panel_name, "panel4_edit", 1);
	if(getValue(C_FSG_4_0_0_1_FctLstItemEn))
	{
		setControlForeColor(panel_name, gCheckbox1, MakeRGB(0,240,0));
	}
	else
	{
		setControlForeColor(panel_name, gCheckbox1, MakeRGB(250,0,0));
	}
	if(getValue(P_FSG_4_0_0_2_FctLstItemEn))
	{
		setControlForeColor(panel_name, gCheckbox2, MakeRGB(0,240,0));
	}
	else
	{
		setControlForeColor(panel_name, gCheckbox2, MakeRGB(250,0,0));
	}
	if(getValue(P_FSG_4_0_0_3_FctLstItemEn))
	{
		setControlForeColor(panel_name, gCheckbox3, MakeRGB(0,240,0));
	}
	else
	{
		setControlForeColor(panel_name, gCheckbox3, MakeRGB(250,0,0));
	}
	EnableControl(panel_name, "panel_P_FSG_4_0_0_4", 1);
	if(getValue(P_FSG_4_0_0_4_FctLstItemEn))
	{
		setControlForeColor(panel_name, gCheckbox4, MakeRGB(0,240,0));
	}
	else
	{
		setControlForeColor(panel_name, gCheckbox4, MakeRGB(250,0,0));
	}
	if(getValue(P_FSG_4_0_0_13_FctLstItemEn))
	{
		EnableControl(panel_name, "panel_P_FSG_4_0_0_13",1);
		EnableControl(panel_name,"errfield_P_FSG_4_0_0_13",1);
		setControlForeColor(panel_name, gCheckbox13, MakeRGB(0,240,0));
	}
	else
	{
		EnableControl(panel_name, "panel_P_FSG_4_0_0_13",0);
		EnableControl(panel_name,"errfield_P_FSG_4_0_0_13",0);
		setControlForeColor(panel_name, gCheckbox13, MakeRGB(250,0,0));
	}
	if(getValue(P_FSG_4_0_0_14_FctLstItemEn))
	{
		EnableControl(panel_name, "panel_P_FSG_4_0_0_14",1);
		EnableControl(panel_name,"errfield_P_FSG_4_0_0_14",1);
		setControlForeColor(panel_name, gCheckbox14, MakeRGB(0,240,0));
	}
	else
	{
		EnableControl(panel_name, "panel_P_FSG_4_0_0_14",0);
		EnableControl(panel_name,"errfield_P_FSG_4_0_0_14",0);
		setControlForeColor(panel_name, gCheckbox14, MakeRGB(250,0,0));
	}
	if(getValue(P_FSG_4_0_0_15_FctLstItemEn))
	{
		EnableControl(panel_name, "panel_P_FSG_4_0_0_15",1);
		EnableControl(panel_name,"errfield_P_FSG_4_0_0_15",1);
		setControlForeColor(panel_name, gCheckbox15, MakeRGB(0,240,0));
	}
	else
	{
		EnableControl(panel_name, "panel_P_FSG_4_0_0_15",0);
		EnableControl(panel_name,"errfield_P_FSG_4_0_0_15",0);
		setControlForeColor(panel_name, gCheckbox15, MakeRGB(250,0,0));
	}
	if(getValue(P_FSG_4_0_0_16_FctLstItemEn))
	{
		EnableControl(panel_name, "panel_P_FSG_4_0_0_16",1);
		EnableControl(panel_name,"errfield_P_FSG_4_0_0_16",1);
		setControlForeColor(panel_name, gCheckbox16, MakeRGB(0,240,0));
	}
	else
	{
		EnableControl(panel_name, "panel_P_FSG_4_0_0_16",0);
		EnableControl(panel_name,"errfield_P_FSG_4_0_0_16",0);
		setControlForeColor(panel_name, gCheckbox16, MakeRGB(250,0,0));
	}
	if(getValue(P_FSG_4_0_0_17_FctLstItemEn))
	{
		EnableControl(panel_name, "panel_P_FSG_4_0_0_17",1);
		EnableControl(panel_name,"errfield_P_FSG_4_0_0_17",1);
		setControlForeColor(panel_name, gCheckbox17, MakeRGB(0,240,0));
	}
	else
	{
		EnableControl(panel_name, "panel_P_FSG_4_0_0_17",0);
		EnableControl(panel_name,"errfield_P_FSG_4_0_0_17",0);
		setControlForeColor(panel_name, gCheckbox17, MakeRGB(250,0,0));
	}
	if(getValue(P_FSG_4_0_0_18_FctLstItemEn))
	{
		EnableControl(panel_name, "panel_P_FSG_4_0_0_18",1);
		EnableControl(panel_name,"errfield_P_FSG_4_0_0_18",1);
		setControlForeColor(panel_name, gCheckbox18, MakeRGB(0,240,0));
	}
	else
	{
		EnableControl(panel_name, "panel_P_FSG_4_0_0_18",0);
		EnableControl(panel_name,"errfield_P_FSG_4_0_0_18",0);
		setControlForeColor(panel_name, gCheckbox18, MakeRGB(250,0,0));
	}
	if(getValue(P_FSG_4_0_0_19_FctLstItemEn))
	{
		EnableControl(panel_name, "panel_P_FSG_4_0_0_19",1);
		EnableControl(panel_name,"errfield_P_FSG_4_0_0_19",1);
		setControlForeColor(panel_name, gCheckbox19, MakeRGB(0,240,0));
	}
	else
	{
		EnableControl(panel_name, "panel_P_FSG_4_0_0_19",0);
		EnableControl(panel_name,"errfield_P_FSG_4_0_0_19",0);
		setControlForeColor(panel_name, gCheckbox19, MakeRGB(250,0,0));
	}
	if(getValue(P_FSG_4_0_0_20_FctLstItemEn))
	{
		EnableControl(panel_name, "panel_P_FSG_4_0_0_20",1);
		EnableControl(panel_name,"errfield_P_FSG_4_0_0_20",1);
		setControlForeColor(panel_name, gCheckbox20, MakeRGB(0,240,0));
	}
	else
	{
		EnableControl(panel_name, "panel_P_FSG_4_0_0_20",0);
		EnableControl(panel_name,"errfield_P_FSG_4_0_0_20",0);
		setControlForeColor(panel_name, gCheckbox20, MakeRGB(250,0,0));
	}
	if(getValue(P_FSG_4_0_0_21_FctLstItemEn))
	{
		EnableControl(panel_name, "panel_P_FSG_4_0_0_21",1);
		EnableControl(panel_name,"errfield_P_FSG_4_0_0_21",1);
		setControlForeColor(panel_name, gCheckbox21, MakeRGB(0,240,0));
	}
	else
	{
		EnableControl(panel_name, "panel_P_FSG_4_0_0_21",0);
		EnableControl(panel_name,"errfield_P_FSG_4_0_0_21",0);
		setControlForeColor(panel_name, gCheckbox21, MakeRGB(250,0,0));
	}
	if(getValue(P_FSG_4_0_0_22_FctLstItemEn))
	{
		EnableControl(panel_name, "panel_P_FSG_4_0_0_22",1);
		EnableControl(panel_name,"errfield_P_FSG_4_0_0_22",1);
		setControlForeColor(panel_name, gCheckbox22, MakeRGB(0,240,0));
	}
	else
	{
		EnableControl(panel_name, "panel_P_FSG_4_0_0_22",0);
		EnableControl(panel_name,"errfield_P_FSG_4_0_0_22",0);
		setControlForeColor(panel_name, gCheckbox22, MakeRGB(250,0,0));
	}
	if(getValue(P_FSG_4_0_0_23_FctLstItemEn))
	{
		EnableControl(panel_name, "panel_P_FSG_4_0_0_23",1);
		EnableControl(panel_name,"errfield_P_FSG_4_0_0_23",1);
		setControlForeColor(panel_name, gCheckbox23, MakeRGB(0,240,0));
	}
	else
	{
		EnableControl(panel_name, "panel_P_FSG_4_0_0_23",0);
		EnableControl(panel_name,"errfield_P_FSG_4_0_0_23",0);
		setControlForeColor(panel_name, gCheckbox23, MakeRGB(250,0,0));
	}
	if(getValue(P_FSG_4_0_0_24_FctLstItemEn))
	{
		EnableControl(panel_name, "panel_P_FSG_4_0_0_24",1);
		EnableControl(panel_name,"errfield_P_FSG_4_0_0_24",1);
		setControlForeColor(panel_name, gCheckbox24, MakeRGB(0,240,0));
	}
	else
	{
		EnableControl(panel_name, "panel_P_FSG_4_0_0_24",0);
		EnableControl(panel_name,"errfield_P_FSG_4_0_0_24",0);
		setControlForeColor(panel_name, gCheckbox24, MakeRGB(250,0,0));
	}
	if(getValue(A_FSG_4_0_0_25_FctLstItemEn))
	{
		EnableControl(panel_name, "panel_A_FSG_4_0_0_25",1);
		EnableControl(panel_name,"panel_A_FSG_4_0_0_25_Status",1);
		EnableControl(panel_name,"errfield_A_FSG_4_0_0_25",1);
		EnableControl(panel_name,"panel_A_FSG_4_0_0_25_Changed",1);
		EnableControl(panel_name,"panel_A_FSG_4_0_0_25_SetGet",1);
		setControlForeColor(panel_name, gCheckbox25, MakeRGB(0,240,0));
	}
	else
	{
		EnableControl(panel_name, "panel_A_FSG_4_0_0_25",0);
		EnableControl(panel_name,"panel_A_FSG_4_0_0_25_Status",0);
		EnableControl(panel_name,"errfield_A_FSG_4_0_0_25",0);
		EnableControl(panel_name,"panel_A_FSG_4_0_0_25_Changed",0);
		EnableControl(panel_name,"panel_A_FSG_4_0_0_25_SetGet",0);
		setControlForeColor(panel_name, gCheckbox25, MakeRGB(250,0,0));
	}
	if(getValue(P_FSG_4_0_0_26_FctLstItemEn))
	{
		EnableControl(panel_name, "panel_P_FSG_4_0_0_26",1);
		EnableControl(panel_name,"errfield_P_FSG_4_0_0_26",1);
		setControlForeColor(panel_name, gCheckbox26, MakeRGB(0,240,0));
	}
	else
	{
		EnableControl(panel_name, "panel_P_FSG_4_0_0_26",0);
		EnableControl(panel_name,"errfield_P_FSG_4_0_0_26",0);
		setControlForeColor(panel_name, gCheckbox26, MakeRGB(250,0,0));
	}
	if(getValue(A_FSG_4_0_0_27_FctLstItemEn))
	{
		EnableControl(panel_name, "panel_A_FSG_4_0_0_27",1);
		EnableControl(panel_name,"panel_A_FSG_4_0_0_27_Status",1);
		EnableControl(panel_name,"errfield_A_FSG_4_0_0_27",1);
		EnableControl(panel_name,"panel_A_FSG_4_0_0_27_Changed",1);
		EnableControl(panel_name,"panel_A_FSG_4_0_0_27_SetGet",1);
		setControlForeColor(panel_name, gCheckbox27, MakeRGB(0,240,0));
	}
	else
	{
		EnableControl(panel_name, "panel_A_FSG_4_0_0_27",0);
		EnableControl(panel_name,"panel_A_FSG_4_0_0_27_Status",0);
		EnableControl(panel_name,"errfield_A_FSG_4_0_0_27",0);
		EnableControl(panel_name,"panel_A_FSG_4_0_0_27_Changed",0);
		EnableControl(panel_name,"panel_A_FSG_4_0_0_27_SetGet",0);
		setControlForeColor(panel_name, gCheckbox27, MakeRGB(250,0,0));
	}
	if(getValue(P_FSG_4_0_0_28_FctLstItemEn))
	{
		EnableControl(panel_name, "panel_P_FSG_4_0_0_28",1);
		EnableControl(panel_name,"errfield_P_FSG_4_0_0_28",1);
		setControlForeColor(panel_name, gCheckbox28, MakeRGB(0,240,0));
	}
	else
	{
		EnableControl(panel_name, "panel_P_FSG_4_0_0_28",0);
		EnableControl(panel_name,"errfield_P_FSG_4_0_0_28",0);
		setControlForeColor(panel_name, gCheckbox28, MakeRGB(250,0,0));
	}
	if(getValue(P_FSG_4_0_0_29_FctLstItemEn))
	{
		EnableControl(panel_name, "panel_P_FSG_4_0_0_29",1);
		EnableControl(panel_name,"errfield_P_FSG_4_0_0_29",1);
		setControlForeColor(panel_name, gCheckbox29, MakeRGB(0,240,0));
	}
	else
	{
		EnableControl(panel_name, "panel_P_FSG_4_0_0_29",0);
		EnableControl(panel_name,"errfield_P_FSG_4_0_0_29",0);
		setControlForeColor(panel_name, gCheckbox29, MakeRGB(250,0,0));
	}

}

resetErrfieldColor()
{
  	setControlBackColor(panel_name, "errfield_C_FSG_4_0_0_1", MakeRGB(255,255,255));
	setControlBackColor(panel_name, "errfield_P_FSG_4_0_0_2", MakeRGB(255,255,255));
	setControlBackColor(panel_name, "errfield_P_FSG_4_0_0_3", MakeRGB(255,255,255));
	setControlBackColor(panel_name, "errfield_P_FSG_4_0_0_4", MakeRGB(255,255,255));
	setControlBackColor(panel_name, "errfield_P_FSG_4_0_0_13", MakeRGB(255,255,255));
	setControlBackColor(panel_name, "errfield_P_FSG_4_0_0_14", MakeRGB(255,255,255));
	setControlBackColor(panel_name, "errfield_P_FSG_4_0_0_15", MakeRGB(255,255,255));
	setControlBackColor(panel_name, "errfield_P_FSG_4_0_0_16", MakeRGB(255,255,255));
	setControlBackColor(panel_name, "errfield_P_FSG_4_0_0_17", MakeRGB(255,255,255));
	setControlBackColor(panel_name, "errfield_P_FSG_4_0_0_18", MakeRGB(255,255,255));
	setControlBackColor(panel_name, "errfield_P_FSG_4_0_0_19", MakeRGB(255,255,255));
	setControlBackColor(panel_name, "errfield_P_FSG_4_0_0_20", MakeRGB(255,255,255));
	setControlBackColor(panel_name, "errfield_P_FSG_4_0_0_21", MakeRGB(255,255,255));
	setControlBackColor(panel_name, "errfield_P_FSG_4_0_0_22", MakeRGB(255,255,255));
	setControlBackColor(panel_name, "errfield_P_FSG_4_0_0_23", MakeRGB(255,255,255));
	setControlBackColor(panel_name, "errfield_P_FSG_4_0_0_24", MakeRGB(255,255,255));
	setControlBackColor(panel_name, "errfield_A_FSG_4_0_0_25", MakeRGB(255,255,255));
	setControlBackColor(panel_name, "errfield_P_FSG_4_0_0_26", MakeRGB(255,255,255));
	setControlBackColor(panel_name, "errfield_A_FSG_4_0_0_27", MakeRGB(255,255,255));
	setControlBackColor(panel_name, "errfield_P_FSG_4_0_0_28", MakeRGB(255,255,255));
	setControlBackColor(panel_name, "errfield_P_FSG_4_0_0_29", MakeRGB(255,255,255));

}

CANoe_Shutdown ()
{
	// Timer: cancel real CAN-communication timer
	canceltimer(TaskTimer);
	// Ruecksetzen der Hintergrundfarbe der Error-Felder
	resetErrfieldColor();
	// Deaktivierung aller Panel Elemente 
	EnableConfigCtrl();
}

on timer TaskTimer
{
	/*** Aufruf des BAP Task in DLL fuer NODE_INDEX ***/
	BAP150_Task(NODE_INDEX);	

	/*** Pollen ueber die anstehenden Indications (Lesen aus DLL, Auslesen eines Puffers der DLL) ***/
	BAP_DLL_Indication();	
	
	/*** Pollen ueber die anstehenden Requests (Schreiben in DLL, dort werden evt. Sendeauftraege gesetzt) ***/
	BAP_DLL_Request();
	
	/*** Abarbeiten der ausstehenden Sendeauftraege innerhalb der BAP DLL und Versenden ueber CANoe ***/
    if (getValue(eSendEnabled))
    {
        BAP_CAN_TX_Request();
    }

	BAP_DLL_SetRxData();

	/*** Retriggern des Timers mit 10 ms ***/
	setTimer(TaskTimer, TaskTime); // @TODO bei anderer Taskzeit muss hier modifiziert werden
}

BAP_DLL_SetRxData()
{
}

BAP_DLL_Indication()	//function to get received BAP-data from DLL (at BAL-interface)
{
	int length, datalength, temp;
    dword i;
	dword Indication_header[6];					// indication header from DLL
	byte BAP_data_type;

	// init local variables
	length=0;
	datalength=0;
	temp=0;
	BAP_data_type=0;

	for(i = 0; i < 6; i++)
		Indication_header[i]=0;

    // BAP-Stack needs this information for successful BAP150_GetIndication 
	Indication_header[4]=BAP_buffer_size;

	while (BAP150_GetInd(NODE_INDEX, Indication_header, gBAP_Indication_data) == 0)
	{		
		//read header and write in global variable
		for (i = 0; i < 6; i++) {
			gBAP_Indication_header[i]=Indication_header[i];	
		}
		// Verarbeiten der Indication
		Process_Current_Indication();

		// Vorbereiten fuer naechsten Durchlauf 
		Indication_header[4]=BAP_buffer_size;
	} 
}

setBitInFctList(word fctid, byte fctList[])
{
    byte byteNo ;
    byte bitno ;
    byte fctValue ;

    byteNo = fctid / 8;
    bitno = fctid % 8;
    fctValue = 0x80 >> bitno;
    fctList[byteNo] |= fctValue;
}

float round (float value, float step)
{
	return _floor(value / step + 0.5) * step;
}

ChangeConfig(long paramIndex,long config[])
{

        byte temp ;
        temp = BAP150_ChangeConfig(NODE_INDEX, paramIndex, config);
        if(temp == 0)
            writelineEx(gBAP_Trace, 0, "BAP150_ChangeConfig for %s succesful (LSG %d, NODE_INDEX %d)", NODE_NAME, LSGID, NODE_INDEX);
        else
            writelineEx(gError_Trace, 0, "BAP150_ChangeConfig error 0x%X for %s (LSG %d, NODE_INDEX %d)", temp, NODE_NAME, LSGID, NODE_INDEX);        
}

PrintIndicationError(char reason[])
{
	writelineEx(gError_Trace, 0, "%s - %s lsgId:%d fctid:%d indType:%d dataType:%s",
		reason, SGtype, gBAP_Indication_header[0], gBAP_Indication_header[1], Indicationtype_Text[gBAP_Indication_header[2]], Datatype_Text[gBAP_Indication_header[3]]);
}

initBapConfig()
{
    long config[3];
    config[0] = LSGID;
    config[1] = 0;
    config[2] = getValue(BAPCFG_FSG_4_0_0_ProtocolMajor);
    ChangeConfig(0x0012,config);
    config[2] = getValue(BAPCFG_FSG_4_0_0_ProtocolMinor);
    ChangeConfig(0x0013,config);
    config[2] = getValue(BAPCFG_FSG_4_0_0_LsgClassMajor);
    ChangeConfig(0x0010,config);
    config[2] = getValue(BAPCFG_FSG_4_0_0_LsgClassMinor);
    ChangeConfig(0x0011,config);
    config[2] = getValue(BAPCFG_FSG_4_0_0_DFMajor);
    ChangeConfig(0x0014,config);
    config[2] = getValue(BAPCFG_FSG_4_0_0_DFMinor);
    ChangeConfig(0x0015,config);
    
}

initFctList()
{
    byte fctList[8]={0,0,0,0,0,0,0,0};
    int i;
    dword request[6];
    byte errorCode;

    fctList[0]=0;
    fctList[1]=0;
    fctList[2]=0;
    fctList[3]=0;
    fctList[4]=0;
    fctList[5]=0;
    fctList[6]=0;
    fctList[7]=0;

    if( getValue( C_FSG_4_0_0_1_FctLstItemEn ))
    {
        setBitInFctList( C_FSG_4_0_0_1_ID, fctList );
    }
    if( getValue( P_FSG_4_0_0_2_FctLstItemEn ))
    {
        setBitInFctList( P_FSG_4_0_0_2_ID, fctList );
    }
    if( getValue( P_FSG_4_0_0_3_FctLstItemEn ))
    {
        setBitInFctList( P_FSG_4_0_0_3_ID, fctList );
    }
    if( getValue( P_FSG_4_0_0_4_FctLstItemEn ))
    {
        setBitInFctList( P_FSG_4_0_0_4_ID, fctList );
    }
    /*
    if( getValue( P_FSG_44_0_13_FunctionListId ))
    {
        setBitInFctList( P_FSG_44_0_13_ID, fctList );
    }
    */
    if( getValue( P_FSG_4_0_0_13_FctLstItemEn ))
    {
        setBitInFctList( P_FSG_4_0_0_13_ID, fctList );
    }
    if( getValue( P_FSG_4_0_0_14_FctLstItemEn ))
    {
        setBitInFctList( P_FSG_4_0_0_14_ID, fctList );
    }
    if( getValue( P_FSG_4_0_0_15_FctLstItemEn ))
    {
        setBitInFctList( P_FSG_4_0_0_15_ID, fctList );
    }
    if( getValue( P_FSG_4_0_0_16_FctLstItemEn ))
    {
        setBitInFctList( P_FSG_4_0_0_16_ID, fctList );
    }
    if( getValue( P_FSG_4_0_0_17_FctLstItemEn ))
    {
        setBitInFctList( P_FSG_4_0_0_17_ID, fctList );
    }
    if( getValue( P_FSG_4_0_0_18_FctLstItemEn ))
    {
        setBitInFctList( P_FSG_4_0_0_18_ID, fctList );
    }
    if( getValue( P_FSG_4_0_0_19_FctLstItemEn ))
    {
        setBitInFctList( P_FSG_4_0_0_19_ID, fctList );
    }
    if( getValue( P_FSG_4_0_0_20_FctLstItemEn ))
    {
        setBitInFctList( P_FSG_4_0_0_20_ID, fctList );
    }
    if( getValue( P_FSG_4_0_0_21_FctLstItemEn ))
    {
        setBitInFctList( P_FSG_4_0_0_21_ID, fctList );
    }
    if( getValue( P_FSG_4_0_0_22_FctLstItemEn ))
    {
        setBitInFctList( P_FSG_4_0_0_22_ID, fctList );
    }
    if( getValue( P_FSG_4_0_0_23_FctLstItemEn ))
    {
        setBitInFctList( P_FSG_4_0_0_23_ID, fctList );
    }
    if( getValue( P_FSG_4_0_0_24_FctLstItemEn ))
    {
        setBitInFctList( P_FSG_4_0_0_24_ID, fctList );
    }
    if( getValue( A_FSG_4_0_0_25_FctLstItemEn ))
    {
        setBitInFctList( A_FSG_4_0_0_25_ID, fctList );
    }
    if( getValue( P_FSG_4_0_0_26_FctLstItemEn ))
    {
        setBitInFctList( P_FSG_4_0_0_26_ID, fctList );
    }
    if( getValue( A_FSG_4_0_0_27_FctLstItemEn ))
    {
        setBitInFctList(A_FSG_4_0_0_27_ID, fctList );
    }
    if( getValue( P_FSG_4_0_0_28_FctLstItemEn ))
    {
        setBitInFctList( P_FSG_4_0_0_28_ID, fctList );
    }
    if( getValue( P_FSG_4_0_0_29_FctLstItemEn ))
    {
        setBitInFctList( P_FSG_4_0_0_29_ID, fctList );
    }

    for( i = 0; i < 8; i++ )
    {
        writelineEx( gBAP_Trace, 0, "fctList[%d]: 0x%02x ", i, fctList[i] );
    }

    request [0]=LSGID;
    request [1]=3;
    request [3]= Bap_byteSequence;
    request [4]= 8;

    errorCode=BAP150_InitSendBuf(NODE_INDEX,request,fctList);
    if(errorCode)
        writelineEx(gError_Trace, 0, "BAP150_InitSendBuf(Functionlist) returns 0x%02x ",errorCode);
}

initHeartbeat()
{
       long data[2];
   data[0]=LSGID;
   if( getValue(P_FSG_4_0_0_4_FctLstItemEn) )
      data[1]=getValue(P_FSG_4_0_0_4);
   else
      data[1]=0;
   ChangeConfig(0x00,data);
   InitSendBuf_int8(P_FSG_4_0_0_4_ID, data[1]);

}

BapOnOff(byte _on)
{
  int i, length, temp;
  char Path[255];
  
  /***** Einschalten ******/
  if(_on==1){
    getAbsFilePath(dbcan_path, Path, 255);
      if(BAP180_LoadDB(NODE_INDEX,1, 0, Path) != 0){
        writelineEx(gError_Trace, 0, "Fehler beim Laden: %s !", Path);
      }
      
    /**** Laden des BAP XML Files ****/
    getAbsFilePath(xml_path, Path, 255);
    writelineEx(gBAP_Trace, 0, "Load BAP-XML-File: %s", Path);
    if (BAP150_LoadConfig(NODE_INDEX, Path) != 0) {
        writelineEx(gError_Trace, 0, "Fehler beim Laden: %s !", Path);
    }

    
    if (BAP150_AddCanMap(NODE_INDEX, 1, 1) != 0) {
        writelineEx(gError_Trace, 0, "Fehler beim Mappen!");
    }
    
    
    // soll der BAP Stack wieder initlialisiert werden?                                 
    if(gBAP_Init==0){
        //gBAP_Init=1;
        temp=BAP150_Init(NODE_INDEX, LSGID);
        if(temp==0)
            writelineEx(gBAP_Trace, 0, "BAP_Init for %s succesful (LSG %d, NODE_INDEX %d)", NODE_NAME, LSGID, NODE_INDEX);
        else
            writelineEx(gError_Trace, 0, "BAP_Init error 0x%X for %s (LSG %d, NODE_INDEX %d)", temp, NODE_NAME, LSGID, NODE_INDEX);         
    }

    // Initialisierung aller Variablen
    Initialize_Variables();                     

    // Aktivierung aller Panelelemente
    EnableFctCtrl();
    //EnableControl(panel_name, bapconfig_panel_name, 0); // @TODO
    DisableConfigCtrl();

    
    //BAP-Shutdown
    temp = BAP150_Shutdown(NODE_INDEX, LSGID);
    if(temp==0)
        writelineEx(gBAP_Trace, 0, "BAP_Shutdown for %s succesful (LSG %d, NODE_INDEX %d)", NODE_NAME, LSGID, NODE_INDEX);
    else
        writelineEx(gError_Trace, 0, "BAP_Shutdown error 0x%X for %s (LSG %d, NODE_INDEX %d)", temp, NODE_NAME, LSGID, NODE_INDEX); 

    initBapConfig();
    initFctList();
    initHeartbeat();

    temp = BAP150_Start(NODE_INDEX, LSGID);             
    if(temp == 0)
        writelineEx(gBAP_Trace, 0, "BAP_Start for %s succesful (LSG %d, NODE_INDEX %d)", NODE_NAME, LSGID, NODE_INDEX);
    else
        writelineEx(gError_Trace, 0, "BAP_Start error 0x%X for %s (LSG %d, NODE_INDEX %d)", temp, NODE_NAME, LSGID, NODE_INDEX);        

    // setze den Timer fuer den zyklischen Aufruf des CANoe-"Tasks"
    setTimer(TaskTimer, 10);                
// ETHERNET AND FLEXRAY NOT ENABLED!
    //  BAPFsg_ProcessDebug(NODE_INDEX,DEBUG_CAN_CHANNEL, DEBUG_ID, LSGID, DEBUG_SWITCH_ON);    
  }
  else{ /***** Ausschalten ****/
      
      BAP150_Shutdown(NODE_INDEX,LSGID);
      
      CANoe_Shutdown();
      
      // ETHERNET NOT ENABLED! (CALL_FCT_CLOSE_UPD_SOCKET_TOKEN)
  }

}

Initialize_Variables()	//initialize/reset all global variables
{
	int temp;
    dword i;
	byte  InitSend_data[BAP_buffer_size];	// InitSend data for DLL
	dword InitSend_header[6];	// InitSend header for DLL

	/**** Request Buffer Geschichten initialisieren ****/
	for (i = 0; i < Requestbuffer_lines; i++)
	{
		gBAP_Requestbuffer_status[i] = 0;
	}	
	for (i = 0; i < BAP_buffer_size; i++)
	{
		InitSend_data[i] = 0;
	}	

	// @TODO nur FSG relevant
	/**** Es ist notwendig mittels InitSendbuffer alle Properties im FSG zu initialisieren ****/
           InitSend_header[0] = LSGID;       
       InitSend_header[1] = 13; 
       InitSend_header[3] = Bap_uint8;
       InitSend_header[4] = 1;
       InitSend_header[5] = getValue(P_FSG_4_0_0_13);
	 putValue(P_FSG_4_0_0_13, InitSend_header[5]);
       temp = Bap150_InitSendBuf(NODE_INDEX, InitSend_header, InitSend_data);
       if(temp != 0)
           writelineEx(gError_Trace, 0, "BAP150_InitSendBuf error 0x%X for %s (LSG %d, FCTID %d)", temp, NODE_NAME, LSGID, InitSend_header[1]);
       InitSend_header[0] = LSGID;       
       InitSend_header[1] = 14; 
       InitSend_header[3] = Bap_fixedByteSequence;
       InitSend_header[4] = 2;
       InitSend_header[5] = 0;
       getValue(P_FSG_4_0_0_14,InitSend_data);
       putValue(P_FSG_4_0_0_14,InitSend_data, 2);
       temp = Bap150_InitSendBuf(NODE_INDEX, InitSend_header, InitSend_data);
       for (i=0; i<(getValueSize(P_FSG_4_0_0_14)); i++) 
       {
           InitSend_data[i] = 0;
       }
       if(temp != 0)
           writelineEx(gError_Trace, 0, "BAP150_InitSendBuf error 0x%X for %s (LSG %d, FCTID %d)", temp, NODE_NAME, LSGID, InitSend_header[1]);
       InitSend_header[0] = LSGID;       
       InitSend_header[1] = 15; 
       InitSend_header[3] = Bap_uint8;
       InitSend_header[4] = 1;
       InitSend_header[5] = getValue(P_FSG_4_0_0_15);
	 putValue(P_FSG_4_0_0_15, InitSend_header[5]);
       temp = Bap150_InitSendBuf(NODE_INDEX, InitSend_header, InitSend_data);
       if(temp != 0)
           writelineEx(gError_Trace, 0, "BAP150_InitSendBuf error 0x%X for %s (LSG %d, FCTID %d)", temp, NODE_NAME, LSGID, InitSend_header[1]);
       InitSend_header[0] = LSGID;       
       InitSend_header[1] = 16; 
       InitSend_header[3] = Bap_fixedByteSequence;
       InitSend_header[4] = 2;
       InitSend_header[5] = 0;
       getValue(P_FSG_4_0_0_16,InitSend_data);
       putValue(P_FSG_4_0_0_16,InitSend_data, 2);
       temp = Bap150_InitSendBuf(NODE_INDEX, InitSend_header, InitSend_data);
       for (i=0; i<(getValueSize(P_FSG_4_0_0_16)); i++) 
       {
           InitSend_data[i] = 0;
       }
       if(temp != 0)
           writelineEx(gError_Trace, 0, "BAP150_InitSendBuf error 0x%X for %s (LSG %d, FCTID %d)", temp, NODE_NAME, LSGID, InitSend_header[1]);
       InitSend_header[0] = LSGID;       
       InitSend_header[1] = 17; 
       InitSend_header[3] = Bap_fixedByteSequence;
       InitSend_header[4] = 3;
       InitSend_header[5] = 0;
       getValue(P_FSG_4_0_0_17,InitSend_data);
       putValue(P_FSG_4_0_0_17,InitSend_data, 3);
       temp = Bap150_InitSendBuf(NODE_INDEX, InitSend_header, InitSend_data);
       for (i=0; i<(getValueSize(P_FSG_4_0_0_17)); i++) 
       {
           InitSend_data[i] = 0;
       }
       if(temp != 0)
           writelineEx(gError_Trace, 0, "BAP150_InitSendBuf error 0x%X for %s (LSG %d, FCTID %d)", temp, NODE_NAME, LSGID, InitSend_header[1]);
       InitSend_header[0] = LSGID;       
       InitSend_header[1] = 18; 
       InitSend_header[3] = Bap_fixedByteSequence;
       InitSend_header[4] = 2;
       InitSend_header[5] = 0;
       getValue(P_FSG_4_0_0_18,InitSend_data);
       putValue(P_FSG_4_0_0_18,InitSend_data, 2);
       temp = Bap150_InitSendBuf(NODE_INDEX, InitSend_header, InitSend_data);
       for (i=0; i<(getValueSize(P_FSG_4_0_0_18)); i++) 
       {
           InitSend_data[i] = 0;
       }
       if(temp != 0)
           writelineEx(gError_Trace, 0, "BAP150_InitSendBuf error 0x%X for %s (LSG %d, FCTID %d)", temp, NODE_NAME, LSGID, InitSend_header[1]);
       InitSend_header[0] = LSGID;       
       InitSend_header[1] = 19; 
       InitSend_header[3] = Bap_uint8;
       InitSend_header[4] = 1;
       InitSend_header[5] = getValue(P_FSG_4_0_0_19);
	 putValue(P_FSG_4_0_0_19, InitSend_header[5]);
       temp = Bap150_InitSendBuf(NODE_INDEX, InitSend_header, InitSend_data);
       if(temp != 0)
           writelineEx(gError_Trace, 0, "BAP150_InitSendBuf error 0x%X for %s (LSG %d, FCTID %d)", temp, NODE_NAME, LSGID, InitSend_header[1]);
       InitSend_header[0] = LSGID;       
       InitSend_header[1] = 20; 
       InitSend_header[3] = Bap_fixedByteSequence;
       InitSend_header[4] = 2;
       InitSend_header[5] = 0;
       getValue(P_FSG_4_0_0_20,InitSend_data);
       putValue(P_FSG_4_0_0_20,InitSend_data, 2);
       temp = Bap150_InitSendBuf(NODE_INDEX, InitSend_header, InitSend_data);
       for (i=0; i<(getValueSize(P_FSG_4_0_0_20)); i++) 
       {
           InitSend_data[i] = 0;
       }
       if(temp != 0)
           writelineEx(gError_Trace, 0, "BAP150_InitSendBuf error 0x%X for %s (LSG %d, FCTID %d)", temp, NODE_NAME, LSGID, InitSend_header[1]);
       InitSend_header[0] = LSGID;       
       InitSend_header[1] = 21; 
       InitSend_header[3] = Bap_fixedByteSequence;
       InitSend_header[4] = 6;
       InitSend_header[5] = 0;
       getValue(P_FSG_4_0_0_21,InitSend_data);
       putValue(P_FSG_4_0_0_21,InitSend_data, 6);
       temp = Bap150_InitSendBuf(NODE_INDEX, InitSend_header, InitSend_data);
       for (i=0; i<(getValueSize(P_FSG_4_0_0_21)); i++) 
       {
           InitSend_data[i] = 0;
       }
       if(temp != 0)
           writelineEx(gError_Trace, 0, "BAP150_InitSendBuf error 0x%X for %s (LSG %d, FCTID %d)", temp, NODE_NAME, LSGID, InitSend_header[1]);
       InitSend_header[0] = LSGID;       
       InitSend_header[1] = 22; 
       InitSend_header[3] = Bap_fixedByteSequence;
       InitSend_header[4] = 2;
       InitSend_header[5] = 0;
       getValue(P_FSG_4_0_0_22,InitSend_data);
       putValue(P_FSG_4_0_0_22,InitSend_data, 2);
       temp = Bap150_InitSendBuf(NODE_INDEX, InitSend_header, InitSend_data);
       for (i=0; i<(getValueSize(P_FSG_4_0_0_22)); i++) 
       {
           InitSend_data[i] = 0;
       }
       if(temp != 0)
           writelineEx(gError_Trace, 0, "BAP150_InitSendBuf error 0x%X for %s (LSG %d, FCTID %d)", temp, NODE_NAME, LSGID, InitSend_header[1]);
       InitSend_header[0] = LSGID;       
       InitSend_header[1] = 23; 
       InitSend_header[3] = Bap_fixedByteSequence;
       InitSend_header[4] = 2;
       InitSend_header[5] = 0;
       getValue(P_FSG_4_0_0_23,InitSend_data);
       putValue(P_FSG_4_0_0_23,InitSend_data, 2);
       temp = Bap150_InitSendBuf(NODE_INDEX, InitSend_header, InitSend_data);
       for (i=0; i<(getValueSize(P_FSG_4_0_0_23)); i++) 
       {
           InitSend_data[i] = 0;
       }
       if(temp != 0)
           writelineEx(gError_Trace, 0, "BAP150_InitSendBuf error 0x%X for %s (LSG %d, FCTID %d)", temp, NODE_NAME, LSGID, InitSend_header[1]);
       InitSend_header[0] = LSGID;       
       InitSend_header[1] = 24; 
       InitSend_header[3] = Bap_fixedByteSequence;
       InitSend_header[4] = 4;
       InitSend_header[5] = 0;
       getValue(P_FSG_4_0_0_24,InitSend_data);
       putValue(P_FSG_4_0_0_24,InitSend_data, 4);
       temp = Bap150_InitSendBuf(NODE_INDEX, InitSend_header, InitSend_data);
       for (i=0; i<(getValueSize(P_FSG_4_0_0_24)); i++) 
       {
           InitSend_data[i] = 0;
       }
       if(temp != 0)
           writelineEx(gError_Trace, 0, "BAP150_InitSendBuf error 0x%X for %s (LSG %d, FCTID %d)", temp, NODE_NAME, LSGID, InitSend_header[1]);
       InitSend_header[0] = LSGID;       
       InitSend_header[1] = 26; 
       InitSend_header[3] = Bap_byteSequence;
       InitSend_header[4] = 18;
       InitSend_header[5] = 0;
       getValue(P_FSG_4_0_0_26,InitSend_data);
       putValue(P_FSG_4_0_0_26,InitSend_data, 18);
       temp = Bap150_InitSendBuf(NODE_INDEX, InitSend_header, InitSend_data);
       for (i=0; i<(getValueSize(P_FSG_4_0_0_26)); i++) 
       {
           InitSend_data[i] = 0;
       }
       if(temp != 0)
           writelineEx(gError_Trace, 0, "BAP150_InitSendBuf error 0x%X for %s (LSG %d, FCTID %d)", temp, NODE_NAME, LSGID, InitSend_header[1]);
       InitSend_header[0] = LSGID;       
       InitSend_header[1] = 28; 
       InitSend_header[3] = Bap_fixedByteSequence;
       InitSend_header[4] = 2;
       InitSend_header[5] = 0;
       getValue(P_FSG_4_0_0_28,InitSend_data);
       putValue(P_FSG_4_0_0_28,InitSend_data, 2);
       temp = Bap150_InitSendBuf(NODE_INDEX, InitSend_header, InitSend_data);
       for (i=0; i<(getValueSize(P_FSG_4_0_0_28)); i++) 
       {
           InitSend_data[i] = 0;
       }
       if(temp != 0)
           writelineEx(gError_Trace, 0, "BAP150_InitSendBuf error 0x%X for %s (LSG %d, FCTID %d)", temp, NODE_NAME, LSGID, InitSend_header[1]);
       InitSend_header[0] = LSGID;       
       InitSend_header[1] = 29; 
       InitSend_header[3] = Bap_fixedByteSequence;
       InitSend_header[4] = 6;
       InitSend_header[5] = 0;
       getValue(P_FSG_4_0_0_29,InitSend_data);
       putValue(P_FSG_4_0_0_29,InitSend_data, 6);
       temp = Bap150_InitSendBuf(NODE_INDEX, InitSend_header, InitSend_data);
       for (i=0; i<(getValueSize(P_FSG_4_0_0_29)); i++) 
       {
           InitSend_data[i] = 0;
       }
       if(temp != 0)
           writelineEx(gError_Trace, 0, "BAP150_InitSendBuf error 0x%X for %s (LSG %d, FCTID %d)", temp, NODE_NAME, LSGID, InitSend_header[1]);

}

on start
{
	// noch nicht eingeschaltet
	gSG_PowerOnOff=0;
	// noch nicht initialisiert
	gBAP_Init=0;
	// open the panel, nur fuer CANoe-Version >= 5.1 erlaubt
	//openPanel(panel_name);
	// deaktiviere alle aktiven Panel Elemente, ausser AN/AUSS
    CANoe_Shutdown();
    
// ETHERNET AND FLEXRAY NOT ENABLED!
        
}

BAP_CAN_TX_Request()	//Function to send BAP-data over CAN
{
   int i;
   byte DestIp[16];
   byte TX_Data[1500];				// CAN-data
   byte TX_Data_FR[10];    		// FlexRay-Data
   dword TX_Header[13];			// Header
   message 0x100 TX_Message;	// dummy-message, Adresse wird noch modifiziert
   
   byte send_result;
   
   // ONLY CAN IS ENABLED! 
      TX_Header[0] = 1; /*BusType: 1=Can, 2=Lin, 3=Flexray, 4=Ethernet*/
   		TX_Header[2] = 64; // max-Length of TX_Data

		// Pollen ueber die Queue, die von der DLL zur Verfuegung gestellt wird
		// Diese Daten muessen ueber den CAN Bus gesendet werden
	   	while (BAP180_GetTxData(NODE_INDEX,TX_Header,TX_Data) == 0) {	
        TX_Message.CAN = TX_Header[1]; 		//CAN channel
        TX_Message.ID = TX_Header[3]; 	  //Can ID
        TX_Message.DataLength = TX_Header[2]; 		// received length
			
			  for (i=0; i<TX_Message.DataLength; i++) {	//CAN data-bytes
		  		TX_Message.byte(i) = TX_Data[i];
		  	}
		  	
        TX_Message.EDL = 0;
        TX_Message.BRS = 0;
        if(TX_Header[4] & 2) 
          TX_Message.EDL = 1;
        if(TX_Header[4] & 4) 
          TX_Message.BRS = 1;
        
		  	output(TX_Message);					//send CAN message
		  	
		  	//Versions Output
		  	if(TX_Data[0] == 0x40 && TX_Data[1] == 0x00 && TX_Header[2] == 4)
		  	{
		    	writelineEx(gBAP_Trace, 0,"Major Version: %i, Minor Version: %i", TX_Data[2], TX_Data[3]);
		  	}       
		  	TX_Header[2] = 64; // max-Length of TX_Data
	   	} 
   // ONLY CAN IS ENABLED!
   // ETHERNET NOT ENABLED! (TX_IP_TOKEN)
}

ringbuffer_write (byte lsgID, byte fctID, byte request, byte dataType, dword singleData)
{
  byte data[1];
  ringbuffer_write(lsgID, fctID, request, dataType, 0, singleData, data);
}

ringbuffer_write (byte lsgID, byte fctID, byte request, byte dataType, dword length, dword singleData, byte data[])
{
	int bufferline;
    dword i;
  
	bufferline = getNextWriteIndex();	//get next free position in ring-buffer

	if (bufferline == -1) 
	{
		writelineEx(gError_Trace, 0, "Crititcal Error: No free buffer found!");
		return;
	}
		
	gBAP_Request_header[bufferline][0] = lsgID;	// LSG
	gBAP_Request_header[bufferline][1] = fctID;	// FCT
	gBAP_Request_header[bufferline][3] = dataType; // dataType
    //writelineEx(gBAP_Trace, 0, "Write request in buffer FSG NODEINDEX:%d lsgid:%d fctid:%d requesttype:%d datatype:%d length:%d", 
    //        NODE_INDEX,lsgID,fctID,request,dataType,length);


	switch (dataType)
	{
		case Bap_void:
			gBAP_Request_header[bufferline][2] = request;	// request
			gBAP_Request_header[bufferline][4] = 0;	// length
				// Void
			// @TODO?		
			break;
		case Bap_uint8:
			gBAP_Request_header[bufferline][2] = request;		// request
			gBAP_Request_header[bufferline][5] = singleData;	// Daten		
			break;
		case Bap_uint16:
			gBAP_Request_header[bufferline][2] = request;		// request
			gBAP_Request_header[bufferline][5] = singleData;	// Daten
			break;			
		case Bap_uint32:
			gBAP_Request_header[bufferline][2] = request;		// request
			gBAP_Request_header[bufferline][5] = singleData;	// Daten		
			break;	
		case Bap_byteSequence:
			gBAP_Request_header[bufferline][2] = request;	// request
			gBAP_Request_header[bufferline][4] = length;	// length
			// Daten der ByteSequence kopieren
      for(i = 0; i < length; i++)									
				gBAP_Request_data[bufferline][i] = data[i];
		case Bap_error:
			gBAP_Request_header[bufferline][5] = singleData;	// Errorcode						
			break;
		default:
			break;
	}
}

Request_void (byte lsgID, byte fctID, byte request)
{
    ringbuffer_write (lsgID, fctID, request, Bap_void, 0);	
}

Request_int8 (byte lsgID, byte fctID, byte request, dword data)
{
    ringbuffer_write (lsgID, fctID, request, Bap_uint8, data);
}

Request_int16 (byte lsgID, byte fctID, byte request, dword data)
{
    ringbuffer_write (lsgID, fctID, request, Bap_uint16, data);
}

Request_int32 (byte lsgID, byte fctID, byte request, dword data)
{
    ringbuffer_write (lsgID, fctID, request, Bap_uint32, data);
}

Request_byteSequence (byte lsgID, byte fctID, byte request, byte data[], dword length)
{
    ringbuffer_write (lsgID, fctID, request, Bap_byteSequence, length, 0, data);
}

Request_error (byte lsgID, byte fctID, byte errorCode)
{
    ringbuffer_write (lsgID, fctID, Error_REQ, Bap_error, errorCode);
}

InitSendBuf_int8 (byte fctID, dword data)
{
    dword request[6];
    int errorCode;
    byte  InitSend_data[1];

    request [0]= LSGID;
    request [1]= fctID;
    request [3]= Bap_uint8;
    request [5]= data;

    errorCode=
    BAP150_InitSendBuf(NODE_INDEX,request,InitSend_data);
    
    if(errorCode)
        writelineEx(gError_Trace, 0, "InitSendBuf_int8 error 0x%X for %s (LSG %d, FCTID %d)", errorCode, NODE_NAME, LSGID, fctID);
    
}

InitSendBuf_int16 (byte fctID, dword data)
{
    dword request[6];
    byte errorCode;
    byte  InitSend_data[1];

    request [0]= LSGID;
    request [1]= fctID;
    request [3]= Bap_uint16;
    request [5]= data;

    errorCode=BAP150_InitSendBuf(NODE_INDEX,request,InitSend_data);
    
    if(errorCode)
        writelineEx(gError_Trace, 0, "InitSendBuf_int16 error 0x%X for %s (LSG %d, FCTID %d)", errorCode, NODE_NAME, LSGID, fctID);
}

InitSendBuf_int32 (byte fctID, dword data)
{
    dword request[6];
    byte errorCode;
    byte  InitSend_data[1];

    request [0]= LSGID;
    request [1]= fctID;
    request [3]= Bap_uint32;
    request [5]= data;

    errorCode=BAP150_InitSendBuf(NODE_INDEX,request,InitSend_data);
    
    if(errorCode)
        writelineEx(gError_Trace, 0, "InitSendBuf_int32 error 0x%X for %s (LSG %d, FCTID %d)", errorCode, NODE_NAME, LSGID, fctID);
}

InitSendBuf_byteSequence (byte fctID, byte data[], word length)
{
    dword request[6];
    byte errorCode;

    request [0]= LSGID;
    request [1]= fctID;
    request [3]= Bap_uint32;
    request [4]= length;

    errorCode=BAP150_InitSendBuf(NODE_INDEX,request,data);
    
    if(errorCode)
        writelineEx(gError_Trace, 0, "InitSendBuf_byteSequence error 0x%X for %s (LSG %d, FCTID %d)", errorCode, NODE_NAME, LSGID, fctID);
}

DisplayRequestErrorCode(dword fctID, dword errCode)
{
       switch(fctID)
   {
       case C_FSG_4_0_0_1_ID:
           gC_FSG_4_0_0_1_ErrCode = 0;
           putValue(C_FSG_4_0_0_1_ErrCode,  errCode);
           setControlBackColor(panel_name,"errfield_C_FSG_4_0_0_1", MakeRGB(255,79,79));
       break;
       case P_FSG_4_0_0_2_ID:
           gP_FSG_4_0_0_2_ErrCode = 0;
           putValue(P_FSG_4_0_0_2_ErrCode,  errCode);
           setControlBackColor(panel_name,"errfield_P_FSG_4_0_0_2", MakeRGB(255,79,79));
       break;
       case P_FSG_4_0_0_3_ID:
           gP_FSG_4_0_0_3_ErrCode = 0;
           putValue(P_FSG_4_0_0_3_ErrCode,  errCode);
           setControlBackColor(panel_name,"errfield_P_FSG_4_0_0_3", MakeRGB(255,79,79));
       break;
       case P_FSG_4_0_0_4_ID:
           gP_FSG_4_0_0_4_ErrCode = 0;
           putValue(P_FSG_4_0_0_4_ErrCode,  errCode);
           setControlBackColor(panel_name,"errfield_P_FSG_4_0_0_4", MakeRGB(255,79,79));
       break;
       case P_FSG_4_0_0_13_ID:
           gP_FSG_4_0_0_13_ErrCode = 0;
           putValue(P_FSG_4_0_0_13_ErrCode,  errCode);
           setControlBackColor(panel_name,"errfield_P_FSG_4_0_0_13", MakeRGB(255,79,79));
       break;
       case P_FSG_4_0_0_14_ID:
           gP_FSG_4_0_0_14_ErrCode = 0;
           putValue(P_FSG_4_0_0_14_ErrCode,  errCode);
           setControlBackColor(panel_name,"errfield_P_FSG_4_0_0_14", MakeRGB(255,79,79));
       break;
       case P_FSG_4_0_0_15_ID:
           gP_FSG_4_0_0_15_ErrCode = 0;
           putValue(P_FSG_4_0_0_15_ErrCode,  errCode);
           setControlBackColor(panel_name,"errfield_P_FSG_4_0_0_15", MakeRGB(255,79,79));
       break;
       case P_FSG_4_0_0_16_ID:
           gP_FSG_4_0_0_16_ErrCode = 0;
           putValue(P_FSG_4_0_0_16_ErrCode,  errCode);
           setControlBackColor(panel_name,"errfield_P_FSG_4_0_0_16", MakeRGB(255,79,79));
       break;
       case P_FSG_4_0_0_17_ID:
           gP_FSG_4_0_0_17_ErrCode = 0;
           putValue(P_FSG_4_0_0_17_ErrCode,  errCode);
           setControlBackColor(panel_name,"errfield_P_FSG_4_0_0_17", MakeRGB(255,79,79));
       break;
       case P_FSG_4_0_0_18_ID:
           gP_FSG_4_0_0_18_ErrCode = 0;
           putValue(P_FSG_4_0_0_18_ErrCode,  errCode);
           setControlBackColor(panel_name,"errfield_P_FSG_4_0_0_18", MakeRGB(255,79,79));
       break;
       case P_FSG_4_0_0_19_ID:
           gP_FSG_4_0_0_19_ErrCode = 0;
           putValue(P_FSG_4_0_0_19_ErrCode,  errCode);
           setControlBackColor(panel_name,"errfield_P_FSG_4_0_0_19", MakeRGB(255,79,79));
       break;
       case P_FSG_4_0_0_20_ID:
           gP_FSG_4_0_0_20_ErrCode = 0;
           putValue(P_FSG_4_0_0_20_ErrCode,  errCode);
           setControlBackColor(panel_name,"errfield_P_FSG_4_0_0_20", MakeRGB(255,79,79));
       break;
       case P_FSG_4_0_0_21_ID:
           gP_FSG_4_0_0_21_ErrCode = 0;
           putValue(P_FSG_4_0_0_21_ErrCode,  errCode);
           setControlBackColor(panel_name,"errfield_P_FSG_4_0_0_21", MakeRGB(255,79,79));
       break;
       case P_FSG_4_0_0_22_ID:
           gP_FSG_4_0_0_22_ErrCode = 0;
           putValue(P_FSG_4_0_0_22_ErrCode,  errCode);
           setControlBackColor(panel_name,"errfield_P_FSG_4_0_0_22", MakeRGB(255,79,79));
       break;
       case P_FSG_4_0_0_23_ID:
           gP_FSG_4_0_0_23_ErrCode = 0;
           putValue(P_FSG_4_0_0_23_ErrCode,  errCode);
           setControlBackColor(panel_name,"errfield_P_FSG_4_0_0_23", MakeRGB(255,79,79));
       break;
       case P_FSG_4_0_0_24_ID:
           gP_FSG_4_0_0_24_ErrCode = 0;
           putValue(P_FSG_4_0_0_24_ErrCode,  errCode);
           setControlBackColor(panel_name,"errfield_P_FSG_4_0_0_24", MakeRGB(255,79,79));
       break;
       case A_FSG_4_0_0_25_ID:
           gA_FSG_4_0_0_25_ErrCode = 0;
           putValue(A_FSG_4_0_0_25_ErrCode,  errCode);
           setControlBackColor(panel_name,"errfield_A_FSG_4_0_0_25", MakeRGB(255,79,79));
       break;
       case P_FSG_4_0_0_26_ID:
           gP_FSG_4_0_0_26_ErrCode = 0;
           putValue(P_FSG_4_0_0_26_ErrCode,  errCode);
           setControlBackColor(panel_name,"errfield_P_FSG_4_0_0_26", MakeRGB(255,79,79));
       break;
       case A_FSG_4_0_0_27_ID:
           gA_FSG_4_0_0_27_ErrCode = 0;
           putValue(A_FSG_4_0_0_27_ErrCode,  errCode);
           setControlBackColor(panel_name,"errfield_A_FSG_4_0_0_27", MakeRGB(255,79,79));
       break;
       case P_FSG_4_0_0_28_ID:
           gP_FSG_4_0_0_28_ErrCode = 0;
           putValue(P_FSG_4_0_0_28_ErrCode,  errCode);
           setControlBackColor(panel_name,"errfield_P_FSG_4_0_0_28", MakeRGB(255,79,79));
       break;
       case P_FSG_4_0_0_29_ID:
           gP_FSG_4_0_0_29_ErrCode = 0;
           putValue(P_FSG_4_0_0_29_ErrCode,  errCode);
           setControlBackColor(panel_name,"errfield_P_FSG_4_0_0_29", MakeRGB(255,79,79));
       break;
       default:
           writelineEx(gError_Trace, 0, "%s%d/%d Unknown Functionid in  displayErrorCode", SGtype, LSGID,fctID);
   }

}

BAP_DLL_Request ()
{
    dword i;
    int l=0;
    byte temp;
    byte Request_data[BAP_buffer_size];    //Request data for DLL
    dword Request_header[6];    //Request header for DLL
    byte dataValid;
    int nextElementToRead;
    
    // defaultmaessig ist senden OK
    dataValid = 1;

    // loeschen der Daten "Container"
    for(i=0;i<6;i++)
        Request_header[i]=0;
    //for(i=0;i<BAP_buffer_size;i++)
    //    Request_data[i]=0;

    
    // Verarbeiten aller noch offenen Requests  
    while ((nextElementToRead = getNextReadIndex()) != -1) 
    {
        // Fuer alle Datentypen gleich
        Request_header[0]=gBAP_Request_header [nextElementToRead][0];       //LSG-ID
        Request_header[1]=gBAP_Request_header [nextElementToRead][1];       //Function-ID
        Request_header[2]=gBAP_Request_header [nextElementToRead][2];       //request type
        Request_header[3]=gBAP_Request_header [nextElementToRead][3];       //BAP data type

        switch(gBAP_Request_header[nextElementToRead][3]){
            case Bap_uint32:
                l=2;
            case Bap_uint16:
                l++;
            case Bap_uint8:
            case Bap_error: // Request (2) wird dabei ignoriert
                l++;
            case Bap_void:  // Datenfeld (5) wird dabei ignoriert
                Request_header[4]=l;                                                //  not used
                Request_header[5]=gBAP_Request_header [nextElementToRead][5];       // Daten
            break;
            case Bap_byteSequence:                                  
                Request_header[4]=gBAP_Request_header [nextElementToRead][4];       // length
                Request_header[5]=0;                                                // not used

                // data-array for BAP-DLL funcion 'BAP_Request'
                for(i=0;i<Request_header[4]/*BAP_buffer_size*/;i++)
                    Request_data[i]=gBAP_Request_data [nextElementToRead][i];
                break;          
            default:
                writelineEx(gError_Trace, 0, "BAP_DLL_Request: invalid BAP-Data-Type: %d", gBAP_Request_header[nextElementToRead][3]);
                dataValid = 0;
            break;          
        }
        
        if(dataValid){
            // wie heisst der Request?
            writelineEx(gBAP_Trace, 0, "%s%d/%d BAP_Request %s datatype:%s length:%d", SGtype, Request_header[0],Request_header[1],Requesttype_Text[Request_header[2]],Datatype_Text[Request_header[3]],Request_header[4]);
            temp = BAP150_Request(NODE_INDEX, Request_header, Request_data);    //send data to BAP-DLL  
            // BAP-Request failed
            if(temp != 0){
                // Fehlercode: Request failed
                writelineEx(gError_Trace, 0, "%s%d/%d Error during BAP_Request errorcode: 0x%X", SGtype, Request_header[0],Request_header[1],temp);
                DisplayRequestErrorCode(Request_header[1],temp);
            } 
        }

    }
} 

int getNextReadIndex ()
{
	int i, ret;
	// der Puffer wird nach dem naechsten zu lesenden Eintrag durchsucht
	// Existiert keiner wird -1 zurueckgegeben
	ret = -1;

	for (i = 0; i < Requestbuffer_lines; i++)
	{
		if (gBAP_Requestbuffer_status[i] == 1)
		{
			// zum verschicken
			ret = i;
			// und wieder freigeben
			gBAP_Requestbuffer_status[i] = 0;
			break;
		}
	}

	return (ret);
}

int getNextWriteIndex ()
{
	int i, ret;
	// der Puffer wird nach dem naechsten freien Eintrag durchsucht
	// Existiert keiner wird -1 zurueckgegeben
	ret = -1;

	for (i = 0; i < Requestbuffer_lines; i++)
	{
		if (gBAP_Requestbuffer_status[i] == 0)
		{
			// zum schreiben
			ret = i;
			// belegen
			gBAP_Requestbuffer_status[i] = 1;
			break;
		}
	}

	return (ret);
}

//gBAP_Indication_header[0])  // LSGID
//gBAP_Indication_header[1]) // FCTID
//gBAP_Indication_header[2]) // IndType
//gBAP_Indication_header[3]) // Datentyp

Process_Current_Indication ()
{
   int rxsize;
   int txsize;
   byte temp[BAP_buffer_size];
   char buffer[BAP_buffer_size];
   if(strncmp(Datatype_Text[gBAP_Indication_header[3]], "acknowledge", 4)!=0) 
       writelineEx(gBAP_Trace, 0, "NodeIndex: %d: CurrentIndication %s lsgid:%d fctid:%d indType:%s dataType=%s length=%d",
               NODE_INDEX, SGtype, gBAP_Indication_header[0], gBAP_Indication_header[1], Indicationtype_Text[gBAP_Indication_header[2]], Datatype_Text[gBAP_Indication_header[3]], gBAP_Indication_header[4]);
   else 
       writelineEx(gBAP_Trace, 0, "Internal acknowledge %s-%d fctid:%d indType:%s dataType=%s length=%d",
               SGtype, gBAP_Indication_header[0], gBAP_Indication_header[1], Acknowledgetype_Text[gBAP_Indication_header[5]], Datatype_Text[gBAP_Indication_header[3]], gBAP_Indication_header[4]);
   switch(gBAP_Indication_header[0])  // LSGID
   {
   case LSGID:
       switch(gBAP_Indication_header[1]) // FCTID
       {
    case P_FSG_4_0_0_13_ID: 
        switch(gBAP_Indication_header[3]) // Datentyp 
        {
            case Bap_uint8:
                    switch(gBAP_Indication_header[2]) // IndType
                    {
                        case DataSet_IND: // Indicationtyp pruefen
                            if (getValue(P_FSG_4_0_0_13_ErrEn)) { 
                               Request_error(LSGID,P_FSG_4_0_0_13_ID,getValue(P_FSG_4_0_0_13_ErrCode)); 
                               break;
                            }
                            // Daten setzen
                            putValue(P_FSG_4_0_0_13, gBAP_Indication_header[5]);
                            setControlBackColor(panel_name, "errfield_P_FSG_4_0_0_13", MakeRGB(255,255,255));  
                            break;                              
                        case DataSetGet_IND: // Indicationtyp pruefen
                            if (getValue(P_FSG_4_0_0_13_ErrEn)) { 
                               Request_error(LSGID,P_FSG_4_0_0_13_ID,getValue(P_FSG_4_0_0_13_ErrCode)); 
                               break;
                            }
                            // Daten setzen
                            putValue(P_FSG_4_0_0_13, gBAP_Indication_header[5]);
                            setControlBackColor(panel_name, "errfield_P_FSG_4_0_0_13", MakeRGB(255,255,255));  
                            // und antworten
                            Request_Int8(LSGID, P_FSG_4_0_0_13_ID, Data_REQ, getValue(P_FSG_4_0_0_13));
                            break;
                        default:
                            PrintIndicationError("Illegal IndType");
                            break;
                    }
                    break;
            case Bap_error:
                gP_FSG_4_0_0_13_ErrCode = 0;
                putValue(P_FSG_4_0_0_13_ErrCode,  gBAP_Indication_header[5]);
                setControlBackColor(panel_name, "errfield_P_FSG_4_0_0_13", MakeRGB(255,79,79));  
                gP_FSG_4_0_0_13_ErrCode = 1;
                break;
            case Bap_acknowledge:
                break;
            default:
                    PrintIndicationError("Illegal DataType");
                    break;
        }
    break;
    case P_FSG_4_0_0_14_ID: 
        switch(gBAP_Indication_header[3]) // Datentyp 
        {
            case Bap_error:
                gP_FSG_4_0_0_14_ErrCode = 0;
                setControlBackColor(panel_name, "errfield_P_FSG_4_0_0_14", MakeRGB(255,79,79));  
                gP_FSG_4_0_0_14_ErrCode = 1;
                break;
            case Bap_acknowledge:
                break;
            default:
                PrintIndicationError("Illegal DataType");
                break;
        }
    break;
    case P_FSG_4_0_0_15_ID: 
        switch(gBAP_Indication_header[3]) // Datentyp 
        {
            case Bap_error:
                gP_FSG_4_0_0_15_ErrCode = 0;
                setControlBackColor(panel_name, "errfield_P_FSG_4_0_0_15", MakeRGB(255,79,79));  
                gP_FSG_4_0_0_15_ErrCode = 1;
                break;
            case Bap_acknowledge:
                break;
            default:
                PrintIndicationError("Illegal DataType");
                break;
        }
    break;
    case P_FSG_4_0_0_16_ID: 
        switch(gBAP_Indication_header[3]) // Datentyp 
        {
            case Bap_byteSequence:
                switch (gBAP_Indication_header[2]) // IndType
                {
                    case DataSet_IND: // Indicationtyp pruefen
                       if (getValue(P_FSG_4_0_0_16_ErrEn)) { 
                           Request_error(LSGID,P_FSG_4_0_0_16_ID,getValue(P_FSG_4_0_0_16_ErrCode)); 
                           break;
                        }
                        // Daten setzen
                        putValue(P_FSG_4_0_0_16, gBAP_Indication_data, gBAP_Indication_header[4]);
                        setControlBackColor(panel_name, "errfield_P_FSG_4_0_0_16", MakeRGB(255,255,255));  
                        break;
                    case DataSetGet_IND: // Indicationtyp pruefen
                       if (getValue(P_FSG_4_0_0_16_ErrEn)) { 
                           Request_error(LSGID,P_FSG_4_0_0_16_ID,getValue(P_FSG_4_0_0_16_ErrCode)); 
                           break;
                        }
                        // Daten setzen
						getValue(P_FSG_4_0_0_16, temp);
						gBAP_Indication_data[1]= gBAP_Indication_data[1]&0x0f;
						gBAP_Indication_data[1]= gBAP_Indication_data[1]|(temp[1]&0xf0);
						gBAP_Indication_data[1]= gBAP_Indication_data[1]&0xf0;
						gBAP_Indication_data[1]= gBAP_Indication_data[1]|(temp[1]&0x0f);
                        putValue(P_FSG_4_0_0_16, gBAP_Indication_data, gBAP_Indication_header[4]);
                        setControlBackColor(panel_name, "errfield_P_FSG_4_0_0_16", MakeRGB(255,255,255));  
                        // und antworten
                        getValue(P_FSG_4_0_0_16, temp);
                        Request_byteSequence(LSGID, P_FSG_4_0_0_16_ID, Data_REQ, temp, gBAP_Indication_header[4]);
                        break;
                    default:
                            PrintIndicationError("Illegal IndType");
                        break;
                }
                break;
            case Bap_error:
                gP_FSG_4_0_0_16_ErrCode = 0;
                putValue(P_FSG_4_0_0_16_ErrCode,  gBAP_Indication_header[5]);
                setControlBackColor(panel_name, "errfield_P_FSG_4_0_0_16", MakeRGB(255,79,79));  
                gP_FSG_4_0_0_16_ErrCode = 1;
                break;
            case Bap_acknowledge:
                break;
            default:
                PrintIndicationError("Illegal DataType");
                break;
        }
    break;
    case P_FSG_4_0_0_17_ID: 
        switch(gBAP_Indication_header[3]) // Datentyp 
        {
            case Bap_byteSequence:
                switch (gBAP_Indication_header[2]) // IndType
                {
                    case DataSet_IND: // Indicationtyp pruefen
                       if (getValue(P_FSG_4_0_0_17_ErrEn)) { 
                           Request_error(LSGID,P_FSG_4_0_0_17_ID,getValue(P_FSG_4_0_0_17_ErrCode)); 
                           break;
                        }
                        // Daten setzen
                        putValue(P_FSG_4_0_0_17, gBAP_Indication_data, gBAP_Indication_header[4]);
                        setControlBackColor(panel_name, "errfield_P_FSG_4_0_0_17", MakeRGB(255,255,255));  
                        break;
                    case DataSetGet_IND: // Indicationtyp pruefen
                       if (getValue(P_FSG_4_0_0_17_ErrEn)) { 
                           Request_error(LSGID,P_FSG_4_0_0_17_ID,getValue(P_FSG_4_0_0_17_ErrCode)); 
                           break;
                        }
                        // Daten setzen
						getValue(P_FSG_4_0_0_17, temp);
						gBAP_Indication_data[2]= gBAP_Indication_data[2]&0x0f;
						gBAP_Indication_data[2]= gBAP_Indication_data[2]|(temp[2]&0xf0);
						gBAP_Indication_data[2]= gBAP_Indication_data[2]&0xf0;
						gBAP_Indication_data[2]= gBAP_Indication_data[2]|(temp[2]&0x0f);
                        putValue(P_FSG_4_0_0_17, gBAP_Indication_data, gBAP_Indication_header[4]);
                        setControlBackColor(panel_name, "errfield_P_FSG_4_0_0_17", MakeRGB(255,255,255));  
                        // und antworten
                        getValue(P_FSG_4_0_0_17, temp);
                        Request_byteSequence(LSGID, P_FSG_4_0_0_17_ID, Data_REQ, temp, gBAP_Indication_header[4]);
                        break;
                    default:
                            PrintIndicationError("Illegal IndType");
                        break;
                }
                break;
            case Bap_error:
                gP_FSG_4_0_0_17_ErrCode = 0;
                putValue(P_FSG_4_0_0_17_ErrCode,  gBAP_Indication_header[5]);
                setControlBackColor(panel_name, "errfield_P_FSG_4_0_0_17", MakeRGB(255,79,79));  
                gP_FSG_4_0_0_17_ErrCode = 1;
                break;
            case Bap_acknowledge:
                break;
            default:
                PrintIndicationError("Illegal DataType");
                break;
        }
    break;
    case P_FSG_4_0_0_18_ID: 
        switch(gBAP_Indication_header[3]) // Datentyp 
        {
            case Bap_byteSequence:
                switch (gBAP_Indication_header[2]) // IndType
                {
                    case DataSet_IND: // Indicationtyp pruefen
                       if (getValue(P_FSG_4_0_0_18_ErrEn)) { 
                           Request_error(LSGID,P_FSG_4_0_0_18_ID,getValue(P_FSG_4_0_0_18_ErrCode)); 
                           break;
                        }
                        // Daten setzen
                        putValue(P_FSG_4_0_0_18, gBAP_Indication_data, gBAP_Indication_header[4]);
                        setControlBackColor(panel_name, "errfield_P_FSG_4_0_0_18", MakeRGB(255,255,255));  
                        break;
                    case DataSetGet_IND: // Indicationtyp pruefen
                       if (getValue(P_FSG_4_0_0_18_ErrEn)) { 
                           Request_error(LSGID,P_FSG_4_0_0_18_ID,getValue(P_FSG_4_0_0_18_ErrCode)); 
                           break;
                        }
                        // Daten setzen
						getValue(P_FSG_4_0_0_18, temp);
						gBAP_Indication_data[1]= gBAP_Indication_data[1]&0x0f;
						gBAP_Indication_data[1]= gBAP_Indication_data[1]|(temp[1]&0xf0);
						gBAP_Indication_data[1]= gBAP_Indication_data[1]&0xf0;
						gBAP_Indication_data[1]= gBAP_Indication_data[1]|(temp[1]&0x0f);
                        putValue(P_FSG_4_0_0_18, gBAP_Indication_data, gBAP_Indication_header[4]);
                        setControlBackColor(panel_name, "errfield_P_FSG_4_0_0_18", MakeRGB(255,255,255));  
                        // und antworten
                        getValue(P_FSG_4_0_0_18, temp);
                        Request_byteSequence(LSGID, P_FSG_4_0_0_18_ID, Data_REQ, temp, gBAP_Indication_header[4]);
                        break;
                    default:
                            PrintIndicationError("Illegal IndType");
                        break;
                }
                break;
            case Bap_error:
                gP_FSG_4_0_0_18_ErrCode = 0;
                putValue(P_FSG_4_0_0_18_ErrCode,  gBAP_Indication_header[5]);
                setControlBackColor(panel_name, "errfield_P_FSG_4_0_0_18", MakeRGB(255,79,79));  
                gP_FSG_4_0_0_18_ErrCode = 1;
                break;
            case Bap_acknowledge:
                break;
            default:
                PrintIndicationError("Illegal DataType");
                break;
        }
    break;
    case P_FSG_4_0_0_19_ID: 
        switch(gBAP_Indication_header[3]) // Datentyp 
        {
            case Bap_error:
                gP_FSG_4_0_0_19_ErrCode = 0;
                setControlBackColor(panel_name, "errfield_P_FSG_4_0_0_19", MakeRGB(255,79,79));  
                gP_FSG_4_0_0_19_ErrCode = 1;
                break;
            case Bap_acknowledge:
                break;
            default:
                PrintIndicationError("Illegal DataType");
                break;
        }
    break;
    case P_FSG_4_0_0_20_ID: 
        switch(gBAP_Indication_header[3]) // Datentyp 
        {
            case Bap_byteSequence:
                switch (gBAP_Indication_header[2]) // IndType
                {
                    case DataSet_IND: // Indicationtyp pruefen
                       if (getValue(P_FSG_4_0_0_20_ErrEn)) { 
                           Request_error(LSGID,P_FSG_4_0_0_20_ID,getValue(P_FSG_4_0_0_20_ErrCode)); 
                           break;
                        }
                        // Daten setzen
                        putValue(P_FSG_4_0_0_20, gBAP_Indication_data, gBAP_Indication_header[4]);
                        setControlBackColor(panel_name, "errfield_P_FSG_4_0_0_20", MakeRGB(255,255,255));  
                        break;
                    case DataSetGet_IND: // Indicationtyp pruefen
                       if (getValue(P_FSG_4_0_0_20_ErrEn)) { 
                           Request_error(LSGID,P_FSG_4_0_0_20_ID,getValue(P_FSG_4_0_0_20_ErrCode)); 
                           break;
                        }
                        // Daten setzen
						getValue(P_FSG_4_0_0_20, temp);
						gBAP_Indication_data[1]= gBAP_Indication_data[1]&0x0f;
						gBAP_Indication_data[1]= gBAP_Indication_data[1]|(temp[1]&0xf0);
						gBAP_Indication_data[1]= gBAP_Indication_data[1]&0xf0;
						gBAP_Indication_data[1]= gBAP_Indication_data[1]|(temp[1]&0x0f);
                        putValue(P_FSG_4_0_0_20, gBAP_Indication_data, gBAP_Indication_header[4]);
                        setControlBackColor(panel_name, "errfield_P_FSG_4_0_0_20", MakeRGB(255,255,255));  
                        // und antworten
                        getValue(P_FSG_4_0_0_20, temp);
                        Request_byteSequence(LSGID, P_FSG_4_0_0_20_ID, Data_REQ, temp, gBAP_Indication_header[4]);
                        break;
                    default:
                            PrintIndicationError("Illegal IndType");
                        break;
                }
                break;
            case Bap_error:
                gP_FSG_4_0_0_20_ErrCode = 0;
                putValue(P_FSG_4_0_0_20_ErrCode,  gBAP_Indication_header[5]);
                setControlBackColor(panel_name, "errfield_P_FSG_4_0_0_20", MakeRGB(255,79,79));  
                gP_FSG_4_0_0_20_ErrCode = 1;
                break;
            case Bap_acknowledge:
                break;
            default:
                PrintIndicationError("Illegal DataType");
                break;
        }
    break;
    case P_FSG_4_0_0_21_ID: 
        switch(gBAP_Indication_header[3]) // Datentyp 
        {
            case Bap_error:
                gP_FSG_4_0_0_21_ErrCode = 0;
                setControlBackColor(panel_name, "errfield_P_FSG_4_0_0_21", MakeRGB(255,79,79));  
                gP_FSG_4_0_0_21_ErrCode = 1;
                break;
            case Bap_acknowledge:
                break;
            default:
                PrintIndicationError("Illegal DataType");
                break;
        }
    break;
    case P_FSG_4_0_0_22_ID: 
        switch(gBAP_Indication_header[3]) // Datentyp 
        {
            case Bap_byteSequence:
                switch (gBAP_Indication_header[2]) // IndType
                {
                    case DataSet_IND: // Indicationtyp pruefen
                       if (getValue(P_FSG_4_0_0_22_ErrEn)) { 
                           Request_error(LSGID,P_FSG_4_0_0_22_ID,getValue(P_FSG_4_0_0_22_ErrCode)); 
                           break;
                        }
                        // Daten setzen
                        putValue(P_FSG_4_0_0_22, gBAP_Indication_data, gBAP_Indication_header[4]);
                        setControlBackColor(panel_name, "errfield_P_FSG_4_0_0_22", MakeRGB(255,255,255));  
                        break;
                    case DataSetGet_IND: // Indicationtyp pruefen
                       if (getValue(P_FSG_4_0_0_22_ErrEn)) { 
                           Request_error(LSGID,P_FSG_4_0_0_22_ID,getValue(P_FSG_4_0_0_22_ErrCode)); 
                           break;
                        }
                        // Daten setzen
						getValue(P_FSG_4_0_0_22, temp);
						gBAP_Indication_data[1]= gBAP_Indication_data[1]&0x0f;
						gBAP_Indication_data[1]= gBAP_Indication_data[1]|(temp[1]&0xf0);
						gBAP_Indication_data[1]= gBAP_Indication_data[1]&0xf0;
						gBAP_Indication_data[1]= gBAP_Indication_data[1]|(temp[1]&0x0f);
                        putValue(P_FSG_4_0_0_22, gBAP_Indication_data, gBAP_Indication_header[4]);
                        setControlBackColor(panel_name, "errfield_P_FSG_4_0_0_22", MakeRGB(255,255,255));  
                        // und antworten
                        getValue(P_FSG_4_0_0_22, temp);
                        Request_byteSequence(LSGID, P_FSG_4_0_0_22_ID, Data_REQ, temp, gBAP_Indication_header[4]);
                        break;
                    default:
                            PrintIndicationError("Illegal IndType");
                        break;
                }
                break;
            case Bap_error:
                gP_FSG_4_0_0_22_ErrCode = 0;
                putValue(P_FSG_4_0_0_22_ErrCode,  gBAP_Indication_header[5]);
                setControlBackColor(panel_name, "errfield_P_FSG_4_0_0_22", MakeRGB(255,79,79));  
                gP_FSG_4_0_0_22_ErrCode = 1;
                break;
            case Bap_acknowledge:
                break;
            default:
                PrintIndicationError("Illegal DataType");
                break;
        }
    break;
    case P_FSG_4_0_0_23_ID: 
        switch(gBAP_Indication_header[3]) // Datentyp 
        {
            case Bap_byteSequence:
                switch (gBAP_Indication_header[2]) // IndType
                {
                    case DataSet_IND: // Indicationtyp pruefen
                       if (getValue(P_FSG_4_0_0_23_ErrEn)) { 
                           Request_error(LSGID,P_FSG_4_0_0_23_ID,getValue(P_FSG_4_0_0_23_ErrCode)); 
                           break;
                        }
                        // Daten setzen
                        putValue(P_FSG_4_0_0_23, gBAP_Indication_data, gBAP_Indication_header[4]);
                        setControlBackColor(panel_name, "errfield_P_FSG_4_0_0_23", MakeRGB(255,255,255));  
                        break;
                    case DataSetGet_IND: // Indicationtyp pruefen
                       if (getValue(P_FSG_4_0_0_23_ErrEn)) { 
                           Request_error(LSGID,P_FSG_4_0_0_23_ID,getValue(P_FSG_4_0_0_23_ErrCode)); 
                           break;
                        }
                        // Daten setzen
						getValue(P_FSG_4_0_0_23, temp);
						gBAP_Indication_data[1]= gBAP_Indication_data[1]&0x0f;
						gBAP_Indication_data[1]= gBAP_Indication_data[1]|(temp[1]&0xf0);
						gBAP_Indication_data[1]= gBAP_Indication_data[1]&0xf0;
						gBAP_Indication_data[1]= gBAP_Indication_data[1]|(temp[1]&0x0f);
                        putValue(P_FSG_4_0_0_23, gBAP_Indication_data, gBAP_Indication_header[4]);
                        setControlBackColor(panel_name, "errfield_P_FSG_4_0_0_23", MakeRGB(255,255,255));  
                        // und antworten
                        getValue(P_FSG_4_0_0_23, temp);
                        Request_byteSequence(LSGID, P_FSG_4_0_0_23_ID, Data_REQ, temp, gBAP_Indication_header[4]);
                        break;
                    default:
                            PrintIndicationError("Illegal IndType");
                        break;
                }
                break;
            case Bap_error:
                gP_FSG_4_0_0_23_ErrCode = 0;
                putValue(P_FSG_4_0_0_23_ErrCode,  gBAP_Indication_header[5]);
                setControlBackColor(panel_name, "errfield_P_FSG_4_0_0_23", MakeRGB(255,79,79));  
                gP_FSG_4_0_0_23_ErrCode = 1;
                break;
            case Bap_acknowledge:
                break;
            default:
                PrintIndicationError("Illegal DataType");
                break;
        }
    break;
    case P_FSG_4_0_0_24_ID: 
        switch(gBAP_Indication_header[3]) // Datentyp 
        {
            case Bap_byteSequence:
                switch (gBAP_Indication_header[2]) // IndType
                {
                    case DataSet_IND: // Indicationtyp pruefen
                       if (getValue(P_FSG_4_0_0_24_ErrEn)) { 
                           Request_error(LSGID,P_FSG_4_0_0_24_ID,getValue(P_FSG_4_0_0_24_ErrCode)); 
                           break;
                        }
                        // Daten setzen
                        putValue(P_FSG_4_0_0_24, gBAP_Indication_data, gBAP_Indication_header[4]);
                        setControlBackColor(panel_name, "errfield_P_FSG_4_0_0_24", MakeRGB(255,255,255));  
                        break;
                    case DataSetGet_IND: // Indicationtyp pruefen
                       if (getValue(P_FSG_4_0_0_24_ErrEn)) { 
                           Request_error(LSGID,P_FSG_4_0_0_24_ID,getValue(P_FSG_4_0_0_24_ErrCode)); 
                           break;
                        }
                        // Daten setzen
						getValue(P_FSG_4_0_0_24, temp);
						gBAP_Indication_data[3]= gBAP_Indication_data[3]&0x0f;
						gBAP_Indication_data[3]= gBAP_Indication_data[3]|(temp[3]&0xf0);
						gBAP_Indication_data[3]= gBAP_Indication_data[3]&0xf0;
						gBAP_Indication_data[3]= gBAP_Indication_data[3]|(temp[3]&0x0f);
                        putValue(P_FSG_4_0_0_24, gBAP_Indication_data, gBAP_Indication_header[4]);
                        setControlBackColor(panel_name, "errfield_P_FSG_4_0_0_24", MakeRGB(255,255,255));  
                        // und antworten
                        getValue(P_FSG_4_0_0_24, temp);
                        Request_byteSequence(LSGID, P_FSG_4_0_0_24_ID, Data_REQ, temp, gBAP_Indication_header[4]);
                        break;
                    default:
                            PrintIndicationError("Illegal IndType");
                        break;
                }
                break;
            case Bap_error:
                gP_FSG_4_0_0_24_ErrCode = 0;
                putValue(P_FSG_4_0_0_24_ErrCode,  gBAP_Indication_header[5]);
                setControlBackColor(panel_name, "errfield_P_FSG_4_0_0_24", MakeRGB(255,79,79));  
                gP_FSG_4_0_0_24_ErrCode = 1;
                break;
            case Bap_acknowledge:
                break;
            default:
                PrintIndicationError("Illegal DataType");
                break;
        }
    break;
    case A_FSG_4_0_0_25_ID: 
    switch(gBAP_Indication_header[3]) // Datentyp
    {
        case Bap_byteSequence:
            switch (gBAP_Indication_header[2]) // IndType
            {
                case DataSet_IND: // Indicationtyp pruefen
                    if (getValue(A_FSG_4_0_0_25_ErrEn)) { 
                               Request_error(LSGID,A_FSG_4_0_0_25_ID,getValue(A_FSG_4_0_0_25_ErrCode)); 
                               break;
                    }
                    // Daten setzen
                    //putValue(A_FSG_4_0_0_25_SetGet, gBAP_Indication_data, gBAP_Indication_header[4]);
                        A_FSG_4_0_0_25_SetInd();
                    setControlBackColor(panel_name, "errfield_A_FSG_4_0_0_25", MakeRGB(255,255,255));  
                    break;
                case DataGet_IND:
                    if (getValue(A_FSG_4_0_0_25_ErrEn)) { 
                               Request_error(LSGID,A_FSG_4_0_0_25_ID,getValue(A_FSG_4_0_0_25_ErrCode)); 
                               break;
                    }
                    // Daten setzen
                    //putValue(A_FSG_4_0_0_25_SetGet, gBAP_Indication_data, gBAP_Indication_header[4]);
                        A_FSG_4_0_0_25_GetInd();
                    setControlBackColor(panel_name, "errfield_A_FSG_4_0_0_25", MakeRGB(255,255,255));  
                    // und antworten
                    //getValue(A_FSG_4_0_0_25, temp);
                    //Request_byteSequence(LSGID, A_FSG_4_0_0_25_ID, Data_REQ, temp, getValueSize(A_FSG_4_0_0_25));
                    //Button fuer Status betaetigen => antwort status wird geschickt, code sparen
                    //putValue(A_FSG_4_0_0_25Status_BTN, 1);
                    //putValue(A_FSG_4_0_0_25Status_BTN, 0);
                    A_FSG_4_0_0_25_SendStatus();
                    break;
                case DataSetGet_IND: // Indicationtyp pruefen
                    if (getValue(A_FSG_4_0_0_25_ErrEn)) { 
                               Request_error(LSGID,A_FSG_4_0_0_25_ID,getValue(A_FSG_4_0_0_25_ErrCode)); 
                               break;
                    }
                    // Daten setzen
                    //putValue(A_FSG_4_0_0_25_SetGet, gBAP_Indication_data, gBAP_Indication_header[4]);
                        A_FSG_4_0_0_25_SetGetInd();
                    setControlBackColor(panel_name, "errfield_A_FSG_4_0_0_25", MakeRGB(255,255,255));  
                    // und antworten
                    //getValue(A_FSG_4_0_0_25, temp);
                    //Request_byteSequence(LSGID, A_FSG_4_0_0_25_ID, Data_REQ, temp, getValueSize(A_FSG_4_0_0_25));
                    //Button fuer Status betaetigen => antwort status wird geschickt, code sparen
                    //putValue(A_FSG_4_0_0_25Status_BTN, 1);
                    //putValue(A_FSG_4_0_0_25Status_BTN, 0);
                    A_FSG_4_0_0_25_SendStatus();
                    break;
                default:
                    PrintIndicationError("Illegal IndType");
                    break;
            }
            break;
            case Bap_error:
                gA_FSG_4_0_0_25_ErrCode = 0;
                putValue(A_FSG_4_0_0_25_ErrCode,  gBAP_Indication_header[5]);
                setControlBackColor(panel_name, "errfield_A_FSG_4_0_0_25", MakeRGB(255,79,79));  
                gA_FSG_4_0_0_25_ErrCode = 1;
                break;
            case Bap_acknowledge:
                break;
            default:
                PrintIndicationError("Illegal DataType");
                break;
        }
    break;
    case P_FSG_4_0_0_26_ID: 
        switch(gBAP_Indication_header[3]) // Datentyp 
        {
            case Bap_byteSequence:
                switch (gBAP_Indication_header[2]) // IndType
                {
                    case DataSet_IND: // Indicationtyp pruefen
                       if (getValue(P_FSG_4_0_0_26_ErrEn)) { 
                           Request_error(LSGID,P_FSG_4_0_0_26_ID,getValue(P_FSG_4_0_0_26_ErrCode)); 
                           break;
                        }
                        // Daten setzen
                        putValue(P_FSG_4_0_0_26, gBAP_Indication_data, gBAP_Indication_header[4]);
                        setControlBackColor(panel_name, "errfield_P_FSG_4_0_0_26", MakeRGB(255,255,255));  
                        break;
                    case DataSetGet_IND: // Indicationtyp pruefen
                       if (getValue(P_FSG_4_0_0_26_ErrEn)) { 
                           Request_error(LSGID,P_FSG_4_0_0_26_ID,getValue(P_FSG_4_0_0_26_ErrCode)); 
                           break;
                        }
                        // Daten setzen
						getValue(P_FSG_4_0_0_26, temp);
						gBAP_Indication_data[0]= gBAP_Indication_data[0]&0x0f;
						gBAP_Indication_data[0]= gBAP_Indication_data[0]|(temp[0]&0xf0);
						gBAP_Indication_data[1]= gBAP_Indication_data[1]&0x0f;
						gBAP_Indication_data[1]= gBAP_Indication_data[1]|(temp[1]&0xf0);
						gBAP_Indication_data[2]= gBAP_Indication_data[2]&0x0f;
						gBAP_Indication_data[2]= gBAP_Indication_data[2]|(temp[2]&0xf0);
						gBAP_Indication_data[3]= gBAP_Indication_data[3]&0x0f;
						gBAP_Indication_data[3]= gBAP_Indication_data[3]|(temp[3]&0xf0);
						gBAP_Indication_data[4]= gBAP_Indication_data[4]&0x0f;
						gBAP_Indication_data[4]= gBAP_Indication_data[4]|(temp[4]&0xf0);
						gBAP_Indication_data[5]= gBAP_Indication_data[5]&0x0f;
						gBAP_Indication_data[5]= gBAP_Indication_data[5]|(temp[5]&0xf0);
						gBAP_Indication_data[6]= gBAP_Indication_data[6]&0x0f;
						gBAP_Indication_data[6]= gBAP_Indication_data[6]|(temp[6]&0xf0);
						gBAP_Indication_data[7]= gBAP_Indication_data[7]&0x0f;
						gBAP_Indication_data[7]= gBAP_Indication_data[7]|(temp[7]&0xf0);
						gBAP_Indication_data[8]= gBAP_Indication_data[8]&0x0f;
						gBAP_Indication_data[8]= gBAP_Indication_data[8]|(temp[8]&0xf0);
                        putValue(P_FSG_4_0_0_26, gBAP_Indication_data, gBAP_Indication_header[4]);
                        setControlBackColor(panel_name, "errfield_P_FSG_4_0_0_26", MakeRGB(255,255,255));  
                        // und antworten
                        getValue(P_FSG_4_0_0_26, temp);
                        Request_byteSequence(LSGID, P_FSG_4_0_0_26_ID, Data_REQ, temp, gBAP_Indication_header[4]);
                        break;
                    default:
                            PrintIndicationError("Illegal IndType");
                        break;
                }
                break;
            case Bap_error:
                gP_FSG_4_0_0_26_ErrCode = 0;
                putValue(P_FSG_4_0_0_26_ErrCode,  gBAP_Indication_header[5]);
                setControlBackColor(panel_name, "errfield_P_FSG_4_0_0_26", MakeRGB(255,79,79));  
                gP_FSG_4_0_0_26_ErrCode = 1;
                break;
            case Bap_acknowledge:
                break;
            default:
                PrintIndicationError("Illegal DataType");
                break;
        }
    break;
    case A_FSG_4_0_0_27_ID: 
    switch(gBAP_Indication_header[3]) // Datentyp
    {
        case Bap_byteSequence:
            switch (gBAP_Indication_header[2]) // IndType
            {
                case DataSet_IND: // Indicationtyp pruefen
                    if (getValue(A_FSG_4_0_0_27_ErrEn)) { 
                               Request_error(LSGID,A_FSG_4_0_0_27_ID,getValue(A_FSG_4_0_0_27_ErrCode)); 
                               break;
                    }
                    // Daten setzen
                    //putValue(A_FSG_4_0_0_27_SetGet, gBAP_Indication_data, gBAP_Indication_header[4]);
                        A_FSG_4_0_0_27_SetInd();
                    setControlBackColor(panel_name, "errfield_A_FSG_4_0_0_27", MakeRGB(255,255,255));  
                    break;
                case DataGet_IND:
                    if (getValue(A_FSG_4_0_0_27_ErrEn)) { 
                               Request_error(LSGID,A_FSG_4_0_0_27_ID,getValue(A_FSG_4_0_0_27_ErrCode)); 
                               break;
                    }
                    // Daten setzen
                    //putValue(A_FSG_4_0_0_27_SetGet, gBAP_Indication_data, gBAP_Indication_header[4]);
                        A_FSG_4_0_0_27_GetInd();
                    setControlBackColor(panel_name, "errfield_A_FSG_4_0_0_27", MakeRGB(255,255,255));  
                    // und antworten
                    //getValue(A_FSG_4_0_0_27, temp);
                    //Request_byteSequence(LSGID, A_FSG_4_0_0_27_ID, Data_REQ, temp, getValueSize(A_FSG_4_0_0_27));
                    //Button fuer Status betaetigen => antwort status wird geschickt, code sparen
                    //putValue(A_FSG_4_0_0_27Status_BTN, 1);
                    //putValue(A_FSG_4_0_0_27Status_BTN, 0);
                    A_FSG_4_0_0_27_SendStatus();
                    break;
                case DataSetGet_IND: // Indicationtyp pruefen
                    if (getValue(A_FSG_4_0_0_27_ErrEn)) { 
                               Request_error(LSGID,A_FSG_4_0_0_27_ID,getValue(A_FSG_4_0_0_27_ErrCode)); 
                               break;
                    }
                    // Daten setzen
                    //putValue(A_FSG_4_0_0_27_SetGet, gBAP_Indication_data, gBAP_Indication_header[4]);
                        A_FSG_4_0_0_27_SetGetInd();
                    setControlBackColor(panel_name, "errfield_A_FSG_4_0_0_27", MakeRGB(255,255,255));  
                    // und antworten
                    //getValue(A_FSG_4_0_0_27, temp);
                    //Request_byteSequence(LSGID, A_FSG_4_0_0_27_ID, Data_REQ, temp, getValueSize(A_FSG_4_0_0_27));
                    //Button fuer Status betaetigen => antwort status wird geschickt, code sparen
                    //putValue(A_FSG_4_0_0_27Status_BTN, 1);
                    //putValue(A_FSG_4_0_0_27Status_BTN, 0);
                    A_FSG_4_0_0_27_SendStatus();
                    break;
                default:
                    PrintIndicationError("Illegal IndType");
                    break;
            }
            break;
            case Bap_error:
                gA_FSG_4_0_0_27_ErrCode = 0;
                putValue(A_FSG_4_0_0_27_ErrCode,  gBAP_Indication_header[5]);
                setControlBackColor(panel_name, "errfield_A_FSG_4_0_0_27", MakeRGB(255,79,79));  
                gA_FSG_4_0_0_27_ErrCode = 1;
                break;
            case Bap_acknowledge:
                break;
            default:
                PrintIndicationError("Illegal DataType");
                break;
        }
    break;
    case P_FSG_4_0_0_28_ID: 
        switch(gBAP_Indication_header[3]) // Datentyp 
        {
            case Bap_byteSequence:
                switch (gBAP_Indication_header[2]) // IndType
                {
                    case DataSet_IND: // Indicationtyp pruefen
                       if (getValue(P_FSG_4_0_0_28_ErrEn)) { 
                           Request_error(LSGID,P_FSG_4_0_0_28_ID,getValue(P_FSG_4_0_0_28_ErrCode)); 
                           break;
                        }
                        // Daten setzen
                        putValue(P_FSG_4_0_0_28, gBAP_Indication_data, gBAP_Indication_header[4]);
                        setControlBackColor(panel_name, "errfield_P_FSG_4_0_0_28", MakeRGB(255,255,255));  
                        break;
                    case DataSetGet_IND: // Indicationtyp pruefen
                       if (getValue(P_FSG_4_0_0_28_ErrEn)) { 
                           Request_error(LSGID,P_FSG_4_0_0_28_ID,getValue(P_FSG_4_0_0_28_ErrCode)); 
                           break;
                        }
                        // Daten setzen
						getValue(P_FSG_4_0_0_28, temp);
						gBAP_Indication_data[1]= gBAP_Indication_data[1]&0x0f;
						gBAP_Indication_data[1]= gBAP_Indication_data[1]|(temp[1]&0xf0);
						gBAP_Indication_data[1]= gBAP_Indication_data[1]&0xf0;
						gBAP_Indication_data[1]= gBAP_Indication_data[1]|(temp[1]&0x0f);
                        putValue(P_FSG_4_0_0_28, gBAP_Indication_data, gBAP_Indication_header[4]);
                        setControlBackColor(panel_name, "errfield_P_FSG_4_0_0_28", MakeRGB(255,255,255));  
                        // und antworten
                        getValue(P_FSG_4_0_0_28, temp);
                        Request_byteSequence(LSGID, P_FSG_4_0_0_28_ID, Data_REQ, temp, gBAP_Indication_header[4]);
                        break;
                    default:
                            PrintIndicationError("Illegal IndType");
                        break;
                }
                break;
            case Bap_error:
                gP_FSG_4_0_0_28_ErrCode = 0;
                putValue(P_FSG_4_0_0_28_ErrCode,  gBAP_Indication_header[5]);
                setControlBackColor(panel_name, "errfield_P_FSG_4_0_0_28", MakeRGB(255,79,79));  
                gP_FSG_4_0_0_28_ErrCode = 1;
                break;
            case Bap_acknowledge:
                break;
            default:
                PrintIndicationError("Illegal DataType");
                break;
        }
    break;
    case P_FSG_4_0_0_29_ID: 
        switch(gBAP_Indication_header[3]) // Datentyp 
        {
            case Bap_byteSequence:
                switch (gBAP_Indication_header[2]) // IndType
                {
                    case DataSet_IND: // Indicationtyp pruefen
                       if (getValue(P_FSG_4_0_0_29_ErrEn)) { 
                           Request_error(LSGID,P_FSG_4_0_0_29_ID,getValue(P_FSG_4_0_0_29_ErrCode)); 
                           break;
                        }
                        // Daten setzen
                        putValue(P_FSG_4_0_0_29, gBAP_Indication_data, gBAP_Indication_header[4]);
                        setControlBackColor(panel_name, "errfield_P_FSG_4_0_0_29", MakeRGB(255,255,255));  
                        break;
                    case DataSetGet_IND: // Indicationtyp pruefen
                       if (getValue(P_FSG_4_0_0_29_ErrEn)) { 
                           Request_error(LSGID,P_FSG_4_0_0_29_ID,getValue(P_FSG_4_0_0_29_ErrCode)); 
                           break;
                        }
                        // Daten setzen
						getValue(P_FSG_4_0_0_29, temp);
						gBAP_Indication_data[5]= gBAP_Indication_data[5]&0x0f;
						gBAP_Indication_data[5]= gBAP_Indication_data[5]|(temp[5]&0xf0);
						gBAP_Indication_data[5]= gBAP_Indication_data[5]&0xf0;
						gBAP_Indication_data[5]= gBAP_Indication_data[5]|(temp[5]&0x0f);
                        putValue(P_FSG_4_0_0_29, gBAP_Indication_data, gBAP_Indication_header[4]);
                        setControlBackColor(panel_name, "errfield_P_FSG_4_0_0_29", MakeRGB(255,255,255));  
                        // und antworten
                        getValue(P_FSG_4_0_0_29, temp);
                        Request_byteSequence(LSGID, P_FSG_4_0_0_29_ID, Data_REQ, temp, gBAP_Indication_header[4]);
                        break;
                    default:
                            PrintIndicationError("Illegal IndType");
                        break;
                }
                break;
            case Bap_error:
                gP_FSG_4_0_0_29_ErrCode = 0;
                putValue(P_FSG_4_0_0_29_ErrCode,  gBAP_Indication_header[5]);
                setControlBackColor(panel_name, "errfield_P_FSG_4_0_0_29", MakeRGB(255,79,79));  
                gP_FSG_4_0_0_29_ErrCode = 1;
                break;
            case Bap_acknowledge:
                break;
            default:
                PrintIndicationError("Illegal DataType");
                break;
        }
    break;
       default:
           writelineEx(gError_Trace, 0, "NodeIndex: %d: Illegal Fct: lsgid:%d fctid:%d indType:%d",
           NODE_INDEX, gBAP_Indication_header[0], gBAP_Indication_header[1], gBAP_Indication_header[2]);
           break;
       }
       break;
   default:
       writelineEx(gError_Trace, 0, "NodeIndex: %d: Illegal LSGID: lsgid:%d fctid:%d indType:%s", NODE_INDEX, gBAP_Indication_header[0], gBAP_Indication_header[1], Indicationtype_Text[gBAP_Indication_header[2]]);
       break;
   }
}

on message *
{
    int i;
    byte RX_Data[64];           // received CAN-DATA
    dword RX_Header[4];         // received CAN-Header
    
    if( gSG_PowerOnOff == Power_on )
    {
        if(( this.msgChannel == 1 ) && (( this.ID & 0xFFFF0000 ) == 0x97330000 ))
        {
            RX_Header[0] = 1; /*BusType: 1=Can, 2=Lin, 3=Flexray, 4=Ethernet*/
            RX_Header[1] = 1;
            RX_Header[2] = this.DataLength; // received length
            RX_Header[3] = this.ID;
            for( i = 0; i < this.DataLength; i++ )
            {
                RX_Data[i] = this.byte(i);
            }
            BAP180_SetRxData( NODE_INDEX, RX_Header, RX_Data );
        }
   }
}

intertelegram_err(long fctId)
{
    long data[4];
    data[0]=LSGID;
    data[1]=fctId;
    data[2]=1;
    data[3]=940;
    ChangeConfig(0x0020,data);
}

sequence_err(long fctId, long size)
{
    long data[5];
    long lastSeg;

    lastSeg = size-5;

    data[0]=LSGID;
    data[1]=fctId;
    data[2]=lastSeg/7+1;
    data[3]=1;
    data[4]=(lastSeg/7+4) & 15;
    ChangeConfig(0x0021,data);
}

intertelegram_err_off(long fctId)
{
    long data[4];
    data[0]=LSGID;
    data[1]=fctId;
    data[2]=5000;
    data[3]=0;
    ChangeConfig(0x0020,data);
}

sequence_err_off(long fctId)
{
    long data[5];

    data[0]=LSGID;
    data[1]=fctId;
    data[2]=5000;
    data[3]=0;
    data[4]=0;
    ChangeConfig(0x0021,data);
}

on envVar ON_OFF_FSG4_0
{
   BapOnOff(getvalue(this));
   gSG_PowerOnOff=getvalue(ON_OFF_FSG4_0);
}
on envVar BAPCFG_FSG_4_0_0_DFMajor
{
    long temp[3];
    byte ret,i ;
    for (i = 0; i < 4; i++)
    {
        temp[0] = LSGID;
        temp[1] = i;
        temp[2] = getValue(this);
        ret = BAP150_ChangeConfig(NODE_INDEX, 9, temp);
        if (ret != 0)
        {
            writeLineEx(gBAP_Trace, 0, "NodeIndex: %d: Error %d occured during setting of Minor DF Version.",NODE_INDEX, ret);
        }
    }
}
on envVar BAPCFG_FSG_4_0_0_DFMinor
{
    long temp[3];
    byte ret,i ;
    for (i = 0; i < 4; i++)
    {
        temp[0] = LSGID;
        temp[1] = i;
        temp[2] = getValue(this);
        ret = BAP150_ChangeConfig(NODE_INDEX, 10, temp);
        if (ret != 0)
        {
            writeLineEx(gBAP_Trace, 0, "NodeIndex: %d: Error %d occured during setting of Minor DF Version.",NODE_INDEX, ret);
        }
    }
}
on envVar BAPCFG_FSG_4_0_0_LsgClassMajor
{
    long temp[3];
    byte ret,i ;
    for (i = 0; i < 4; i++)
    {
        temp[0] = LSGID;
        temp[1] = i;
        temp[2] = getValue(this);
        ret = BAP150_ChangeConfig(NODE_INDEX, 5, temp);
        if (ret != 0)
        {
            writeLineEx(gBAP_Trace, 0, "NodeIndex: %d: Error %d occured during setting of Minor DF Version.",NODE_INDEX, ret);
        }
    }
}
on envVar BAPCFG_FSG_4_0_0_LsgClassMinor
{
    long temp[3];
    byte ret,i ;
    for (i = 0; i < 4; i++)
    {
        temp[0] = LSGID;
        temp[1] = i;
        temp[2] = getValue(this);
        ret = BAP150_ChangeConfig(NODE_INDEX, 6, temp);
        if (ret != 0)
        {
            writeLineEx(gBAP_Trace, 0, "NodeIndex: %d: Error %d occured during setting of Minor DF Version.",NODE_INDEX, ret);
        }
    }
}
on envVar BAPCFG_FSG_4_0_0_ProtocolMajor
{
    long temp[3];
    byte ret,i ;
    for (i = 0; i < 4; i++)
    {
        temp[0] = LSGID;
        temp[1] = i;
        temp[2] = getValue(this);
        ret = BAP150_ChangeConfig(NODE_INDEX, 7, temp);
        if (ret != 0)
        {
            writeLineEx(gBAP_Trace, 0, "NodeIndex: %d: Error %d occured during setting of Minor DF Version.",NODE_INDEX, ret);
        }
    }
}
on envVar BAPCFG_FSG_4_0_0_ProtocolMinor
{
    long temp[3];
    byte ret,i ;
    for (i = 0; i < 4; i++)
    {
        temp[0] = LSGID;
        temp[1] = i;
        temp[2] = getValue(this);
        ret = BAP150_ChangeConfig(NODE_INDEX, 8, temp);
        if (ret != 0)
        {
            writeLineEx(gBAP_Trace, 0, "NodeIndex: %d: Error %d occured during setting of Minor DF Version.",NODE_INDEX, ret);
        }
    }
}
// Setzen der Schriftfarbe bei Zustandswechsel der FCTID C_FSG_4_0_0_1_ID
on envVar C_FSG_4_0_0_1_FctLstItemEn
{
       if(getValue(this)) 
       {
           setControlForeColor(panel_name, "checkbox_C_FSG_4_0_0_1", MakeRGB(0,240,0));
       }
       else
       {
           setControlForeColor(panel_name, "checkbox_C_FSG_4_0_0_1", MakeRGB(250,0,0));
       }
}
// Setzen der Schriftfarbe bei Zustandswechsel der FCTID P_FSG_4_0_0_2_ID
on envVar P_FSG_4_0_0_2_FctLstItemEn
{
       if(getValue(this)) 
       {
           setControlForeColor(panel_name, "checkbox_P_FSG_4_0_0_2", MakeRGB(0,240,0));
       }
       else
       {
           setControlForeColor(panel_name, "checkbox_P_FSG_4_0_0_2", MakeRGB(250,0,0));
       }
}
// Ruecksetzen des Fehlerstatus durch manuelle Fehlereingabe
on envVar P_FSG_4_0_0_2_ErrCode
{
       if(gP_FSG_4_0_0_2_ErrCode) 
       {
           setControlBackColor(panel_name,"errfield_P_FSG_4_0_0_2", MakeRGB(255,255,255));
       }
       gP_FSG_4_0_0_2_ErrCode = 1;
}
// Setzen der Schriftfarbe bei Zustandswechsel der FCTID P_FSG_4_0_0_3_ID
on envVar P_FSG_4_0_0_3_FctLstItemEn
{
       if(getValue(this)) 
       {
           setControlForeColor(panel_name, "checkbox_P_FSG_4_0_0_3", MakeRGB(0,240,0));
       }
       else
       {
           setControlForeColor(panel_name, "checkbox_P_FSG_4_0_0_3", MakeRGB(250,0,0));
       }
}
// Ruecksetzen des Fehlerstatus durch manuelle Fehlereingabe
on envVar P_FSG_4_0_0_3_ErrCode
{
       if(gP_FSG_4_0_0_3_ErrCode) 
       {
           setControlBackColor(panel_name,"errfield_P_FSG_4_0_0_3", MakeRGB(255,255,255));
       }
       gP_FSG_4_0_0_3_ErrCode = 1;
}
// De-Aktivierung der Eingabefelder der HB-FCT P_FSG_4_0_0_4
on envVar P_FSG_4_0_0_4_FctLstItemEn
{
       if(getValue(this)) 
       {
//           EnableControl(panel_name,"panel_FSG_4_0_0_4",1);
//           EnableControl(panel_name,"${ERRFIELD}",1);
           EnableControl(panel_name,"panel_P_FSG_4_0_0_4_HBEn",1);
           setControlForeColor(panel_name, "checkbox_P_FSG_4_0_0_4", MakeRGB(0,240,0));
       }
       else
       {
//           EnableControl(panel_name,"panel_FSG_4_0_0_4",0);
//           EnableControl(panel_name,"${ERRFIELD}",0);
           EnableControl(panel_name,"panel_P_FSG_4_0_0_4_HBEn",0);
           setControlForeColor(panel_name, "checkbox_P_FSG_4_0_0_4", MakeRGB(250,0,0));
       }
}
on envVar P_FSG_4_0_0_4_FctEn
{
	long data[2];
	if(getValue(P_FSG_4_0_0_4_FctEn)>0)
	{
		data[0] = 4;
		data[1] = getValue(P_FSG_4_0_0_4);
		write("enable HB");
	}
	else
	{
		data[0] = 4;
		data[1] = 0;
		write("disable HB");
	}
	Bap150_ChangeConfig(NODE_INDEX, 0x00, data);
}
// Ruecksetzen des Fehlerstatus durch manuelle Fehlereingabe
on envVar P_FSG_4_0_0_4_ErrCode
{
       if(gP_FSG_4_0_0_4_ErrCode) 
       {
           setControlBackColor(panel_name,"errfield_P_FSG_4_0_0_4", MakeRGB(255,255,255));
       }
       gP_FSG_4_0_0_4_ErrCode = 1;
}
// Ruecksetzen des Fehlerstatus durch manuelle Fehlereingabe
on envVar P_FSG_4_0_0_13_ErrCode
{
       if(gP_FSG_4_0_0_13_ErrCode) 
       {
           setControlBackColor(panel_name,"errfield_P_FSG_4_0_0_13", MakeRGB(255,255,255));
       }
       gP_FSG_4_0_0_13_ErrCode = 1;
}
on envVar P_FSG_4_0_0_13Status_BTN
{
    if (P_FSG_4_0_0_13Status_BTN_already_pressed == 0)
    {
       putValue(P_FSG_4_0_0_13_ErrCode,0);
       SetControlBackColor(panel_name,"errField_P_FSG_4_0_0_13",MakeRGB(255,255,255));
       P_FSG_4_0_0_13Status_BTN_already_pressed = 1;
    }
    else
    {
       Request_Int8(LSGID, P_FSG_4_0_0_13_ID, Data_REQ, getValue(P_FSG_4_0_0_13));
      P_FSG_4_0_0_13Status_BTN_already_pressed = 0;
    }
}
on envVar P_FSG_4_0_0_13_FctEn
{
    long data[3];
    data[0]=LSGID;
    data[1]=P_FSG_4_0_0_13_ID;
    data[2]=getValue(P_FSG_4_0_0_13_FctEn);
    ChangeConfig(0x0031,data);
}
// De-Aktivierung der Eingabefelder der FCTID P_FSG_4_0_0_13
on envVar P_FSG_4_0_0_13_FctLstItemEn
{
       if(getValue(this)) 
       {
           EnableControl(panel_name,"panel_FSG_4_0_0_13",1);
           EnableControl(panel_name,"errfield_P_FSG_4_0_0_13",1);
           EnableControl(panel_name,"panel_P_FSG_4_0_0_13",1);
           setControlForeColor(panel_name, "checkbox_P_FSG_4_0_0_13", MakeRGB(0,240,0));
       }
       else
       {
           EnableControl(panel_name,"panel_FSG_4_0_0_13",0);
           EnableControl(panel_name,"errfield_P_FSG_4_0_0_13",0);
           EnableControl(panel_name,"panel_P_FSG_4_0_0_13",0);
           setControlForeColor(panel_name, "checkbox_P_FSG_4_0_0_13", MakeRGB(250,0,0));
       }
}
on envVar P_FSG_4_0_0_13 // bus value of FSG_Control (13).
{
	// opcodes: Error-Status
	byte param1; // Controlcode
	// DATATYPE_UINTXX
	param1 = getValue(P_FSG_4_0_0_13);
	putValue(P_FSG_4_0_0_13_1, param1);
}

on envVar P_FSG_4_0_0_13_1_0
{
	byte bitval;
	//thisval steht hier fuer den bitfield-wert, 
	//aus Generierungsgruenden hier keine einheitliche Bezeichnung moeglich.
	byte thisval; // Controlcode
	bitval= getValue(this);
	thisval = getValue(P_FSG_4_0_0_13_1);
	thisval = thisval&~(1<<0)|(bitval<<0);
	putValue(P_FSG_4_0_0_13_1,thisval);
}

on envVar P_FSG_4_0_0_13_1_4
{
	byte bitval;
	//thisval steht hier fuer den bitfield-wert, 
	//aus Generierungsgruenden hier keine einheitliche Bezeichnung moeglich.
	byte thisval; // Controlcode
	bitval= getValue(this);
	thisval = getValue(P_FSG_4_0_0_13_1);
	thisval = thisval&~(1<<4)|(bitval<<4);
	putValue(P_FSG_4_0_0_13_1,thisval);
}

on envVar P_FSG_4_0_0_13_1 // FSG_Control.Controlcode
{
	byte superval;

	//Update Childvalue (BitField)
	byte mask=0x01;
	int i = 0;
	byte thisval; // Controlcode
	thisval = getValue(this);
	if(thisval&(mask<<0))
		putValue(P_FSG_4_0_0_13_1_0, 1);
	else
		putValue(P_FSG_4_0_0_13_1_0, 0);
	if(thisval&(mask<<4))
		putValue(P_FSG_4_0_0_13_1_4, 1);
	else
		putValue(P_FSG_4_0_0_13_1_4, 0);

    // Update superval
	superval = getValue(P_FSG_4_0_0_13);
	superval = thisval;
	putValue(P_FSG_4_0_0_13,superval);
}

// Ruecksetzen des Fehlerstatus durch manuelle Fehlereingabe
on envVar P_FSG_4_0_0_14_ErrCode
{
       if(gP_FSG_4_0_0_14_ErrCode) 
       {
           setControlBackColor(panel_name,"errfield_P_FSG_4_0_0_14", MakeRGB(255,255,255));
       }
       gP_FSG_4_0_0_14_ErrCode = 1;
}
on envVar P_FSG_4_0_0_14Status_BTN
{
	byte BAPTemp[2];
   if (P_FSG_4_0_0_14Status_BTN_already_pressed == 0)
   {
      putValue(P_FSG_4_0_0_14_ErrCode,0);
      SetControlBackColor(panel_name,"errField_P_FSG_4_0_0_14",MakeRGB(255,255,255));
      P_FSG_4_0_0_14Status_BTN_already_pressed = 1;
   }
   else
   {
      getValue(P_FSG_4_0_0_14, BAPTemp);
      Request_ByteSequence(LSGID, P_FSG_4_0_0_14_ID, Data_REQ, BAPTemp, getValueSize(P_FSG_4_0_0_14));
      P_FSG_4_0_0_14Status_BTN_already_pressed = 0;
   }
}
on envVar P_FSG_4_0_0_14_FctEn
{
    long data[3];
    data[0]=LSGID;
    data[1]=P_FSG_4_0_0_14_ID;
    data[2]=getValue(P_FSG_4_0_0_14_FctEn);
    ChangeConfig(0x0031,data);
}
// De-Aktivierung der Eingabefelder der FCTID P_FSG_4_0_0_14
on envVar P_FSG_4_0_0_14_FctLstItemEn
{
       if(getValue(this)) 
       {
           EnableControl(panel_name,"panel_FSG_4_0_0_14",1);
           EnableControl(panel_name,"errfield_P_FSG_4_0_0_14",1);
           EnableControl(panel_name,"panel_P_FSG_4_0_0_14",1);
           setControlForeColor(panel_name, "checkbox_P_FSG_4_0_0_14", MakeRGB(0,240,0));
       }
       else
       {
           EnableControl(panel_name,"panel_FSG_4_0_0_14",0);
           EnableControl(panel_name,"errfield_P_FSG_4_0_0_14",0);
           EnableControl(panel_name,"panel_P_FSG_4_0_0_14",0);
           setControlForeColor(panel_name, "checkbox_P_FSG_4_0_0_14", MakeRGB(250,0,0));
       }
}
on envVar P_FSG_4_0_0_14 // bus value of FSG_Setup (14).
{
	// opcodes: Error-Status
	byte param1; // Installation
	byte param2; // Installation2
	// DATATYPE_BYTESEQUENCE / DATATYPE_FIXEDBYTESEQUENCE
	dword i;
	byte superval[2];
	dword currentPos;
	currentPos = 0;
	for( i = 0; i < 2; i++ ) {
		superval[i] = 0;
	}
	getValue(P_FSG_4_0_0_14, superval);
	///////// Start param1 - UINT8 /////////
	param1 = superval[currentPos++];
	putValue(P_FSG_4_0_0_14_1, param1);
	///////// Start param2 - UINT8 /////////
	param2 = superval[currentPos++];
	putValue(P_FSG_4_0_0_14_2, param2);
}

on envVar P_FSG_4_0_0_14_1_0
{
	byte bitval;
	//thisval steht hier fuer den bitfield-wert, 
	//aus Generierungsgruenden hier keine einheitliche Bezeichnung moeglich.
	byte thisval; // Installation
	bitval= getValue(this);
	thisval = getValue(P_FSG_4_0_0_14_1);
	thisval = thisval&~(1<<0)|(bitval<<0);
	putValue(P_FSG_4_0_0_14_1,thisval);
}

on envVar P_FSG_4_0_0_14_1_1
{
	byte bitval;
	//thisval steht hier fuer den bitfield-wert, 
	//aus Generierungsgruenden hier keine einheitliche Bezeichnung moeglich.
	byte thisval; // Installation
	bitval= getValue(this);
	thisval = getValue(P_FSG_4_0_0_14_1);
	thisval = thisval&~(1<<1)|(bitval<<1);
	putValue(P_FSG_4_0_0_14_1,thisval);
}

on envVar P_FSG_4_0_0_14_1_2
{
	byte bitval;
	//thisval steht hier fuer den bitfield-wert, 
	//aus Generierungsgruenden hier keine einheitliche Bezeichnung moeglich.
	byte thisval; // Installation
	bitval= getValue(this);
	thisval = getValue(P_FSG_4_0_0_14_1);
	thisval = thisval&~(1<<2)|(bitval<<2);
	putValue(P_FSG_4_0_0_14_1,thisval);
}

on envVar P_FSG_4_0_0_14_1_3
{
	byte bitval;
	//thisval steht hier fuer den bitfield-wert, 
	//aus Generierungsgruenden hier keine einheitliche Bezeichnung moeglich.
	byte thisval; // Installation
	bitval= getValue(this);
	thisval = getValue(P_FSG_4_0_0_14_1);
	thisval = thisval&~(1<<3)|(bitval<<3);
	putValue(P_FSG_4_0_0_14_1,thisval);
}

on envVar P_FSG_4_0_0_14_1_4
{
	byte bitval;
	//thisval steht hier fuer den bitfield-wert, 
	//aus Generierungsgruenden hier keine einheitliche Bezeichnung moeglich.
	byte thisval; // Installation
	bitval= getValue(this);
	thisval = getValue(P_FSG_4_0_0_14_1);
	thisval = thisval&~(1<<4)|(bitval<<4);
	putValue(P_FSG_4_0_0_14_1,thisval);
}

on envVar P_FSG_4_0_0_14_1_5
{
	byte bitval;
	//thisval steht hier fuer den bitfield-wert, 
	//aus Generierungsgruenden hier keine einheitliche Bezeichnung moeglich.
	byte thisval; // Installation
	bitval= getValue(this);
	thisval = getValue(P_FSG_4_0_0_14_1);
	thisval = thisval&~(1<<5)|(bitval<<5);
	putValue(P_FSG_4_0_0_14_1,thisval);
}

on envVar P_FSG_4_0_0_14_1_6
{
	byte bitval;
	//thisval steht hier fuer den bitfield-wert, 
	//aus Generierungsgruenden hier keine einheitliche Bezeichnung moeglich.
	byte thisval; // Installation
	bitval= getValue(this);
	thisval = getValue(P_FSG_4_0_0_14_1);
	thisval = thisval&~(1<<6)|(bitval<<6);
	putValue(P_FSG_4_0_0_14_1,thisval);
}

on envVar P_FSG_4_0_0_14_1_7
{
	byte bitval;
	//thisval steht hier fuer den bitfield-wert, 
	//aus Generierungsgruenden hier keine einheitliche Bezeichnung moeglich.
	byte thisval; // Installation
	bitval= getValue(this);
	thisval = getValue(P_FSG_4_0_0_14_1);
	thisval = thisval&~(1<<7)|(bitval<<7);
	putValue(P_FSG_4_0_0_14_1,thisval);
}

on envVar P_FSG_4_0_0_14_1 // FSG_Setup.Installation
{
	byte superval[2];

	//Update Childvalue (BitField)
	byte mask=0x01;
	int i = 0;
	byte thisval; // Installation
	thisval = getValue(this);
	if(thisval&(mask<<0))
		putValue(P_FSG_4_0_0_14_1_0, 1);
	else
		putValue(P_FSG_4_0_0_14_1_0, 0);
	if(thisval&(mask<<1))
		putValue(P_FSG_4_0_0_14_1_1, 1);
	else
		putValue(P_FSG_4_0_0_14_1_1, 0);
	if(thisval&(mask<<2))
		putValue(P_FSG_4_0_0_14_1_2, 1);
	else
		putValue(P_FSG_4_0_0_14_1_2, 0);
	if(thisval&(mask<<3))
		putValue(P_FSG_4_0_0_14_1_3, 1);
	else
		putValue(P_FSG_4_0_0_14_1_3, 0);
	if(thisval&(mask<<4))
		putValue(P_FSG_4_0_0_14_1_4, 1);
	else
		putValue(P_FSG_4_0_0_14_1_4, 0);
	if(thisval&(mask<<5))
		putValue(P_FSG_4_0_0_14_1_5, 1);
	else
		putValue(P_FSG_4_0_0_14_1_5, 0);
	if(thisval&(mask<<6))
		putValue(P_FSG_4_0_0_14_1_6, 1);
	else
		putValue(P_FSG_4_0_0_14_1_6, 0);
	if(thisval&(mask<<7))
		putValue(P_FSG_4_0_0_14_1_7, 1);
	else
		putValue(P_FSG_4_0_0_14_1_7, 0);

    // Update superval
	getValue(P_FSG_4_0_0_14, superval);
	superval[0]=thisval;
	putValue(P_FSG_4_0_0_14,superval);
}

on envVar P_FSG_4_0_0_14_2_0
{
	byte bitval;
	//thisval steht hier fuer den bitfield-wert, 
	//aus Generierungsgruenden hier keine einheitliche Bezeichnung moeglich.
	byte thisval; // Installation2
	bitval= getValue(this);
	thisval = getValue(P_FSG_4_0_0_14_2);
	thisval = thisval&~(1<<0)|(bitval<<0);
	putValue(P_FSG_4_0_0_14_2,thisval);
}

on envVar P_FSG_4_0_0_14_2_1
{
	byte bitval;
	//thisval steht hier fuer den bitfield-wert, 
	//aus Generierungsgruenden hier keine einheitliche Bezeichnung moeglich.
	byte thisval; // Installation2
	bitval= getValue(this);
	thisval = getValue(P_FSG_4_0_0_14_2);
	thisval = thisval&~(1<<1)|(bitval<<1);
	putValue(P_FSG_4_0_0_14_2,thisval);
}

on envVar P_FSG_4_0_0_14_2_2
{
	byte bitval;
	//thisval steht hier fuer den bitfield-wert, 
	//aus Generierungsgruenden hier keine einheitliche Bezeichnung moeglich.
	byte thisval; // Installation2
	bitval= getValue(this);
	thisval = getValue(P_FSG_4_0_0_14_2);
	thisval = thisval&~(1<<2)|(bitval<<2);
	putValue(P_FSG_4_0_0_14_2,thisval);
}

on envVar P_FSG_4_0_0_14_2_3
{
	byte bitval;
	//thisval steht hier fuer den bitfield-wert, 
	//aus Generierungsgruenden hier keine einheitliche Bezeichnung moeglich.
	byte thisval; // Installation2
	bitval= getValue(this);
	thisval = getValue(P_FSG_4_0_0_14_2);
	thisval = thisval&~(1<<3)|(bitval<<3);
	putValue(P_FSG_4_0_0_14_2,thisval);
}

on envVar P_FSG_4_0_0_14_2_4
{
	byte bitval;
	//thisval steht hier fuer den bitfield-wert, 
	//aus Generierungsgruenden hier keine einheitliche Bezeichnung moeglich.
	byte thisval; // Installation2
	bitval= getValue(this);
	thisval = getValue(P_FSG_4_0_0_14_2);
	thisval = thisval&~(1<<4)|(bitval<<4);
	putValue(P_FSG_4_0_0_14_2,thisval);
}

on envVar P_FSG_4_0_0_14_2_5
{
	byte bitval;
	//thisval steht hier fuer den bitfield-wert, 
	//aus Generierungsgruenden hier keine einheitliche Bezeichnung moeglich.
	byte thisval; // Installation2
	bitval= getValue(this);
	thisval = getValue(P_FSG_4_0_0_14_2);
	thisval = thisval&~(1<<5)|(bitval<<5);
	putValue(P_FSG_4_0_0_14_2,thisval);
}

on envVar P_FSG_4_0_0_14_2_6
{
	byte bitval;
	//thisval steht hier fuer den bitfield-wert, 
	//aus Generierungsgruenden hier keine einheitliche Bezeichnung moeglich.
	byte thisval; // Installation2
	bitval= getValue(this);
	thisval = getValue(P_FSG_4_0_0_14_2);
	thisval = thisval&~(1<<6)|(bitval<<6);
	putValue(P_FSG_4_0_0_14_2,thisval);
}

on envVar P_FSG_4_0_0_14_2 // FSG_Setup.Installation2
{
	byte superval[2];

	//Update Childvalue (BitField)
	byte mask=0x01;
	int i = 0;
	byte thisval; // Installation2
	thisval = getValue(this);
	if(thisval&(mask<<0))
		putValue(P_FSG_4_0_0_14_2_0, 1);
	else
		putValue(P_FSG_4_0_0_14_2_0, 0);
	if(thisval&(mask<<1))
		putValue(P_FSG_4_0_0_14_2_1, 1);
	else
		putValue(P_FSG_4_0_0_14_2_1, 0);
	if(thisval&(mask<<2))
		putValue(P_FSG_4_0_0_14_2_2, 1);
	else
		putValue(P_FSG_4_0_0_14_2_2, 0);
	if(thisval&(mask<<3))
		putValue(P_FSG_4_0_0_14_2_3, 1);
	else
		putValue(P_FSG_4_0_0_14_2_3, 0);
	if(thisval&(mask<<4))
		putValue(P_FSG_4_0_0_14_2_4, 1);
	else
		putValue(P_FSG_4_0_0_14_2_4, 0);
	if(thisval&(mask<<5))
		putValue(P_FSG_4_0_0_14_2_5, 1);
	else
		putValue(P_FSG_4_0_0_14_2_5, 0);
	if(thisval&(mask<<6))
		putValue(P_FSG_4_0_0_14_2_6, 1);
	else
		putValue(P_FSG_4_0_0_14_2_6, 0);

    // Update superval
	getValue(P_FSG_4_0_0_14, superval);
	superval[1]=thisval;
	putValue(P_FSG_4_0_0_14,superval);
}

// Ruecksetzen des Fehlerstatus durch manuelle Fehlereingabe
on envVar P_FSG_4_0_0_15_ErrCode
{
       if(gP_FSG_4_0_0_15_ErrCode) 
       {
           setControlBackColor(panel_name,"errfield_P_FSG_4_0_0_15", MakeRGB(255,255,255));
       }
       gP_FSG_4_0_0_15_ErrCode = 1;
}
on envVar P_FSG_4_0_0_15Status_BTN
{
    if (P_FSG_4_0_0_15Status_BTN_already_pressed == 0)
    {
       putValue(P_FSG_4_0_0_15_ErrCode,0);
       SetControlBackColor(panel_name,"errField_P_FSG_4_0_0_15",MakeRGB(255,255,255));
       P_FSG_4_0_0_15Status_BTN_already_pressed = 1;
    }
    else
    {
       Request_Int8(LSGID, P_FSG_4_0_0_15_ID, Data_REQ, getValue(P_FSG_4_0_0_15));
      P_FSG_4_0_0_15Status_BTN_already_pressed = 0;
    }
}
on envVar P_FSG_4_0_0_15_FctEn
{
    long data[3];
    data[0]=LSGID;
    data[1]=P_FSG_4_0_0_15_ID;
    data[2]=getValue(P_FSG_4_0_0_15_FctEn);
    ChangeConfig(0x0031,data);
}
// De-Aktivierung der Eingabefelder der FCTID P_FSG_4_0_0_15
on envVar P_FSG_4_0_0_15_FctLstItemEn
{
       if(getValue(this)) 
       {
           EnableControl(panel_name,"panel_FSG_4_0_0_15",1);
           EnableControl(panel_name,"errfield_P_FSG_4_0_0_15",1);
           EnableControl(panel_name,"panel_P_FSG_4_0_0_15",1);
           setControlForeColor(panel_name, "checkbox_P_FSG_4_0_0_15", MakeRGB(0,240,0));
       }
       else
       {
           EnableControl(panel_name,"panel_FSG_4_0_0_15",0);
           EnableControl(panel_name,"errfield_P_FSG_4_0_0_15",0);
           EnableControl(panel_name,"panel_P_FSG_4_0_0_15",0);
           setControlForeColor(panel_name, "checkbox_P_FSG_4_0_0_15", MakeRGB(250,0,0));
       }
}
on envVar P_FSG_4_0_0_15 // bus value of FSG_OperationState (15).
{
	// opcodes: Error-Status
	byte param1; // OP_State
	// DATATYPE_UINTXX
	param1 = getValue(P_FSG_4_0_0_15);
	putValue(P_FSG_4_0_0_15_1, param1);
}

on envVar P_FSG_4_0_0_15_1 // FSG_OperationState.OP_State
{
	byte superval;

	//Update Childvalue (Enum)
	byte thisval; // OP_State
	thisval = getValue(this);

    // Update superval
	superval = getValue(P_FSG_4_0_0_15);
	superval = thisval;
	putValue(P_FSG_4_0_0_15,superval);
}

// Ruecksetzen des Fehlerstatus durch manuelle Fehlereingabe
on envVar P_FSG_4_0_0_16_ErrCode
{
       if(gP_FSG_4_0_0_16_ErrCode) 
       {
           setControlBackColor(panel_name,"errfield_P_FSG_4_0_0_16", MakeRGB(255,255,255));
       }
       gP_FSG_4_0_0_16_ErrCode = 1;
}
on envVar P_FSG_4_0_0_16Status_BTN
{
	byte BAPTemp[2];
   if (P_FSG_4_0_0_16Status_BTN_already_pressed == 0)
   {
      putValue(P_FSG_4_0_0_16_ErrCode,0);
      SetControlBackColor(panel_name,"errField_P_FSG_4_0_0_16",MakeRGB(255,255,255));
      P_FSG_4_0_0_16Status_BTN_already_pressed = 1;
   }
   else
   {
      getValue(P_FSG_4_0_0_16, BAPTemp);
      Request_ByteSequence(LSGID, P_FSG_4_0_0_16_ID, Data_REQ, BAPTemp, getValueSize(P_FSG_4_0_0_16));
      P_FSG_4_0_0_16Status_BTN_already_pressed = 0;
   }
}
on envVar P_FSG_4_0_0_16_FctEn
{
    long data[3];
    data[0]=LSGID;
    data[1]=P_FSG_4_0_0_16_ID;
    data[2]=getValue(P_FSG_4_0_0_16_FctEn);
    ChangeConfig(0x0031,data);
}
// De-Aktivierung der Eingabefelder der FCTID P_FSG_4_0_0_16
on envVar P_FSG_4_0_0_16_FctLstItemEn
{
       if(getValue(this)) 
       {
           EnableControl(panel_name,"panel_FSG_4_0_0_16",1);
           EnableControl(panel_name,"errfield_P_FSG_4_0_0_16",1);
           EnableControl(panel_name,"panel_P_FSG_4_0_0_16",1);
           setControlForeColor(panel_name, "checkbox_P_FSG_4_0_0_16", MakeRGB(0,240,0));
       }
       else
       {
           EnableControl(panel_name,"panel_FSG_4_0_0_16",0);
           EnableControl(panel_name,"errfield_P_FSG_4_0_0_16",0);
           EnableControl(panel_name,"panel_P_FSG_4_0_0_16",0);
           setControlForeColor(panel_name, "checkbox_P_FSG_4_0_0_16", MakeRGB(250,0,0));
       }
}
on envVar P_FSG_4_0_0_16 // bus value of Brightness (16).
{
	// opcodes: Error-Status
	byte param1; // Setup
	byte param2; // ModificationReason
	byte param3; // ModificationState
	// DATATYPE_BYTESEQUENCE / DATATYPE_FIXEDBYTESEQUENCE
	dword i;
	byte superval[2];
	dword currentPos;
	currentPos = 0;
	for( i = 0; i < 2; i++ ) {
		superval[i] = 0;
	}
	getValue(P_FSG_4_0_0_16, superval);
	///////// Start param1 - UINT8 /////////
	param1 = superval[currentPos++];
	putValue(P_FSG_4_0_0_16_1, round((param1 * 1.0) - (0) + (0), 1.0));
	///////// Start param2 - NIBBLE /////////
	param2 = (superval[currentPos] & 0xf0)>>4;
	putValue(P_FSG_4_0_0_16_2, param2);
	///////// Start param3 - NIBBLE /////////
	param3 = superval[currentPos++] & 0x0f;
	putValue(P_FSG_4_0_0_16_3, param3);
}

// Ueberwachung der Darstellungsvariable der Range.
on envVar P_FSG_4_0_0_16_1_range // Brightness.Setup 
{
	@P_FSG_4_0_0_16_1 = @P_FSG_4_0_0_16_1_range - (0); // slider = range - min
}

on envVar P_FSG_4_0_0_16_1 // Brightness.Setup
{
	byte superval[2];

	//Update Childvalue (Number)
	byte thisval; // Setup
	float slider_value;

	slider_value = round(@P_FSG_4_0_0_16_1, 1.0);
	@P_FSG_4_0_0_16_1_range = slider_value + (0); // real value := slider value + range min.
	thisval = (byte)round((slider_value + (0) - (0)) / (1.0), 1); // bus value := (slider value + min - offset) / step.

    // Update superval
	getValue(P_FSG_4_0_0_16, superval);
	superval[0]=thisval;
	putValue(P_FSG_4_0_0_16,superval);
}

on envVar P_FSG_4_0_0_16_2 // Brightness.ModificationReason
{
	byte superval[2];

	//Update Childvalue (Enum)
	byte thisval; // ModificationReason
	thisval = 0x0f & getValue(this);

    // Update superval
	getValue(P_FSG_4_0_0_16, superval);
	superval[1]= superval[1]&0x0f;
	superval[1]= superval[1]|(thisval<<4);
	putValue(P_FSG_4_0_0_16,superval);
}

on envVar P_FSG_4_0_0_16_3_0
{
	byte bitval;
	//thisval steht hier fuer den bitfield-wert, 
	//aus Generierungsgruenden hier keine einheitliche Bezeichnung moeglich.
	byte thisval; // ModificationState
	bitval= getValue(this);
	thisval = getValue(P_FSG_4_0_0_16_3);
	thisval = thisval&~(1<<0)|(bitval<<0);
	putValue(P_FSG_4_0_0_16_3,thisval);
}

on envVar P_FSG_4_0_0_16_3 // Brightness.ModificationState
{
	byte superval[2];

	//Update Childvalue (BitField)
	byte mask=0x01;
	int i = 0;
	byte thisval; // ModificationState
	thisval = getValue(this);
	if(thisval&(mask<<0))
		putValue(P_FSG_4_0_0_16_3_0, 1);
	else
		putValue(P_FSG_4_0_0_16_3_0, 0);

    // Update superval
	getValue(P_FSG_4_0_0_16, superval);
	superval[1]= superval[1]&0xf0;
	superval[1]= superval[1]|thisval;
	putValue(P_FSG_4_0_0_16,superval);
}

// Ruecksetzen des Fehlerstatus durch manuelle Fehlereingabe
on envVar P_FSG_4_0_0_17_ErrCode
{
       if(gP_FSG_4_0_0_17_ErrCode) 
       {
           setControlBackColor(panel_name,"errfield_P_FSG_4_0_0_17", MakeRGB(255,255,255));
       }
       gP_FSG_4_0_0_17_ErrCode = 1;
}
on envVar P_FSG_4_0_0_17Status_BTN
{
	byte BAPTemp[3];
   if (P_FSG_4_0_0_17Status_BTN_already_pressed == 0)
   {
      putValue(P_FSG_4_0_0_17_ErrCode,0);
      SetControlBackColor(panel_name,"errField_P_FSG_4_0_0_17",MakeRGB(255,255,255));
      P_FSG_4_0_0_17Status_BTN_already_pressed = 1;
   }
   else
   {
      getValue(P_FSG_4_0_0_17, BAPTemp);
      Request_ByteSequence(LSGID, P_FSG_4_0_0_17_ID, Data_REQ, BAPTemp, getValueSize(P_FSG_4_0_0_17));
      P_FSG_4_0_0_17Status_BTN_already_pressed = 0;
   }
}
on envVar P_FSG_4_0_0_17_FctEn
{
    long data[3];
    data[0]=LSGID;
    data[1]=P_FSG_4_0_0_17_ID;
    data[2]=getValue(P_FSG_4_0_0_17_FctEn);
    ChangeConfig(0x0031,data);
}
// De-Aktivierung der Eingabefelder der FCTID P_FSG_4_0_0_17
on envVar P_FSG_4_0_0_17_FctLstItemEn
{
       if(getValue(this)) 
       {
           EnableControl(panel_name,"panel_FSG_4_0_0_17",1);
           EnableControl(panel_name,"errfield_P_FSG_4_0_0_17",1);
           EnableControl(panel_name,"panel_P_FSG_4_0_0_17",1);
           setControlForeColor(panel_name, "checkbox_P_FSG_4_0_0_17", MakeRGB(0,240,0));
       }
       else
       {
           EnableControl(panel_name,"panel_FSG_4_0_0_17",0);
           EnableControl(panel_name,"errfield_P_FSG_4_0_0_17",0);
           EnableControl(panel_name,"panel_P_FSG_4_0_0_17",0);
           setControlForeColor(panel_name, "checkbox_P_FSG_4_0_0_17", MakeRGB(250,0,0));
       }
}
on envVar P_FSG_4_0_0_17 // bus value of DisplayedTopics (17).
{
	// opcodes: Error-Status
	byte param1; // Topics
	byte param2; // Topics2
	byte param3; // ModificationReason
	byte param4; // ModificationState
	// DATATYPE_BYTESEQUENCE / DATATYPE_FIXEDBYTESEQUENCE
	dword i;
	byte superval[3];
	dword currentPos;
	currentPos = 0;
	for( i = 0; i < 3; i++ ) {
		superval[i] = 0;
	}
	getValue(P_FSG_4_0_0_17, superval);
	///////// Start param1 - UINT8 /////////
	param1 = superval[currentPos++];
	putValue(P_FSG_4_0_0_17_1, param1);
	///////// Start param2 - UINT8 /////////
	param2 = superval[currentPos++];
	putValue(P_FSG_4_0_0_17_2, param2);
	///////// Start param3 - NIBBLE /////////
	param3 = (superval[currentPos] & 0xf0)>>4;
	putValue(P_FSG_4_0_0_17_3, param3);
	///////// Start param4 - NIBBLE /////////
	param4 = superval[currentPos++] & 0x0f;
	putValue(P_FSG_4_0_0_17_4, param4);
}

on envVar P_FSG_4_0_0_17_1_0
{
	byte bitval;
	//thisval steht hier fuer den bitfield-wert, 
	//aus Generierungsgruenden hier keine einheitliche Bezeichnung moeglich.
	byte thisval; // Topics
	bitval= getValue(this);
	thisval = getValue(P_FSG_4_0_0_17_1);
	thisval = thisval&~(1<<0)|(bitval<<0);
	putValue(P_FSG_4_0_0_17_1,thisval);
}

on envVar P_FSG_4_0_0_17_1_1
{
	byte bitval;
	//thisval steht hier fuer den bitfield-wert, 
	//aus Generierungsgruenden hier keine einheitliche Bezeichnung moeglich.
	byte thisval; // Topics
	bitval= getValue(this);
	thisval = getValue(P_FSG_4_0_0_17_1);
	thisval = thisval&~(1<<1)|(bitval<<1);
	putValue(P_FSG_4_0_0_17_1,thisval);
}

on envVar P_FSG_4_0_0_17_1_2
{
	byte bitval;
	//thisval steht hier fuer den bitfield-wert, 
	//aus Generierungsgruenden hier keine einheitliche Bezeichnung moeglich.
	byte thisval; // Topics
	bitval= getValue(this);
	thisval = getValue(P_FSG_4_0_0_17_1);
	thisval = thisval&~(1<<2)|(bitval<<2);
	putValue(P_FSG_4_0_0_17_1,thisval);
}

on envVar P_FSG_4_0_0_17_1_3
{
	byte bitval;
	//thisval steht hier fuer den bitfield-wert, 
	//aus Generierungsgruenden hier keine einheitliche Bezeichnung moeglich.
	byte thisval; // Topics
	bitval= getValue(this);
	thisval = getValue(P_FSG_4_0_0_17_1);
	thisval = thisval&~(1<<3)|(bitval<<3);
	putValue(P_FSG_4_0_0_17_1,thisval);
}

on envVar P_FSG_4_0_0_17_1_4
{
	byte bitval;
	//thisval steht hier fuer den bitfield-wert, 
	//aus Generierungsgruenden hier keine einheitliche Bezeichnung moeglich.
	byte thisval; // Topics
	bitval= getValue(this);
	thisval = getValue(P_FSG_4_0_0_17_1);
	thisval = thisval&~(1<<4)|(bitval<<4);
	putValue(P_FSG_4_0_0_17_1,thisval);
}

on envVar P_FSG_4_0_0_17_1_5
{
	byte bitval;
	//thisval steht hier fuer den bitfield-wert, 
	//aus Generierungsgruenden hier keine einheitliche Bezeichnung moeglich.
	byte thisval; // Topics
	bitval= getValue(this);
	thisval = getValue(P_FSG_4_0_0_17_1);
	thisval = thisval&~(1<<5)|(bitval<<5);
	putValue(P_FSG_4_0_0_17_1,thisval);
}

on envVar P_FSG_4_0_0_17_1_6
{
	byte bitval;
	//thisval steht hier fuer den bitfield-wert, 
	//aus Generierungsgruenden hier keine einheitliche Bezeichnung moeglich.
	byte thisval; // Topics
	bitval= getValue(this);
	thisval = getValue(P_FSG_4_0_0_17_1);
	thisval = thisval&~(1<<6)|(bitval<<6);
	putValue(P_FSG_4_0_0_17_1,thisval);
}

on envVar P_FSG_4_0_0_17_1_7
{
	byte bitval;
	//thisval steht hier fuer den bitfield-wert, 
	//aus Generierungsgruenden hier keine einheitliche Bezeichnung moeglich.
	byte thisval; // Topics
	bitval= getValue(this);
	thisval = getValue(P_FSG_4_0_0_17_1);
	thisval = thisval&~(1<<7)|(bitval<<7);
	putValue(P_FSG_4_0_0_17_1,thisval);
}

on envVar P_FSG_4_0_0_17_1 // DisplayedTopics.Topics
{
	byte superval[3];

	//Update Childvalue (BitField)
	byte mask=0x01;
	int i = 0;
	byte thisval; // Topics
	thisval = getValue(this);
	if(thisval&(mask<<0))
		putValue(P_FSG_4_0_0_17_1_0, 1);
	else
		putValue(P_FSG_4_0_0_17_1_0, 0);
	if(thisval&(mask<<1))
		putValue(P_FSG_4_0_0_17_1_1, 1);
	else
		putValue(P_FSG_4_0_0_17_1_1, 0);
	if(thisval&(mask<<2))
		putValue(P_FSG_4_0_0_17_1_2, 1);
	else
		putValue(P_FSG_4_0_0_17_1_2, 0);
	if(thisval&(mask<<3))
		putValue(P_FSG_4_0_0_17_1_3, 1);
	else
		putValue(P_FSG_4_0_0_17_1_3, 0);
	if(thisval&(mask<<4))
		putValue(P_FSG_4_0_0_17_1_4, 1);
	else
		putValue(P_FSG_4_0_0_17_1_4, 0);
	if(thisval&(mask<<5))
		putValue(P_FSG_4_0_0_17_1_5, 1);
	else
		putValue(P_FSG_4_0_0_17_1_5, 0);
	if(thisval&(mask<<6))
		putValue(P_FSG_4_0_0_17_1_6, 1);
	else
		putValue(P_FSG_4_0_0_17_1_6, 0);
	if(thisval&(mask<<7))
		putValue(P_FSG_4_0_0_17_1_7, 1);
	else
		putValue(P_FSG_4_0_0_17_1_7, 0);

    // Update superval
	getValue(P_FSG_4_0_0_17, superval);
	superval[0]=thisval;
	putValue(P_FSG_4_0_0_17,superval);
}

on envVar P_FSG_4_0_0_17_2_0
{
	byte bitval;
	//thisval steht hier fuer den bitfield-wert, 
	//aus Generierungsgruenden hier keine einheitliche Bezeichnung moeglich.
	byte thisval; // Topics2
	bitval= getValue(this);
	thisval = getValue(P_FSG_4_0_0_17_2);
	thisval = thisval&~(1<<0)|(bitval<<0);
	putValue(P_FSG_4_0_0_17_2,thisval);
}

on envVar P_FSG_4_0_0_17_2_1
{
	byte bitval;
	//thisval steht hier fuer den bitfield-wert, 
	//aus Generierungsgruenden hier keine einheitliche Bezeichnung moeglich.
	byte thisval; // Topics2
	bitval= getValue(this);
	thisval = getValue(P_FSG_4_0_0_17_2);
	thisval = thisval&~(1<<1)|(bitval<<1);
	putValue(P_FSG_4_0_0_17_2,thisval);
}

on envVar P_FSG_4_0_0_17_2_2
{
	byte bitval;
	//thisval steht hier fuer den bitfield-wert, 
	//aus Generierungsgruenden hier keine einheitliche Bezeichnung moeglich.
	byte thisval; // Topics2
	bitval= getValue(this);
	thisval = getValue(P_FSG_4_0_0_17_2);
	thisval = thisval&~(1<<2)|(bitval<<2);
	putValue(P_FSG_4_0_0_17_2,thisval);
}

on envVar P_FSG_4_0_0_17_2_3
{
	byte bitval;
	//thisval steht hier fuer den bitfield-wert, 
	//aus Generierungsgruenden hier keine einheitliche Bezeichnung moeglich.
	byte thisval; // Topics2
	bitval= getValue(this);
	thisval = getValue(P_FSG_4_0_0_17_2);
	thisval = thisval&~(1<<3)|(bitval<<3);
	putValue(P_FSG_4_0_0_17_2,thisval);
}

on envVar P_FSG_4_0_0_17_2_4
{
	byte bitval;
	//thisval steht hier fuer den bitfield-wert, 
	//aus Generierungsgruenden hier keine einheitliche Bezeichnung moeglich.
	byte thisval; // Topics2
	bitval= getValue(this);
	thisval = getValue(P_FSG_4_0_0_17_2);
	thisval = thisval&~(1<<4)|(bitval<<4);
	putValue(P_FSG_4_0_0_17_2,thisval);
}

on envVar P_FSG_4_0_0_17_2_5
{
	byte bitval;
	//thisval steht hier fuer den bitfield-wert, 
	//aus Generierungsgruenden hier keine einheitliche Bezeichnung moeglich.
	byte thisval; // Topics2
	bitval= getValue(this);
	thisval = getValue(P_FSG_4_0_0_17_2);
	thisval = thisval&~(1<<5)|(bitval<<5);
	putValue(P_FSG_4_0_0_17_2,thisval);
}

on envVar P_FSG_4_0_0_17_2_6
{
	byte bitval;
	//thisval steht hier fuer den bitfield-wert, 
	//aus Generierungsgruenden hier keine einheitliche Bezeichnung moeglich.
	byte thisval; // Topics2
	bitval= getValue(this);
	thisval = getValue(P_FSG_4_0_0_17_2);
	thisval = thisval&~(1<<6)|(bitval<<6);
	putValue(P_FSG_4_0_0_17_2,thisval);
}

on envVar P_FSG_4_0_0_17_2 // DisplayedTopics.Topics2
{
	byte superval[3];

	//Update Childvalue (BitField)
	byte mask=0x01;
	int i = 0;
	byte thisval; // Topics2
	thisval = getValue(this);
	if(thisval&(mask<<0))
		putValue(P_FSG_4_0_0_17_2_0, 1);
	else
		putValue(P_FSG_4_0_0_17_2_0, 0);
	if(thisval&(mask<<1))
		putValue(P_FSG_4_0_0_17_2_1, 1);
	else
		putValue(P_FSG_4_0_0_17_2_1, 0);
	if(thisval&(mask<<2))
		putValue(P_FSG_4_0_0_17_2_2, 1);
	else
		putValue(P_FSG_4_0_0_17_2_2, 0);
	if(thisval&(mask<<3))
		putValue(P_FSG_4_0_0_17_2_3, 1);
	else
		putValue(P_FSG_4_0_0_17_2_3, 0);
	if(thisval&(mask<<4))
		putValue(P_FSG_4_0_0_17_2_4, 1);
	else
		putValue(P_FSG_4_0_0_17_2_4, 0);
	if(thisval&(mask<<5))
		putValue(P_FSG_4_0_0_17_2_5, 1);
	else
		putValue(P_FSG_4_0_0_17_2_5, 0);
	if(thisval&(mask<<6))
		putValue(P_FSG_4_0_0_17_2_6, 1);
	else
		putValue(P_FSG_4_0_0_17_2_6, 0);

    // Update superval
	getValue(P_FSG_4_0_0_17, superval);
	superval[1]=thisval;
	putValue(P_FSG_4_0_0_17,superval);
}

on envVar P_FSG_4_0_0_17_3 // DisplayedTopics.ModificationReason
{
	byte superval[3];

	//Update Childvalue (Enum)
	byte thisval; // ModificationReason
	thisval = 0x0f & getValue(this);

    // Update superval
	getValue(P_FSG_4_0_0_17, superval);
	superval[2]= superval[2]&0x0f;
	superval[2]= superval[2]|(thisval<<4);
	putValue(P_FSG_4_0_0_17,superval);
}

on envVar P_FSG_4_0_0_17_4_0
{
	byte bitval;
	//thisval steht hier fuer den bitfield-wert, 
	//aus Generierungsgruenden hier keine einheitliche Bezeichnung moeglich.
	byte thisval; // ModificationState
	bitval= getValue(this);
	thisval = getValue(P_FSG_4_0_0_17_4);
	thisval = thisval&~(1<<0)|(bitval<<0);
	putValue(P_FSG_4_0_0_17_4,thisval);
}

on envVar P_FSG_4_0_0_17_4 // DisplayedTopics.ModificationState
{
	byte superval[3];

	//Update Childvalue (BitField)
	byte mask=0x01;
	int i = 0;
	byte thisval; // ModificationState
	thisval = getValue(this);
	if(thisval&(mask<<0))
		putValue(P_FSG_4_0_0_17_4_0, 1);
	else
		putValue(P_FSG_4_0_0_17_4_0, 0);

    // Update superval
	getValue(P_FSG_4_0_0_17, superval);
	superval[2]= superval[2]&0xf0;
	superval[2]= superval[2]|thisval;
	putValue(P_FSG_4_0_0_17,superval);
}

// Ruecksetzen des Fehlerstatus durch manuelle Fehlereingabe
on envVar P_FSG_4_0_0_18_ErrCode
{
       if(gP_FSG_4_0_0_18_ErrCode) 
       {
           setControlBackColor(panel_name,"errfield_P_FSG_4_0_0_18", MakeRGB(255,255,255));
       }
       gP_FSG_4_0_0_18_ErrCode = 1;
}
on envVar P_FSG_4_0_0_18Status_BTN
{
	byte BAPTemp[2];
   if (P_FSG_4_0_0_18Status_BTN_already_pressed == 0)
   {
      putValue(P_FSG_4_0_0_18_ErrCode,0);
      SetControlBackColor(panel_name,"errField_P_FSG_4_0_0_18",MakeRGB(255,255,255));
      P_FSG_4_0_0_18Status_BTN_already_pressed = 1;
   }
   else
   {
      getValue(P_FSG_4_0_0_18, BAPTemp);
      Request_ByteSequence(LSGID, P_FSG_4_0_0_18_ID, Data_REQ, BAPTemp, getValueSize(P_FSG_4_0_0_18));
      P_FSG_4_0_0_18Status_BTN_already_pressed = 0;
   }
}
on envVar P_FSG_4_0_0_18_FctEn
{
    long data[3];
    data[0]=LSGID;
    data[1]=P_FSG_4_0_0_18_ID;
    data[2]=getValue(P_FSG_4_0_0_18_FctEn);
    ChangeConfig(0x0031,data);
}
// De-Aktivierung der Eingabefelder der FCTID P_FSG_4_0_0_18
on envVar P_FSG_4_0_0_18_FctLstItemEn
{
       if(getValue(this)) 
       {
           EnableControl(panel_name,"panel_FSG_4_0_0_18",1);
           EnableControl(panel_name,"errfield_P_FSG_4_0_0_18",1);
           EnableControl(panel_name,"panel_P_FSG_4_0_0_18",1);
           setControlForeColor(panel_name, "checkbox_P_FSG_4_0_0_18", MakeRGB(0,240,0));
       }
       else
       {
           EnableControl(panel_name,"panel_FSG_4_0_0_18",0);
           EnableControl(panel_name,"errfield_P_FSG_4_0_0_18",0);
           EnableControl(panel_name,"panel_P_FSG_4_0_0_18",0);
           setControlForeColor(panel_name, "checkbox_P_FSG_4_0_0_18", MakeRGB(250,0,0));
       }
}
on envVar P_FSG_4_0_0_18 // bus value of HeightAdjustment (18).
{
	// opcodes: Error-Status
	byte param1; // Setup
	byte param2; // ModificationReason
	byte param3; // ModificationState
	// DATATYPE_BYTESEQUENCE / DATATYPE_FIXEDBYTESEQUENCE
	dword i;
	byte superval[2];
	dword currentPos;
	currentPos = 0;
	for( i = 0; i < 2; i++ ) {
		superval[i] = 0;
	}
	getValue(P_FSG_4_0_0_18, superval);
	///////// Start param1 - UINT8 /////////
	param1 = superval[currentPos++];
	putValue(P_FSG_4_0_0_18_1, round((param1 * 1.0) - (0) + (0), 1.0));
	///////// Start param2 - NIBBLE /////////
	param2 = (superval[currentPos] & 0xf0)>>4;
	putValue(P_FSG_4_0_0_18_2, param2);
	///////// Start param3 - NIBBLE /////////
	param3 = superval[currentPos++] & 0x0f;
	putValue(P_FSG_4_0_0_18_3, param3);
}

// Ueberwachung der Darstellungsvariable der Range.
on envVar P_FSG_4_0_0_18_1_range // HeightAdjustment.Setup 
{
	@P_FSG_4_0_0_18_1 = @P_FSG_4_0_0_18_1_range - (0); // slider = range - min
}

on envVar P_FSG_4_0_0_18_1 // HeightAdjustment.Setup
{
	byte superval[2];

	//Update Childvalue (Number)
	byte thisval; // Setup
	float slider_value;

	slider_value = round(@P_FSG_4_0_0_18_1, 1.0);
	@P_FSG_4_0_0_18_1_range = slider_value + (0); // real value := slider value + range min.
	thisval = (byte)round((slider_value + (0) - (0)) / (1.0), 1); // bus value := (slider value + min - offset) / step.

    // Update superval
	getValue(P_FSG_4_0_0_18, superval);
	superval[0]=thisval;
	putValue(P_FSG_4_0_0_18,superval);
}

on envVar P_FSG_4_0_0_18_2 // HeightAdjustment.ModificationReason
{
	byte superval[2];

	//Update Childvalue (Enum)
	byte thisval; // ModificationReason
	thisval = 0x0f & getValue(this);

    // Update superval
	getValue(P_FSG_4_0_0_18, superval);
	superval[1]= superval[1]&0x0f;
	superval[1]= superval[1]|(thisval<<4);
	putValue(P_FSG_4_0_0_18,superval);
}

on envVar P_FSG_4_0_0_18_3_0
{
	byte bitval;
	//thisval steht hier fuer den bitfield-wert, 
	//aus Generierungsgruenden hier keine einheitliche Bezeichnung moeglich.
	byte thisval; // ModificationState
	bitval= getValue(this);
	thisval = getValue(P_FSG_4_0_0_18_3);
	thisval = thisval&~(1<<0)|(bitval<<0);
	putValue(P_FSG_4_0_0_18_3,thisval);
}

on envVar P_FSG_4_0_0_18_3 // HeightAdjustment.ModificationState
{
	byte superval[2];

	//Update Childvalue (BitField)
	byte mask=0x01;
	int i = 0;
	byte thisval; // ModificationState
	thisval = getValue(this);
	if(thisval&(mask<<0))
		putValue(P_FSG_4_0_0_18_3_0, 1);
	else
		putValue(P_FSG_4_0_0_18_3_0, 0);

    // Update superval
	getValue(P_FSG_4_0_0_18, superval);
	superval[1]= superval[1]&0xf0;
	superval[1]= superval[1]|thisval;
	putValue(P_FSG_4_0_0_18,superval);
}

// Ruecksetzen des Fehlerstatus durch manuelle Fehlereingabe
on envVar P_FSG_4_0_0_19_ErrCode
{
       if(gP_FSG_4_0_0_19_ErrCode) 
       {
           setControlBackColor(panel_name,"errfield_P_FSG_4_0_0_19", MakeRGB(255,255,255));
       }
       gP_FSG_4_0_0_19_ErrCode = 1;
}
on envVar P_FSG_4_0_0_19Status_BTN
{
    if (P_FSG_4_0_0_19Status_BTN_already_pressed == 0)
    {
       putValue(P_FSG_4_0_0_19_ErrCode,0);
       SetControlBackColor(panel_name,"errField_P_FSG_4_0_0_19",MakeRGB(255,255,255));
       P_FSG_4_0_0_19Status_BTN_already_pressed = 1;
    }
    else
    {
       Request_Int8(LSGID, P_FSG_4_0_0_19_ID, Data_REQ, getValue(P_FSG_4_0_0_19));
      P_FSG_4_0_0_19Status_BTN_already_pressed = 0;
    }
}
on envVar P_FSG_4_0_0_19_FctEn
{
    long data[3];
    data[0]=LSGID;
    data[1]=P_FSG_4_0_0_19_ID;
    data[2]=getValue(P_FSG_4_0_0_19_FctEn);
    ChangeConfig(0x0031,data);
}
// De-Aktivierung der Eingabefelder der FCTID P_FSG_4_0_0_19
on envVar P_FSG_4_0_0_19_FctLstItemEn
{
       if(getValue(this)) 
       {
           EnableControl(panel_name,"panel_FSG_4_0_0_19",1);
           EnableControl(panel_name,"errfield_P_FSG_4_0_0_19",1);
           EnableControl(panel_name,"panel_P_FSG_4_0_0_19",1);
           setControlForeColor(panel_name, "checkbox_P_FSG_4_0_0_19", MakeRGB(0,240,0));
       }
       else
       {
           EnableControl(panel_name,"panel_FSG_4_0_0_19",0);
           EnableControl(panel_name,"errfield_P_FSG_4_0_0_19",0);
           EnableControl(panel_name,"panel_P_FSG_4_0_0_19",0);
           setControlForeColor(panel_name, "checkbox_P_FSG_4_0_0_19", MakeRGB(250,0,0));
       }
}
on envVar P_FSG_4_0_0_19 // bus value of DisplayContent (19).
{
	// opcodes: Error-Status
	byte param1; // Status
	// DATATYPE_UINTXX
	param1 = getValue(P_FSG_4_0_0_19);
	putValue(P_FSG_4_0_0_19_1, param1);
}

on envVar P_FSG_4_0_0_19_1_0
{
	byte bitval;
	//thisval steht hier fuer den bitfield-wert, 
	//aus Generierungsgruenden hier keine einheitliche Bezeichnung moeglich.
	byte thisval; // Status
	bitval= getValue(this);
	thisval = getValue(P_FSG_4_0_0_19_1);
	thisval = thisval&~(1<<0)|(bitval<<0);
	putValue(P_FSG_4_0_0_19_1,thisval);
}

on envVar P_FSG_4_0_0_19_1 // DisplayContent.Status
{
	byte superval;

	//Update Childvalue (BitField)
	byte mask=0x01;
	int i = 0;
	byte thisval; // Status
	thisval = getValue(this);
	if(thisval&(mask<<0))
		putValue(P_FSG_4_0_0_19_1_0, 1);
	else
		putValue(P_FSG_4_0_0_19_1_0, 0);

    // Update superval
	superval = getValue(P_FSG_4_0_0_19);
	superval = thisval;
	putValue(P_FSG_4_0_0_19,superval);
}

// Ruecksetzen des Fehlerstatus durch manuelle Fehlereingabe
on envVar P_FSG_4_0_0_20_ErrCode
{
       if(gP_FSG_4_0_0_20_ErrCode) 
       {
           setControlBackColor(panel_name,"errfield_P_FSG_4_0_0_20", MakeRGB(255,255,255));
       }
       gP_FSG_4_0_0_20_ErrCode = 1;
}
on envVar P_FSG_4_0_0_20Status_BTN
{
	byte BAPTemp[2];
   if (P_FSG_4_0_0_20Status_BTN_already_pressed == 0)
   {
      putValue(P_FSG_4_0_0_20_ErrCode,0);
      SetControlBackColor(panel_name,"errField_P_FSG_4_0_0_20",MakeRGB(255,255,255));
      P_FSG_4_0_0_20Status_BTN_already_pressed = 1;
   }
   else
   {
      getValue(P_FSG_4_0_0_20, BAPTemp);
      Request_ByteSequence(LSGID, P_FSG_4_0_0_20_ID, Data_REQ, BAPTemp, getValueSize(P_FSG_4_0_0_20));
      P_FSG_4_0_0_20Status_BTN_already_pressed = 0;
   }
}
on envVar P_FSG_4_0_0_20_FctEn
{
    long data[3];
    data[0]=LSGID;
    data[1]=P_FSG_4_0_0_20_ID;
    data[2]=getValue(P_FSG_4_0_0_20_FctEn);
    ChangeConfig(0x0031,data);
}
// De-Aktivierung der Eingabefelder der FCTID P_FSG_4_0_0_20
on envVar P_FSG_4_0_0_20_FctLstItemEn
{
       if(getValue(this)) 
       {
           EnableControl(panel_name,"panel_FSG_4_0_0_20",1);
           EnableControl(panel_name,"errfield_P_FSG_4_0_0_20",1);
           EnableControl(panel_name,"panel_P_FSG_4_0_0_20",1);
           setControlForeColor(panel_name, "checkbox_P_FSG_4_0_0_20", MakeRGB(0,240,0));
       }
       else
       {
           EnableControl(panel_name,"panel_FSG_4_0_0_20",0);
           EnableControl(panel_name,"errfield_P_FSG_4_0_0_20",0);
           EnableControl(panel_name,"panel_P_FSG_4_0_0_20",0);
           setControlForeColor(panel_name, "checkbox_P_FSG_4_0_0_20", MakeRGB(250,0,0));
       }
}
on envVar P_FSG_4_0_0_20 // bus value of RotationAdjustment (20).
{
	// opcodes: Error-Status
	char param1; // Rotation
	byte param2; // ModificationReason
	byte param3; // ModificationState
	// DATATYPE_BYTESEQUENCE / DATATYPE_FIXEDBYTESEQUENCE
	dword i;
	byte superval[2];
	dword currentPos;
	currentPos = 0;
	for( i = 0; i < 2; i++ ) {
		superval[i] = 0;
	}
	getValue(P_FSG_4_0_0_20, superval);
	///////// Start param1 - UINT8 /////////
	param1 = superval[currentPos++];
	putValue(P_FSG_4_0_0_20_1, round((param1 * 1.0) - (-10) + (0), 1.0));
	///////// Start param2 - NIBBLE /////////
	param2 = (superval[currentPos] & 0xf0)>>4;
	putValue(P_FSG_4_0_0_20_2, param2);
	///////// Start param3 - NIBBLE /////////
	param3 = superval[currentPos++] & 0x0f;
	putValue(P_FSG_4_0_0_20_3, param3);
}

// Ueberwachung der Darstellungsvariable der Range.
on envVar P_FSG_4_0_0_20_1_range // RotationAdjustment.Rotation 
{
	@P_FSG_4_0_0_20_1 = @P_FSG_4_0_0_20_1_range - (-10); // slider = range - min
}

on envVar P_FSG_4_0_0_20_1 // RotationAdjustment.Rotation
{
	byte superval[2];

	//Update Childvalue (Number)
	char thisval; // Rotation
	float slider_value;

	slider_value = round(@P_FSG_4_0_0_20_1, 1.0);
	@P_FSG_4_0_0_20_1_range = slider_value + (-10); // real value := slider value + range min.
	thisval = (char)round((slider_value + (-10) - (0)) / (1.0), 1); // bus value := (slider value + min - offset) / step.

    // Update superval
	getValue(P_FSG_4_0_0_20, superval);
	superval[0]=thisval;
	putValue(P_FSG_4_0_0_20,superval);
}

on envVar P_FSG_4_0_0_20_2 // RotationAdjustment.ModificationReason
{
	byte superval[2];

	//Update Childvalue (Enum)
	byte thisval; // ModificationReason
	thisval = 0x0f & getValue(this);

    // Update superval
	getValue(P_FSG_4_0_0_20, superval);
	superval[1]= superval[1]&0x0f;
	superval[1]= superval[1]|(thisval<<4);
	putValue(P_FSG_4_0_0_20,superval);
}

on envVar P_FSG_4_0_0_20_3_0
{
	byte bitval;
	//thisval steht hier fuer den bitfield-wert, 
	//aus Generierungsgruenden hier keine einheitliche Bezeichnung moeglich.
	byte thisval; // ModificationState
	bitval= getValue(this);
	thisval = getValue(P_FSG_4_0_0_20_3);
	thisval = thisval&~(1<<0)|(bitval<<0);
	putValue(P_FSG_4_0_0_20_3,thisval);
}

on envVar P_FSG_4_0_0_20_3 // RotationAdjustment.ModificationState
{
	byte superval[2];

	//Update Childvalue (BitField)
	byte mask=0x01;
	int i = 0;
	byte thisval; // ModificationState
	thisval = getValue(this);
	if(thisval&(mask<<0))
		putValue(P_FSG_4_0_0_20_3_0, 1);
	else
		putValue(P_FSG_4_0_0_20_3_0, 0);

    // Update superval
	getValue(P_FSG_4_0_0_20, superval);
	superval[1]= superval[1]&0xf0;
	superval[1]= superval[1]|thisval;
	putValue(P_FSG_4_0_0_20,superval);
}

// Ruecksetzen des Fehlerstatus durch manuelle Fehlereingabe
on envVar P_FSG_4_0_0_21_ErrCode
{
       if(gP_FSG_4_0_0_21_ErrCode) 
       {
           setControlBackColor(panel_name,"errfield_P_FSG_4_0_0_21", MakeRGB(255,255,255));
       }
       gP_FSG_4_0_0_21_ErrCode = 1;
}
on envVar P_FSG_4_0_0_21Status_BTN
{
	byte BAPTemp[6];
   if (P_FSG_4_0_0_21Status_BTN_already_pressed == 0)
   {
      putValue(P_FSG_4_0_0_21_ErrCode,0);
      SetControlBackColor(panel_name,"errField_P_FSG_4_0_0_21",MakeRGB(255,255,255));
      P_FSG_4_0_0_21Status_BTN_already_pressed = 1;
   }
   else
   {
      getValue(P_FSG_4_0_0_21, BAPTemp);
      Request_ByteSequence(LSGID, P_FSG_4_0_0_21_ID, Data_REQ, BAPTemp, getValueSize(P_FSG_4_0_0_21));
      P_FSG_4_0_0_21Status_BTN_already_pressed = 0;
   }
}
on envVar P_FSG_4_0_0_21_FctEn
{
    long data[3];
    data[0]=LSGID;
    data[1]=P_FSG_4_0_0_21_ID;
    data[2]=getValue(P_FSG_4_0_0_21_FctEn);
    ChangeConfig(0x0031,data);
}
// De-Aktivierung der Eingabefelder der FCTID P_FSG_4_0_0_21
on envVar P_FSG_4_0_0_21_FctLstItemEn
{
       if(getValue(this)) 
       {
           EnableControl(panel_name,"panel_FSG_4_0_0_21",1);
           EnableControl(panel_name,"errfield_P_FSG_4_0_0_21",1);
           EnableControl(panel_name,"panel_P_FSG_4_0_0_21",1);
           setControlForeColor(panel_name, "checkbox_P_FSG_4_0_0_21", MakeRGB(0,240,0));
       }
       else
       {
           EnableControl(panel_name,"panel_FSG_4_0_0_21",0);
           EnableControl(panel_name,"errfield_P_FSG_4_0_0_21",0);
           EnableControl(panel_name,"panel_P_FSG_4_0_0_21",0);
           setControlForeColor(panel_name, "checkbox_P_FSG_4_0_0_21", MakeRGB(250,0,0));
       }
}
on envVar P_FSG_4_0_0_21 // bus value of FSG_Setup2 (21).
{
	// opcodes: Error-Status
	word param1; // SupportedColourDesign
	word param2; // SupportedColour
	byte param3; // SupportedPresets
	byte param4; // SupportedDisplaySection
	// DATATYPE_BYTESEQUENCE / DATATYPE_FIXEDBYTESEQUENCE
	dword i;
	byte superval[6];
	dword currentPos;
	currentPos = 0;
	for( i = 0; i < 6; i++ ) {
		superval[i] = 0;
	}
	getValue(P_FSG_4_0_0_21, superval);
	///////// Start param1 - UINT16 /////////
	param1 = superval[currentPos++]|(superval[currentPos++]<<8);
	putValue(P_FSG_4_0_0_21_1, param1);
	///////// Start param2 - UINT16 /////////
	param2 = superval[currentPos++]|(superval[currentPos++]<<8);
	putValue(P_FSG_4_0_0_21_2, param2);
	///////// Start param3 - UINT8 /////////
	param3 = superval[currentPos++];
	putValue(P_FSG_4_0_0_21_3, param3);
	///////// Start param4 - UINT8 /////////
	param4 = superval[currentPos++];
	putValue(P_FSG_4_0_0_21_4, param4);
}

on envVar P_FSG_4_0_0_21_1_0
{
	byte bitval;
	//thisval steht hier fuer den bitfield-wert, 
	//aus Generierungsgruenden hier keine einheitliche Bezeichnung moeglich.
	word thisval; // SupportedColourDesign
	bitval= getValue(this);
	thisval = getValue(P_FSG_4_0_0_21_1);
	thisval = thisval&~(1<<0)|(bitval<<0);
	putValue(P_FSG_4_0_0_21_1,thisval);
}

on envVar P_FSG_4_0_0_21_1_1
{
	byte bitval;
	//thisval steht hier fuer den bitfield-wert, 
	//aus Generierungsgruenden hier keine einheitliche Bezeichnung moeglich.
	word thisval; // SupportedColourDesign
	bitval= getValue(this);
	thisval = getValue(P_FSG_4_0_0_21_1);
	thisval = thisval&~(1<<1)|(bitval<<1);
	putValue(P_FSG_4_0_0_21_1,thisval);
}

on envVar P_FSG_4_0_0_21_1_2
{
	byte bitval;
	//thisval steht hier fuer den bitfield-wert, 
	//aus Generierungsgruenden hier keine einheitliche Bezeichnung moeglich.
	word thisval; // SupportedColourDesign
	bitval= getValue(this);
	thisval = getValue(P_FSG_4_0_0_21_1);
	thisval = thisval&~(1<<2)|(bitval<<2);
	putValue(P_FSG_4_0_0_21_1,thisval);
}

on envVar P_FSG_4_0_0_21_1 // FSG_Setup2.SupportedColourDesign
{
	byte superval[6];

	//Update Childvalue (BitField)
	byte mask=0x01;
	int i = 0;
	word thisval; // SupportedColourDesign
	thisval = getValue(this);
	if(thisval&(mask<<0))
		putValue(P_FSG_4_0_0_21_1_0, 1);
	else
		putValue(P_FSG_4_0_0_21_1_0, 0);
	if(thisval&(mask<<1))
		putValue(P_FSG_4_0_0_21_1_1, 1);
	else
		putValue(P_FSG_4_0_0_21_1_1, 0);
	if(thisval&(mask<<2))
		putValue(P_FSG_4_0_0_21_1_2, 1);
	else
		putValue(P_FSG_4_0_0_21_1_2, 0);

    // Update superval
	getValue(P_FSG_4_0_0_21, superval);
	superval[0]=thisval&0x00ff;
	superval[1]=(thisval&0xff00)>>8;
	putValue(P_FSG_4_0_0_21,superval);
}

on envVar P_FSG_4_0_0_21_2_0
{
	byte bitval;
	//thisval steht hier fuer den bitfield-wert, 
	//aus Generierungsgruenden hier keine einheitliche Bezeichnung moeglich.
	word thisval; // SupportedColour
	bitval= getValue(this);
	thisval = getValue(P_FSG_4_0_0_21_2);
	thisval = thisval&~(1<<0)|(bitval<<0);
	putValue(P_FSG_4_0_0_21_2,thisval);
}

on envVar P_FSG_4_0_0_21_2_1
{
	byte bitval;
	//thisval steht hier fuer den bitfield-wert, 
	//aus Generierungsgruenden hier keine einheitliche Bezeichnung moeglich.
	word thisval; // SupportedColour
	bitval= getValue(this);
	thisval = getValue(P_FSG_4_0_0_21_2);
	thisval = thisval&~(1<<1)|(bitval<<1);
	putValue(P_FSG_4_0_0_21_2,thisval);
}

on envVar P_FSG_4_0_0_21_2 // FSG_Setup2.SupportedColour
{
	byte superval[6];

	//Update Childvalue (BitField)
	byte mask=0x01;
	int i = 0;
	word thisval; // SupportedColour
	thisval = getValue(this);
	if(thisval&(mask<<0))
		putValue(P_FSG_4_0_0_21_2_0, 1);
	else
		putValue(P_FSG_4_0_0_21_2_0, 0);
	if(thisval&(mask<<1))
		putValue(P_FSG_4_0_0_21_2_1, 1);
	else
		putValue(P_FSG_4_0_0_21_2_1, 0);

    // Update superval
	getValue(P_FSG_4_0_0_21, superval);
	superval[2]=thisval&0x00ff;
	superval[3]=(thisval&0xff00)>>8;
	putValue(P_FSG_4_0_0_21,superval);
}

on envVar P_FSG_4_0_0_21_3_0
{
	byte bitval;
	//thisval steht hier fuer den bitfield-wert, 
	//aus Generierungsgruenden hier keine einheitliche Bezeichnung moeglich.
	byte thisval; // SupportedPresets
	bitval= getValue(this);
	thisval = getValue(P_FSG_4_0_0_21_3);
	thisval = thisval&~(1<<0)|(bitval<<0);
	putValue(P_FSG_4_0_0_21_3,thisval);
}

on envVar P_FSG_4_0_0_21_3_1
{
	byte bitval;
	//thisval steht hier fuer den bitfield-wert, 
	//aus Generierungsgruenden hier keine einheitliche Bezeichnung moeglich.
	byte thisval; // SupportedPresets
	bitval= getValue(this);
	thisval = getValue(P_FSG_4_0_0_21_3);
	thisval = thisval&~(1<<1)|(bitval<<1);
	putValue(P_FSG_4_0_0_21_3,thisval);
}

on envVar P_FSG_4_0_0_21_3_2
{
	byte bitval;
	//thisval steht hier fuer den bitfield-wert, 
	//aus Generierungsgruenden hier keine einheitliche Bezeichnung moeglich.
	byte thisval; // SupportedPresets
	bitval= getValue(this);
	thisval = getValue(P_FSG_4_0_0_21_3);
	thisval = thisval&~(1<<2)|(bitval<<2);
	putValue(P_FSG_4_0_0_21_3,thisval);
}

on envVar P_FSG_4_0_0_21_3_3
{
	byte bitval;
	//thisval steht hier fuer den bitfield-wert, 
	//aus Generierungsgruenden hier keine einheitliche Bezeichnung moeglich.
	byte thisval; // SupportedPresets
	bitval= getValue(this);
	thisval = getValue(P_FSG_4_0_0_21_3);
	thisval = thisval&~(1<<3)|(bitval<<3);
	putValue(P_FSG_4_0_0_21_3,thisval);
}

on envVar P_FSG_4_0_0_21_3_4
{
	byte bitval;
	//thisval steht hier fuer den bitfield-wert, 
	//aus Generierungsgruenden hier keine einheitliche Bezeichnung moeglich.
	byte thisval; // SupportedPresets
	bitval= getValue(this);
	thisval = getValue(P_FSG_4_0_0_21_3);
	thisval = thisval&~(1<<4)|(bitval<<4);
	putValue(P_FSG_4_0_0_21_3,thisval);
}

on envVar P_FSG_4_0_0_21_3_5
{
	byte bitval;
	//thisval steht hier fuer den bitfield-wert, 
	//aus Generierungsgruenden hier keine einheitliche Bezeichnung moeglich.
	byte thisval; // SupportedPresets
	bitval= getValue(this);
	thisval = getValue(P_FSG_4_0_0_21_3);
	thisval = thisval&~(1<<5)|(bitval<<5);
	putValue(P_FSG_4_0_0_21_3,thisval);
}

on envVar P_FSG_4_0_0_21_3_6
{
	byte bitval;
	//thisval steht hier fuer den bitfield-wert, 
	//aus Generierungsgruenden hier keine einheitliche Bezeichnung moeglich.
	byte thisval; // SupportedPresets
	bitval= getValue(this);
	thisval = getValue(P_FSG_4_0_0_21_3);
	thisval = thisval&~(1<<6)|(bitval<<6);
	putValue(P_FSG_4_0_0_21_3,thisval);
}

on envVar P_FSG_4_0_0_21_3 // FSG_Setup2.SupportedPresets
{
	byte superval[6];

	//Update Childvalue (BitField)
	byte mask=0x01;
	int i = 0;
	byte thisval; // SupportedPresets
	thisval = getValue(this);
	if(thisval&(mask<<0))
		putValue(P_FSG_4_0_0_21_3_0, 1);
	else
		putValue(P_FSG_4_0_0_21_3_0, 0);
	if(thisval&(mask<<1))
		putValue(P_FSG_4_0_0_21_3_1, 1);
	else
		putValue(P_FSG_4_0_0_21_3_1, 0);
	if(thisval&(mask<<2))
		putValue(P_FSG_4_0_0_21_3_2, 1);
	else
		putValue(P_FSG_4_0_0_21_3_2, 0);
	if(thisval&(mask<<3))
		putValue(P_FSG_4_0_0_21_3_3, 1);
	else
		putValue(P_FSG_4_0_0_21_3_3, 0);
	if(thisval&(mask<<4))
		putValue(P_FSG_4_0_0_21_3_4, 1);
	else
		putValue(P_FSG_4_0_0_21_3_4, 0);
	if(thisval&(mask<<5))
		putValue(P_FSG_4_0_0_21_3_5, 1);
	else
		putValue(P_FSG_4_0_0_21_3_5, 0);
	if(thisval&(mask<<6))
		putValue(P_FSG_4_0_0_21_3_6, 1);
	else
		putValue(P_FSG_4_0_0_21_3_6, 0);

    // Update superval
	getValue(P_FSG_4_0_0_21, superval);
	superval[4]=thisval;
	putValue(P_FSG_4_0_0_21,superval);
}

on envVar P_FSG_4_0_0_21_4_0
{
	byte bitval;
	//thisval steht hier fuer den bitfield-wert, 
	//aus Generierungsgruenden hier keine einheitliche Bezeichnung moeglich.
	byte thisval; // SupportedDisplaySection
	bitval= getValue(this);
	thisval = getValue(P_FSG_4_0_0_21_4);
	thisval = thisval&~(1<<0)|(bitval<<0);
	putValue(P_FSG_4_0_0_21_4,thisval);
}

on envVar P_FSG_4_0_0_21_4_1
{
	byte bitval;
	//thisval steht hier fuer den bitfield-wert, 
	//aus Generierungsgruenden hier keine einheitliche Bezeichnung moeglich.
	byte thisval; // SupportedDisplaySection
	bitval= getValue(this);
	thisval = getValue(P_FSG_4_0_0_21_4);
	thisval = thisval&~(1<<1)|(bitval<<1);
	putValue(P_FSG_4_0_0_21_4,thisval);
}

on envVar P_FSG_4_0_0_21_4_2
{
	byte bitval;
	//thisval steht hier fuer den bitfield-wert, 
	//aus Generierungsgruenden hier keine einheitliche Bezeichnung moeglich.
	byte thisval; // SupportedDisplaySection
	bitval= getValue(this);
	thisval = getValue(P_FSG_4_0_0_21_4);
	thisval = thisval&~(1<<2)|(bitval<<2);
	putValue(P_FSG_4_0_0_21_4,thisval);
}

on envVar P_FSG_4_0_0_21_4_3
{
	byte bitval;
	//thisval steht hier fuer den bitfield-wert, 
	//aus Generierungsgruenden hier keine einheitliche Bezeichnung moeglich.
	byte thisval; // SupportedDisplaySection
	bitval= getValue(this);
	thisval = getValue(P_FSG_4_0_0_21_4);
	thisval = thisval&~(1<<3)|(bitval<<3);
	putValue(P_FSG_4_0_0_21_4,thisval);
}

on envVar P_FSG_4_0_0_21_4_4
{
	byte bitval;
	//thisval steht hier fuer den bitfield-wert, 
	//aus Generierungsgruenden hier keine einheitliche Bezeichnung moeglich.
	byte thisval; // SupportedDisplaySection
	bitval= getValue(this);
	thisval = getValue(P_FSG_4_0_0_21_4);
	thisval = thisval&~(1<<4)|(bitval<<4);
	putValue(P_FSG_4_0_0_21_4,thisval);
}

on envVar P_FSG_4_0_0_21_4_5
{
	byte bitval;
	//thisval steht hier fuer den bitfield-wert, 
	//aus Generierungsgruenden hier keine einheitliche Bezeichnung moeglich.
	byte thisval; // SupportedDisplaySection
	bitval= getValue(this);
	thisval = getValue(P_FSG_4_0_0_21_4);
	thisval = thisval&~(1<<5)|(bitval<<5);
	putValue(P_FSG_4_0_0_21_4,thisval);
}

on envVar P_FSG_4_0_0_21_4_6
{
	byte bitval;
	//thisval steht hier fuer den bitfield-wert, 
	//aus Generierungsgruenden hier keine einheitliche Bezeichnung moeglich.
	byte thisval; // SupportedDisplaySection
	bitval= getValue(this);
	thisval = getValue(P_FSG_4_0_0_21_4);
	thisval = thisval&~(1<<6)|(bitval<<6);
	putValue(P_FSG_4_0_0_21_4,thisval);
}

on envVar P_FSG_4_0_0_21_4_7
{
	byte bitval;
	//thisval steht hier fuer den bitfield-wert, 
	//aus Generierungsgruenden hier keine einheitliche Bezeichnung moeglich.
	byte thisval; // SupportedDisplaySection
	bitval= getValue(this);
	thisval = getValue(P_FSG_4_0_0_21_4);
	thisval = thisval&~(1<<7)|(bitval<<7);
	putValue(P_FSG_4_0_0_21_4,thisval);
}

on envVar P_FSG_4_0_0_21_4 // FSG_Setup2.SupportedDisplaySection
{
	byte superval[6];

	//Update Childvalue (BitField)
	byte mask=0x01;
	int i = 0;
	byte thisval; // SupportedDisplaySection
	thisval = getValue(this);
	if(thisval&(mask<<0))
		putValue(P_FSG_4_0_0_21_4_0, 1);
	else
		putValue(P_FSG_4_0_0_21_4_0, 0);
	if(thisval&(mask<<1))
		putValue(P_FSG_4_0_0_21_4_1, 1);
	else
		putValue(P_FSG_4_0_0_21_4_1, 0);
	if(thisval&(mask<<2))
		putValue(P_FSG_4_0_0_21_4_2, 1);
	else
		putValue(P_FSG_4_0_0_21_4_2, 0);
	if(thisval&(mask<<3))
		putValue(P_FSG_4_0_0_21_4_3, 1);
	else
		putValue(P_FSG_4_0_0_21_4_3, 0);
	if(thisval&(mask<<4))
		putValue(P_FSG_4_0_0_21_4_4, 1);
	else
		putValue(P_FSG_4_0_0_21_4_4, 0);
	if(thisval&(mask<<5))
		putValue(P_FSG_4_0_0_21_4_5, 1);
	else
		putValue(P_FSG_4_0_0_21_4_5, 0);
	if(thisval&(mask<<6))
		putValue(P_FSG_4_0_0_21_4_6, 1);
	else
		putValue(P_FSG_4_0_0_21_4_6, 0);
	if(thisval&(mask<<7))
		putValue(P_FSG_4_0_0_21_4_7, 1);
	else
		putValue(P_FSG_4_0_0_21_4_7, 0);

    // Update superval
	getValue(P_FSG_4_0_0_21, superval);
	superval[5]=thisval;
	putValue(P_FSG_4_0_0_21,superval);
}

// Ruecksetzen des Fehlerstatus durch manuelle Fehlereingabe
on envVar P_FSG_4_0_0_22_ErrCode
{
       if(gP_FSG_4_0_0_22_ErrCode) 
       {
           setControlBackColor(panel_name,"errfield_P_FSG_4_0_0_22", MakeRGB(255,255,255));
       }
       gP_FSG_4_0_0_22_ErrCode = 1;
}
on envVar P_FSG_4_0_0_22Status_BTN
{
	byte BAPTemp[2];
   if (P_FSG_4_0_0_22Status_BTN_already_pressed == 0)
   {
      putValue(P_FSG_4_0_0_22_ErrCode,0);
      SetControlBackColor(panel_name,"errField_P_FSG_4_0_0_22",MakeRGB(255,255,255));
      P_FSG_4_0_0_22Status_BTN_already_pressed = 1;
   }
   else
   {
      getValue(P_FSG_4_0_0_22, BAPTemp);
      Request_ByteSequence(LSGID, P_FSG_4_0_0_22_ID, Data_REQ, BAPTemp, getValueSize(P_FSG_4_0_0_22));
      P_FSG_4_0_0_22Status_BTN_already_pressed = 0;
   }
}
on envVar P_FSG_4_0_0_22_FctEn
{
    long data[3];
    data[0]=LSGID;
    data[1]=P_FSG_4_0_0_22_ID;
    data[2]=getValue(P_FSG_4_0_0_22_FctEn);
    ChangeConfig(0x0031,data);
}
// De-Aktivierung der Eingabefelder der FCTID P_FSG_4_0_0_22
on envVar P_FSG_4_0_0_22_FctLstItemEn
{
       if(getValue(this)) 
       {
           EnableControl(panel_name,"panel_FSG_4_0_0_22",1);
           EnableControl(panel_name,"errfield_P_FSG_4_0_0_22",1);
           EnableControl(panel_name,"panel_P_FSG_4_0_0_22",1);
           setControlForeColor(panel_name, "checkbox_P_FSG_4_0_0_22", MakeRGB(0,240,0));
       }
       else
       {
           EnableControl(panel_name,"panel_FSG_4_0_0_22",0);
           EnableControl(panel_name,"errfield_P_FSG_4_0_0_22",0);
           EnableControl(panel_name,"panel_P_FSG_4_0_0_22",0);
           setControlForeColor(panel_name, "checkbox_P_FSG_4_0_0_22", MakeRGB(250,0,0));
       }
}
on envVar P_FSG_4_0_0_22 // bus value of Colour (22).
{
	// opcodes: Error-Status
	byte param1; // ColourDesign
	byte param2; // Colour
	byte param3; // ModificationReason
	byte param4; // ModificationState
	// DATATYPE_BYTESEQUENCE / DATATYPE_FIXEDBYTESEQUENCE
	dword i;
	byte superval[2];
	dword currentPos;
	currentPos = 0;
	for( i = 0; i < 2; i++ ) {
		superval[i] = 0;
	}
	getValue(P_FSG_4_0_0_22, superval);
	///////// Start param1 - NIBBLE /////////
	param1 = (superval[currentPos] & 0xf0)>>4;
	putValue(P_FSG_4_0_0_22_1, param1);
	///////// Start param2 - NIBBLE /////////
	param2 = superval[currentPos++] & 0x0f;
	putValue(P_FSG_4_0_0_22_2, param2);
	///////// Start param3 - NIBBLE /////////
	param3 = (superval[currentPos] & 0xf0)>>4;
	putValue(P_FSG_4_0_0_22_3, param3);
	///////// Start param4 - NIBBLE /////////
	param4 = superval[currentPos++] & 0x0f;
	putValue(P_FSG_4_0_0_22_4, param4);
}

on envVar P_FSG_4_0_0_22_1 // Colour.ColourDesign
{
	byte superval[2];

	//Update Childvalue (Enum)
	byte thisval; // ColourDesign
	thisval = 0x0f & getValue(this);

    // Update superval
	getValue(P_FSG_4_0_0_22, superval);
	superval[0]= superval[0]&0x0f;
	superval[0]= superval[0]|(thisval<<4);
	putValue(P_FSG_4_0_0_22,superval);
}

on envVar P_FSG_4_0_0_22_2 // Colour.Colour
{
	byte superval[2];

	//Update Childvalue (Enum)
	byte thisval; // Colour
	thisval = 0x0f & getValue(this);

    // Update superval
	getValue(P_FSG_4_0_0_22, superval);
	superval[0]= superval[0]&0xf0;
	superval[0]= superval[0]|thisval;
	putValue(P_FSG_4_0_0_22,superval);
}

on envVar P_FSG_4_0_0_22_3 // Colour.ModificationReason
{
	byte superval[2];

	//Update Childvalue (Enum)
	byte thisval; // ModificationReason
	thisval = 0x0f & getValue(this);

    // Update superval
	getValue(P_FSG_4_0_0_22, superval);
	superval[1]= superval[1]&0x0f;
	superval[1]= superval[1]|(thisval<<4);
	putValue(P_FSG_4_0_0_22,superval);
}

on envVar P_FSG_4_0_0_22_4_0
{
	byte bitval;
	//thisval steht hier fuer den bitfield-wert, 
	//aus Generierungsgruenden hier keine einheitliche Bezeichnung moeglich.
	byte thisval; // ModificationState
	bitval= getValue(this);
	thisval = getValue(P_FSG_4_0_0_22_4);
	thisval = thisval&~(1<<0)|(bitval<<0);
	putValue(P_FSG_4_0_0_22_4,thisval);
}

on envVar P_FSG_4_0_0_22_4 // Colour.ModificationState
{
	byte superval[2];

	//Update Childvalue (BitField)
	byte mask=0x01;
	int i = 0;
	byte thisval; // ModificationState
	thisval = getValue(this);
	if(thisval&(mask<<0))
		putValue(P_FSG_4_0_0_22_4_0, 1);
	else
		putValue(P_FSG_4_0_0_22_4_0, 0);

    // Update superval
	getValue(P_FSG_4_0_0_22, superval);
	superval[1]= superval[1]&0xf0;
	superval[1]= superval[1]|thisval;
	putValue(P_FSG_4_0_0_22,superval);
}

// Ruecksetzen des Fehlerstatus durch manuelle Fehlereingabe
on envVar P_FSG_4_0_0_23_ErrCode
{
       if(gP_FSG_4_0_0_23_ErrCode) 
       {
           setControlBackColor(panel_name,"errfield_P_FSG_4_0_0_23", MakeRGB(255,255,255));
       }
       gP_FSG_4_0_0_23_ErrCode = 1;
}
on envVar P_FSG_4_0_0_23Status_BTN
{
	byte BAPTemp[2];
   if (P_FSG_4_0_0_23Status_BTN_already_pressed == 0)
   {
      putValue(P_FSG_4_0_0_23_ErrCode,0);
      SetControlBackColor(panel_name,"errField_P_FSG_4_0_0_23",MakeRGB(255,255,255));
      P_FSG_4_0_0_23Status_BTN_already_pressed = 1;
   }
   else
   {
      getValue(P_FSG_4_0_0_23, BAPTemp);
      Request_ByteSequence(LSGID, P_FSG_4_0_0_23_ID, Data_REQ, BAPTemp, getValueSize(P_FSG_4_0_0_23));
      P_FSG_4_0_0_23Status_BTN_already_pressed = 0;
   }
}
on envVar P_FSG_4_0_0_23_FctEn
{
    long data[3];
    data[0]=LSGID;
    data[1]=P_FSG_4_0_0_23_ID;
    data[2]=getValue(P_FSG_4_0_0_23_FctEn);
    ChangeConfig(0x0031,data);
}
// De-Aktivierung der Eingabefelder der FCTID P_FSG_4_0_0_23
on envVar P_FSG_4_0_0_23_FctLstItemEn
{
       if(getValue(this)) 
       {
           EnableControl(panel_name,"panel_FSG_4_0_0_23",1);
           EnableControl(panel_name,"errfield_P_FSG_4_0_0_23",1);
           EnableControl(panel_name,"panel_P_FSG_4_0_0_23",1);
           setControlForeColor(panel_name, "checkbox_P_FSG_4_0_0_23", MakeRGB(0,240,0));
       }
       else
       {
           EnableControl(panel_name,"panel_FSG_4_0_0_23",0);
           EnableControl(panel_name,"errfield_P_FSG_4_0_0_23",0);
           EnableControl(panel_name,"panel_P_FSG_4_0_0_23",0);
           setControlForeColor(panel_name, "checkbox_P_FSG_4_0_0_23", MakeRGB(250,0,0));
       }
}
on envVar P_FSG_4_0_0_23 // bus value of License (23).
{
	// opcodes: Error-Status
	byte param1; // Control
	byte param2; // ModificationReason
	byte param3; // ModificationState
	// DATATYPE_BYTESEQUENCE / DATATYPE_FIXEDBYTESEQUENCE
	dword i;
	byte superval[2];
	dword currentPos;
	currentPos = 0;
	for( i = 0; i < 2; i++ ) {
		superval[i] = 0;
	}
	getValue(P_FSG_4_0_0_23, superval);
	///////// Start param1 - UINT8 /////////
	param1 = superval[currentPos++];
	putValue(P_FSG_4_0_0_23_1, param1);
	///////// Start param2 - NIBBLE /////////
	param2 = (superval[currentPos] & 0xf0)>>4;
	putValue(P_FSG_4_0_0_23_2, param2);
	///////// Start param3 - NIBBLE /////////
	param3 = superval[currentPos++] & 0x0f;
	putValue(P_FSG_4_0_0_23_3, param3);
}

on envVar P_FSG_4_0_0_23_1_0
{
	byte bitval;
	//thisval steht hier fuer den bitfield-wert, 
	//aus Generierungsgruenden hier keine einheitliche Bezeichnung moeglich.
	byte thisval; // Control
	bitval= getValue(this);
	thisval = getValue(P_FSG_4_0_0_23_1);
	thisval = thisval&~(1<<0)|(bitval<<0);
	putValue(P_FSG_4_0_0_23_1,thisval);
}

on envVar P_FSG_4_0_0_23_1 // License.Control
{
	byte superval[2];

	//Update Childvalue (BitField)
	byte mask=0x01;
	int i = 0;
	byte thisval; // Control
	thisval = getValue(this);
	if(thisval&(mask<<0))
		putValue(P_FSG_4_0_0_23_1_0, 1);
	else
		putValue(P_FSG_4_0_0_23_1_0, 0);

    // Update superval
	getValue(P_FSG_4_0_0_23, superval);
	superval[0]=thisval;
	putValue(P_FSG_4_0_0_23,superval);
}

on envVar P_FSG_4_0_0_23_2 // License.ModificationReason
{
	byte superval[2];

	//Update Childvalue (Enum)
	byte thisval; // ModificationReason
	thisval = 0x0f & getValue(this);

    // Update superval
	getValue(P_FSG_4_0_0_23, superval);
	superval[1]= superval[1]&0x0f;
	superval[1]= superval[1]|(thisval<<4);
	putValue(P_FSG_4_0_0_23,superval);
}

on envVar P_FSG_4_0_0_23_3_0
{
	byte bitval;
	//thisval steht hier fuer den bitfield-wert, 
	//aus Generierungsgruenden hier keine einheitliche Bezeichnung moeglich.
	byte thisval; // ModificationState
	bitval= getValue(this);
	thisval = getValue(P_FSG_4_0_0_23_3);
	thisval = thisval&~(1<<0)|(bitval<<0);
	putValue(P_FSG_4_0_0_23_3,thisval);
}

on envVar P_FSG_4_0_0_23_3 // License.ModificationState
{
	byte superval[2];

	//Update Childvalue (BitField)
	byte mask=0x01;
	int i = 0;
	byte thisval; // ModificationState
	thisval = getValue(this);
	if(thisval&(mask<<0))
		putValue(P_FSG_4_0_0_23_3_0, 1);
	else
		putValue(P_FSG_4_0_0_23_3_0, 0);

    // Update superval
	getValue(P_FSG_4_0_0_23, superval);
	superval[1]= superval[1]&0xf0;
	superval[1]= superval[1]|thisval;
	putValue(P_FSG_4_0_0_23,superval);
}

// Ruecksetzen des Fehlerstatus durch manuelle Fehlereingabe
on envVar P_FSG_4_0_0_24_ErrCode
{
       if(gP_FSG_4_0_0_24_ErrCode) 
       {
           setControlBackColor(panel_name,"errfield_P_FSG_4_0_0_24", MakeRGB(255,255,255));
       }
       gP_FSG_4_0_0_24_ErrCode = 1;
}
on envVar P_FSG_4_0_0_24Status_BTN
{
	byte BAPTemp[4];
   if (P_FSG_4_0_0_24Status_BTN_already_pressed == 0)
   {
      putValue(P_FSG_4_0_0_24_ErrCode,0);
      SetControlBackColor(panel_name,"errField_P_FSG_4_0_0_24",MakeRGB(255,255,255));
      P_FSG_4_0_0_24Status_BTN_already_pressed = 1;
   }
   else
   {
      getValue(P_FSG_4_0_0_24, BAPTemp);
      Request_ByteSequence(LSGID, P_FSG_4_0_0_24_ID, Data_REQ, BAPTemp, getValueSize(P_FSG_4_0_0_24));
      P_FSG_4_0_0_24Status_BTN_already_pressed = 0;
   }
}
on envVar P_FSG_4_0_0_24_FctEn
{
    long data[3];
    data[0]=LSGID;
    data[1]=P_FSG_4_0_0_24_ID;
    data[2]=getValue(P_FSG_4_0_0_24_FctEn);
    ChangeConfig(0x0031,data);
}
// De-Aktivierung der Eingabefelder der FCTID P_FSG_4_0_0_24
on envVar P_FSG_4_0_0_24_FctLstItemEn
{
       if(getValue(this)) 
       {
           EnableControl(panel_name,"panel_FSG_4_0_0_24",1);
           EnableControl(panel_name,"errfield_P_FSG_4_0_0_24",1);
           EnableControl(panel_name,"panel_P_FSG_4_0_0_24",1);
           setControlForeColor(panel_name, "checkbox_P_FSG_4_0_0_24", MakeRGB(0,240,0));
       }
       else
       {
           EnableControl(panel_name,"panel_FSG_4_0_0_24",0);
           EnableControl(panel_name,"errfield_P_FSG_4_0_0_24",0);
           EnableControl(panel_name,"panel_P_FSG_4_0_0_24",0);
           setControlForeColor(panel_name, "checkbox_P_FSG_4_0_0_24", MakeRGB(250,0,0));
       }
}
on envVar P_FSG_4_0_0_24 // bus value of Presets (24).
{
	// opcodes: Error-Status
	byte param1; // Preset_Active
	byte param2; // Preset_Preselection
	byte param3; // Extension1
	byte param4; // ModificationReason
	byte param5; // ModificationState
	// DATATYPE_BYTESEQUENCE / DATATYPE_FIXEDBYTESEQUENCE
	dword i;
	byte superval[4];
	dword currentPos;
	currentPos = 0;
	for( i = 0; i < 4; i++ ) {
		superval[i] = 0;
	}
	getValue(P_FSG_4_0_0_24, superval);
	///////// Start param1 - UINT8 /////////
	param1 = superval[currentPos++];
	putValue(P_FSG_4_0_0_24_1, param1);
	///////// Start param2 - UINT8 /////////
	param2 = superval[currentPos++];
	putValue(P_FSG_4_0_0_24_2, param2);
	///////// Start param3 - UINT8 /////////
	param3 = superval[currentPos++];
	putValue(P_FSG_4_0_0_24_3, round((param3 * 1.0) - (0) + (0), 1.0));
	///////// Start param4 - NIBBLE /////////
	param4 = (superval[currentPos] & 0xf0)>>4;
	putValue(P_FSG_4_0_0_24_4, param4);
	///////// Start param5 - NIBBLE /////////
	param5 = superval[currentPos++] & 0x0f;
	putValue(P_FSG_4_0_0_24_5, param5);
}

on envVar P_FSG_4_0_0_24_1 // Presets.Preset_Active
{
	byte superval[4];

	//Update Childvalue (Enum)
	byte thisval; // Preset_Active
	thisval = getValue(this);

    // Update superval
	getValue(P_FSG_4_0_0_24, superval);
	superval[0]=thisval;
	putValue(P_FSG_4_0_0_24,superval);
}

on envVar P_FSG_4_0_0_24_2 // Presets.Preset_Preselection
{
	byte superval[4];

	//Update Childvalue (Enum)
	byte thisval; // Preset_Preselection
	thisval = getValue(this);

    // Update superval
	getValue(P_FSG_4_0_0_24, superval);
	superval[1]=thisval;
	putValue(P_FSG_4_0_0_24,superval);
}

// Ueberwachung der Darstellungsvariable der Range.
on envVar P_FSG_4_0_0_24_3_range // Presets.Extension1 
{
	@P_FSG_4_0_0_24_3 = @P_FSG_4_0_0_24_3_range - (0); // slider = range - min
}

on envVar P_FSG_4_0_0_24_3 // Presets.Extension1
{
	byte superval[4];

	//Update Childvalue (Number)
	byte thisval; // Extension1
	float slider_value;

	slider_value = 0; // Konstanter Parameter.
	@P_FSG_4_0_0_24_3_range = slider_value + (0); // real value := slider value + range min.
	thisval = (byte)round((slider_value + (0) - (0)) / (1.0), 1); // bus value := (slider value + min - offset) / step.

    // Update superval
	getValue(P_FSG_4_0_0_24, superval);
	superval[2]=thisval;
	putValue(P_FSG_4_0_0_24,superval);
}

on envVar P_FSG_4_0_0_24_4 // Presets.ModificationReason
{
	byte superval[4];

	//Update Childvalue (Enum)
	byte thisval; // ModificationReason
	thisval = 0x0f & getValue(this);

    // Update superval
	getValue(P_FSG_4_0_0_24, superval);
	superval[3]= superval[3]&0x0f;
	superval[3]= superval[3]|(thisval<<4);
	putValue(P_FSG_4_0_0_24,superval);
}

on envVar P_FSG_4_0_0_24_5_0
{
	byte bitval;
	//thisval steht hier fuer den bitfield-wert, 
	//aus Generierungsgruenden hier keine einheitliche Bezeichnung moeglich.
	byte thisval; // ModificationState
	bitval= getValue(this);
	thisval = getValue(P_FSG_4_0_0_24_5);
	thisval = thisval&~(1<<0)|(bitval<<0);
	putValue(P_FSG_4_0_0_24_5,thisval);
}

on envVar P_FSG_4_0_0_24_5 // Presets.ModificationState
{
	byte superval[4];

	//Update Childvalue (BitField)
	byte mask=0x01;
	int i = 0;
	byte thisval; // ModificationState
	thisval = getValue(this);
	if(thisval&(mask<<0))
		putValue(P_FSG_4_0_0_24_5_0, 1);
	else
		putValue(P_FSG_4_0_0_24_5_0, 0);

    // Update superval
	getValue(P_FSG_4_0_0_24, superval);
	superval[3]= superval[3]&0xf0;
	superval[3]= superval[3]|thisval;
	putValue(P_FSG_4_0_0_24,superval);
}

// Ruecksetzen des Fehlerstatus durch manuelle Fehlereingabe
on envVar A_FSG_4_0_0_25_ErrCode
{
       if(gA_FSG_4_0_0_25_ErrCode) 
       {
           setControlBackColor(panel_name,"errfield_A_FSG_4_0_0_25", MakeRGB(255,255,255));
       }
       gA_FSG_4_0_0_25_ErrCode = 1;
}
on envVar A_FSG_4_0_0_25Changed_BTN
{
    byte data[85]; 
    byte stringValue[85];
    byte head[5];
    dword i;
    int headLength;
    long tempValue;
    dword currentPos;
    word startVal;
    word elementsVal;
  byte nibbleSetted;
    if (A_FSG_4_0_0_25Changed_BTN_already_pressed == 0)
    {
        putValue(A_FSG_4_0_0_25_ErrCode,0);
        SetControlBackColor(panel_name,"errField_A_FSG_4_0_0_25",MakeRGB(255,255,255));
        A_FSG_4_0_0_25Changed_BTN_already_pressed = 1;
    }
    else 
    {
        currentPos = 0;
        //head Parameter
        headLength = getValueSize(A_FSG_4_0_0_25_Changed);
        getValue(A_FSG_4_0_0_25_Changed,head);
        for(i=0; i< headLength; i++)
        {
            data[currentPos++] = head[i];
        }
    //data Parameter
     startVal = getValue(A_FSG_4_0_0_25_Changed_Start);
     elementsVal = getValue(A_FSG_4_0_0_25_Changed_Elements);
     nibbleSetted = 0;
    if( (head[0]&0x20) == 0)
    {
     if( (head[0] & 0x10) > 0)
     {
        startVal++;
     }
     for( i = startVal ; i < startVal + elementsVal ; i++)
     {
       if( i < 0 || i >= A_FSG_4_0_0_25_ArrayDataList_Length )
       {
         write("Array index ausserhalb der Grenzen, Fct: 25");
         break;
       }
      if(nibbleSetted == 1) currentPos++;
      nibbleSetted = 0;
    //sollte der letzte Parameter ein first nibble gewesen sein, muss noch 1 increment durchgefuehrt werden
    if( nibbleSetted==1) currentPos++;
    nibbleSetted = 0;
     }
    }
    else
    {
     if( (head[0] & 0x10) > 0)
     {
        if(startVal != 0) startVal--;
        else
        {
           startVal = A_FSG_4_0_0_25_ArrayDataList_Length -1;
        }
     }
     for( i = startVal ; i > startVal - elementsVal ; i--)
     {
       if( i < 0 || i >= A_FSG_4_0_0_25_ArrayDataList_Length )
       {
         write("Array index ausserhalb der Grenzen, Fct: 25");
         break;
       }
      if(nibbleSetted == 1) currentPos++;
      nibbleSetted = 0;
    //sollte der letzte Parameter ein first nibble gewesen sein, muss noch 1 increment durchgefuehrt werden
    if( nibbleSetted==1) currentPos++;
    nibbleSetted = 0;
     }
    }

       Request_ByteSequence(LSGID, A_FSG_4_0_0_25_ID, Changed_REQ, data, currentPos);
       if(getValue(A_FSG_4_0_0_25_IntTlgEn)) //getValue(IT))
       {
           intertelegram_err(A_FSG_4_0_0_25_ID);
       }
       if(getValue(A_FSG_4_0_0_25_SegmEn))   //getvalue(SG)
       {
             sequence_err(A_FSG_4_0_0_25_ID,getValueSize(A_FSG_4_0_0_25_Changed));
       }
        A_FSG_4_0_0_25Changed_BTN_already_pressed = 0;
    }
}
on envVar A_FSG_4_0_0_25Status_BTN
{
    byte data[85 + 5]; // array header (3 or 5 bytes), followed by payload.
    byte stringValue[85];
    byte head[5];
    dword i = 0;
    dword j = 0;
    dword StringLength = 0;
    int headLength;
    long tempValue;
    dword currentPos;
    word startVal;
    word elementsVal;
    byte nibbleSetted;
    if (A_FSG_4_0_0_25Status_BTN_already_pressed == 0)
    {
        putValue(A_FSG_4_0_0_25_ErrCode,0);
        SetControlBackColor(panel_name,"errField_A_FSG_4_0_0_25",MakeRGB(255,255,255));
        A_FSG_4_0_0_25Status_BTN_already_pressed = 1;
    }
    else
    {
        currentPos = 0;
        //Einzelparameter: ASG_ID
        tempValue = getValue(A_FSG_4_0_0_25_1);
    if(nibbleSetted == 1)
    {
        //voriger Parameter war ein Nibble, => second nibble, Pos incr und Flag zuruecksetzen
        data[currentPos] = (tempValue &0x0F) | (data[currentPos] &0xF0);
        currentPos++;
        nibbleSetted = 0;
    }
    else
    {
        //first nibble, kein increment, Flag setzen
        data[currentPos] = (tempValue<<4) &0xF0;
        nibbleSetted = 1;
    }
        //Einzelparameter: TAID
        tempValue = getValue(A_FSG_4_0_0_25_2);
    if(nibbleSetted == 1)
    {
        //voriger Parameter war ein Nibble, => second nibble, Pos incr und Flag zuruecksetzen
        data[currentPos] = (tempValue &0x0F) | (data[currentPos] &0xF0);
        currentPos++;
        nibbleSetted = 0;
    }
    else
    {
        //first nibble, kein increment, Flag setzen
        data[currentPos] = (tempValue<<4) &0xF0;
        nibbleSetted = 1;
    }
        //Einzelparameter: TotalNumListElements
        tempValue = getValue(A_FSG_4_0_0_25_3);
        //voriger Parameter war ein first nibble, bei 1 Byte Werten Position incr
        if(nibbleSetted == 1) currentPos++;
        nibbleSetted = 0;
        data[currentPos++] = tempValue;
        //head Parameter
        headLength = getValueSize(A_FSG_4_0_0_25);
        getValue(A_FSG_4_0_0_25,head);
        for(i=0; i< headLength; i++)
        {
            data[currentPos++] = head[i];
        }
    //data Parameter
     startVal = getValue(A_FSG_4_0_0_25_Start);
     elementsVal = getValue(A_FSG_4_0_0_25_Elements);
     nibbleSetted = 0;
    if( (head[0]&0x20) == 0)
    {
     if( (head[0] & 0x10) > 0)
     {
        startVal++;
     }
     for( i = startVal ; i < startVal + elementsVal ; i++)
     {
       if( i < 0 || i >= A_FSG_4_0_0_25_ArrayDataList_Length )
       {
         write("Array index ausserhalb der Grenzen, Fct: 25");
         break;
       }
      if(nibbleSetted == 1) currentPos++;
      nibbleSetted = 0;
     if( (head[0]&0x40) == 0){ /* Transmit_Pos = 0, keine Positionsdaten */ }
     else
     {
        if( (head[0]&0x80) == 0)
        {
           //IndexSize = 0, Pos als 1 Byte Wert
           data[currentPos++] = A_FSG_4_0_0_25_ArrayDataList[i].Param1 & 0xFF;
        }
        else
        {
           //IndexSize = 1, Pos als 2 Byte Wert
           data[currentPos++] = A_FSG_4_0_0_25_ArrayDataList[i].Param1 & 0xFF;
           data[currentPos++] = (A_FSG_4_0_0_25_ArrayDataList[i].Param1 >> 8) & 0xFF;
        }
     }
      // Check if the current value of RecAdr enables the variable DisplaySection:
      if( 0 || 1 == getValue( A_FSG_4_0_0_25_RecAdr ) || 2 == getValue( A_FSG_4_0_0_25_RecAdr ) || 3 == getValue( A_FSG_4_0_0_25_RecAdr ) )
      {
        //Sollte vor einem 1 Byte Wert 1 Nibble kommen, muss der index um 1 incrementiert werden!
        if( nibbleSetted==1) currentPos++;
        nibbleSetted = 0;
        data[currentPos++] = (A_FSG_4_0_0_25_ArrayDataList[i].Param2 ) & 0xFF;
       }
      // Check if the current value of RecAdr enables the variable DisplaySectionSetup1:
      if( 0 || 1 == getValue( A_FSG_4_0_0_25_RecAdr ) || 2 == getValue( A_FSG_4_0_0_25_RecAdr ) )
      {
        //Sollte vor einem 1 Byte Wert 1 Nibble kommen, muss der index um 1 incrementiert werden!
        if( nibbleSetted==1) currentPos++;
        nibbleSetted = 0;
        data[currentPos++] = (A_FSG_4_0_0_25_ArrayDataList[i].Param3 ) & 0xFF;
       }
      // Check if the current value of RecAdr enables the variable DisplaySectionSetup2:
      if( 0 || 1 == getValue( A_FSG_4_0_0_25_RecAdr ) || 2 == getValue( A_FSG_4_0_0_25_RecAdr ) )
      {
        //Sollte vor einem 1 Byte Wert 1 Nibble kommen, muss der index um 1 incrementiert werden!
        if( nibbleSetted==1) currentPos++;
        nibbleSetted = 0;
        data[currentPos++] = (A_FSG_4_0_0_25_ArrayDataList[i].Param4 ) & 0xFF;
       }
      // Check if the current value of RecAdr enables the variable DisplaySectionSetup3:
      if( 0 || 1 == getValue( A_FSG_4_0_0_25_RecAdr ) || 2 == getValue( A_FSG_4_0_0_25_RecAdr ) )
      {
        //Sollte vor einem 1 Byte Wert 1 Nibble kommen, muss der index um 1 incrementiert werden!
        if( nibbleSetted==1) currentPos++;
        nibbleSetted = 0;
        data[currentPos++] = (A_FSG_4_0_0_25_ArrayDataList[i].Param5 ) & 0xFF;
       }
      // Check if the current value of RecAdr enables the variable DisplaySectionSetup4:
      if( 0 || 1 == getValue( A_FSG_4_0_0_25_RecAdr ) || 2 == getValue( A_FSG_4_0_0_25_RecAdr ) )
      {
        //Sollte vor einem 1 Byte Wert 1 Nibble kommen, muss der index um 1 incrementiert werden!
        if( nibbleSetted==1) currentPos++;
        nibbleSetted = 0;
        data[currentPos++] = (A_FSG_4_0_0_25_ArrayDataList[i].Param6 ) & 0xFF;
       }
      // Check if the current value of RecAdr enables the variable DisplaySectionSelection1:
      if( 0 || 1 == getValue( A_FSG_4_0_0_25_RecAdr ) || 3 == getValue( A_FSG_4_0_0_25_RecAdr ) )
      {
        //Sollte vor einem 1 Byte Wert 1 Nibble kommen, muss der index um 1 incrementiert werden!
        if( nibbleSetted==1) currentPos++;
        nibbleSetted = 0;
        data[currentPos++] = (A_FSG_4_0_0_25_ArrayDataList[i].Param7 ) & 0xFF;
       }
      // Check if the current value of RecAdr enables the variable DisplaySectionSelection2:
      if( 0 || 1 == getValue( A_FSG_4_0_0_25_RecAdr ) || 3 == getValue( A_FSG_4_0_0_25_RecAdr ) )
      {
        //Sollte vor einem 1 Byte Wert 1 Nibble kommen, muss der index um 1 incrementiert werden!
        if( nibbleSetted==1) currentPos++;
        nibbleSetted = 0;
        data[currentPos++] = (A_FSG_4_0_0_25_ArrayDataList[i].Param8 ) & 0xFF;
       }
      // Check if the current value of RecAdr enables the variable DisplaySectionSelection3:
      if( 0 || 1 == getValue( A_FSG_4_0_0_25_RecAdr ) || 3 == getValue( A_FSG_4_0_0_25_RecAdr ) )
      {
        //Sollte vor einem 1 Byte Wert 1 Nibble kommen, muss der index um 1 incrementiert werden!
        if( nibbleSetted==1) currentPos++;
        nibbleSetted = 0;
        data[currentPos++] = (A_FSG_4_0_0_25_ArrayDataList[i].Param9 ) & 0xFF;
       }
      // Check if the current value of RecAdr enables the variable DisplaySectionSelection4:
      if( 0 || 1 == getValue( A_FSG_4_0_0_25_RecAdr ) || 3 == getValue( A_FSG_4_0_0_25_RecAdr ) )
      {
        //Sollte vor einem 1 Byte Wert 1 Nibble kommen, muss der index um 1 incrementiert werden!
        if( nibbleSetted==1) currentPos++;
        nibbleSetted = 0;
        data[currentPos++] = (A_FSG_4_0_0_25_ArrayDataList[i].Param10 ) & 0xFF;
       }
    //sollte der letzte Parameter ein first nibble gewesen sein, muss noch 1 increment durchgefuehrt werden
    if( nibbleSetted==1) currentPos++;
    nibbleSetted = 0;
     }
    }
    else
    {
     if( (head[0] & 0x10) > 0)
     {
        if(startVal != 0) startVal--;
        else
        {
           startVal = A_FSG_4_0_0_25_ArrayDataList_Length -1;
        }
     }
     for( i = startVal ; i > startVal - elementsVal ; i--)
     {
       if( i < 0 || i >= A_FSG_4_0_0_25_ArrayDataList_Length )
       {
         write("Array index ausserhalb der Grenzen, Fct: 25");
         break;
       }
      if(nibbleSetted == 1) currentPos++;
      nibbleSetted = 0;
     if( (head[0]&0x40) == 0){ /* Transmit_Pos = 0, keine Positionsdaten */ }
     else
     {
        if( (head[0]&0x80) == 0)
        {
           //IndexSize = 0, Pos als 1 Byte Wert
           data[currentPos++] = A_FSG_4_0_0_25_ArrayDataList[i].Param1 & 0xFF;
        }
        else
        {
           //IndexSize = 1, Pos als 2 Byte Wert
           data[currentPos++] = A_FSG_4_0_0_25_ArrayDataList[i].Param1 & 0xFF;
           data[currentPos++] = (A_FSG_4_0_0_25_ArrayDataList[i].Param1 >> 8) & 0xFF;
        }
     }
      // Check if the current value of RecAdr enables the variable DisplaySection:
      if( 0 || 1 == getValue( A_FSG_4_0_0_25_RecAdr ) || 2 == getValue( A_FSG_4_0_0_25_RecAdr ) || 3 == getValue( A_FSG_4_0_0_25_RecAdr ) )
      {
        //Sollte vor einem 1 Byte Wert 1 Nibble kommen, muss der index um 1 incrementiert werden!
        if( nibbleSetted==1) currentPos++;
        nibbleSetted = 0;
        data[currentPos++] = (A_FSG_4_0_0_25_ArrayDataList[i].Param2 ) & 0xFF;
       }
      // Check if the current value of RecAdr enables the variable DisplaySectionSetup1:
      if( 0 || 1 == getValue( A_FSG_4_0_0_25_RecAdr ) || 2 == getValue( A_FSG_4_0_0_25_RecAdr ) )
      {
        //Sollte vor einem 1 Byte Wert 1 Nibble kommen, muss der index um 1 incrementiert werden!
        if( nibbleSetted==1) currentPos++;
        nibbleSetted = 0;
        data[currentPos++] = (A_FSG_4_0_0_25_ArrayDataList[i].Param3 ) & 0xFF;
       }
      // Check if the current value of RecAdr enables the variable DisplaySectionSetup2:
      if( 0 || 1 == getValue( A_FSG_4_0_0_25_RecAdr ) || 2 == getValue( A_FSG_4_0_0_25_RecAdr ) )
      {
        //Sollte vor einem 1 Byte Wert 1 Nibble kommen, muss der index um 1 incrementiert werden!
        if( nibbleSetted==1) currentPos++;
        nibbleSetted = 0;
        data[currentPos++] = (A_FSG_4_0_0_25_ArrayDataList[i].Param4 ) & 0xFF;
       }
      // Check if the current value of RecAdr enables the variable DisplaySectionSetup3:
      if( 0 || 1 == getValue( A_FSG_4_0_0_25_RecAdr ) || 2 == getValue( A_FSG_4_0_0_25_RecAdr ) )
      {
        //Sollte vor einem 1 Byte Wert 1 Nibble kommen, muss der index um 1 incrementiert werden!
        if( nibbleSetted==1) currentPos++;
        nibbleSetted = 0;
        data[currentPos++] = (A_FSG_4_0_0_25_ArrayDataList[i].Param5 ) & 0xFF;
       }
      // Check if the current value of RecAdr enables the variable DisplaySectionSetup4:
      if( 0 || 1 == getValue( A_FSG_4_0_0_25_RecAdr ) || 2 == getValue( A_FSG_4_0_0_25_RecAdr ) )
      {
        //Sollte vor einem 1 Byte Wert 1 Nibble kommen, muss der index um 1 incrementiert werden!
        if( nibbleSetted==1) currentPos++;
        nibbleSetted = 0;
        data[currentPos++] = (A_FSG_4_0_0_25_ArrayDataList[i].Param6 ) & 0xFF;
       }
      // Check if the current value of RecAdr enables the variable DisplaySectionSelection1:
      if( 0 || 1 == getValue( A_FSG_4_0_0_25_RecAdr ) || 3 == getValue( A_FSG_4_0_0_25_RecAdr ) )
      {
        //Sollte vor einem 1 Byte Wert 1 Nibble kommen, muss der index um 1 incrementiert werden!
        if( nibbleSetted==1) currentPos++;
        nibbleSetted = 0;
        data[currentPos++] = (A_FSG_4_0_0_25_ArrayDataList[i].Param7 ) & 0xFF;
       }
      // Check if the current value of RecAdr enables the variable DisplaySectionSelection2:
      if( 0 || 1 == getValue( A_FSG_4_0_0_25_RecAdr ) || 3 == getValue( A_FSG_4_0_0_25_RecAdr ) )
      {
        //Sollte vor einem 1 Byte Wert 1 Nibble kommen, muss der index um 1 incrementiert werden!
        if( nibbleSetted==1) currentPos++;
        nibbleSetted = 0;
        data[currentPos++] = (A_FSG_4_0_0_25_ArrayDataList[i].Param8 ) & 0xFF;
       }
      // Check if the current value of RecAdr enables the variable DisplaySectionSelection3:
      if( 0 || 1 == getValue( A_FSG_4_0_0_25_RecAdr ) || 3 == getValue( A_FSG_4_0_0_25_RecAdr ) )
      {
        //Sollte vor einem 1 Byte Wert 1 Nibble kommen, muss der index um 1 incrementiert werden!
        if( nibbleSetted==1) currentPos++;
        nibbleSetted = 0;
        data[currentPos++] = (A_FSG_4_0_0_25_ArrayDataList[i].Param9 ) & 0xFF;
       }
      // Check if the current value of RecAdr enables the variable DisplaySectionSelection4:
      if( 0 || 1 == getValue( A_FSG_4_0_0_25_RecAdr ) || 3 == getValue( A_FSG_4_0_0_25_RecAdr ) )
      {
        //Sollte vor einem 1 Byte Wert 1 Nibble kommen, muss der index um 1 incrementiert werden!
        if( nibbleSetted==1) currentPos++;
        nibbleSetted = 0;
        data[currentPos++] = (A_FSG_4_0_0_25_ArrayDataList[i].Param10 ) & 0xFF;
       }
    //sollte der letzte Parameter ein first nibble gewesen sein, muss noch 1 increment durchgefuehrt werden
    if( nibbleSetted==1) currentPos++;
    nibbleSetted = 0;
     }
    }

        //getValue(A_FSG_4_0_0_25, data);
        Request_ByteSequence(LSGID, A_FSG_4_0_0_25_ID, Data_REQ, data,currentPos);
        if(getValue(A_FSG_4_0_0_25_IntTlgEn)) //getValue(IT))
        {
            intertelegram_err(A_FSG_4_0_0_25_ID);
        }
        if(getValue(A_FSG_4_0_0_25_SegmEn))   //getvalue(SG)
        {
            sequence_err(A_FSG_4_0_0_25_ID,getValueSize(A_FSG_4_0_0_25));
        }
        A_FSG_4_0_0_25Status_BTN_already_pressed = 0;
    }
}
A_FSG_4_0_0_25_SendStatus()
{
    dword currentPos;
    word headLength;
    dword i;
    dword j;
    dword StringLength;
    long tempValue;
    word startVal;
    word elementsVal;
    byte data[85];
    byte stringValue[85];
    byte head[5];
    byte nibbleSetted;
    nibbleSetted = 0;
        currentPos = 0;
        //Einzelparameter: ASG_ID
        tempValue = getValue(A_FSG_4_0_0_25_1);
    if(nibbleSetted == 1)
    {
        //voriger Parameter war ein Nibble, => second nibble, Pos incr und Flag zuruecksetzen
        data[currentPos] = (tempValue &0x0F) | (data[currentPos] &0xF0);
        currentPos++;
        nibbleSetted = 0;
    }
    else
    {
        //first nibble, kein increment, Flag setzen
        data[currentPos] = (tempValue<<4) &0xF0;
        nibbleSetted = 1;
    }
        //Einzelparameter: TAID
        tempValue = getValue(A_FSG_4_0_0_25_2);
    if(nibbleSetted == 1)
    {
        //voriger Parameter war ein Nibble, => second nibble, Pos incr und Flag zuruecksetzen
        data[currentPos] = (tempValue &0x0F) | (data[currentPos] &0xF0);
        currentPos++;
        nibbleSetted = 0;
    }
    else
    {
        //first nibble, kein increment, Flag setzen
        data[currentPos] = (tempValue<<4) &0xF0;
        nibbleSetted = 1;
    }
        //Einzelparameter: TotalNumListElements
        tempValue = getValue(A_FSG_4_0_0_25_3);
        //voriger Parameter war ein first nibble, bei 1 Byte Werten Position incr
        if(nibbleSetted == 1) currentPos++;
        nibbleSetted = 0;
        data[currentPos++] = tempValue;
        //head Parameter
        headLength = getValueSize(A_FSG_4_0_0_25);
        getValue(A_FSG_4_0_0_25,head);
        for(i=0; i< headLength; i++)
        {
            data[currentPos++] = head[i];
        }
    //data Parameter
     startVal = getValue(A_FSG_4_0_0_25_Start);
     elementsVal = getValue(A_FSG_4_0_0_25_Elements);
     nibbleSetted = 0;
    if( (head[0]&0x20) == 0)
    {
     if( (head[0] & 0x10) > 0)
     {
        startVal++;
     }
     for( i = startVal ; i < startVal + elementsVal ; i++)
     {
       if( i < 0 || i >= A_FSG_4_0_0_25_ArrayDataList_Length )
       {
         write("Array index ausserhalb der Grenzen, Fct: 25");
         break;
       }
      if(nibbleSetted == 1) currentPos++;
      nibbleSetted = 0;
     if( (head[0]&0x40) == 0){ /* Transmit_Pos = 0, keine Positionsdaten */ }
     else
     {
        if( (head[0]&0x80) == 0)
        {
           //IndexSize = 0, Pos als 1 Byte Wert
           data[currentPos++] = A_FSG_4_0_0_25_ArrayDataList[i].Param1 & 0xFF;
        }
        else
        {
           //IndexSize = 1, Pos als 2 Byte Wert
           data[currentPos++] = A_FSG_4_0_0_25_ArrayDataList[i].Param1 & 0xFF;
           data[currentPos++] = (A_FSG_4_0_0_25_ArrayDataList[i].Param1 >> 8) & 0xFF;
        }
     }
      // Check if the current value of RecAdr enables the variable DisplaySection:
      if( 0 || 1 == getValue( A_FSG_4_0_0_25_RecAdr ) || 2 == getValue( A_FSG_4_0_0_25_RecAdr ) || 3 == getValue( A_FSG_4_0_0_25_RecAdr ) )
      {
        //Sollte vor einem 1 Byte Wert 1 Nibble kommen, muss der index um 1 incrementiert werden!
        if( nibbleSetted==1) currentPos++;
        nibbleSetted = 0;
        data[currentPos++] = (A_FSG_4_0_0_25_ArrayDataList[i].Param2 ) & 0xFF;
       }
      // Check if the current value of RecAdr enables the variable DisplaySectionSetup1:
      if( 0 || 1 == getValue( A_FSG_4_0_0_25_RecAdr ) || 2 == getValue( A_FSG_4_0_0_25_RecAdr ) )
      {
        //Sollte vor einem 1 Byte Wert 1 Nibble kommen, muss der index um 1 incrementiert werden!
        if( nibbleSetted==1) currentPos++;
        nibbleSetted = 0;
        data[currentPos++] = (A_FSG_4_0_0_25_ArrayDataList[i].Param3 ) & 0xFF;
       }
      // Check if the current value of RecAdr enables the variable DisplaySectionSetup2:
      if( 0 || 1 == getValue( A_FSG_4_0_0_25_RecAdr ) || 2 == getValue( A_FSG_4_0_0_25_RecAdr ) )
      {
        //Sollte vor einem 1 Byte Wert 1 Nibble kommen, muss der index um 1 incrementiert werden!
        if( nibbleSetted==1) currentPos++;
        nibbleSetted = 0;
        data[currentPos++] = (A_FSG_4_0_0_25_ArrayDataList[i].Param4 ) & 0xFF;
       }
      // Check if the current value of RecAdr enables the variable DisplaySectionSetup3:
      if( 0 || 1 == getValue( A_FSG_4_0_0_25_RecAdr ) || 2 == getValue( A_FSG_4_0_0_25_RecAdr ) )
      {
        //Sollte vor einem 1 Byte Wert 1 Nibble kommen, muss der index um 1 incrementiert werden!
        if( nibbleSetted==1) currentPos++;
        nibbleSetted = 0;
        data[currentPos++] = (A_FSG_4_0_0_25_ArrayDataList[i].Param5 ) & 0xFF;
       }
      // Check if the current value of RecAdr enables the variable DisplaySectionSetup4:
      if( 0 || 1 == getValue( A_FSG_4_0_0_25_RecAdr ) || 2 == getValue( A_FSG_4_0_0_25_RecAdr ) )
      {
        //Sollte vor einem 1 Byte Wert 1 Nibble kommen, muss der index um 1 incrementiert werden!
        if( nibbleSetted==1) currentPos++;
        nibbleSetted = 0;
        data[currentPos++] = (A_FSG_4_0_0_25_ArrayDataList[i].Param6 ) & 0xFF;
       }
      // Check if the current value of RecAdr enables the variable DisplaySectionSelection1:
      if( 0 || 1 == getValue( A_FSG_4_0_0_25_RecAdr ) || 3 == getValue( A_FSG_4_0_0_25_RecAdr ) )
      {
        //Sollte vor einem 1 Byte Wert 1 Nibble kommen, muss der index um 1 incrementiert werden!
        if( nibbleSetted==1) currentPos++;
        nibbleSetted = 0;
        data[currentPos++] = (A_FSG_4_0_0_25_ArrayDataList[i].Param7 ) & 0xFF;
       }
      // Check if the current value of RecAdr enables the variable DisplaySectionSelection2:
      if( 0 || 1 == getValue( A_FSG_4_0_0_25_RecAdr ) || 3 == getValue( A_FSG_4_0_0_25_RecAdr ) )
      {
        //Sollte vor einem 1 Byte Wert 1 Nibble kommen, muss der index um 1 incrementiert werden!
        if( nibbleSetted==1) currentPos++;
        nibbleSetted = 0;
        data[currentPos++] = (A_FSG_4_0_0_25_ArrayDataList[i].Param8 ) & 0xFF;
       }
      // Check if the current value of RecAdr enables the variable DisplaySectionSelection3:
      if( 0 || 1 == getValue( A_FSG_4_0_0_25_RecAdr ) || 3 == getValue( A_FSG_4_0_0_25_RecAdr ) )
      {
        //Sollte vor einem 1 Byte Wert 1 Nibble kommen, muss der index um 1 incrementiert werden!
        if( nibbleSetted==1) currentPos++;
        nibbleSetted = 0;
        data[currentPos++] = (A_FSG_4_0_0_25_ArrayDataList[i].Param9 ) & 0xFF;
       }
      // Check if the current value of RecAdr enables the variable DisplaySectionSelection4:
      if( 0 || 1 == getValue( A_FSG_4_0_0_25_RecAdr ) || 3 == getValue( A_FSG_4_0_0_25_RecAdr ) )
      {
        //Sollte vor einem 1 Byte Wert 1 Nibble kommen, muss der index um 1 incrementiert werden!
        if( nibbleSetted==1) currentPos++;
        nibbleSetted = 0;
        data[currentPos++] = (A_FSG_4_0_0_25_ArrayDataList[i].Param10 ) & 0xFF;
       }
    //sollte der letzte Parameter ein first nibble gewesen sein, muss noch 1 increment durchgefuehrt werden
    if( nibbleSetted==1) currentPos++;
    nibbleSetted = 0;
     }
    }
    else
    {
     if( (head[0] & 0x10) > 0)
     {
        if(startVal != 0) startVal--;
        else
        {
           startVal = A_FSG_4_0_0_25_ArrayDataList_Length -1;
        }
     }
     for( i = startVal ; i > startVal - elementsVal ; i--)
     {
       if( i < 0 || i >= A_FSG_4_0_0_25_ArrayDataList_Length )
       {
         write("Array index ausserhalb der Grenzen, Fct: 25");
         break;
       }
      if(nibbleSetted == 1) currentPos++;
      nibbleSetted = 0;
     if( (head[0]&0x40) == 0){ /* Transmit_Pos = 0, keine Positionsdaten */ }
     else
     {
        if( (head[0]&0x80) == 0)
        {
           //IndexSize = 0, Pos als 1 Byte Wert
           data[currentPos++] = A_FSG_4_0_0_25_ArrayDataList[i].Param1 & 0xFF;
        }
        else
        {
           //IndexSize = 1, Pos als 2 Byte Wert
           data[currentPos++] = A_FSG_4_0_0_25_ArrayDataList[i].Param1 & 0xFF;
           data[currentPos++] = (A_FSG_4_0_0_25_ArrayDataList[i].Param1 >> 8) & 0xFF;
        }
     }
      // Check if the current value of RecAdr enables the variable DisplaySection:
      if( 0 || 1 == getValue( A_FSG_4_0_0_25_RecAdr ) || 2 == getValue( A_FSG_4_0_0_25_RecAdr ) || 3 == getValue( A_FSG_4_0_0_25_RecAdr ) )
      {
        //Sollte vor einem 1 Byte Wert 1 Nibble kommen, muss der index um 1 incrementiert werden!
        if( nibbleSetted==1) currentPos++;
        nibbleSetted = 0;
        data[currentPos++] = (A_FSG_4_0_0_25_ArrayDataList[i].Param2 ) & 0xFF;
       }
      // Check if the current value of RecAdr enables the variable DisplaySectionSetup1:
      if( 0 || 1 == getValue( A_FSG_4_0_0_25_RecAdr ) || 2 == getValue( A_FSG_4_0_0_25_RecAdr ) )
      {
        //Sollte vor einem 1 Byte Wert 1 Nibble kommen, muss der index um 1 incrementiert werden!
        if( nibbleSetted==1) currentPos++;
        nibbleSetted = 0;
        data[currentPos++] = (A_FSG_4_0_0_25_ArrayDataList[i].Param3 ) & 0xFF;
       }
      // Check if the current value of RecAdr enables the variable DisplaySectionSetup2:
      if( 0 || 1 == getValue( A_FSG_4_0_0_25_RecAdr ) || 2 == getValue( A_FSG_4_0_0_25_RecAdr ) )
      {
        //Sollte vor einem 1 Byte Wert 1 Nibble kommen, muss der index um 1 incrementiert werden!
        if( nibbleSetted==1) currentPos++;
        nibbleSetted = 0;
        data[currentPos++] = (A_FSG_4_0_0_25_ArrayDataList[i].Param4 ) & 0xFF;
       }
      // Check if the current value of RecAdr enables the variable DisplaySectionSetup3:
      if( 0 || 1 == getValue( A_FSG_4_0_0_25_RecAdr ) || 2 == getValue( A_FSG_4_0_0_25_RecAdr ) )
      {
        //Sollte vor einem 1 Byte Wert 1 Nibble kommen, muss der index um 1 incrementiert werden!
        if( nibbleSetted==1) currentPos++;
        nibbleSetted = 0;
        data[currentPos++] = (A_FSG_4_0_0_25_ArrayDataList[i].Param5 ) & 0xFF;
       }
      // Check if the current value of RecAdr enables the variable DisplaySectionSetup4:
      if( 0 || 1 == getValue( A_FSG_4_0_0_25_RecAdr ) || 2 == getValue( A_FSG_4_0_0_25_RecAdr ) )
      {
        //Sollte vor einem 1 Byte Wert 1 Nibble kommen, muss der index um 1 incrementiert werden!
        if( nibbleSetted==1) currentPos++;
        nibbleSetted = 0;
        data[currentPos++] = (A_FSG_4_0_0_25_ArrayDataList[i].Param6 ) & 0xFF;
       }
      // Check if the current value of RecAdr enables the variable DisplaySectionSelection1:
      if( 0 || 1 == getValue( A_FSG_4_0_0_25_RecAdr ) || 3 == getValue( A_FSG_4_0_0_25_RecAdr ) )
      {
        //Sollte vor einem 1 Byte Wert 1 Nibble kommen, muss der index um 1 incrementiert werden!
        if( nibbleSetted==1) currentPos++;
        nibbleSetted = 0;
        data[currentPos++] = (A_FSG_4_0_0_25_ArrayDataList[i].Param7 ) & 0xFF;
       }
      // Check if the current value of RecAdr enables the variable DisplaySectionSelection2:
      if( 0 || 1 == getValue( A_FSG_4_0_0_25_RecAdr ) || 3 == getValue( A_FSG_4_0_0_25_RecAdr ) )
      {
        //Sollte vor einem 1 Byte Wert 1 Nibble kommen, muss der index um 1 incrementiert werden!
        if( nibbleSetted==1) currentPos++;
        nibbleSetted = 0;
        data[currentPos++] = (A_FSG_4_0_0_25_ArrayDataList[i].Param8 ) & 0xFF;
       }
      // Check if the current value of RecAdr enables the variable DisplaySectionSelection3:
      if( 0 || 1 == getValue( A_FSG_4_0_0_25_RecAdr ) || 3 == getValue( A_FSG_4_0_0_25_RecAdr ) )
      {
        //Sollte vor einem 1 Byte Wert 1 Nibble kommen, muss der index um 1 incrementiert werden!
        if( nibbleSetted==1) currentPos++;
        nibbleSetted = 0;
        data[currentPos++] = (A_FSG_4_0_0_25_ArrayDataList[i].Param9 ) & 0xFF;
       }
      // Check if the current value of RecAdr enables the variable DisplaySectionSelection4:
      if( 0 || 1 == getValue( A_FSG_4_0_0_25_RecAdr ) || 3 == getValue( A_FSG_4_0_0_25_RecAdr ) )
      {
        //Sollte vor einem 1 Byte Wert 1 Nibble kommen, muss der index um 1 incrementiert werden!
        if( nibbleSetted==1) currentPos++;
        nibbleSetted = 0;
        data[currentPos++] = (A_FSG_4_0_0_25_ArrayDataList[i].Param10 ) & 0xFF;
       }
    //sollte der letzte Parameter ein first nibble gewesen sein, muss noch 1 increment durchgefuehrt werden
    if( nibbleSetted==1) currentPos++;
    nibbleSetted = 0;
     }
    }
    Request_byteSequence(LSGID, A_FSG_4_0_0_25_ID, Data_REQ, data, currentPos);
}
on envVar A_FSG_4_0_0_25
{
    byte temp[85];
    getValue(A_FSG_4_0_0_25, temp);
    putValue(A_FSG_4_0_0_25_RecAdr, 0x0F & temp[0]); //Record Address = Bit 0-3 von Byte 0
    if ( (0x10 & temp[0]) >0)
        putValue(A_FSG_4_0_0_25_Shift, 1); //Shift = Bit 4 von Byte 0
    else
        putValue(A_FSG_4_0_0_25_Shift, 0); //Shift = Bit 4 von Byte 0
    if ( (0x20 & temp[0]) >0)
        putValue(A_FSG_4_0_0_25_Direction, 1); //Direction = Bit 5 von Byte 0
    else
        putValue(A_FSG_4_0_0_25_Direction, 0); //Direction = Bit 5 von Byte 0
    if ( (0x40 & temp[0]) >0)
        putValue(A_FSG_4_0_0_25_TransPos, 1); //Transmission Pos = Bit 6 von Byte 0
    else
        putValue(A_FSG_4_0_0_25_TransPos, 0); //Transmission Pos = Bit 6 von Byte 0
    if ( (0x80 & temp[0]) >0)
        putValue(A_FSG_4_0_0_25_IndexSize, 1); //IndexSize = Bit 7 von Byte 0
    else
        putValue(A_FSG_4_0_0_25_IndexSize, 0); //IndexSize = Bit 7 von Byte 0
    if(getValue(A_FSG_4_0_0_25_IndexSize))
    {
        putValue(A_FSG_4_0_0_25_Start, ((temp[2]<<8)| temp[1]) ); // Array Start index, 2 Byte.
        putValue(A_FSG_4_0_0_25_Elements, ((temp[4]<<8)| temp[3]) ); // Array element count, 2 Byte.
    }
    else
    {
        putValue(A_FSG_4_0_0_25_Start, temp[1]); // Array Start index, 1 Byte.
        putValue(A_FSG_4_0_0_25_Elements, temp[2]); // Array element count, 1 Byte.
    }
}
A_FSG_4_0_0_25_GenerateStatus()
{
    byte head[5];
    int i = 0;
    int headLength;
    long tempValue;
    int currentPos;
    //Record Address in Byte 0 Bit 0-3 kopieren - MAX Wert = 0x0F
    if(getValue(A_FSG_4_0_0_25_RecAdr) > 0x0F)
        putValue(A_FSG_4_0_0_25_RecAdr , 0x0F);
    head[0] = (head[0] & 0xF0) | getValue(A_FSG_4_0_0_25_RecAdr);
    //Shift Bit in Byte 0 Bit 4 kopieren
    if( getValue(A_FSG_4_0_0_25_Shift) > 0) head[0] = head[0] | 0x10;
    else head[0] = head[0] & 0xEF;
    // Direction Bit in Byte 0 Bit 5 kopieren
    if( getValue(A_FSG_4_0_0_25_Direction) > 0) head[0] = head[0] | 0x20;
    else head[0] = head[0] & 0xDF;
    // TransmissionPos Bit in Byte 0 Bit 6 kopieren
    if( getValue(A_FSG_4_0_0_25_TransPos) > 0) head[0] = head[0] | 0x40;
    else head[0] = head[0] & 0xBF;
    if( getValue(A_FSG_4_0_0_25_IndexSize) > 0)
    {
        // 5 Byte Header
        head[0] = head[0] | 0x80;
        head[1] =  getValue(A_FSG_4_0_0_25_Start) & 0xFF;
        head[2] = (getValue(A_FSG_4_0_0_25_Start) >> 8 ) & 0xFF;
        head[3] =  getValue(A_FSG_4_0_0_25_Elements) & 0xFF;
        head[4] = (getValue(A_FSG_4_0_0_25_Elements)  >> 8 ) & 0xFF;
        //ToDo: DATA - derzeit einfach laenge = 5
        headLength = 5;
    }
    else 
    {
        // 3 Byte Header
        head[0] = head[0] & 0x7F;
        head[1] = getValue(A_FSG_4_0_0_25_Start) & 0xFF;
        head[2] = getValue(A_FSG_4_0_0_25_Elements) & 0xFF;
        //ToDo: DATA - derzeit einfach laenge = 3
        headLength = 3;
    }

    currentPos = 0;

    putValue(A_FSG_4_0_0_25, head, headLength); 
}

on envVar A_FSG_4_0_0_25_RecAdr
{
    A_FSG_4_0_0_25_GenerateStatus();
}

on envVar A_FSG_4_0_0_25_Shift
{
    A_FSG_4_0_0_25_GenerateStatus();
}

on envVar A_FSG_4_0_0_25_Direction
{
    A_FSG_4_0_0_25_GenerateStatus();
}

on envVar A_FSG_4_0_0_25_Start
{
    A_FSG_4_0_0_25_GenerateStatus();
}

on envVar A_FSG_4_0_0_25_Elements
{
    A_FSG_4_0_0_25_GenerateStatus();
}

on envVar A_FSG_4_0_0_25_IndexSize
{
    A_FSG_4_0_0_25_GenerateStatus();
}
on envVar A_FSG_4_0_0_25_TransPos
{
    A_FSG_4_0_0_25_GenerateStatus();
}
A_FSG_4_0_0_25_Changed_GenerateChanged()
{
    byte head[5];
    //Record Address in Byte 0 Bit 0-3 kopieren - MAX Wert = 0x0F
    if(getValue(A_FSG_4_0_0_25_Changed_RecAdr) > 0x0F)
        putValue(A_FSG_4_0_0_25_Changed_RecAdr , 0x0F);
    head[0] = (head[0] & 0xF0) | getValue(A_FSG_4_0_0_25_Changed_RecAdr);
    //Shift Bit in Byte 0 Bit 4 kopieren
    if( getValue(A_FSG_4_0_0_25_Changed_Shift) > 0) head[0] = head[0] | 0x10;
    else head[0] = head[0] & 0xEF;
    // Direction Bit in Byte 0 Bit 5 kopieren
    if( getValue(A_FSG_4_0_0_25_Changed_Direction) > 0) head[0] = head[0] | 0x20;
    else head[0] = head[0] & 0xDF;
    // TransmissionPos Bit in Byte 0 Bit 6 kopieren
    if( getValue(A_FSG_4_0_0_25_Changed_TransPos) > 0) head[0] = head[0] | 0x40;
    else head[0] = head[0] & 0xBF;
    if( getValue(A_FSG_4_0_0_25_Changed_IndexSize) > 0)
    {
        // 5 Byte Header
        head[0] = head[0] | 0x80;
        head[1] =  getValue(A_FSG_4_0_0_25_Changed_Start) & 0xFF;
        head[2] = (getValue(A_FSG_4_0_0_25_Changed_Start) >> 8 ) & 0xFF;
        head[3] =  getValue(A_FSG_4_0_0_25_Changed_Elements) & 0xFF;
        head[4] = (getValue(A_FSG_4_0_0_25_Changed_Elements)  >> 8 ) & 0xFF;
        //ToDo: DATA - derzeit einfach laenge = 5
        putValue(A_FSG_4_0_0_25_Changed, head, 5); 
    }
    else 
    {
        // 3 Byte Header
        head[0] = head[0] & 0x7F;
        head[1] = getValue(A_FSG_4_0_0_25_Changed_Start) & 0xFF;
        head[2] = getValue(A_FSG_4_0_0_25_Changed_Elements) & 0xFF;
        //ToDo: DATA - derzeit einfach laenge = 3
        putValue(A_FSG_4_0_0_25_Changed, head, 3); 
    }
}

on envVar A_FSG_4_0_0_25_Changed_RecAdr
{
    A_FSG_4_0_0_25_Changed_GenerateChanged();
}

on envVar A_FSG_4_0_0_25_Changed_Shift
{
    A_FSG_4_0_0_25_Changed_GenerateChanged();
}

on envVar A_FSG_4_0_0_25_Changed_Direction
{
    A_FSG_4_0_0_25_Changed_GenerateChanged();
}

on envVar A_FSG_4_0_0_25_Changed_Start
{
    A_FSG_4_0_0_25_Changed_GenerateChanged();
}

on envVar A_FSG_4_0_0_25_Changed_Elements
{
    A_FSG_4_0_0_25_Changed_GenerateChanged();
}

on envVar A_FSG_4_0_0_25_Changed_IndexSize
{
    A_FSG_4_0_0_25_Changed_GenerateChanged();
}
on envVar A_FSG_4_0_0_25_Changed_TransPos
{
    A_FSG_4_0_0_25_Changed_GenerateChanged();
}
on envVar A_FSG_4_0_0_25_SetGet
{
    byte temp[85];
    getValue(A_FSG_4_0_0_25_SetGet, temp);
    putValue(A_FSG_4_0_0_25_SetGet_RecAdr, 0x0F & temp[0]); //Record Address = Bit 0-3 von Byte 0
    if ( (0x10 & temp[0]) >0)
        putValue(A_FSG_4_0_0_25_SetGet_Shift, 1); //Shift = Bit 4 von Byte 0
    else
        putValue(A_FSG_4_0_0_25_SetGet_Shift, 0); //Shift = Bit 4 von Byte 0
    if ( (0x20 & temp[0]) >0)
        putValue(A_FSG_4_0_0_25_SetGet_Direction, 1); //Direction = Bit 5 von Byte 0
    else
        putValue(A_FSG_4_0_0_25_SetGet_Direction, 0); //Direction = Bit 5 von Byte 0
    // Bit 6 von Byte 0 = reserved
    if ( (0x80 & temp[0]) >0)
        putValue(A_FSG_4_0_0_25_SetGet_IndexSize, 1); //IndexSize = Bit 7 von Byte 0
    else
        putValue(A_FSG_4_0_0_25_SetGet_IndexSize, 0); //IndexSize = Bit 7 von Byte 0
    if(getValue(A_FSG_4_0_0_25_SetGet_IndexSize))
    {
        putValue(A_FSG_4_0_0_25_SetGet_Start, ((temp[2]<<8)| temp[1]) ); //Start Wert, 2 Byte lang
        putValue(A_FSG_4_0_0_25_SetGet_Elements, ((temp[4]<<8)| temp[3]) ); //Elements Wert, 2 Byte lang
    }
    else
    {
        putValue(A_FSG_4_0_0_25_SetGet_Start, temp[1]); //Start Wert, 1 Byte lang
        putValue(A_FSG_4_0_0_25_SetGet_Elements, temp[2]); //Start Wert, 1 Byte lang
    }
}
A_FSG_4_0_0_25_LoadArray()
{
	/********* Statische Deklarationen ***********/
	dword CSVfileHandle;
	dword filePos;
	dword paramPos;
	dword Num_of_csv_byte;
	dword element;
	dword current_CSV_line;
	byte buffer_byte[0xFFFF];
	dword i;
	dword j;
	char CSV_filename[255];

	/********* Param Puffer Deklarationen ***********/
	char temp1[25];
	char temp2[25];
	char temp3[25];
	char temp4[25];
	char temp5[25];
	char temp6[25];
	char temp7[25];
	char temp8[25];
	char temp9[25];
	char temp10[25];

	/********* Initialisierungen ***********/
	CSVfileHandle = 0;
	filePos = 0;
	paramPos = 0;
	Num_of_csv_byte = 0;
	element = 1;
	current_CSV_line = 0;
	for(i = 0; i < A_FSG_4_0_0_25_ArrayDataList_Length; i++)
	{ /* Initialisierung von den Ziel-Strukturen */
		A_FSG_4_0_0_25_ArrayDataList[i].Param1 = 0;
		A_FSG_4_0_0_25_ArrayDataList[i].Param2 = 0;
		A_FSG_4_0_0_25_ArrayDataList[i].Param3 = 0;
		A_FSG_4_0_0_25_ArrayDataList[i].Param4 = 0;
		A_FSG_4_0_0_25_ArrayDataList[i].Param5 = 0;
		A_FSG_4_0_0_25_ArrayDataList[i].Param6 = 0;
		A_FSG_4_0_0_25_ArrayDataList[i].Param7 = 0;
		A_FSG_4_0_0_25_ArrayDataList[i].Param8 = 0;
		A_FSG_4_0_0_25_ArrayDataList[i].Param9 = 0;
		A_FSG_4_0_0_25_ArrayDataList[i].Param10 = 0;
	}

	/********* Laden der CSV-Datei ***********/
	getValue(A_FSG_4_0_0_25_fileSelector, CSV_filename);
	CSVfileHandle = openFileRead(CSV_filename, 1); //open *.csv (binary-mode ->get the ASCII/UTF-8 code)

	if (CSVfileHandle!=0) //*.csv file access successful
	{
		writelineEx(gBAP_Trace, 0,"Dateizugriff auf '%s' erfolgreich", CSV_filename);    //output result
		//get data from *.csv and store the total number of byte in *.csv-file
		Num_of_csv_byte = fileGetBinaryBlock (buffer_byte, elcount(buffer_byte), CSVfileHandle);

		for (filePos = 0; filePos < Num_of_csv_byte; filePos++) //copy data into "LastDestList"
		{
			if (buffer_byte[filePos] != 0x3B) //read data if no ";" is detected
			{
				//nextline in *.csv (next "record element" in LastDestList) -> "LF" and "CR" detected -> copy (transform string -> long) data from help values in global values
				if(buffer_byte[filePos] == 0x0D && buffer_byte[filePos+1] == 0x0A)
				{
					if(current_CSV_line > 0 && current_CSV_line < 9) //ignore first line in *.csv file
					{
						A_FSG_4_0_0_25_ArrayDataList[current_CSV_line-1].Param1 = atol(temp1); //Pos
						A_FSG_4_0_0_25_ArrayDataList[current_CSV_line-1].Param2 = atol(temp2); //DisplaySection
						A_FSG_4_0_0_25_ArrayDataList[current_CSV_line-1].Param3 = atol(temp3); //DisplaySectionSetup1
						A_FSG_4_0_0_25_ArrayDataList[current_CSV_line-1].Param4 = atol(temp4); //DisplaySectionSetup2
						A_FSG_4_0_0_25_ArrayDataList[current_CSV_line-1].Param5 = atol(temp5); //DisplaySectionSetup3
						A_FSG_4_0_0_25_ArrayDataList[current_CSV_line-1].Param6 = atol(temp6); //DisplaySectionSetup4
						A_FSG_4_0_0_25_ArrayDataList[current_CSV_line-1].Param7 = atol(temp7); //DisplaySectionSelection1
						A_FSG_4_0_0_25_ArrayDataList[current_CSV_line-1].Param8 = atol(temp8); //DisplaySectionSelection2
						A_FSG_4_0_0_25_ArrayDataList[current_CSV_line-1].Param9 = atol(temp9); //DisplaySectionSelection3
						A_FSG_4_0_0_25_ArrayDataList[current_CSV_line-1].Param10 = atol(temp10); //DisplaySectionSelection4
						for(i = 0; i < 25; i++)
						{ /* Temp-Puffer Initialisierung zur Vermeidung von Nebeneffekte */
							temp1[i]=0;
							temp2[i]=0;
							temp3[i]=0;
							temp4[i]=0;
							temp5[i]=0;
							temp6[i]=0;
							temp7[i]=0;
							temp8[i]=0;
							temp9[i]=0;
							temp10[i]=0;
						}
					}
					current_CSV_line++; //next line in *.csv file
					element = 1; //start at 'POS' (first record element of "array data")
					paramPos = 0; //reset value
				}
 				//copy data from "buffer_byte" (data from *.csv file) in help values and "name" until end of line is not detected
				else if(current_CSV_line > 0 && current_CSV_line < 9)
				{
					//writelineEx(gBAP_Trace, 0, "Element %x  Index %x", element, j);
					switch (element)
					{
						case 1: //Pos
								if( paramPos >= elCount(temp1) ){
									writelineEx(gBAP_Trace, 0, "Param%x in Zeile %d in der Input CSV Datei, enthaelt mehr Zeichen als erlaubt. Bearbeitung abgebrochen!", element, current_CSV_line);
									return; //False
								}else{
									temp1[paramPos] = buffer_byte[filePos];
									paramPos++;
								}
							break;
						case 2: //DisplaySection
								if( paramPos >= elCount(temp2) ){
									writelineEx(gBAP_Trace, 0, "Param%x in Zeile %d in der Input CSV Datei, enthaelt mehr Zeichen als erlaubt. Bearbeitung abgebrochen!", element, current_CSV_line);
									return; //False
								}else{
									temp2[paramPos] = buffer_byte[filePos];
									paramPos++;
								}
							break;
						case 3: //DisplaySectionSetup1
								if( paramPos >= elCount(temp3) ){
									writelineEx(gBAP_Trace, 0, "Param%x in Zeile %d in der Input CSV Datei, enthaelt mehr Zeichen als erlaubt. Bearbeitung abgebrochen!", element, current_CSV_line);
									return; //False
								}else{
									temp3[paramPos] = buffer_byte[filePos];
									paramPos++;
								}
							break;
						case 4: //DisplaySectionSetup2
								if( paramPos >= elCount(temp4) ){
									writelineEx(gBAP_Trace, 0, "Param%x in Zeile %d in der Input CSV Datei, enthaelt mehr Zeichen als erlaubt. Bearbeitung abgebrochen!", element, current_CSV_line);
									return; //False
								}else{
									temp4[paramPos] = buffer_byte[filePos];
									paramPos++;
								}
							break;
						case 5: //DisplaySectionSetup3
								if( paramPos >= elCount(temp5) ){
									writelineEx(gBAP_Trace, 0, "Param%x in Zeile %d in der Input CSV Datei, enthaelt mehr Zeichen als erlaubt. Bearbeitung abgebrochen!", element, current_CSV_line);
									return; //False
								}else{
									temp5[paramPos] = buffer_byte[filePos];
									paramPos++;
								}
							break;
						case 6: //DisplaySectionSetup4
								if( paramPos >= elCount(temp6) ){
									writelineEx(gBAP_Trace, 0, "Param%x in Zeile %d in der Input CSV Datei, enthaelt mehr Zeichen als erlaubt. Bearbeitung abgebrochen!", element, current_CSV_line);
									return; //False
								}else{
									temp6[paramPos] = buffer_byte[filePos];
									paramPos++;
								}
							break;
						case 7: //DisplaySectionSelection1
								if( paramPos >= elCount(temp7) ){
									writelineEx(gBAP_Trace, 0, "Param%x in Zeile %d in der Input CSV Datei, enthaelt mehr Zeichen als erlaubt. Bearbeitung abgebrochen!", element, current_CSV_line);
									return; //False
								}else{
									temp7[paramPos] = buffer_byte[filePos];
									paramPos++;
								}
							break;
						case 8: //DisplaySectionSelection2
								if( paramPos >= elCount(temp8) ){
									writelineEx(gBAP_Trace, 0, "Param%x in Zeile %d in der Input CSV Datei, enthaelt mehr Zeichen als erlaubt. Bearbeitung abgebrochen!", element, current_CSV_line);
									return; //False
								}else{
									temp8[paramPos] = buffer_byte[filePos];
									paramPos++;
								}
							break;
						case 9: //DisplaySectionSelection3
								if( paramPos >= elCount(temp9) ){
									writelineEx(gBAP_Trace, 0, "Param%x in Zeile %d in der Input CSV Datei, enthaelt mehr Zeichen als erlaubt. Bearbeitung abgebrochen!", element, current_CSV_line);
									return; //False
								}else{
									temp9[paramPos] = buffer_byte[filePos];
									paramPos++;
								}
							break;
						case 10: //DisplaySectionSelection4
								if( paramPos >= elCount(temp10) ){
									writelineEx(gBAP_Trace, 0, "Param%x in Zeile %d in der Input CSV Datei, enthaelt mehr Zeichen als erlaubt. Bearbeitung abgebrochen!", element, current_CSV_line);
									return; //False
								}else{
									temp10[paramPos] = buffer_byte[filePos];
									paramPos++;
								}
							break;
						default:
						break;
					}
				}
			}
			else  // ";" is detected ->next record element of "array data"
			{
				//writelineEx(gBAP_Trace, 0, "naechstes Element %d Bytes",element);
				element++;
				paramPos=0; //reset value
			}
		}

		if(fileClose (CSVfileHandle) !=0) //close *.csv file
			writelineEx(gBAP_Trace, 0,"Datei '%s' geschlossen", CSV_filename); //output result
		else
			writelineEx(gBAP_Trace, 0,"Fehler beim Schliessen der Datei '%s'", CSV_filename);//output result
	}
	else //*.csv file access not successful
	{
		writelineEx(gBAP_Trace, 0,"Fehler beim Dateizugriff auf '%s'",CSV_filename); //output result
	}
}

on envVar A_FSG_4_0_0_25_loadArray_Btn
{
	char filePath[255];
	if (A_FSG_4_0_0_25_generateData_Btn_already_pressed == 0)
	{
		A_FSG_4_0_0_25_generateData_Btn_already_pressed = 1;
	}
	else
	{
		A_FSG_4_0_0_25_generateData_Btn_already_pressed = 0;
		getValue(A_FSG_4_0_0_25_fileSelector, filePath);
		if(0 == strlen(filePath))
		{
			writelineEx(gBAP_Trace, 0, "Invalid file path!");
		}
		else
		{
			A_FSG_4_0_0_25_LoadArray();
			writelineEx(gBAP_Trace, 0, "Load array from CSV file: %s", filePath);
		}
		putValue(A_FSG_4_0_0_25_Data_1, A_FSG_4_0_0_25_ArrayDataList[ getValue( A_FSG_4_0_0_25_DataIndex) ].Param1);
	putValue(A_FSG_4_0_0_25_Data_2, A_FSG_4_0_0_25_ArrayDataList[ getValue( A_FSG_4_0_0_25_DataIndex) ].Param2);
	putValue(A_FSG_4_0_0_25_Data_3, A_FSG_4_0_0_25_ArrayDataList[ getValue( A_FSG_4_0_0_25_DataIndex) ].Param3);
	putValue(A_FSG_4_0_0_25_Data_4, A_FSG_4_0_0_25_ArrayDataList[ getValue( A_FSG_4_0_0_25_DataIndex) ].Param4);
	putValue(A_FSG_4_0_0_25_Data_5, A_FSG_4_0_0_25_ArrayDataList[ getValue( A_FSG_4_0_0_25_DataIndex) ].Param5);
	putValue(A_FSG_4_0_0_25_Data_6, A_FSG_4_0_0_25_ArrayDataList[ getValue( A_FSG_4_0_0_25_DataIndex) ].Param6);
	putValue(A_FSG_4_0_0_25_Data_7, A_FSG_4_0_0_25_ArrayDataList[ getValue( A_FSG_4_0_0_25_DataIndex) ].Param7);
	putValue(A_FSG_4_0_0_25_Data_8, A_FSG_4_0_0_25_ArrayDataList[ getValue( A_FSG_4_0_0_25_DataIndex) ].Param8);
	putValue(A_FSG_4_0_0_25_Data_9, A_FSG_4_0_0_25_ArrayDataList[ getValue( A_FSG_4_0_0_25_DataIndex) ].Param9);
	putValue(A_FSG_4_0_0_25_Data_10, A_FSG_4_0_0_25_ArrayDataList[ getValue( A_FSG_4_0_0_25_DataIndex) ].Param10);
	}
}


on envVar A_FSG_4_0_0_25_generateData_Btn
{
	word i;
	dword elementsArray[10] = {1, 1, 1, 1, 1, 1, 1, 1, 1, 1};
	byte elementsTypeArray[10] = {0, 0, 0, 0, 0, 0, 0, 0, 0, 0};
	dword elementsMaxSizeArray[10] = {255, 7, 0xFF, 0xFF, 0xFF, 0xFF, 0xFF, 0xFF, 0xFF, 0xFF};
	byte tempArray[80];
	if (A_FSG_4_0_0_25_generateData_Btn_already_pressed == 0)
	{
		A_FSG_4_0_0_25_generateData_Btn_already_pressed = 1;
	}
	else
	{
		initStruct(tempArray, elementsArray, elementsTypeArray, elementsMaxSizeArray, 25, 8 );
		for(i = 0; i < 8; i++)
		{
			memcpy(A_FSG_4_0_0_25_ArrayDataList[i], tempArray, (i * 10) );
		}
		A_FSG_4_0_0_25_generateData_Btn_already_pressed = 0;
	putValue(A_FSG_4_0_0_25_Data_1, A_FSG_4_0_0_25_ArrayDataList[ getValue( A_FSG_4_0_0_25_DataIndex) ].Param1);
	putValue(A_FSG_4_0_0_25_Data_2, A_FSG_4_0_0_25_ArrayDataList[ getValue( A_FSG_4_0_0_25_DataIndex) ].Param2);
	putValue(A_FSG_4_0_0_25_Data_3, A_FSG_4_0_0_25_ArrayDataList[ getValue( A_FSG_4_0_0_25_DataIndex) ].Param3);
	putValue(A_FSG_4_0_0_25_Data_4, A_FSG_4_0_0_25_ArrayDataList[ getValue( A_FSG_4_0_0_25_DataIndex) ].Param4);
	putValue(A_FSG_4_0_0_25_Data_5, A_FSG_4_0_0_25_ArrayDataList[ getValue( A_FSG_4_0_0_25_DataIndex) ].Param5);
	putValue(A_FSG_4_0_0_25_Data_6, A_FSG_4_0_0_25_ArrayDataList[ getValue( A_FSG_4_0_0_25_DataIndex) ].Param6);
	putValue(A_FSG_4_0_0_25_Data_7, A_FSG_4_0_0_25_ArrayDataList[ getValue( A_FSG_4_0_0_25_DataIndex) ].Param7);
	putValue(A_FSG_4_0_0_25_Data_8, A_FSG_4_0_0_25_ArrayDataList[ getValue( A_FSG_4_0_0_25_DataIndex) ].Param8);
	putValue(A_FSG_4_0_0_25_Data_9, A_FSG_4_0_0_25_ArrayDataList[ getValue( A_FSG_4_0_0_25_DataIndex) ].Param9);
	putValue(A_FSG_4_0_0_25_Data_10, A_FSG_4_0_0_25_ArrayDataList[ getValue( A_FSG_4_0_0_25_DataIndex) ].Param10);
	}
}
// HME generateCaplOnEnv (3131)
on envVar A_FSG_4_0_0_25_DataIndex
{
    long index;
    long maxIndex = 8-1;
    index = getValue(this);
    if(index >= maxIndex) index = maxIndex;
    else if(index < 0) index = 0;
    putValue(this, index);
    putValue(A_FSG_4_0_0_25_Data_1, A_FSG_4_0_0_25_ArrayDataList[index].Param1*(1.0)-(0.0));
    putValue(A_FSG_4_0_0_25_Data_2, A_FSG_4_0_0_25_ArrayDataList[index].Param2*(1.0)-(1.0));
    putValue(A_FSG_4_0_0_25_Data_3, A_FSG_4_0_0_25_ArrayDataList[index].Param3);
    putValue(A_FSG_4_0_0_25_Data_4, A_FSG_4_0_0_25_ArrayDataList[index].Param4);
    putValue(A_FSG_4_0_0_25_Data_5, A_FSG_4_0_0_25_ArrayDataList[index].Param5);
    putValue(A_FSG_4_0_0_25_Data_6, A_FSG_4_0_0_25_ArrayDataList[index].Param6);
    putValue(A_FSG_4_0_0_25_Data_7, A_FSG_4_0_0_25_ArrayDataList[index].Param7);
    putValue(A_FSG_4_0_0_25_Data_8, A_FSG_4_0_0_25_ArrayDataList[index].Param8);
    putValue(A_FSG_4_0_0_25_Data_9, A_FSG_4_0_0_25_ArrayDataList[index].Param9);
    putValue(A_FSG_4_0_0_25_Data_10, A_FSG_4_0_0_25_ArrayDataList[index].Param10);

}
on envVar A_FSG_4_0_0_25_DataIndex_Incr
{
    long index;
    if(A_FSG_4_0_0_25_DataIndex_Incr_already_pressed == 0)
    {
        A_FSG_4_0_0_25_DataIndex_Incr_already_pressed = 1;
    }
    else
    {
        index = getValue(A_FSG_4_0_0_25_DataIndex);
        index++;
        putValue(A_FSG_4_0_0_25_DataIndex, index);
        A_FSG_4_0_0_25_DataIndex_Incr_already_pressed = 0;
    }
}
on envVar A_FSG_4_0_0_25_DataIndex_Decr
{
    long index;
    if(A_FSG_4_0_0_25_DataIndex_Decr_already_pressed == 0)
    {
        A_FSG_4_0_0_25_DataIndex_Decr_already_pressed = 1;
    }
    else
    {
        index = getValue(A_FSG_4_0_0_25_DataIndex);
        index--;
        putValue(A_FSG_4_0_0_25_DataIndex, index);
        A_FSG_4_0_0_25_DataIndex_Decr_already_pressed = 0;
    }
}
// HME generateCaplOnEnv (3160)
on envVar A_FSG_4_0_0_25_DataIndex_SetGet
{
    long index;
    long maxIndex = 8-1;
    index = getValue(this);
    if(index >= maxIndex) index = maxIndex;
    else if(index < 0) index = 0;
    putValue(this, index);
    putValue(A_FSG_4_0_0_25_Data_1_SetGet, A_FSG_4_0_0_25_ArrayDataList[index].Param1*(1.0)-(0.0));
    putValue(A_FSG_4_0_0_25_Data_2_SetGet, A_FSG_4_0_0_25_ArrayDataList[index].Param2*(1.0)-(1.0));
    putValue(A_FSG_4_0_0_25_Data_3_SetGet, A_FSG_4_0_0_25_ArrayDataList[index].Param3);
    putValue(A_FSG_4_0_0_25_Data_4_SetGet, A_FSG_4_0_0_25_ArrayDataList[index].Param4);
    putValue(A_FSG_4_0_0_25_Data_5_SetGet, A_FSG_4_0_0_25_ArrayDataList[index].Param5);
    putValue(A_FSG_4_0_0_25_Data_6_SetGet, A_FSG_4_0_0_25_ArrayDataList[index].Param6);
    putValue(A_FSG_4_0_0_25_Data_7_SetGet, A_FSG_4_0_0_25_ArrayDataList[index].Param7);
    putValue(A_FSG_4_0_0_25_Data_8_SetGet, A_FSG_4_0_0_25_ArrayDataList[index].Param8);
    putValue(A_FSG_4_0_0_25_Data_9_SetGet, A_FSG_4_0_0_25_ArrayDataList[index].Param9);
    putValue(A_FSG_4_0_0_25_Data_10_SetGet, A_FSG_4_0_0_25_ArrayDataList[index].Param10);

}
on envVar A_FSG_4_0_0_25_DataIndex_SetGet_Incr
{
    long index;
    if(A_FSG_4_0_0_25_DataIndex_SetGet_Incr_already_pressed == 0)
    {
        A_FSG_4_0_0_25_DataIndex_SetGet_Incr_already_pressed = 1;
    }
    else
    {
        index = getValue(A_FSG_4_0_0_25_DataIndex_SetGet);
        index++;
        putValue(A_FSG_4_0_0_25_DataIndex_SetGet, index);
        A_FSG_4_0_0_25_DataIndex_SetGet_Incr_already_pressed = 0;
    }
}
on envVar A_FSG_4_0_0_25_DataIndex_SetGet_Decr
{
    long index;
    if(A_FSG_4_0_0_25_DataIndex_SetGet_Decr_already_pressed == 0)
    {
        A_FSG_4_0_0_25_DataIndex_SetGet_Decr_already_pressed = 1;
    }
    else
    {
        index = getValue(A_FSG_4_0_0_25_DataIndex_SetGet);
        index--;
        putValue(A_FSG_4_0_0_25_DataIndex_SetGet, index);
        A_FSG_4_0_0_25_DataIndex_SetGet_Decr_already_pressed = 0;
    }
}
on envVar A_FSG_4_0_0_25_FctEn
{
    long data[3];
    data[0]=LSGID;
    data[1]=A_FSG_4_0_0_25_ID;
    data[2]=getValue(A_FSG_4_0_0_25_FctEn);
    ChangeConfig(0x0031,data);
}
// De-Aktivierung der Eingabefelder der FCTID A_FSG_4_0_0_25
on envVar A_FSG_4_0_0_25_FctLstItemEn
{
       if(getValue(this)) 
       {
           EnableControl(panel_name,"panel_FSG_4_0_0_25",1);
           EnableControl(panel_name,"panel_A_FSG_4_0_0_25_Status",1);
           EnableControl(panel_name,"errfield_A_FSG_4_0_0_25",1);
           EnableControl(panel_name,"panel_A_FSG_4_0_0_25",1);
           EnableControl(panel_name,"panel_A_FSG_4_0_0_25_Changed",1);
           EnableControl(panel_name,"panel_A_FSG_4_0_0_25_SetGet",1);
           setControlForeColor(panel_name, "checkbox_A_FSG_4_0_0_25", MakeRGB(0,240,0));
       }
       else
       {
           EnableControl(panel_name,"panel_FSG_4_0_0_25",0);
           EnableControl(panel_name,"panel_A_FSG_4_0_0_25_Status",0);
           EnableControl(panel_name,"errfield_A_FSG_4_0_0_25",0);
           EnableControl(panel_name,"panel_A_FSG_4_0_0_25",0);
           EnableControl(panel_name,"panel_A_FSG_4_0_0_25_Changed",0);
           EnableControl(panel_name,"panel_A_FSG_4_0_0_25_SetGet",0);
           setControlForeColor(panel_name, "checkbox_A_FSG_4_0_0_25", MakeRGB(250,0,0));
       }
}
// Man darf gleichzeitig nur Checkbox fuer SegmError oder IntertelegramError aktiviert werden
on envVar A_FSG_4_0_0_25_IntTlgEn
{
       if(getValue(this)) 
       {
           putValue(A_FSG_4_0_0_25_SegmEn,0);
           intertelegram_err(A_FSG_4_0_0_25_ID);
       }
       else
       {
           intertelegram_err_off(A_FSG_4_0_0_25_ID);
       }
}
// Man darf gleichzeitig nur Checkbox fuer SegmError oder IntertelegramError aktiviert werden
on envVar A_FSG_4_0_0_25_SegmEn
{
       if(getValue(this)) 
       {
           putValue(A_FSG_4_0_0_25_IntTlgEn,0);
           sequence_err(A_FSG_4_0_0_25_ID,getValueSize(A_FSG_4_0_0_25_SegmEn));
       }
       else
       {
              sequence_err_off(A_FSG_4_0_0_25_ID);
       }
}

// [XL] Ueberwachung der CheckBox fuer AT
on envVar A_FSG_4_0_0_25_AT
{
	if(getValue(this))
	{
		EnableControl(panel_name,"panel_A_FSG_4_0_0_25_Status",0);
	}
	else
	{
   	EnableControl(panel_name,"panel_A_FSG_4_0_0_25_Status",1);
 	}
}



A_FSG_4_0_0_25_SetInd () { /* leere Function*/ }

A_FSG_4_0_0_25_SetGetInd()
{
    dword currentPos;
    byte head[5];
    byte stringTempValue[85];
    dword i;
    dword j;
    int startVal;
    int elementsVal;
    byte recordAddressVal;
    byte transmitPosVal;
    long tempValue;
    long index;
    byte nibbleSetted;
    currentPos = 0;
    nibbleSetted = 0;
    //Einzelparameter: ASG_ID
    if(nibbleSetted == 1)
    {
        //voriger Parameter war ein Nibble, => second nibble, Pos incr und Flag zuruecksetzen
        tempValue = (gBAP_Indication_data[currentPos++] &0xF);
        nibbleSetted = 0;
    }
    else
    {
        //first nibble, kein increment, Flag setzen
        tempValue = ((gBAP_Indication_data[currentPos]>>4) &0xF);
        nibbleSetted = 1;
    }
    putValue(A_FSG_4_0_0_25_1_SetGet, tempValue);
    //Einzelparameter: TAID
    if(nibbleSetted == 1)
    {
        //voriger Parameter war ein Nibble, => second nibble, Pos incr und Flag zuruecksetzen
        tempValue = (gBAP_Indication_data[currentPos++] &0xF);
        nibbleSetted = 0;
    }
    else
    {
        //first nibble, kein increment, Flag setzen
        tempValue = ((gBAP_Indication_data[currentPos]>>4) &0xF);
        nibbleSetted = 1;
    }
    putValue(A_FSG_4_0_0_25_2_SetGet, tempValue);
    //head Parameter
    if(gBAP_Indication_header[4] >= (3+currentPos))
    {
        if( (gBAP_Indication_data[currentPos] & 0x80) > 0)
            if(gBAP_Indication_header[4] >= (5+currentPos))
            {
                for(i = 0; i < 5; i++) head[i] = gBAP_Indication_data[currentPos++];
                putValue(A_FSG_4_0_0_25_SetGet, head, 5);
                if(getValue(A_FSG_4_0_0_25_AT))
                {
                    putValue(A_FSG_4_0_0_25,head,5);
                }
                startVal = (head[2]<<8) | head[1];
                elementsVal = (head[4]<<8) | head[3];
            }
            else write("received Data Error");
        else
        {
            for(i = 0; i < 3; i++) head[i] = gBAP_Indication_data[currentPos++];
            putValue(A_FSG_4_0_0_25_SetGet, head, 3);
            if(getValue(A_FSG_4_0_0_25_AT))
            {
                putValue(A_FSG_4_0_0_25,head,3);
            }
                startVal = head[1];
                elementsVal = head[2];
        }
        recordAddressVal = head[0] & 0x0F;
        transmitPosVal = head[0] & 0x40;
        if(getValue(A_FSG_4_0_0_25_AT))
        {
            putValue(A_FSG_4_0_0_25_RecAdr,recordAddressVal);
            putValue(A_FSG_4_0_0_25_Start, startVal);
            putValue(A_FSG_4_0_0_25_Elements, elementsVal);
            putValue(A_FSG_4_0_0_25_TransPos, transmitPosVal);
        }
    }
    //data Parameter
     nibbleSetted = 0;
    if( (head[0] & 0x20) == 0) { // array header: increasing indices (Direction = 0).
      if( (head[0] & 0x10) > 0) { // array header: first element is one after specified start element (Shift = 1, Direction = 0).
        startVal++;
      }
      for ( i = startVal ; i < startVal + elementsVal ; i++) {
        if ( i < 0 || i >= A_FSG_4_0_0_25_ArrayDataList_Length ) {
          write("Array index ausserhalb der Grenzen, Fct: 25");
          break;
        }
        if(nibbleSetted == 1) currentPos++;
        nibbleSetted = 0;
     if( (head[0]&0x40) == 0){ /* Transmit_Pos = 0, keine Positionsdaten */ }
     else
     {
        if( (head[0]&0x80) == 0)
        {
           //IndexSize = 0, Pos als 1 Byte Wert
           A_FSG_4_0_0_25_ArrayDataList[i].Param1 = gBAP_Indication_data[currentPos++];
        }
        else
        {
           //IndexSize = 1, Pos als 2 Byte Wert
           A_FSG_4_0_0_25_ArrayDataList[i].Param1 = ( gBAP_Indication_data[currentPos++] &0xFF) + ((gBAP_Indication_data[currentPos++] &0xFF)<<8);
        }
     }
      // 0 - es kann vorkommen, dass das if leer ist dies wuerde zum Fehler fuehren. => automatische generierung der 0
      if( 0 || 1 == recordAddressVal || 2 == recordAddressVal || 3 == recordAddressVal )
      {
        //Sollte vor einem 1 Byte Wert 1 Nibble kommen, muss der index um 1 incrementiert werden!
        if( nibbleSetted==1) currentPos++;
        nibbleSetted = 0;
        A_FSG_4_0_0_25_ArrayDataList[i].Param2 = (gBAP_Indication_data[currentPos++] & 0xFF);
      }
      // 0 - es kann vorkommen, dass das if leer ist dies wuerde zum Fehler fuehren. => automatische generierung der 0
      if( 0 || 1 == recordAddressVal || 2 == recordAddressVal )
      {
        //Sollte vor einem 1 Byte Wert 1 Nibble kommen, muss der index um 1 incrementiert werden!
        if( nibbleSetted==1) currentPos++;
        nibbleSetted = 0;
        A_FSG_4_0_0_25_ArrayDataList[i].Param3 = (gBAP_Indication_data[currentPos++] & 0xFF);
      }
      // 0 - es kann vorkommen, dass das if leer ist dies wuerde zum Fehler fuehren. => automatische generierung der 0
      if( 0 || 1 == recordAddressVal || 2 == recordAddressVal )
      {
        //Sollte vor einem 1 Byte Wert 1 Nibble kommen, muss der index um 1 incrementiert werden!
        if( nibbleSetted==1) currentPos++;
        nibbleSetted = 0;
        A_FSG_4_0_0_25_ArrayDataList[i].Param4 = (gBAP_Indication_data[currentPos++] & 0xFF);
      }
      // 0 - es kann vorkommen, dass das if leer ist dies wuerde zum Fehler fuehren. => automatische generierung der 0
      if( 0 || 1 == recordAddressVal || 2 == recordAddressVal )
      {
        //Sollte vor einem 1 Byte Wert 1 Nibble kommen, muss der index um 1 incrementiert werden!
        if( nibbleSetted==1) currentPos++;
        nibbleSetted = 0;
        A_FSG_4_0_0_25_ArrayDataList[i].Param5 = (gBAP_Indication_data[currentPos++] & 0xFF);
      }
      // 0 - es kann vorkommen, dass das if leer ist dies wuerde zum Fehler fuehren. => automatische generierung der 0
      if( 0 || 1 == recordAddressVal || 2 == recordAddressVal )
      {
        //Sollte vor einem 1 Byte Wert 1 Nibble kommen, muss der index um 1 incrementiert werden!
        if( nibbleSetted==1) currentPos++;
        nibbleSetted = 0;
        A_FSG_4_0_0_25_ArrayDataList[i].Param6 = (gBAP_Indication_data[currentPos++] & 0xFF);
      }
      // 0 - es kann vorkommen, dass das if leer ist dies wuerde zum Fehler fuehren. => automatische generierung der 0
      if( 0 || 1 == recordAddressVal || 3 == recordAddressVal )
      {
        //Sollte vor einem 1 Byte Wert 1 Nibble kommen, muss der index um 1 incrementiert werden!
        if( nibbleSetted==1) currentPos++;
        nibbleSetted = 0;
        A_FSG_4_0_0_25_ArrayDataList[i].Param7 = (gBAP_Indication_data[currentPos++] & 0xFF);
      }
      // 0 - es kann vorkommen, dass das if leer ist dies wuerde zum Fehler fuehren. => automatische generierung der 0
      if( 0 || 1 == recordAddressVal || 3 == recordAddressVal )
      {
        //Sollte vor einem 1 Byte Wert 1 Nibble kommen, muss der index um 1 incrementiert werden!
        if( nibbleSetted==1) currentPos++;
        nibbleSetted = 0;
        A_FSG_4_0_0_25_ArrayDataList[i].Param8 = (gBAP_Indication_data[currentPos++] & 0xFF);
      }
      // 0 - es kann vorkommen, dass das if leer ist dies wuerde zum Fehler fuehren. => automatische generierung der 0
      if( 0 || 1 == recordAddressVal || 3 == recordAddressVal )
      {
        //Sollte vor einem 1 Byte Wert 1 Nibble kommen, muss der index um 1 incrementiert werden!
        if( nibbleSetted==1) currentPos++;
        nibbleSetted = 0;
        A_FSG_4_0_0_25_ArrayDataList[i].Param9 = (gBAP_Indication_data[currentPos++] & 0xFF);
      }
      // 0 - es kann vorkommen, dass das if leer ist dies wuerde zum Fehler fuehren. => automatische generierung der 0
      if( 0 || 1 == recordAddressVal || 3 == recordAddressVal )
      {
        //Sollte vor einem 1 Byte Wert 1 Nibble kommen, muss der index um 1 incrementiert werden!
        if( nibbleSetted==1) currentPos++;
        nibbleSetted = 0;
        A_FSG_4_0_0_25_ArrayDataList[i].Param10 = (gBAP_Indication_data[currentPos++] & 0xFF);
      }
      } // for
    } else { // array header: decreasing indices (Direction = 1).
      if( (head[0] & 0x10) > 0) { // array header: first element is one before specified start element (Shift = 1, Direction = 1).
        if(startVal != 0) {          startVal--;
        } else {
          startVal = A_FSG_4_0_0_25_ArrayDataList_Length -1;
        }
      }
      for ( i = startVal ; i > startVal - elementsVal ; i--) {
        if ( i < 0 || i >= A_FSG_4_0_0_25_ArrayDataList_Length ) {
          write("Array index ausserhalb der Grenzen, Fct: 25");
          break;
        }
        if(nibbleSetted == 1) currentPos++;
        nibbleSetted = 0;
     if( (head[0]&0x40) == 0){ /* Transmit_Pos = 0, keine Positionsdaten */ }
     else
     {
        if( (head[0]&0x80) == 0)
        {
           //IndexSize = 0, Pos als 1 Byte Wert
           A_FSG_4_0_0_25_ArrayDataList[i].Param1 = gBAP_Indication_data[currentPos++];
        }
        else
        {
           //IndexSize = 1, Pos als 2 Byte Wert
           A_FSG_4_0_0_25_ArrayDataList[i].Param1 = ( gBAP_Indication_data[currentPos++] &0xFF) + ((gBAP_Indication_data[currentPos++] &0xFF)<<8);
        }
     }
      // 0 - es kann vorkommen, dass das if leer ist dies wuerde zum Fehler fuehren. => automatische generierung der 0
      if( 0 || 1 == recordAddressVal || 2 == recordAddressVal || 3 == recordAddressVal )
      {
        //Sollte vor einem 1 Byte Wert 1 Nibble kommen, muss der index um 1 incrementiert werden!
        if( nibbleSetted==1) currentPos++;
        nibbleSetted = 0;
        A_FSG_4_0_0_25_ArrayDataList[i].Param2 = (gBAP_Indication_data[currentPos++] & 0xFF);
      }
      // 0 - es kann vorkommen, dass das if leer ist dies wuerde zum Fehler fuehren. => automatische generierung der 0
      if( 0 || 1 == recordAddressVal || 2 == recordAddressVal )
      {
        //Sollte vor einem 1 Byte Wert 1 Nibble kommen, muss der index um 1 incrementiert werden!
        if( nibbleSetted==1) currentPos++;
        nibbleSetted = 0;
        A_FSG_4_0_0_25_ArrayDataList[i].Param3 = (gBAP_Indication_data[currentPos++] & 0xFF);
      }
      // 0 - es kann vorkommen, dass das if leer ist dies wuerde zum Fehler fuehren. => automatische generierung der 0
      if( 0 || 1 == recordAddressVal || 2 == recordAddressVal )
      {
        //Sollte vor einem 1 Byte Wert 1 Nibble kommen, muss der index um 1 incrementiert werden!
        if( nibbleSetted==1) currentPos++;
        nibbleSetted = 0;
        A_FSG_4_0_0_25_ArrayDataList[i].Param4 = (gBAP_Indication_data[currentPos++] & 0xFF);
      }
      // 0 - es kann vorkommen, dass das if leer ist dies wuerde zum Fehler fuehren. => automatische generierung der 0
      if( 0 || 1 == recordAddressVal || 2 == recordAddressVal )
      {
        //Sollte vor einem 1 Byte Wert 1 Nibble kommen, muss der index um 1 incrementiert werden!
        if( nibbleSetted==1) currentPos++;
        nibbleSetted = 0;
        A_FSG_4_0_0_25_ArrayDataList[i].Param5 = (gBAP_Indication_data[currentPos++] & 0xFF);
      }
      // 0 - es kann vorkommen, dass das if leer ist dies wuerde zum Fehler fuehren. => automatische generierung der 0
      if( 0 || 1 == recordAddressVal || 2 == recordAddressVal )
      {
        //Sollte vor einem 1 Byte Wert 1 Nibble kommen, muss der index um 1 incrementiert werden!
        if( nibbleSetted==1) currentPos++;
        nibbleSetted = 0;
        A_FSG_4_0_0_25_ArrayDataList[i].Param6 = (gBAP_Indication_data[currentPos++] & 0xFF);
      }
      // 0 - es kann vorkommen, dass das if leer ist dies wuerde zum Fehler fuehren. => automatische generierung der 0
      if( 0 || 1 == recordAddressVal || 3 == recordAddressVal )
      {
        //Sollte vor einem 1 Byte Wert 1 Nibble kommen, muss der index um 1 incrementiert werden!
        if( nibbleSetted==1) currentPos++;
        nibbleSetted = 0;
        A_FSG_4_0_0_25_ArrayDataList[i].Param7 = (gBAP_Indication_data[currentPos++] & 0xFF);
      }
      // 0 - es kann vorkommen, dass das if leer ist dies wuerde zum Fehler fuehren. => automatische generierung der 0
      if( 0 || 1 == recordAddressVal || 3 == recordAddressVal )
      {
        //Sollte vor einem 1 Byte Wert 1 Nibble kommen, muss der index um 1 incrementiert werden!
        if( nibbleSetted==1) currentPos++;
        nibbleSetted = 0;
        A_FSG_4_0_0_25_ArrayDataList[i].Param8 = (gBAP_Indication_data[currentPos++] & 0xFF);
      }
      // 0 - es kann vorkommen, dass das if leer ist dies wuerde zum Fehler fuehren. => automatische generierung der 0
      if( 0 || 1 == recordAddressVal || 3 == recordAddressVal )
      {
        //Sollte vor einem 1 Byte Wert 1 Nibble kommen, muss der index um 1 incrementiert werden!
        if( nibbleSetted==1) currentPos++;
        nibbleSetted = 0;
        A_FSG_4_0_0_25_ArrayDataList[i].Param9 = (gBAP_Indication_data[currentPos++] & 0xFF);
      }
      // 0 - es kann vorkommen, dass das if leer ist dies wuerde zum Fehler fuehren. => automatische generierung der 0
      if( 0 || 1 == recordAddressVal || 3 == recordAddressVal )
      {
        //Sollte vor einem 1 Byte Wert 1 Nibble kommen, muss der index um 1 incrementiert werden!
        if( nibbleSetted==1) currentPos++;
        nibbleSetted = 0;
        A_FSG_4_0_0_25_ArrayDataList[i].Param10 = (gBAP_Indication_data[currentPos++] & 0xFF);
      }
      } // for
    }
    nibbleSetted = 0;
index = getValue(A_FSG_4_0_0_25_DataIndex);
    putValue(A_FSG_4_0_0_25_Data_1, A_FSG_4_0_0_25_ArrayDataList[index].Param1*(1.0)-(0.0));
    putValue(A_FSG_4_0_0_25_Data_2, A_FSG_4_0_0_25_ArrayDataList[index].Param2*(1.0)-(1.0));
    putValue(A_FSG_4_0_0_25_Data_3, A_FSG_4_0_0_25_ArrayDataList[index].Param3);
    putValue(A_FSG_4_0_0_25_Data_4, A_FSG_4_0_0_25_ArrayDataList[index].Param4);
    putValue(A_FSG_4_0_0_25_Data_5, A_FSG_4_0_0_25_ArrayDataList[index].Param5);
    putValue(A_FSG_4_0_0_25_Data_6, A_FSG_4_0_0_25_ArrayDataList[index].Param6);
    putValue(A_FSG_4_0_0_25_Data_7, A_FSG_4_0_0_25_ArrayDataList[index].Param7);
    putValue(A_FSG_4_0_0_25_Data_8, A_FSG_4_0_0_25_ArrayDataList[index].Param8);
    putValue(A_FSG_4_0_0_25_Data_9, A_FSG_4_0_0_25_ArrayDataList[index].Param9);
    putValue(A_FSG_4_0_0_25_Data_10, A_FSG_4_0_0_25_ArrayDataList[index].Param10);
}

A_FSG_4_0_0_25_GetInd()
{
    dword currentPos;
    byte head[5];
    byte stringTempValue[85];
    dword i;
    dword j;
    int startVal;
    int elementsVal;
    byte recordAddressVal;
    byte transmitPosVal;
    long tempValue;
    long index;
    byte nibbleSetted;
    currentPos = 0;
    nibbleSetted = 0;
    //Einzelparameter: ASG_ID
    if(nibbleSetted == 1)
    {
        //voriger Parameter war ein Nibble, => second nibble, Pos incr und Flag zuruecksetzen
        tempValue = (gBAP_Indication_data[currentPos++] &0xF);
        nibbleSetted = 0;
    }
    else
    {
        //first nibble, kein increment, Flag setzen
        tempValue = ((gBAP_Indication_data[currentPos]>>4) &0xF);
        nibbleSetted = 1;
    }
    putValue(A_FSG_4_0_0_25_1_SetGet, tempValue);
    //Einzelparameter: TAID
    if(nibbleSetted == 1)
    {
        //voriger Parameter war ein Nibble, => second nibble, Pos incr und Flag zuruecksetzen
        tempValue = (gBAP_Indication_data[currentPos++] &0xF);
        nibbleSetted = 0;
    }
    else
    {
        //first nibble, kein increment, Flag setzen
        tempValue = ((gBAP_Indication_data[currentPos]>>4) &0xF);
        nibbleSetted = 1;
    }
    putValue(A_FSG_4_0_0_25_2_SetGet, tempValue);
    //head Parameter
    if(gBAP_Indication_header[4] >= (3+currentPos))
    {
        if( (gBAP_Indication_data[currentPos] & 0x80) > 0)
            if(gBAP_Indication_header[4] >= (5+currentPos))
            {
                for(i = 0; i < 5; i++) head[i] = gBAP_Indication_data[currentPos++];
                putValue(A_FSG_4_0_0_25_SetGet, head, 5);
                if(getValue(A_FSG_4_0_0_25_AT))
                {
                    putValue(A_FSG_4_0_0_25,head,5);
                }
                startVal = (head[2]<<8) | head[1];
                elementsVal = (head[4]<<8) | head[3];
            }
            else write("received Data Error");
        else
        {
            for(i = 0; i < 3; i++) head[i] = gBAP_Indication_data[currentPos++];
            putValue(A_FSG_4_0_0_25_SetGet, head, 3);
            if(getValue(A_FSG_4_0_0_25_AT))
            {
                putValue(A_FSG_4_0_0_25,head,3);
            }
                startVal = head[1];
                elementsVal = head[2];
        }
        recordAddressVal = head[0] & 0x0F;
        transmitPosVal = head[0] & 0x40;
        if(getValue(A_FSG_4_0_0_25_AT))
        {
            putValue(A_FSG_4_0_0_25_RecAdr,recordAddressVal);
            putValue(A_FSG_4_0_0_25_Start, startVal);
            putValue(A_FSG_4_0_0_25_Elements, elementsVal);
            putValue(A_FSG_4_0_0_25_TransPos, transmitPosVal);
        }
    }
}

on envVar A_FSG_4_0_0_25_1
{

	//Update Childvalue (Enum)
	byte thisval; // ASG_ID
	thisval = 0x0f & getValue(this);
}
// Ueberwachung der Darstellungsvariable der Range.
on envVar A_FSG_4_0_0_25_2_range // SectionConfig.TAID 
{
	@A_FSG_4_0_0_25_2 = @A_FSG_4_0_0_25_2_range - (0); // slider = range - min
}

on envVar A_FSG_4_0_0_25_2
{

	//Update Childvalue (Number)
	byte thisval; // TAID
	float slider_value;

	slider_value = round(@A_FSG_4_0_0_25_2, 1.0);
	@A_FSG_4_0_0_25_2_range = slider_value + (0); // real value := slider value + range min.
	thisval = (byte)round((slider_value + (0) - (0)) / (1.0), 1); // bus value := (slider value + min - offset) / step.
}
// Ueberwachung der Darstellungsvariable der Range.
on envVar A_FSG_4_0_0_25_3_range // SectionConfig.TotalNumListElements 
{
	@A_FSG_4_0_0_25_3 = @A_FSG_4_0_0_25_3_range - (0); // slider = range - min
}

on envVar A_FSG_4_0_0_25_3
{

	//Update Childvalue (Number)
	byte thisval; // TotalNumListElements
	float slider_value;

	slider_value = round(@A_FSG_4_0_0_25_3, 1.0);
	@A_FSG_4_0_0_25_3_range = slider_value + (0); // real value := slider value + range min.
	thisval = (byte)round((slider_value + (0) - (0)) / (1.0), 1); // bus value := (slider value + min - offset) / step.
}
// Ueberwachung der Darstellungsvariable der Range.
on envVar A_FSG_4_0_0_25_Data_1_range // SectionConfig.Pos 
{
	@A_FSG_4_0_0_25_Data_1 = @A_FSG_4_0_0_25_Data_1_range - (0); // slider = range - min
}

on envVar A_FSG_4_0_0_25_Data_1
{

	//Update Childvalue (Number)
	byte thisval; // Pos
	float slider_value;

	slider_value = round(@A_FSG_4_0_0_25_Data_1, 1.0);
	@A_FSG_4_0_0_25_Data_1_range = slider_value + (0); // real value := slider value + range min.
	thisval = (byte)round((slider_value + (0) - (0)) / (1.0), 1); // bus value := (slider value + min - offset) / step.
    A_FSG_4_0_0_25_ArrayDataList[getValue(A_FSG_4_0_0_25_DataIndex)].Param1 = thisval;
}
// Ueberwachung der Darstellungsvariable der Range.
on envVar A_FSG_4_0_0_25_Data_2_range // SectionConfig.DisplaySection 
{
	@A_FSG_4_0_0_25_Data_2 = @A_FSG_4_0_0_25_Data_2_range - (1); // slider = range - min
}

on envVar A_FSG_4_0_0_25_Data_2
{

	//Update Childvalue (Number)
	byte thisval; // DisplaySection
	float slider_value;

	slider_value = round(@A_FSG_4_0_0_25_Data_2, 1.0);
	@A_FSG_4_0_0_25_Data_2_range = slider_value + (1); // real value := slider value + range min.
	thisval = (byte)round((slider_value + (1) - (1)) / (1.0), 1); // bus value := (slider value + min - offset) / step.
    A_FSG_4_0_0_25_ArrayDataList[getValue(A_FSG_4_0_0_25_DataIndex)].Param2 = thisval;
}
on envVar A_FSG_4_0_0_25_Data_3_0
{
	byte bitval;
	//thisval steht hier fuer den bitfield-wert, 
	//aus Generierungsgruenden hier keine einheitliche Bezeichnung moeglich.
	byte thisval; // DisplaySectionSetup1
	bitval= getValue(this);
	thisval = getValue(A_FSG_4_0_0_25_Data_3);
	thisval = thisval&~(1<<0)|(bitval<<0);
	putValue(A_FSG_4_0_0_25_Data_3,thisval);
}

on envVar A_FSG_4_0_0_25_Data_3_1
{
	byte bitval;
	//thisval steht hier fuer den bitfield-wert, 
	//aus Generierungsgruenden hier keine einheitliche Bezeichnung moeglich.
	byte thisval; // DisplaySectionSetup1
	bitval= getValue(this);
	thisval = getValue(A_FSG_4_0_0_25_Data_3);
	thisval = thisval&~(1<<1)|(bitval<<1);
	putValue(A_FSG_4_0_0_25_Data_3,thisval);
}

on envVar A_FSG_4_0_0_25_Data_3_2
{
	byte bitval;
	//thisval steht hier fuer den bitfield-wert, 
	//aus Generierungsgruenden hier keine einheitliche Bezeichnung moeglich.
	byte thisval; // DisplaySectionSetup1
	bitval= getValue(this);
	thisval = getValue(A_FSG_4_0_0_25_Data_3);
	thisval = thisval&~(1<<2)|(bitval<<2);
	putValue(A_FSG_4_0_0_25_Data_3,thisval);
}

on envVar A_FSG_4_0_0_25_Data_3_3
{
	byte bitval;
	//thisval steht hier fuer den bitfield-wert, 
	//aus Generierungsgruenden hier keine einheitliche Bezeichnung moeglich.
	byte thisval; // DisplaySectionSetup1
	bitval= getValue(this);
	thisval = getValue(A_FSG_4_0_0_25_Data_3);
	thisval = thisval&~(1<<3)|(bitval<<3);
	putValue(A_FSG_4_0_0_25_Data_3,thisval);
}

on envVar A_FSG_4_0_0_25_Data_3_4
{
	byte bitval;
	//thisval steht hier fuer den bitfield-wert, 
	//aus Generierungsgruenden hier keine einheitliche Bezeichnung moeglich.
	byte thisval; // DisplaySectionSetup1
	bitval= getValue(this);
	thisval = getValue(A_FSG_4_0_0_25_Data_3);
	thisval = thisval&~(1<<4)|(bitval<<4);
	putValue(A_FSG_4_0_0_25_Data_3,thisval);
}

on envVar A_FSG_4_0_0_25_Data_3_5
{
	byte bitval;
	//thisval steht hier fuer den bitfield-wert, 
	//aus Generierungsgruenden hier keine einheitliche Bezeichnung moeglich.
	byte thisval; // DisplaySectionSetup1
	bitval= getValue(this);
	thisval = getValue(A_FSG_4_0_0_25_Data_3);
	thisval = thisval&~(1<<5)|(bitval<<5);
	putValue(A_FSG_4_0_0_25_Data_3,thisval);
}

on envVar A_FSG_4_0_0_25_Data_3_6
{
	byte bitval;
	//thisval steht hier fuer den bitfield-wert, 
	//aus Generierungsgruenden hier keine einheitliche Bezeichnung moeglich.
	byte thisval; // DisplaySectionSetup1
	bitval= getValue(this);
	thisval = getValue(A_FSG_4_0_0_25_Data_3);
	thisval = thisval&~(1<<6)|(bitval<<6);
	putValue(A_FSG_4_0_0_25_Data_3,thisval);
}

on envVar A_FSG_4_0_0_25_Data_3_7
{
	byte bitval;
	//thisval steht hier fuer den bitfield-wert, 
	//aus Generierungsgruenden hier keine einheitliche Bezeichnung moeglich.
	byte thisval; // DisplaySectionSetup1
	bitval= getValue(this);
	thisval = getValue(A_FSG_4_0_0_25_Data_3);
	thisval = thisval&~(1<<7)|(bitval<<7);
	putValue(A_FSG_4_0_0_25_Data_3,thisval);
}

on envVar A_FSG_4_0_0_25_Data_3
{

	//Update Childvalue (BitField)
	byte mask=0x01;
	int i = 0;
	byte thisval; // DisplaySectionSetup1
	thisval = getValue(this);
	if(thisval&(mask<<0))
		putValue(A_FSG_4_0_0_25_Data_3_0, 1);
	else
		putValue(A_FSG_4_0_0_25_Data_3_0, 0);
	if(thisval&(mask<<1))
		putValue(A_FSG_4_0_0_25_Data_3_1, 1);
	else
		putValue(A_FSG_4_0_0_25_Data_3_1, 0);
	if(thisval&(mask<<2))
		putValue(A_FSG_4_0_0_25_Data_3_2, 1);
	else
		putValue(A_FSG_4_0_0_25_Data_3_2, 0);
	if(thisval&(mask<<3))
		putValue(A_FSG_4_0_0_25_Data_3_3, 1);
	else
		putValue(A_FSG_4_0_0_25_Data_3_3, 0);
	if(thisval&(mask<<4))
		putValue(A_FSG_4_0_0_25_Data_3_4, 1);
	else
		putValue(A_FSG_4_0_0_25_Data_3_4, 0);
	if(thisval&(mask<<5))
		putValue(A_FSG_4_0_0_25_Data_3_5, 1);
	else
		putValue(A_FSG_4_0_0_25_Data_3_5, 0);
	if(thisval&(mask<<6))
		putValue(A_FSG_4_0_0_25_Data_3_6, 1);
	else
		putValue(A_FSG_4_0_0_25_Data_3_6, 0);
	if(thisval&(mask<<7))
		putValue(A_FSG_4_0_0_25_Data_3_7, 1);
	else
		putValue(A_FSG_4_0_0_25_Data_3_7, 0);
    A_FSG_4_0_0_25_ArrayDataList[getValue(A_FSG_4_0_0_25_DataIndex)].Param3 = thisval;
}
on envVar A_FSG_4_0_0_25_Data_4_0
{
	byte bitval;
	//thisval steht hier fuer den bitfield-wert, 
	//aus Generierungsgruenden hier keine einheitliche Bezeichnung moeglich.
	byte thisval; // DisplaySectionSetup2
	bitval= getValue(this);
	thisval = getValue(A_FSG_4_0_0_25_Data_4);
	thisval = thisval&~(1<<0)|(bitval<<0);
	putValue(A_FSG_4_0_0_25_Data_4,thisval);
}

on envVar A_FSG_4_0_0_25_Data_4_1
{
	byte bitval;
	//thisval steht hier fuer den bitfield-wert, 
	//aus Generierungsgruenden hier keine einheitliche Bezeichnung moeglich.
	byte thisval; // DisplaySectionSetup2
	bitval= getValue(this);
	thisval = getValue(A_FSG_4_0_0_25_Data_4);
	thisval = thisval&~(1<<1)|(bitval<<1);
	putValue(A_FSG_4_0_0_25_Data_4,thisval);
}

on envVar A_FSG_4_0_0_25_Data_4_2
{
	byte bitval;
	//thisval steht hier fuer den bitfield-wert, 
	//aus Generierungsgruenden hier keine einheitliche Bezeichnung moeglich.
	byte thisval; // DisplaySectionSetup2
	bitval= getValue(this);
	thisval = getValue(A_FSG_4_0_0_25_Data_4);
	thisval = thisval&~(1<<2)|(bitval<<2);
	putValue(A_FSG_4_0_0_25_Data_4,thisval);
}

on envVar A_FSG_4_0_0_25_Data_4_3
{
	byte bitval;
	//thisval steht hier fuer den bitfield-wert, 
	//aus Generierungsgruenden hier keine einheitliche Bezeichnung moeglich.
	byte thisval; // DisplaySectionSetup2
	bitval= getValue(this);
	thisval = getValue(A_FSG_4_0_0_25_Data_4);
	thisval = thisval&~(1<<3)|(bitval<<3);
	putValue(A_FSG_4_0_0_25_Data_4,thisval);
}

on envVar A_FSG_4_0_0_25_Data_4_4
{
	byte bitval;
	//thisval steht hier fuer den bitfield-wert, 
	//aus Generierungsgruenden hier keine einheitliche Bezeichnung moeglich.
	byte thisval; // DisplaySectionSetup2
	bitval= getValue(this);
	thisval = getValue(A_FSG_4_0_0_25_Data_4);
	thisval = thisval&~(1<<4)|(bitval<<4);
	putValue(A_FSG_4_0_0_25_Data_4,thisval);
}

on envVar A_FSG_4_0_0_25_Data_4_5
{
	byte bitval;
	//thisval steht hier fuer den bitfield-wert, 
	//aus Generierungsgruenden hier keine einheitliche Bezeichnung moeglich.
	byte thisval; // DisplaySectionSetup2
	bitval= getValue(this);
	thisval = getValue(A_FSG_4_0_0_25_Data_4);
	thisval = thisval&~(1<<5)|(bitval<<5);
	putValue(A_FSG_4_0_0_25_Data_4,thisval);
}

on envVar A_FSG_4_0_0_25_Data_4_6
{
	byte bitval;
	//thisval steht hier fuer den bitfield-wert, 
	//aus Generierungsgruenden hier keine einheitliche Bezeichnung moeglich.
	byte thisval; // DisplaySectionSetup2
	bitval= getValue(this);
	thisval = getValue(A_FSG_4_0_0_25_Data_4);
	thisval = thisval&~(1<<6)|(bitval<<6);
	putValue(A_FSG_4_0_0_25_Data_4,thisval);
}

on envVar A_FSG_4_0_0_25_Data_4_7
{
	byte bitval;
	//thisval steht hier fuer den bitfield-wert, 
	//aus Generierungsgruenden hier keine einheitliche Bezeichnung moeglich.
	byte thisval; // DisplaySectionSetup2
	bitval= getValue(this);
	thisval = getValue(A_FSG_4_0_0_25_Data_4);
	thisval = thisval&~(1<<7)|(bitval<<7);
	putValue(A_FSG_4_0_0_25_Data_4,thisval);
}

on envVar A_FSG_4_0_0_25_Data_4
{

	//Update Childvalue (BitField)
	byte mask=0x01;
	int i = 0;
	byte thisval; // DisplaySectionSetup2
	thisval = getValue(this);
	if(thisval&(mask<<0))
		putValue(A_FSG_4_0_0_25_Data_4_0, 1);
	else
		putValue(A_FSG_4_0_0_25_Data_4_0, 0);
	if(thisval&(mask<<1))
		putValue(A_FSG_4_0_0_25_Data_4_1, 1);
	else
		putValue(A_FSG_4_0_0_25_Data_4_1, 0);
	if(thisval&(mask<<2))
		putValue(A_FSG_4_0_0_25_Data_4_2, 1);
	else
		putValue(A_FSG_4_0_0_25_Data_4_2, 0);
	if(thisval&(mask<<3))
		putValue(A_FSG_4_0_0_25_Data_4_3, 1);
	else
		putValue(A_FSG_4_0_0_25_Data_4_3, 0);
	if(thisval&(mask<<4))
		putValue(A_FSG_4_0_0_25_Data_4_4, 1);
	else
		putValue(A_FSG_4_0_0_25_Data_4_4, 0);
	if(thisval&(mask<<5))
		putValue(A_FSG_4_0_0_25_Data_4_5, 1);
	else
		putValue(A_FSG_4_0_0_25_Data_4_5, 0);
	if(thisval&(mask<<6))
		putValue(A_FSG_4_0_0_25_Data_4_6, 1);
	else
		putValue(A_FSG_4_0_0_25_Data_4_6, 0);
	if(thisval&(mask<<7))
		putValue(A_FSG_4_0_0_25_Data_4_7, 1);
	else
		putValue(A_FSG_4_0_0_25_Data_4_7, 0);
    A_FSG_4_0_0_25_ArrayDataList[getValue(A_FSG_4_0_0_25_DataIndex)].Param4 = thisval;
}
on envVar A_FSG_4_0_0_25_Data_5_0
{
	byte bitval;
	//thisval steht hier fuer den bitfield-wert, 
	//aus Generierungsgruenden hier keine einheitliche Bezeichnung moeglich.
	byte thisval; // DisplaySectionSetup3
	bitval= getValue(this);
	thisval = getValue(A_FSG_4_0_0_25_Data_5);
	thisval = thisval&~(1<<0)|(bitval<<0);
	putValue(A_FSG_4_0_0_25_Data_5,thisval);
}

on envVar A_FSG_4_0_0_25_Data_5_1
{
	byte bitval;
	//thisval steht hier fuer den bitfield-wert, 
	//aus Generierungsgruenden hier keine einheitliche Bezeichnung moeglich.
	byte thisval; // DisplaySectionSetup3
	bitval= getValue(this);
	thisval = getValue(A_FSG_4_0_0_25_Data_5);
	thisval = thisval&~(1<<1)|(bitval<<1);
	putValue(A_FSG_4_0_0_25_Data_5,thisval);
}

on envVar A_FSG_4_0_0_25_Data_5_2
{
	byte bitval;
	//thisval steht hier fuer den bitfield-wert, 
	//aus Generierungsgruenden hier keine einheitliche Bezeichnung moeglich.
	byte thisval; // DisplaySectionSetup3
	bitval= getValue(this);
	thisval = getValue(A_FSG_4_0_0_25_Data_5);
	thisval = thisval&~(1<<2)|(bitval<<2);
	putValue(A_FSG_4_0_0_25_Data_5,thisval);
}

on envVar A_FSG_4_0_0_25_Data_5_3
{
	byte bitval;
	//thisval steht hier fuer den bitfield-wert, 
	//aus Generierungsgruenden hier keine einheitliche Bezeichnung moeglich.
	byte thisval; // DisplaySectionSetup3
	bitval= getValue(this);
	thisval = getValue(A_FSG_4_0_0_25_Data_5);
	thisval = thisval&~(1<<3)|(bitval<<3);
	putValue(A_FSG_4_0_0_25_Data_5,thisval);
}

on envVar A_FSG_4_0_0_25_Data_5_4
{
	byte bitval;
	//thisval steht hier fuer den bitfield-wert, 
	//aus Generierungsgruenden hier keine einheitliche Bezeichnung moeglich.
	byte thisval; // DisplaySectionSetup3
	bitval= getValue(this);
	thisval = getValue(A_FSG_4_0_0_25_Data_5);
	thisval = thisval&~(1<<4)|(bitval<<4);
	putValue(A_FSG_4_0_0_25_Data_5,thisval);
}

on envVar A_FSG_4_0_0_25_Data_5_5
{
	byte bitval;
	//thisval steht hier fuer den bitfield-wert, 
	//aus Generierungsgruenden hier keine einheitliche Bezeichnung moeglich.
	byte thisval; // DisplaySectionSetup3
	bitval= getValue(this);
	thisval = getValue(A_FSG_4_0_0_25_Data_5);
	thisval = thisval&~(1<<5)|(bitval<<5);
	putValue(A_FSG_4_0_0_25_Data_5,thisval);
}

on envVar A_FSG_4_0_0_25_Data_5_6
{
	byte bitval;
	//thisval steht hier fuer den bitfield-wert, 
	//aus Generierungsgruenden hier keine einheitliche Bezeichnung moeglich.
	byte thisval; // DisplaySectionSetup3
	bitval= getValue(this);
	thisval = getValue(A_FSG_4_0_0_25_Data_5);
	thisval = thisval&~(1<<6)|(bitval<<6);
	putValue(A_FSG_4_0_0_25_Data_5,thisval);
}

on envVar A_FSG_4_0_0_25_Data_5_7
{
	byte bitval;
	//thisval steht hier fuer den bitfield-wert, 
	//aus Generierungsgruenden hier keine einheitliche Bezeichnung moeglich.
	byte thisval; // DisplaySectionSetup3
	bitval= getValue(this);
	thisval = getValue(A_FSG_4_0_0_25_Data_5);
	thisval = thisval&~(1<<7)|(bitval<<7);
	putValue(A_FSG_4_0_0_25_Data_5,thisval);
}

on envVar A_FSG_4_0_0_25_Data_5
{

	//Update Childvalue (BitField)
	byte mask=0x01;
	int i = 0;
	byte thisval; // DisplaySectionSetup3
	thisval = getValue(this);
	if(thisval&(mask<<0))
		putValue(A_FSG_4_0_0_25_Data_5_0, 1);
	else
		putValue(A_FSG_4_0_0_25_Data_5_0, 0);
	if(thisval&(mask<<1))
		putValue(A_FSG_4_0_0_25_Data_5_1, 1);
	else
		putValue(A_FSG_4_0_0_25_Data_5_1, 0);
	if(thisval&(mask<<2))
		putValue(A_FSG_4_0_0_25_Data_5_2, 1);
	else
		putValue(A_FSG_4_0_0_25_Data_5_2, 0);
	if(thisval&(mask<<3))
		putValue(A_FSG_4_0_0_25_Data_5_3, 1);
	else
		putValue(A_FSG_4_0_0_25_Data_5_3, 0);
	if(thisval&(mask<<4))
		putValue(A_FSG_4_0_0_25_Data_5_4, 1);
	else
		putValue(A_FSG_4_0_0_25_Data_5_4, 0);
	if(thisval&(mask<<5))
		putValue(A_FSG_4_0_0_25_Data_5_5, 1);
	else
		putValue(A_FSG_4_0_0_25_Data_5_5, 0);
	if(thisval&(mask<<6))
		putValue(A_FSG_4_0_0_25_Data_5_6, 1);
	else
		putValue(A_FSG_4_0_0_25_Data_5_6, 0);
	if(thisval&(mask<<7))
		putValue(A_FSG_4_0_0_25_Data_5_7, 1);
	else
		putValue(A_FSG_4_0_0_25_Data_5_7, 0);
    A_FSG_4_0_0_25_ArrayDataList[getValue(A_FSG_4_0_0_25_DataIndex)].Param5 = thisval;
}
on envVar A_FSG_4_0_0_25_Data_6_0
{
	byte bitval;
	//thisval steht hier fuer den bitfield-wert, 
	//aus Generierungsgruenden hier keine einheitliche Bezeichnung moeglich.
	byte thisval; // DisplaySectionSetup4
	bitval= getValue(this);
	thisval = getValue(A_FSG_4_0_0_25_Data_6);
	thisval = thisval&~(1<<0)|(bitval<<0);
	putValue(A_FSG_4_0_0_25_Data_6,thisval);
}

on envVar A_FSG_4_0_0_25_Data_6_1
{
	byte bitval;
	//thisval steht hier fuer den bitfield-wert, 
	//aus Generierungsgruenden hier keine einheitliche Bezeichnung moeglich.
	byte thisval; // DisplaySectionSetup4
	bitval= getValue(this);
	thisval = getValue(A_FSG_4_0_0_25_Data_6);
	thisval = thisval&~(1<<1)|(bitval<<1);
	putValue(A_FSG_4_0_0_25_Data_6,thisval);
}

on envVar A_FSG_4_0_0_25_Data_6_2
{
	byte bitval;
	//thisval steht hier fuer den bitfield-wert, 
	//aus Generierungsgruenden hier keine einheitliche Bezeichnung moeglich.
	byte thisval; // DisplaySectionSetup4
	bitval= getValue(this);
	thisval = getValue(A_FSG_4_0_0_25_Data_6);
	thisval = thisval&~(1<<2)|(bitval<<2);
	putValue(A_FSG_4_0_0_25_Data_6,thisval);
}

on envVar A_FSG_4_0_0_25_Data_6_3
{
	byte bitval;
	//thisval steht hier fuer den bitfield-wert, 
	//aus Generierungsgruenden hier keine einheitliche Bezeichnung moeglich.
	byte thisval; // DisplaySectionSetup4
	bitval= getValue(this);
	thisval = getValue(A_FSG_4_0_0_25_Data_6);
	thisval = thisval&~(1<<3)|(bitval<<3);
	putValue(A_FSG_4_0_0_25_Data_6,thisval);
}

on envVar A_FSG_4_0_0_25_Data_6
{

	//Update Childvalue (BitField)
	byte mask=0x01;
	int i = 0;
	byte thisval; // DisplaySectionSetup4
	thisval = getValue(this);
	if(thisval&(mask<<0))
		putValue(A_FSG_4_0_0_25_Data_6_0, 1);
	else
		putValue(A_FSG_4_0_0_25_Data_6_0, 0);
	if(thisval&(mask<<1))
		putValue(A_FSG_4_0_0_25_Data_6_1, 1);
	else
		putValue(A_FSG_4_0_0_25_Data_6_1, 0);
	if(thisval&(mask<<2))
		putValue(A_FSG_4_0_0_25_Data_6_2, 1);
	else
		putValue(A_FSG_4_0_0_25_Data_6_2, 0);
	if(thisval&(mask<<3))
		putValue(A_FSG_4_0_0_25_Data_6_3, 1);
	else
		putValue(A_FSG_4_0_0_25_Data_6_3, 0);
    A_FSG_4_0_0_25_ArrayDataList[getValue(A_FSG_4_0_0_25_DataIndex)].Param6 = thisval;
}
on envVar A_FSG_4_0_0_25_Data_7_0
{
	byte bitval;
	//thisval steht hier fuer den bitfield-wert, 
	//aus Generierungsgruenden hier keine einheitliche Bezeichnung moeglich.
	byte thisval; // DisplaySectionSelection1
	bitval= getValue(this);
	thisval = getValue(A_FSG_4_0_0_25_Data_7);
	thisval = thisval&~(1<<0)|(bitval<<0);
	putValue(A_FSG_4_0_0_25_Data_7,thisval);
}

on envVar A_FSG_4_0_0_25_Data_7_1
{
	byte bitval;
	//thisval steht hier fuer den bitfield-wert, 
	//aus Generierungsgruenden hier keine einheitliche Bezeichnung moeglich.
	byte thisval; // DisplaySectionSelection1
	bitval= getValue(this);
	thisval = getValue(A_FSG_4_0_0_25_Data_7);
	thisval = thisval&~(1<<1)|(bitval<<1);
	putValue(A_FSG_4_0_0_25_Data_7,thisval);
}

on envVar A_FSG_4_0_0_25_Data_7_2
{
	byte bitval;
	//thisval steht hier fuer den bitfield-wert, 
	//aus Generierungsgruenden hier keine einheitliche Bezeichnung moeglich.
	byte thisval; // DisplaySectionSelection1
	bitval= getValue(this);
	thisval = getValue(A_FSG_4_0_0_25_Data_7);
	thisval = thisval&~(1<<2)|(bitval<<2);
	putValue(A_FSG_4_0_0_25_Data_7,thisval);
}

on envVar A_FSG_4_0_0_25_Data_7_3
{
	byte bitval;
	//thisval steht hier fuer den bitfield-wert, 
	//aus Generierungsgruenden hier keine einheitliche Bezeichnung moeglich.
	byte thisval; // DisplaySectionSelection1
	bitval= getValue(this);
	thisval = getValue(A_FSG_4_0_0_25_Data_7);
	thisval = thisval&~(1<<3)|(bitval<<3);
	putValue(A_FSG_4_0_0_25_Data_7,thisval);
}

on envVar A_FSG_4_0_0_25_Data_7_4
{
	byte bitval;
	//thisval steht hier fuer den bitfield-wert, 
	//aus Generierungsgruenden hier keine einheitliche Bezeichnung moeglich.
	byte thisval; // DisplaySectionSelection1
	bitval= getValue(this);
	thisval = getValue(A_FSG_4_0_0_25_Data_7);
	thisval = thisval&~(1<<4)|(bitval<<4);
	putValue(A_FSG_4_0_0_25_Data_7,thisval);
}

on envVar A_FSG_4_0_0_25_Data_7_5
{
	byte bitval;
	//thisval steht hier fuer den bitfield-wert, 
	//aus Generierungsgruenden hier keine einheitliche Bezeichnung moeglich.
	byte thisval; // DisplaySectionSelection1
	bitval= getValue(this);
	thisval = getValue(A_FSG_4_0_0_25_Data_7);
	thisval = thisval&~(1<<5)|(bitval<<5);
	putValue(A_FSG_4_0_0_25_Data_7,thisval);
}

on envVar A_FSG_4_0_0_25_Data_7_6
{
	byte bitval;
	//thisval steht hier fuer den bitfield-wert, 
	//aus Generierungsgruenden hier keine einheitliche Bezeichnung moeglich.
	byte thisval; // DisplaySectionSelection1
	bitval= getValue(this);
	thisval = getValue(A_FSG_4_0_0_25_Data_7);
	thisval = thisval&~(1<<6)|(bitval<<6);
	putValue(A_FSG_4_0_0_25_Data_7,thisval);
}

on envVar A_FSG_4_0_0_25_Data_7_7
{
	byte bitval;
	//thisval steht hier fuer den bitfield-wert, 
	//aus Generierungsgruenden hier keine einheitliche Bezeichnung moeglich.
	byte thisval; // DisplaySectionSelection1
	bitval= getValue(this);
	thisval = getValue(A_FSG_4_0_0_25_Data_7);
	thisval = thisval&~(1<<7)|(bitval<<7);
	putValue(A_FSG_4_0_0_25_Data_7,thisval);
}

on envVar A_FSG_4_0_0_25_Data_7
{

	//Update Childvalue (BitField)
	byte mask=0x01;
	int i = 0;
	byte thisval; // DisplaySectionSelection1
	thisval = getValue(this);
	if(thisval&(mask<<0))
		putValue(A_FSG_4_0_0_25_Data_7_0, 1);
	else
		putValue(A_FSG_4_0_0_25_Data_7_0, 0);
	if(thisval&(mask<<1))
		putValue(A_FSG_4_0_0_25_Data_7_1, 1);
	else
		putValue(A_FSG_4_0_0_25_Data_7_1, 0);
	if(thisval&(mask<<2))
		putValue(A_FSG_4_0_0_25_Data_7_2, 1);
	else
		putValue(A_FSG_4_0_0_25_Data_7_2, 0);
	if(thisval&(mask<<3))
		putValue(A_FSG_4_0_0_25_Data_7_3, 1);
	else
		putValue(A_FSG_4_0_0_25_Data_7_3, 0);
	if(thisval&(mask<<4))
		putValue(A_FSG_4_0_0_25_Data_7_4, 1);
	else
		putValue(A_FSG_4_0_0_25_Data_7_4, 0);
	if(thisval&(mask<<5))
		putValue(A_FSG_4_0_0_25_Data_7_5, 1);
	else
		putValue(A_FSG_4_0_0_25_Data_7_5, 0);
	if(thisval&(mask<<6))
		putValue(A_FSG_4_0_0_25_Data_7_6, 1);
	else
		putValue(A_FSG_4_0_0_25_Data_7_6, 0);
	if(thisval&(mask<<7))
		putValue(A_FSG_4_0_0_25_Data_7_7, 1);
	else
		putValue(A_FSG_4_0_0_25_Data_7_7, 0);
    A_FSG_4_0_0_25_ArrayDataList[getValue(A_FSG_4_0_0_25_DataIndex)].Param7 = thisval;
}
on envVar A_FSG_4_0_0_25_Data_8_0
{
	byte bitval;
	//thisval steht hier fuer den bitfield-wert, 
	//aus Generierungsgruenden hier keine einheitliche Bezeichnung moeglich.
	byte thisval; // DisplaySectionSelection2
	bitval= getValue(this);
	thisval = getValue(A_FSG_4_0_0_25_Data_8);
	thisval = thisval&~(1<<0)|(bitval<<0);
	putValue(A_FSG_4_0_0_25_Data_8,thisval);
}

on envVar A_FSG_4_0_0_25_Data_8_1
{
	byte bitval;
	//thisval steht hier fuer den bitfield-wert, 
	//aus Generierungsgruenden hier keine einheitliche Bezeichnung moeglich.
	byte thisval; // DisplaySectionSelection2
	bitval= getValue(this);
	thisval = getValue(A_FSG_4_0_0_25_Data_8);
	thisval = thisval&~(1<<1)|(bitval<<1);
	putValue(A_FSG_4_0_0_25_Data_8,thisval);
}

on envVar A_FSG_4_0_0_25_Data_8_2
{
	byte bitval;
	//thisval steht hier fuer den bitfield-wert, 
	//aus Generierungsgruenden hier keine einheitliche Bezeichnung moeglich.
	byte thisval; // DisplaySectionSelection2
	bitval= getValue(this);
	thisval = getValue(A_FSG_4_0_0_25_Data_8);
	thisval = thisval&~(1<<2)|(bitval<<2);
	putValue(A_FSG_4_0_0_25_Data_8,thisval);
}

on envVar A_FSG_4_0_0_25_Data_8_3
{
	byte bitval;
	//thisval steht hier fuer den bitfield-wert, 
	//aus Generierungsgruenden hier keine einheitliche Bezeichnung moeglich.
	byte thisval; // DisplaySectionSelection2
	bitval= getValue(this);
	thisval = getValue(A_FSG_4_0_0_25_Data_8);
	thisval = thisval&~(1<<3)|(bitval<<3);
	putValue(A_FSG_4_0_0_25_Data_8,thisval);
}

on envVar A_FSG_4_0_0_25_Data_8_4
{
	byte bitval;
	//thisval steht hier fuer den bitfield-wert, 
	//aus Generierungsgruenden hier keine einheitliche Bezeichnung moeglich.
	byte thisval; // DisplaySectionSelection2
	bitval= getValue(this);
	thisval = getValue(A_FSG_4_0_0_25_Data_8);
	thisval = thisval&~(1<<4)|(bitval<<4);
	putValue(A_FSG_4_0_0_25_Data_8,thisval);
}

on envVar A_FSG_4_0_0_25_Data_8_5
{
	byte bitval;
	//thisval steht hier fuer den bitfield-wert, 
	//aus Generierungsgruenden hier keine einheitliche Bezeichnung moeglich.
	byte thisval; // DisplaySectionSelection2
	bitval= getValue(this);
	thisval = getValue(A_FSG_4_0_0_25_Data_8);
	thisval = thisval&~(1<<5)|(bitval<<5);
	putValue(A_FSG_4_0_0_25_Data_8,thisval);
}

on envVar A_FSG_4_0_0_25_Data_8_6
{
	byte bitval;
	//thisval steht hier fuer den bitfield-wert, 
	//aus Generierungsgruenden hier keine einheitliche Bezeichnung moeglich.
	byte thisval; // DisplaySectionSelection2
	bitval= getValue(this);
	thisval = getValue(A_FSG_4_0_0_25_Data_8);
	thisval = thisval&~(1<<6)|(bitval<<6);
	putValue(A_FSG_4_0_0_25_Data_8,thisval);
}

on envVar A_FSG_4_0_0_25_Data_8_7
{
	byte bitval;
	//thisval steht hier fuer den bitfield-wert, 
	//aus Generierungsgruenden hier keine einheitliche Bezeichnung moeglich.
	byte thisval; // DisplaySectionSelection2
	bitval= getValue(this);
	thisval = getValue(A_FSG_4_0_0_25_Data_8);
	thisval = thisval&~(1<<7)|(bitval<<7);
	putValue(A_FSG_4_0_0_25_Data_8,thisval);
}

on envVar A_FSG_4_0_0_25_Data_8
{

	//Update Childvalue (BitField)
	byte mask=0x01;
	int i = 0;
	byte thisval; // DisplaySectionSelection2
	thisval = getValue(this);
	if(thisval&(mask<<0))
		putValue(A_FSG_4_0_0_25_Data_8_0, 1);
	else
		putValue(A_FSG_4_0_0_25_Data_8_0, 0);
	if(thisval&(mask<<1))
		putValue(A_FSG_4_0_0_25_Data_8_1, 1);
	else
		putValue(A_FSG_4_0_0_25_Data_8_1, 0);
	if(thisval&(mask<<2))
		putValue(A_FSG_4_0_0_25_Data_8_2, 1);
	else
		putValue(A_FSG_4_0_0_25_Data_8_2, 0);
	if(thisval&(mask<<3))
		putValue(A_FSG_4_0_0_25_Data_8_3, 1);
	else
		putValue(A_FSG_4_0_0_25_Data_8_3, 0);
	if(thisval&(mask<<4))
		putValue(A_FSG_4_0_0_25_Data_8_4, 1);
	else
		putValue(A_FSG_4_0_0_25_Data_8_4, 0);
	if(thisval&(mask<<5))
		putValue(A_FSG_4_0_0_25_Data_8_5, 1);
	else
		putValue(A_FSG_4_0_0_25_Data_8_5, 0);
	if(thisval&(mask<<6))
		putValue(A_FSG_4_0_0_25_Data_8_6, 1);
	else
		putValue(A_FSG_4_0_0_25_Data_8_6, 0);
	if(thisval&(mask<<7))
		putValue(A_FSG_4_0_0_25_Data_8_7, 1);
	else
		putValue(A_FSG_4_0_0_25_Data_8_7, 0);
    A_FSG_4_0_0_25_ArrayDataList[getValue(A_FSG_4_0_0_25_DataIndex)].Param8 = thisval;
}
on envVar A_FSG_4_0_0_25_Data_9_0
{
	byte bitval;
	//thisval steht hier fuer den bitfield-wert, 
	//aus Generierungsgruenden hier keine einheitliche Bezeichnung moeglich.
	byte thisval; // DisplaySectionSelection3
	bitval= getValue(this);
	thisval = getValue(A_FSG_4_0_0_25_Data_9);
	thisval = thisval&~(1<<0)|(bitval<<0);
	putValue(A_FSG_4_0_0_25_Data_9,thisval);
}

on envVar A_FSG_4_0_0_25_Data_9_1
{
	byte bitval;
	//thisval steht hier fuer den bitfield-wert, 
	//aus Generierungsgruenden hier keine einheitliche Bezeichnung moeglich.
	byte thisval; // DisplaySectionSelection3
	bitval= getValue(this);
	thisval = getValue(A_FSG_4_0_0_25_Data_9);
	thisval = thisval&~(1<<1)|(bitval<<1);
	putValue(A_FSG_4_0_0_25_Data_9,thisval);
}

on envVar A_FSG_4_0_0_25_Data_9_2
{
	byte bitval;
	//thisval steht hier fuer den bitfield-wert, 
	//aus Generierungsgruenden hier keine einheitliche Bezeichnung moeglich.
	byte thisval; // DisplaySectionSelection3
	bitval= getValue(this);
	thisval = getValue(A_FSG_4_0_0_25_Data_9);
	thisval = thisval&~(1<<2)|(bitval<<2);
	putValue(A_FSG_4_0_0_25_Data_9,thisval);
}

on envVar A_FSG_4_0_0_25_Data_9_3
{
	byte bitval;
	//thisval steht hier fuer den bitfield-wert, 
	//aus Generierungsgruenden hier keine einheitliche Bezeichnung moeglich.
	byte thisval; // DisplaySectionSelection3
	bitval= getValue(this);
	thisval = getValue(A_FSG_4_0_0_25_Data_9);
	thisval = thisval&~(1<<3)|(bitval<<3);
	putValue(A_FSG_4_0_0_25_Data_9,thisval);
}

on envVar A_FSG_4_0_0_25_Data_9_4
{
	byte bitval;
	//thisval steht hier fuer den bitfield-wert, 
	//aus Generierungsgruenden hier keine einheitliche Bezeichnung moeglich.
	byte thisval; // DisplaySectionSelection3
	bitval= getValue(this);
	thisval = getValue(A_FSG_4_0_0_25_Data_9);
	thisval = thisval&~(1<<4)|(bitval<<4);
	putValue(A_FSG_4_0_0_25_Data_9,thisval);
}

on envVar A_FSG_4_0_0_25_Data_9_5
{
	byte bitval;
	//thisval steht hier fuer den bitfield-wert, 
	//aus Generierungsgruenden hier keine einheitliche Bezeichnung moeglich.
	byte thisval; // DisplaySectionSelection3
	bitval= getValue(this);
	thisval = getValue(A_FSG_4_0_0_25_Data_9);
	thisval = thisval&~(1<<5)|(bitval<<5);
	putValue(A_FSG_4_0_0_25_Data_9,thisval);
}

on envVar A_FSG_4_0_0_25_Data_9_6
{
	byte bitval;
	//thisval steht hier fuer den bitfield-wert, 
	//aus Generierungsgruenden hier keine einheitliche Bezeichnung moeglich.
	byte thisval; // DisplaySectionSelection3
	bitval= getValue(this);
	thisval = getValue(A_FSG_4_0_0_25_Data_9);
	thisval = thisval&~(1<<6)|(bitval<<6);
	putValue(A_FSG_4_0_0_25_Data_9,thisval);
}

on envVar A_FSG_4_0_0_25_Data_9_7
{
	byte bitval;
	//thisval steht hier fuer den bitfield-wert, 
	//aus Generierungsgruenden hier keine einheitliche Bezeichnung moeglich.
	byte thisval; // DisplaySectionSelection3
	bitval= getValue(this);
	thisval = getValue(A_FSG_4_0_0_25_Data_9);
	thisval = thisval&~(1<<7)|(bitval<<7);
	putValue(A_FSG_4_0_0_25_Data_9,thisval);
}

on envVar A_FSG_4_0_0_25_Data_9
{

	//Update Childvalue (BitField)
	byte mask=0x01;
	int i = 0;
	byte thisval; // DisplaySectionSelection3
	thisval = getValue(this);
	if(thisval&(mask<<0))
		putValue(A_FSG_4_0_0_25_Data_9_0, 1);
	else
		putValue(A_FSG_4_0_0_25_Data_9_0, 0);
	if(thisval&(mask<<1))
		putValue(A_FSG_4_0_0_25_Data_9_1, 1);
	else
		putValue(A_FSG_4_0_0_25_Data_9_1, 0);
	if(thisval&(mask<<2))
		putValue(A_FSG_4_0_0_25_Data_9_2, 1);
	else
		putValue(A_FSG_4_0_0_25_Data_9_2, 0);
	if(thisval&(mask<<3))
		putValue(A_FSG_4_0_0_25_Data_9_3, 1);
	else
		putValue(A_FSG_4_0_0_25_Data_9_3, 0);
	if(thisval&(mask<<4))
		putValue(A_FSG_4_0_0_25_Data_9_4, 1);
	else
		putValue(A_FSG_4_0_0_25_Data_9_4, 0);
	if(thisval&(mask<<5))
		putValue(A_FSG_4_0_0_25_Data_9_5, 1);
	else
		putValue(A_FSG_4_0_0_25_Data_9_5, 0);
	if(thisval&(mask<<6))
		putValue(A_FSG_4_0_0_25_Data_9_6, 1);
	else
		putValue(A_FSG_4_0_0_25_Data_9_6, 0);
	if(thisval&(mask<<7))
		putValue(A_FSG_4_0_0_25_Data_9_7, 1);
	else
		putValue(A_FSG_4_0_0_25_Data_9_7, 0);
    A_FSG_4_0_0_25_ArrayDataList[getValue(A_FSG_4_0_0_25_DataIndex)].Param9 = thisval;
}
on envVar A_FSG_4_0_0_25_Data_10_0
{
	byte bitval;
	//thisval steht hier fuer den bitfield-wert, 
	//aus Generierungsgruenden hier keine einheitliche Bezeichnung moeglich.
	byte thisval; // DisplaySectionSelection4
	bitval= getValue(this);
	thisval = getValue(A_FSG_4_0_0_25_Data_10);
	thisval = thisval&~(1<<0)|(bitval<<0);
	putValue(A_FSG_4_0_0_25_Data_10,thisval);
}

on envVar A_FSG_4_0_0_25_Data_10_1
{
	byte bitval;
	//thisval steht hier fuer den bitfield-wert, 
	//aus Generierungsgruenden hier keine einheitliche Bezeichnung moeglich.
	byte thisval; // DisplaySectionSelection4
	bitval= getValue(this);
	thisval = getValue(A_FSG_4_0_0_25_Data_10);
	thisval = thisval&~(1<<1)|(bitval<<1);
	putValue(A_FSG_4_0_0_25_Data_10,thisval);
}

on envVar A_FSG_4_0_0_25_Data_10_2
{
	byte bitval;
	//thisval steht hier fuer den bitfield-wert, 
	//aus Generierungsgruenden hier keine einheitliche Bezeichnung moeglich.
	byte thisval; // DisplaySectionSelection4
	bitval= getValue(this);
	thisval = getValue(A_FSG_4_0_0_25_Data_10);
	thisval = thisval&~(1<<2)|(bitval<<2);
	putValue(A_FSG_4_0_0_25_Data_10,thisval);
}

on envVar A_FSG_4_0_0_25_Data_10_3
{
	byte bitval;
	//thisval steht hier fuer den bitfield-wert, 
	//aus Generierungsgruenden hier keine einheitliche Bezeichnung moeglich.
	byte thisval; // DisplaySectionSelection4
	bitval= getValue(this);
	thisval = getValue(A_FSG_4_0_0_25_Data_10);
	thisval = thisval&~(1<<3)|(bitval<<3);
	putValue(A_FSG_4_0_0_25_Data_10,thisval);
}

on envVar A_FSG_4_0_0_25_Data_10
{

	//Update Childvalue (BitField)
	byte mask=0x01;
	int i = 0;
	byte thisval; // DisplaySectionSelection4
	thisval = getValue(this);
	if(thisval&(mask<<0))
		putValue(A_FSG_4_0_0_25_Data_10_0, 1);
	else
		putValue(A_FSG_4_0_0_25_Data_10_0, 0);
	if(thisval&(mask<<1))
		putValue(A_FSG_4_0_0_25_Data_10_1, 1);
	else
		putValue(A_FSG_4_0_0_25_Data_10_1, 0);
	if(thisval&(mask<<2))
		putValue(A_FSG_4_0_0_25_Data_10_2, 1);
	else
		putValue(A_FSG_4_0_0_25_Data_10_2, 0);
	if(thisval&(mask<<3))
		putValue(A_FSG_4_0_0_25_Data_10_3, 1);
	else
		putValue(A_FSG_4_0_0_25_Data_10_3, 0);
    A_FSG_4_0_0_25_ArrayDataList[getValue(A_FSG_4_0_0_25_DataIndex)].Param10 = thisval;
}
on envVar A_FSG_4_0_0_25_1_SetGet
{

	//Update Childvalue (Enum)
	byte thisval; // ASG_ID
	thisval = 0x0f & getValue(this);
}
// Ueberwachung der Darstellungsvariable der Range.
on envVar A_FSG_4_0_0_25_2_SetGet_range // SectionConfig.TAID 
{
	@A_FSG_4_0_0_25_2_SetGet = @A_FSG_4_0_0_25_2_SetGet_range - (0); // slider = range - min
}

on envVar A_FSG_4_0_0_25_2_SetGet
{

	//Update Childvalue (Number)
	byte thisval; // TAID
	float slider_value;

	slider_value = round(@A_FSG_4_0_0_25_2_SetGet, 1.0);
	@A_FSG_4_0_0_25_2_SetGet_range = slider_value + (0); // real value := slider value + range min.
	thisval = (byte)round((slider_value + (0) - (0)) / (1.0), 1); // bus value := (slider value + min - offset) / step.
}
// Ueberwachung der Darstellungsvariable der Range.
on envVar A_FSG_4_0_0_25_Data_1_SetGet_range // SectionConfig.Pos 
{
	@A_FSG_4_0_0_25_Data_1_SetGet = @A_FSG_4_0_0_25_Data_1_SetGet_range - (0); // slider = range - min
}

on envVar A_FSG_4_0_0_25_Data_1_SetGet
{

	//Update Childvalue (Number)
	byte thisval; // Pos
	float slider_value;

	slider_value = round(@A_FSG_4_0_0_25_Data_1_SetGet, 1.0);
	@A_FSG_4_0_0_25_Data_1_SetGet_range = slider_value + (0); // real value := slider value + range min.
	thisval = (byte)round((slider_value + (0) - (0)) / (1.0), 1); // bus value := (slider value + min - offset) / step.
    A_FSG_4_0_0_25_ArrayDataList[getValue(A_FSG_4_0_0_25_DataIndex_SetGet)].Param1 = thisval;
}
// Ueberwachung der Darstellungsvariable der Range.
on envVar A_FSG_4_0_0_25_Data_2_SetGet_range // SectionConfig.DisplaySection 
{
	@A_FSG_4_0_0_25_Data_2_SetGet = @A_FSG_4_0_0_25_Data_2_SetGet_range - (1); // slider = range - min
}

on envVar A_FSG_4_0_0_25_Data_2_SetGet
{

	//Update Childvalue (Number)
	byte thisval; // DisplaySection
	float slider_value;

	slider_value = round(@A_FSG_4_0_0_25_Data_2_SetGet, 1.0);
	@A_FSG_4_0_0_25_Data_2_SetGet_range = slider_value + (1); // real value := slider value + range min.
	thisval = (byte)round((slider_value + (1) - (1)) / (1.0), 1); // bus value := (slider value + min - offset) / step.
    A_FSG_4_0_0_25_ArrayDataList[getValue(A_FSG_4_0_0_25_DataIndex_SetGet)].Param2 = thisval;
}
on envVar A_FSG_4_0_0_25_Data_3_SetGet_0
{
	byte bitval;
	//thisval steht hier fuer den bitfield-wert, 
	//aus Generierungsgruenden hier keine einheitliche Bezeichnung moeglich.
	byte thisval; // DisplaySectionSetup1
	bitval= getValue(this);
	thisval = getValue(A_FSG_4_0_0_25_Data_3_SetGet);
	thisval = thisval&~(1<<0)|(bitval<<0);
	putValue(A_FSG_4_0_0_25_Data_3_SetGet,thisval);
}

on envVar A_FSG_4_0_0_25_Data_3_SetGet_1
{
	byte bitval;
	//thisval steht hier fuer den bitfield-wert, 
	//aus Generierungsgruenden hier keine einheitliche Bezeichnung moeglich.
	byte thisval; // DisplaySectionSetup1
	bitval= getValue(this);
	thisval = getValue(A_FSG_4_0_0_25_Data_3_SetGet);
	thisval = thisval&~(1<<1)|(bitval<<1);
	putValue(A_FSG_4_0_0_25_Data_3_SetGet,thisval);
}

on envVar A_FSG_4_0_0_25_Data_3_SetGet_2
{
	byte bitval;
	//thisval steht hier fuer den bitfield-wert, 
	//aus Generierungsgruenden hier keine einheitliche Bezeichnung moeglich.
	byte thisval; // DisplaySectionSetup1
	bitval= getValue(this);
	thisval = getValue(A_FSG_4_0_0_25_Data_3_SetGet);
	thisval = thisval&~(1<<2)|(bitval<<2);
	putValue(A_FSG_4_0_0_25_Data_3_SetGet,thisval);
}

on envVar A_FSG_4_0_0_25_Data_3_SetGet_3
{
	byte bitval;
	//thisval steht hier fuer den bitfield-wert, 
	//aus Generierungsgruenden hier keine einheitliche Bezeichnung moeglich.
	byte thisval; // DisplaySectionSetup1
	bitval= getValue(this);
	thisval = getValue(A_FSG_4_0_0_25_Data_3_SetGet);
	thisval = thisval&~(1<<3)|(bitval<<3);
	putValue(A_FSG_4_0_0_25_Data_3_SetGet,thisval);
}

on envVar A_FSG_4_0_0_25_Data_3_SetGet_4
{
	byte bitval;
	//thisval steht hier fuer den bitfield-wert, 
	//aus Generierungsgruenden hier keine einheitliche Bezeichnung moeglich.
	byte thisval; // DisplaySectionSetup1
	bitval= getValue(this);
	thisval = getValue(A_FSG_4_0_0_25_Data_3_SetGet);
	thisval = thisval&~(1<<4)|(bitval<<4);
	putValue(A_FSG_4_0_0_25_Data_3_SetGet,thisval);
}

on envVar A_FSG_4_0_0_25_Data_3_SetGet_5
{
	byte bitval;
	//thisval steht hier fuer den bitfield-wert, 
	//aus Generierungsgruenden hier keine einheitliche Bezeichnung moeglich.
	byte thisval; // DisplaySectionSetup1
	bitval= getValue(this);
	thisval = getValue(A_FSG_4_0_0_25_Data_3_SetGet);
	thisval = thisval&~(1<<5)|(bitval<<5);
	putValue(A_FSG_4_0_0_25_Data_3_SetGet,thisval);
}

on envVar A_FSG_4_0_0_25_Data_3_SetGet_6
{
	byte bitval;
	//thisval steht hier fuer den bitfield-wert, 
	//aus Generierungsgruenden hier keine einheitliche Bezeichnung moeglich.
	byte thisval; // DisplaySectionSetup1
	bitval= getValue(this);
	thisval = getValue(A_FSG_4_0_0_25_Data_3_SetGet);
	thisval = thisval&~(1<<6)|(bitval<<6);
	putValue(A_FSG_4_0_0_25_Data_3_SetGet,thisval);
}

on envVar A_FSG_4_0_0_25_Data_3_SetGet_7
{
	byte bitval;
	//thisval steht hier fuer den bitfield-wert, 
	//aus Generierungsgruenden hier keine einheitliche Bezeichnung moeglich.
	byte thisval; // DisplaySectionSetup1
	bitval= getValue(this);
	thisval = getValue(A_FSG_4_0_0_25_Data_3_SetGet);
	thisval = thisval&~(1<<7)|(bitval<<7);
	putValue(A_FSG_4_0_0_25_Data_3_SetGet,thisval);
}

on envVar A_FSG_4_0_0_25_Data_3_SetGet
{

	//Update Childvalue (BitField)
	byte mask=0x01;
	int i = 0;
	byte thisval; // DisplaySectionSetup1
	thisval = getValue(this);
	if(thisval&(mask<<0))
		putValue(A_FSG_4_0_0_25_Data_3_SetGet_0, 1);
	else
		putValue(A_FSG_4_0_0_25_Data_3_SetGet_0, 0);
	if(thisval&(mask<<1))
		putValue(A_FSG_4_0_0_25_Data_3_SetGet_1, 1);
	else
		putValue(A_FSG_4_0_0_25_Data_3_SetGet_1, 0);
	if(thisval&(mask<<2))
		putValue(A_FSG_4_0_0_25_Data_3_SetGet_2, 1);
	else
		putValue(A_FSG_4_0_0_25_Data_3_SetGet_2, 0);
	if(thisval&(mask<<3))
		putValue(A_FSG_4_0_0_25_Data_3_SetGet_3, 1);
	else
		putValue(A_FSG_4_0_0_25_Data_3_SetGet_3, 0);
	if(thisval&(mask<<4))
		putValue(A_FSG_4_0_0_25_Data_3_SetGet_4, 1);
	else
		putValue(A_FSG_4_0_0_25_Data_3_SetGet_4, 0);
	if(thisval&(mask<<5))
		putValue(A_FSG_4_0_0_25_Data_3_SetGet_5, 1);
	else
		putValue(A_FSG_4_0_0_25_Data_3_SetGet_5, 0);
	if(thisval&(mask<<6))
		putValue(A_FSG_4_0_0_25_Data_3_SetGet_6, 1);
	else
		putValue(A_FSG_4_0_0_25_Data_3_SetGet_6, 0);
	if(thisval&(mask<<7))
		putValue(A_FSG_4_0_0_25_Data_3_SetGet_7, 1);
	else
		putValue(A_FSG_4_0_0_25_Data_3_SetGet_7, 0);
    A_FSG_4_0_0_25_ArrayDataList[getValue(A_FSG_4_0_0_25_DataIndex_SetGet)].Param3 = thisval;
}
on envVar A_FSG_4_0_0_25_Data_4_SetGet_0
{
	byte bitval;
	//thisval steht hier fuer den bitfield-wert, 
	//aus Generierungsgruenden hier keine einheitliche Bezeichnung moeglich.
	byte thisval; // DisplaySectionSetup2
	bitval= getValue(this);
	thisval = getValue(A_FSG_4_0_0_25_Data_4_SetGet);
	thisval = thisval&~(1<<0)|(bitval<<0);
	putValue(A_FSG_4_0_0_25_Data_4_SetGet,thisval);
}

on envVar A_FSG_4_0_0_25_Data_4_SetGet_1
{
	byte bitval;
	//thisval steht hier fuer den bitfield-wert, 
	//aus Generierungsgruenden hier keine einheitliche Bezeichnung moeglich.
	byte thisval; // DisplaySectionSetup2
	bitval= getValue(this);
	thisval = getValue(A_FSG_4_0_0_25_Data_4_SetGet);
	thisval = thisval&~(1<<1)|(bitval<<1);
	putValue(A_FSG_4_0_0_25_Data_4_SetGet,thisval);
}

on envVar A_FSG_4_0_0_25_Data_4_SetGet_2
{
	byte bitval;
	//thisval steht hier fuer den bitfield-wert, 
	//aus Generierungsgruenden hier keine einheitliche Bezeichnung moeglich.
	byte thisval; // DisplaySectionSetup2
	bitval= getValue(this);
	thisval = getValue(A_FSG_4_0_0_25_Data_4_SetGet);
	thisval = thisval&~(1<<2)|(bitval<<2);
	putValue(A_FSG_4_0_0_25_Data_4_SetGet,thisval);
}

on envVar A_FSG_4_0_0_25_Data_4_SetGet_3
{
	byte bitval;
	//thisval steht hier fuer den bitfield-wert, 
	//aus Generierungsgruenden hier keine einheitliche Bezeichnung moeglich.
	byte thisval; // DisplaySectionSetup2
	bitval= getValue(this);
	thisval = getValue(A_FSG_4_0_0_25_Data_4_SetGet);
	thisval = thisval&~(1<<3)|(bitval<<3);
	putValue(A_FSG_4_0_0_25_Data_4_SetGet,thisval);
}

on envVar A_FSG_4_0_0_25_Data_4_SetGet_4
{
	byte bitval;
	//thisval steht hier fuer den bitfield-wert, 
	//aus Generierungsgruenden hier keine einheitliche Bezeichnung moeglich.
	byte thisval; // DisplaySectionSetup2
	bitval= getValue(this);
	thisval = getValue(A_FSG_4_0_0_25_Data_4_SetGet);
	thisval = thisval&~(1<<4)|(bitval<<4);
	putValue(A_FSG_4_0_0_25_Data_4_SetGet,thisval);
}

on envVar A_FSG_4_0_0_25_Data_4_SetGet_5
{
	byte bitval;
	//thisval steht hier fuer den bitfield-wert, 
	//aus Generierungsgruenden hier keine einheitliche Bezeichnung moeglich.
	byte thisval; // DisplaySectionSetup2
	bitval= getValue(this);
	thisval = getValue(A_FSG_4_0_0_25_Data_4_SetGet);
	thisval = thisval&~(1<<5)|(bitval<<5);
	putValue(A_FSG_4_0_0_25_Data_4_SetGet,thisval);
}

on envVar A_FSG_4_0_0_25_Data_4_SetGet_6
{
	byte bitval;
	//thisval steht hier fuer den bitfield-wert, 
	//aus Generierungsgruenden hier keine einheitliche Bezeichnung moeglich.
	byte thisval; // DisplaySectionSetup2
	bitval= getValue(this);
	thisval = getValue(A_FSG_4_0_0_25_Data_4_SetGet);
	thisval = thisval&~(1<<6)|(bitval<<6);
	putValue(A_FSG_4_0_0_25_Data_4_SetGet,thisval);
}

on envVar A_FSG_4_0_0_25_Data_4_SetGet_7
{
	byte bitval;
	//thisval steht hier fuer den bitfield-wert, 
	//aus Generierungsgruenden hier keine einheitliche Bezeichnung moeglich.
	byte thisval; // DisplaySectionSetup2
	bitval= getValue(this);
	thisval = getValue(A_FSG_4_0_0_25_Data_4_SetGet);
	thisval = thisval&~(1<<7)|(bitval<<7);
	putValue(A_FSG_4_0_0_25_Data_4_SetGet,thisval);
}

on envVar A_FSG_4_0_0_25_Data_4_SetGet
{

	//Update Childvalue (BitField)
	byte mask=0x01;
	int i = 0;
	byte thisval; // DisplaySectionSetup2
	thisval = getValue(this);
	if(thisval&(mask<<0))
		putValue(A_FSG_4_0_0_25_Data_4_SetGet_0, 1);
	else
		putValue(A_FSG_4_0_0_25_Data_4_SetGet_0, 0);
	if(thisval&(mask<<1))
		putValue(A_FSG_4_0_0_25_Data_4_SetGet_1, 1);
	else
		putValue(A_FSG_4_0_0_25_Data_4_SetGet_1, 0);
	if(thisval&(mask<<2))
		putValue(A_FSG_4_0_0_25_Data_4_SetGet_2, 1);
	else
		putValue(A_FSG_4_0_0_25_Data_4_SetGet_2, 0);
	if(thisval&(mask<<3))
		putValue(A_FSG_4_0_0_25_Data_4_SetGet_3, 1);
	else
		putValue(A_FSG_4_0_0_25_Data_4_SetGet_3, 0);
	if(thisval&(mask<<4))
		putValue(A_FSG_4_0_0_25_Data_4_SetGet_4, 1);
	else
		putValue(A_FSG_4_0_0_25_Data_4_SetGet_4, 0);
	if(thisval&(mask<<5))
		putValue(A_FSG_4_0_0_25_Data_4_SetGet_5, 1);
	else
		putValue(A_FSG_4_0_0_25_Data_4_SetGet_5, 0);
	if(thisval&(mask<<6))
		putValue(A_FSG_4_0_0_25_Data_4_SetGet_6, 1);
	else
		putValue(A_FSG_4_0_0_25_Data_4_SetGet_6, 0);
	if(thisval&(mask<<7))
		putValue(A_FSG_4_0_0_25_Data_4_SetGet_7, 1);
	else
		putValue(A_FSG_4_0_0_25_Data_4_SetGet_7, 0);
    A_FSG_4_0_0_25_ArrayDataList[getValue(A_FSG_4_0_0_25_DataIndex_SetGet)].Param4 = thisval;
}
on envVar A_FSG_4_0_0_25_Data_5_SetGet_0
{
	byte bitval;
	//thisval steht hier fuer den bitfield-wert, 
	//aus Generierungsgruenden hier keine einheitliche Bezeichnung moeglich.
	byte thisval; // DisplaySectionSetup3
	bitval= getValue(this);
	thisval = getValue(A_FSG_4_0_0_25_Data_5_SetGet);
	thisval = thisval&~(1<<0)|(bitval<<0);
	putValue(A_FSG_4_0_0_25_Data_5_SetGet,thisval);
}

on envVar A_FSG_4_0_0_25_Data_5_SetGet_1
{
	byte bitval;
	//thisval steht hier fuer den bitfield-wert, 
	//aus Generierungsgruenden hier keine einheitliche Bezeichnung moeglich.
	byte thisval; // DisplaySectionSetup3
	bitval= getValue(this);
	thisval = getValue(A_FSG_4_0_0_25_Data_5_SetGet);
	thisval = thisval&~(1<<1)|(bitval<<1);
	putValue(A_FSG_4_0_0_25_Data_5_SetGet,thisval);
}

on envVar A_FSG_4_0_0_25_Data_5_SetGet_2
{
	byte bitval;
	//thisval steht hier fuer den bitfield-wert, 
	//aus Generierungsgruenden hier keine einheitliche Bezeichnung moeglich.
	byte thisval; // DisplaySectionSetup3
	bitval= getValue(this);
	thisval = getValue(A_FSG_4_0_0_25_Data_5_SetGet);
	thisval = thisval&~(1<<2)|(bitval<<2);
	putValue(A_FSG_4_0_0_25_Data_5_SetGet,thisval);
}

on envVar A_FSG_4_0_0_25_Data_5_SetGet_3
{
	byte bitval;
	//thisval steht hier fuer den bitfield-wert, 
	//aus Generierungsgruenden hier keine einheitliche Bezeichnung moeglich.
	byte thisval; // DisplaySectionSetup3
	bitval= getValue(this);
	thisval = getValue(A_FSG_4_0_0_25_Data_5_SetGet);
	thisval = thisval&~(1<<3)|(bitval<<3);
	putValue(A_FSG_4_0_0_25_Data_5_SetGet,thisval);
}

on envVar A_FSG_4_0_0_25_Data_5_SetGet_4
{
	byte bitval;
	//thisval steht hier fuer den bitfield-wert, 
	//aus Generierungsgruenden hier keine einheitliche Bezeichnung moeglich.
	byte thisval; // DisplaySectionSetup3
	bitval= getValue(this);
	thisval = getValue(A_FSG_4_0_0_25_Data_5_SetGet);
	thisval = thisval&~(1<<4)|(bitval<<4);
	putValue(A_FSG_4_0_0_25_Data_5_SetGet,thisval);
}

on envVar A_FSG_4_0_0_25_Data_5_SetGet_5
{
	byte bitval;
	//thisval steht hier fuer den bitfield-wert, 
	//aus Generierungsgruenden hier keine einheitliche Bezeichnung moeglich.
	byte thisval; // DisplaySectionSetup3
	bitval= getValue(this);
	thisval = getValue(A_FSG_4_0_0_25_Data_5_SetGet);
	thisval = thisval&~(1<<5)|(bitval<<5);
	putValue(A_FSG_4_0_0_25_Data_5_SetGet,thisval);
}

on envVar A_FSG_4_0_0_25_Data_5_SetGet_6
{
	byte bitval;
	//thisval steht hier fuer den bitfield-wert, 
	//aus Generierungsgruenden hier keine einheitliche Bezeichnung moeglich.
	byte thisval; // DisplaySectionSetup3
	bitval= getValue(this);
	thisval = getValue(A_FSG_4_0_0_25_Data_5_SetGet);
	thisval = thisval&~(1<<6)|(bitval<<6);
	putValue(A_FSG_4_0_0_25_Data_5_SetGet,thisval);
}

on envVar A_FSG_4_0_0_25_Data_5_SetGet_7
{
	byte bitval;
	//thisval steht hier fuer den bitfield-wert, 
	//aus Generierungsgruenden hier keine einheitliche Bezeichnung moeglich.
	byte thisval; // DisplaySectionSetup3
	bitval= getValue(this);
	thisval = getValue(A_FSG_4_0_0_25_Data_5_SetGet);
	thisval = thisval&~(1<<7)|(bitval<<7);
	putValue(A_FSG_4_0_0_25_Data_5_SetGet,thisval);
}

on envVar A_FSG_4_0_0_25_Data_5_SetGet
{

	//Update Childvalue (BitField)
	byte mask=0x01;
	int i = 0;
	byte thisval; // DisplaySectionSetup3
	thisval = getValue(this);
	if(thisval&(mask<<0))
		putValue(A_FSG_4_0_0_25_Data_5_SetGet_0, 1);
	else
		putValue(A_FSG_4_0_0_25_Data_5_SetGet_0, 0);
	if(thisval&(mask<<1))
		putValue(A_FSG_4_0_0_25_Data_5_SetGet_1, 1);
	else
		putValue(A_FSG_4_0_0_25_Data_5_SetGet_1, 0);
	if(thisval&(mask<<2))
		putValue(A_FSG_4_0_0_25_Data_5_SetGet_2, 1);
	else
		putValue(A_FSG_4_0_0_25_Data_5_SetGet_2, 0);
	if(thisval&(mask<<3))
		putValue(A_FSG_4_0_0_25_Data_5_SetGet_3, 1);
	else
		putValue(A_FSG_4_0_0_25_Data_5_SetGet_3, 0);
	if(thisval&(mask<<4))
		putValue(A_FSG_4_0_0_25_Data_5_SetGet_4, 1);
	else
		putValue(A_FSG_4_0_0_25_Data_5_SetGet_4, 0);
	if(thisval&(mask<<5))
		putValue(A_FSG_4_0_0_25_Data_5_SetGet_5, 1);
	else
		putValue(A_FSG_4_0_0_25_Data_5_SetGet_5, 0);
	if(thisval&(mask<<6))
		putValue(A_FSG_4_0_0_25_Data_5_SetGet_6, 1);
	else
		putValue(A_FSG_4_0_0_25_Data_5_SetGet_6, 0);
	if(thisval&(mask<<7))
		putValue(A_FSG_4_0_0_25_Data_5_SetGet_7, 1);
	else
		putValue(A_FSG_4_0_0_25_Data_5_SetGet_7, 0);
    A_FSG_4_0_0_25_ArrayDataList[getValue(A_FSG_4_0_0_25_DataIndex_SetGet)].Param5 = thisval;
}
on envVar A_FSG_4_0_0_25_Data_6_SetGet_0
{
	byte bitval;
	//thisval steht hier fuer den bitfield-wert, 
	//aus Generierungsgruenden hier keine einheitliche Bezeichnung moeglich.
	byte thisval; // DisplaySectionSetup4
	bitval= getValue(this);
	thisval = getValue(A_FSG_4_0_0_25_Data_6_SetGet);
	thisval = thisval&~(1<<0)|(bitval<<0);
	putValue(A_FSG_4_0_0_25_Data_6_SetGet,thisval);
}

on envVar A_FSG_4_0_0_25_Data_6_SetGet_1
{
	byte bitval;
	//thisval steht hier fuer den bitfield-wert, 
	//aus Generierungsgruenden hier keine einheitliche Bezeichnung moeglich.
	byte thisval; // DisplaySectionSetup4
	bitval= getValue(this);
	thisval = getValue(A_FSG_4_0_0_25_Data_6_SetGet);
	thisval = thisval&~(1<<1)|(bitval<<1);
	putValue(A_FSG_4_0_0_25_Data_6_SetGet,thisval);
}

on envVar A_FSG_4_0_0_25_Data_6_SetGet_2
{
	byte bitval;
	//thisval steht hier fuer den bitfield-wert, 
	//aus Generierungsgruenden hier keine einheitliche Bezeichnung moeglich.
	byte thisval; // DisplaySectionSetup4
	bitval= getValue(this);
	thisval = getValue(A_FSG_4_0_0_25_Data_6_SetGet);
	thisval = thisval&~(1<<2)|(bitval<<2);
	putValue(A_FSG_4_0_0_25_Data_6_SetGet,thisval);
}

on envVar A_FSG_4_0_0_25_Data_6_SetGet_3
{
	byte bitval;
	//thisval steht hier fuer den bitfield-wert, 
	//aus Generierungsgruenden hier keine einheitliche Bezeichnung moeglich.
	byte thisval; // DisplaySectionSetup4
	bitval= getValue(this);
	thisval = getValue(A_FSG_4_0_0_25_Data_6_SetGet);
	thisval = thisval&~(1<<3)|(bitval<<3);
	putValue(A_FSG_4_0_0_25_Data_6_SetGet,thisval);
}

on envVar A_FSG_4_0_0_25_Data_6_SetGet
{

	//Update Childvalue (BitField)
	byte mask=0x01;
	int i = 0;
	byte thisval; // DisplaySectionSetup4
	thisval = getValue(this);
	if(thisval&(mask<<0))
		putValue(A_FSG_4_0_0_25_Data_6_SetGet_0, 1);
	else
		putValue(A_FSG_4_0_0_25_Data_6_SetGet_0, 0);
	if(thisval&(mask<<1))
		putValue(A_FSG_4_0_0_25_Data_6_SetGet_1, 1);
	else
		putValue(A_FSG_4_0_0_25_Data_6_SetGet_1, 0);
	if(thisval&(mask<<2))
		putValue(A_FSG_4_0_0_25_Data_6_SetGet_2, 1);
	else
		putValue(A_FSG_4_0_0_25_Data_6_SetGet_2, 0);
	if(thisval&(mask<<3))
		putValue(A_FSG_4_0_0_25_Data_6_SetGet_3, 1);
	else
		putValue(A_FSG_4_0_0_25_Data_6_SetGet_3, 0);
    A_FSG_4_0_0_25_ArrayDataList[getValue(A_FSG_4_0_0_25_DataIndex_SetGet)].Param6 = thisval;
}
on envVar A_FSG_4_0_0_25_Data_7_SetGet_0
{
	byte bitval;
	//thisval steht hier fuer den bitfield-wert, 
	//aus Generierungsgruenden hier keine einheitliche Bezeichnung moeglich.
	byte thisval; // DisplaySectionSelection1
	bitval= getValue(this);
	thisval = getValue(A_FSG_4_0_0_25_Data_7_SetGet);
	thisval = thisval&~(1<<0)|(bitval<<0);
	putValue(A_FSG_4_0_0_25_Data_7_SetGet,thisval);
}

on envVar A_FSG_4_0_0_25_Data_7_SetGet_1
{
	byte bitval;
	//thisval steht hier fuer den bitfield-wert, 
	//aus Generierungsgruenden hier keine einheitliche Bezeichnung moeglich.
	byte thisval; // DisplaySectionSelection1
	bitval= getValue(this);
	thisval = getValue(A_FSG_4_0_0_25_Data_7_SetGet);
	thisval = thisval&~(1<<1)|(bitval<<1);
	putValue(A_FSG_4_0_0_25_Data_7_SetGet,thisval);
}

on envVar A_FSG_4_0_0_25_Data_7_SetGet_2
{
	byte bitval;
	//thisval steht hier fuer den bitfield-wert, 
	//aus Generierungsgruenden hier keine einheitliche Bezeichnung moeglich.
	byte thisval; // DisplaySectionSelection1
	bitval= getValue(this);
	thisval = getValue(A_FSG_4_0_0_25_Data_7_SetGet);
	thisval = thisval&~(1<<2)|(bitval<<2);
	putValue(A_FSG_4_0_0_25_Data_7_SetGet,thisval);
}

on envVar A_FSG_4_0_0_25_Data_7_SetGet_3
{
	byte bitval;
	//thisval steht hier fuer den bitfield-wert, 
	//aus Generierungsgruenden hier keine einheitliche Bezeichnung moeglich.
	byte thisval; // DisplaySectionSelection1
	bitval= getValue(this);
	thisval = getValue(A_FSG_4_0_0_25_Data_7_SetGet);
	thisval = thisval&~(1<<3)|(bitval<<3);
	putValue(A_FSG_4_0_0_25_Data_7_SetGet,thisval);
}

on envVar A_FSG_4_0_0_25_Data_7_SetGet_4
{
	byte bitval;
	//thisval steht hier fuer den bitfield-wert, 
	//aus Generierungsgruenden hier keine einheitliche Bezeichnung moeglich.
	byte thisval; // DisplaySectionSelection1
	bitval= getValue(this);
	thisval = getValue(A_FSG_4_0_0_25_Data_7_SetGet);
	thisval = thisval&~(1<<4)|(bitval<<4);
	putValue(A_FSG_4_0_0_25_Data_7_SetGet,thisval);
}

on envVar A_FSG_4_0_0_25_Data_7_SetGet_5
{
	byte bitval;
	//thisval steht hier fuer den bitfield-wert, 
	//aus Generierungsgruenden hier keine einheitliche Bezeichnung moeglich.
	byte thisval; // DisplaySectionSelection1
	bitval= getValue(this);
	thisval = getValue(A_FSG_4_0_0_25_Data_7_SetGet);
	thisval = thisval&~(1<<5)|(bitval<<5);
	putValue(A_FSG_4_0_0_25_Data_7_SetGet,thisval);
}

on envVar A_FSG_4_0_0_25_Data_7_SetGet_6
{
	byte bitval;
	//thisval steht hier fuer den bitfield-wert, 
	//aus Generierungsgruenden hier keine einheitliche Bezeichnung moeglich.
	byte thisval; // DisplaySectionSelection1
	bitval= getValue(this);
	thisval = getValue(A_FSG_4_0_0_25_Data_7_SetGet);
	thisval = thisval&~(1<<6)|(bitval<<6);
	putValue(A_FSG_4_0_0_25_Data_7_SetGet,thisval);
}

on envVar A_FSG_4_0_0_25_Data_7_SetGet_7
{
	byte bitval;
	//thisval steht hier fuer den bitfield-wert, 
	//aus Generierungsgruenden hier keine einheitliche Bezeichnung moeglich.
	byte thisval; // DisplaySectionSelection1
	bitval= getValue(this);
	thisval = getValue(A_FSG_4_0_0_25_Data_7_SetGet);
	thisval = thisval&~(1<<7)|(bitval<<7);
	putValue(A_FSG_4_0_0_25_Data_7_SetGet,thisval);
}

on envVar A_FSG_4_0_0_25_Data_7_SetGet
{

	//Update Childvalue (BitField)
	byte mask=0x01;
	int i = 0;
	byte thisval; // DisplaySectionSelection1
	thisval = getValue(this);
	if(thisval&(mask<<0))
		putValue(A_FSG_4_0_0_25_Data_7_SetGet_0, 1);
	else
		putValue(A_FSG_4_0_0_25_Data_7_SetGet_0, 0);
	if(thisval&(mask<<1))
		putValue(A_FSG_4_0_0_25_Data_7_SetGet_1, 1);
	else
		putValue(A_FSG_4_0_0_25_Data_7_SetGet_1, 0);
	if(thisval&(mask<<2))
		putValue(A_FSG_4_0_0_25_Data_7_SetGet_2, 1);
	else
		putValue(A_FSG_4_0_0_25_Data_7_SetGet_2, 0);
	if(thisval&(mask<<3))
		putValue(A_FSG_4_0_0_25_Data_7_SetGet_3, 1);
	else
		putValue(A_FSG_4_0_0_25_Data_7_SetGet_3, 0);
	if(thisval&(mask<<4))
		putValue(A_FSG_4_0_0_25_Data_7_SetGet_4, 1);
	else
		putValue(A_FSG_4_0_0_25_Data_7_SetGet_4, 0);
	if(thisval&(mask<<5))
		putValue(A_FSG_4_0_0_25_Data_7_SetGet_5, 1);
	else
		putValue(A_FSG_4_0_0_25_Data_7_SetGet_5, 0);
	if(thisval&(mask<<6))
		putValue(A_FSG_4_0_0_25_Data_7_SetGet_6, 1);
	else
		putValue(A_FSG_4_0_0_25_Data_7_SetGet_6, 0);
	if(thisval&(mask<<7))
		putValue(A_FSG_4_0_0_25_Data_7_SetGet_7, 1);
	else
		putValue(A_FSG_4_0_0_25_Data_7_SetGet_7, 0);
    A_FSG_4_0_0_25_ArrayDataList[getValue(A_FSG_4_0_0_25_DataIndex_SetGet)].Param7 = thisval;
}
on envVar A_FSG_4_0_0_25_Data_8_SetGet_0
{
	byte bitval;
	//thisval steht hier fuer den bitfield-wert, 
	//aus Generierungsgruenden hier keine einheitliche Bezeichnung moeglich.
	byte thisval; // DisplaySectionSelection2
	bitval= getValue(this);
	thisval = getValue(A_FSG_4_0_0_25_Data_8_SetGet);
	thisval = thisval&~(1<<0)|(bitval<<0);
	putValue(A_FSG_4_0_0_25_Data_8_SetGet,thisval);
}

on envVar A_FSG_4_0_0_25_Data_8_SetGet_1
{
	byte bitval;
	//thisval steht hier fuer den bitfield-wert, 
	//aus Generierungsgruenden hier keine einheitliche Bezeichnung moeglich.
	byte thisval; // DisplaySectionSelection2
	bitval= getValue(this);
	thisval = getValue(A_FSG_4_0_0_25_Data_8_SetGet);
	thisval = thisval&~(1<<1)|(bitval<<1);
	putValue(A_FSG_4_0_0_25_Data_8_SetGet,thisval);
}

on envVar A_FSG_4_0_0_25_Data_8_SetGet_2
{
	byte bitval;
	//thisval steht hier fuer den bitfield-wert, 
	//aus Generierungsgruenden hier keine einheitliche Bezeichnung moeglich.
	byte thisval; // DisplaySectionSelection2
	bitval= getValue(this);
	thisval = getValue(A_FSG_4_0_0_25_Data_8_SetGet);
	thisval = thisval&~(1<<2)|(bitval<<2);
	putValue(A_FSG_4_0_0_25_Data_8_SetGet,thisval);
}

on envVar A_FSG_4_0_0_25_Data_8_SetGet_3
{
	byte bitval;
	//thisval steht hier fuer den bitfield-wert, 
	//aus Generierungsgruenden hier keine einheitliche Bezeichnung moeglich.
	byte thisval; // DisplaySectionSelection2
	bitval= getValue(this);
	thisval = getValue(A_FSG_4_0_0_25_Data_8_SetGet);
	thisval = thisval&~(1<<3)|(bitval<<3);
	putValue(A_FSG_4_0_0_25_Data_8_SetGet,thisval);
}

on envVar A_FSG_4_0_0_25_Data_8_SetGet_4
{
	byte bitval;
	//thisval steht hier fuer den bitfield-wert, 
	//aus Generierungsgruenden hier keine einheitliche Bezeichnung moeglich.
	byte thisval; // DisplaySectionSelection2
	bitval= getValue(this);
	thisval = getValue(A_FSG_4_0_0_25_Data_8_SetGet);
	thisval = thisval&~(1<<4)|(bitval<<4);
	putValue(A_FSG_4_0_0_25_Data_8_SetGet,thisval);
}

on envVar A_FSG_4_0_0_25_Data_8_SetGet_5
{
	byte bitval;
	//thisval steht hier fuer den bitfield-wert, 
	//aus Generierungsgruenden hier keine einheitliche Bezeichnung moeglich.
	byte thisval; // DisplaySectionSelection2
	bitval= getValue(this);
	thisval = getValue(A_FSG_4_0_0_25_Data_8_SetGet);
	thisval = thisval&~(1<<5)|(bitval<<5);
	putValue(A_FSG_4_0_0_25_Data_8_SetGet,thisval);
}

on envVar A_FSG_4_0_0_25_Data_8_SetGet_6
{
	byte bitval;
	//thisval steht hier fuer den bitfield-wert, 
	//aus Generierungsgruenden hier keine einheitliche Bezeichnung moeglich.
	byte thisval; // DisplaySectionSelection2
	bitval= getValue(this);
	thisval = getValue(A_FSG_4_0_0_25_Data_8_SetGet);
	thisval = thisval&~(1<<6)|(bitval<<6);
	putValue(A_FSG_4_0_0_25_Data_8_SetGet,thisval);
}

on envVar A_FSG_4_0_0_25_Data_8_SetGet_7
{
	byte bitval;
	//thisval steht hier fuer den bitfield-wert, 
	//aus Generierungsgruenden hier keine einheitliche Bezeichnung moeglich.
	byte thisval; // DisplaySectionSelection2
	bitval= getValue(this);
	thisval = getValue(A_FSG_4_0_0_25_Data_8_SetGet);
	thisval = thisval&~(1<<7)|(bitval<<7);
	putValue(A_FSG_4_0_0_25_Data_8_SetGet,thisval);
}

on envVar A_FSG_4_0_0_25_Data_8_SetGet
{

	//Update Childvalue (BitField)
	byte mask=0x01;
	int i = 0;
	byte thisval; // DisplaySectionSelection2
	thisval = getValue(this);
	if(thisval&(mask<<0))
		putValue(A_FSG_4_0_0_25_Data_8_SetGet_0, 1);
	else
		putValue(A_FSG_4_0_0_25_Data_8_SetGet_0, 0);
	if(thisval&(mask<<1))
		putValue(A_FSG_4_0_0_25_Data_8_SetGet_1, 1);
	else
		putValue(A_FSG_4_0_0_25_Data_8_SetGet_1, 0);
	if(thisval&(mask<<2))
		putValue(A_FSG_4_0_0_25_Data_8_SetGet_2, 1);
	else
		putValue(A_FSG_4_0_0_25_Data_8_SetGet_2, 0);
	if(thisval&(mask<<3))
		putValue(A_FSG_4_0_0_25_Data_8_SetGet_3, 1);
	else
		putValue(A_FSG_4_0_0_25_Data_8_SetGet_3, 0);
	if(thisval&(mask<<4))
		putValue(A_FSG_4_0_0_25_Data_8_SetGet_4, 1);
	else
		putValue(A_FSG_4_0_0_25_Data_8_SetGet_4, 0);
	if(thisval&(mask<<5))
		putValue(A_FSG_4_0_0_25_Data_8_SetGet_5, 1);
	else
		putValue(A_FSG_4_0_0_25_Data_8_SetGet_5, 0);
	if(thisval&(mask<<6))
		putValue(A_FSG_4_0_0_25_Data_8_SetGet_6, 1);
	else
		putValue(A_FSG_4_0_0_25_Data_8_SetGet_6, 0);
	if(thisval&(mask<<7))
		putValue(A_FSG_4_0_0_25_Data_8_SetGet_7, 1);
	else
		putValue(A_FSG_4_0_0_25_Data_8_SetGet_7, 0);
    A_FSG_4_0_0_25_ArrayDataList[getValue(A_FSG_4_0_0_25_DataIndex_SetGet)].Param8 = thisval;
}
on envVar A_FSG_4_0_0_25_Data_9_SetGet_0
{
	byte bitval;
	//thisval steht hier fuer den bitfield-wert, 
	//aus Generierungsgruenden hier keine einheitliche Bezeichnung moeglich.
	byte thisval; // DisplaySectionSelection3
	bitval= getValue(this);
	thisval = getValue(A_FSG_4_0_0_25_Data_9_SetGet);
	thisval = thisval&~(1<<0)|(bitval<<0);
	putValue(A_FSG_4_0_0_25_Data_9_SetGet,thisval);
}

on envVar A_FSG_4_0_0_25_Data_9_SetGet_1
{
	byte bitval;
	//thisval steht hier fuer den bitfield-wert, 
	//aus Generierungsgruenden hier keine einheitliche Bezeichnung moeglich.
	byte thisval; // DisplaySectionSelection3
	bitval= getValue(this);
	thisval = getValue(A_FSG_4_0_0_25_Data_9_SetGet);
	thisval = thisval&~(1<<1)|(bitval<<1);
	putValue(A_FSG_4_0_0_25_Data_9_SetGet,thisval);
}

on envVar A_FSG_4_0_0_25_Data_9_SetGet_2
{
	byte bitval;
	//thisval steht hier fuer den bitfield-wert, 
	//aus Generierungsgruenden hier keine einheitliche Bezeichnung moeglich.
	byte thisval; // DisplaySectionSelection3
	bitval= getValue(this);
	thisval = getValue(A_FSG_4_0_0_25_Data_9_SetGet);
	thisval = thisval&~(1<<2)|(bitval<<2);
	putValue(A_FSG_4_0_0_25_Data_9_SetGet,thisval);
}

on envVar A_FSG_4_0_0_25_Data_9_SetGet_3
{
	byte bitval;
	//thisval steht hier fuer den bitfield-wert, 
	//aus Generierungsgruenden hier keine einheitliche Bezeichnung moeglich.
	byte thisval; // DisplaySectionSelection3
	bitval= getValue(this);
	thisval = getValue(A_FSG_4_0_0_25_Data_9_SetGet);
	thisval = thisval&~(1<<3)|(bitval<<3);
	putValue(A_FSG_4_0_0_25_Data_9_SetGet,thisval);
}

on envVar A_FSG_4_0_0_25_Data_9_SetGet_4
{
	byte bitval;
	//thisval steht hier fuer den bitfield-wert, 
	//aus Generierungsgruenden hier keine einheitliche Bezeichnung moeglich.
	byte thisval; // DisplaySectionSelection3
	bitval= getValue(this);
	thisval = getValue(A_FSG_4_0_0_25_Data_9_SetGet);
	thisval = thisval&~(1<<4)|(bitval<<4);
	putValue(A_FSG_4_0_0_25_Data_9_SetGet,thisval);
}

on envVar A_FSG_4_0_0_25_Data_9_SetGet_5
{
	byte bitval;
	//thisval steht hier fuer den bitfield-wert, 
	//aus Generierungsgruenden hier keine einheitliche Bezeichnung moeglich.
	byte thisval; // DisplaySectionSelection3
	bitval= getValue(this);
	thisval = getValue(A_FSG_4_0_0_25_Data_9_SetGet);
	thisval = thisval&~(1<<5)|(bitval<<5);
	putValue(A_FSG_4_0_0_25_Data_9_SetGet,thisval);
}

on envVar A_FSG_4_0_0_25_Data_9_SetGet_6
{
	byte bitval;
	//thisval steht hier fuer den bitfield-wert, 
	//aus Generierungsgruenden hier keine einheitliche Bezeichnung moeglich.
	byte thisval; // DisplaySectionSelection3
	bitval= getValue(this);
	thisval = getValue(A_FSG_4_0_0_25_Data_9_SetGet);
	thisval = thisval&~(1<<6)|(bitval<<6);
	putValue(A_FSG_4_0_0_25_Data_9_SetGet,thisval);
}

on envVar A_FSG_4_0_0_25_Data_9_SetGet_7
{
	byte bitval;
	//thisval steht hier fuer den bitfield-wert, 
	//aus Generierungsgruenden hier keine einheitliche Bezeichnung moeglich.
	byte thisval; // DisplaySectionSelection3
	bitval= getValue(this);
	thisval = getValue(A_FSG_4_0_0_25_Data_9_SetGet);
	thisval = thisval&~(1<<7)|(bitval<<7);
	putValue(A_FSG_4_0_0_25_Data_9_SetGet,thisval);
}

on envVar A_FSG_4_0_0_25_Data_9_SetGet
{

	//Update Childvalue (BitField)
	byte mask=0x01;
	int i = 0;
	byte thisval; // DisplaySectionSelection3
	thisval = getValue(this);
	if(thisval&(mask<<0))
		putValue(A_FSG_4_0_0_25_Data_9_SetGet_0, 1);
	else
		putValue(A_FSG_4_0_0_25_Data_9_SetGet_0, 0);
	if(thisval&(mask<<1))
		putValue(A_FSG_4_0_0_25_Data_9_SetGet_1, 1);
	else
		putValue(A_FSG_4_0_0_25_Data_9_SetGet_1, 0);
	if(thisval&(mask<<2))
		putValue(A_FSG_4_0_0_25_Data_9_SetGet_2, 1);
	else
		putValue(A_FSG_4_0_0_25_Data_9_SetGet_2, 0);
	if(thisval&(mask<<3))
		putValue(A_FSG_4_0_0_25_Data_9_SetGet_3, 1);
	else
		putValue(A_FSG_4_0_0_25_Data_9_SetGet_3, 0);
	if(thisval&(mask<<4))
		putValue(A_FSG_4_0_0_25_Data_9_SetGet_4, 1);
	else
		putValue(A_FSG_4_0_0_25_Data_9_SetGet_4, 0);
	if(thisval&(mask<<5))
		putValue(A_FSG_4_0_0_25_Data_9_SetGet_5, 1);
	else
		putValue(A_FSG_4_0_0_25_Data_9_SetGet_5, 0);
	if(thisval&(mask<<6))
		putValue(A_FSG_4_0_0_25_Data_9_SetGet_6, 1);
	else
		putValue(A_FSG_4_0_0_25_Data_9_SetGet_6, 0);
	if(thisval&(mask<<7))
		putValue(A_FSG_4_0_0_25_Data_9_SetGet_7, 1);
	else
		putValue(A_FSG_4_0_0_25_Data_9_SetGet_7, 0);
    A_FSG_4_0_0_25_ArrayDataList[getValue(A_FSG_4_0_0_25_DataIndex_SetGet)].Param9 = thisval;
}
on envVar A_FSG_4_0_0_25_Data_10_SetGet_0
{
	byte bitval;
	//thisval steht hier fuer den bitfield-wert, 
	//aus Generierungsgruenden hier keine einheitliche Bezeichnung moeglich.
	byte thisval; // DisplaySectionSelection4
	bitval= getValue(this);
	thisval = getValue(A_FSG_4_0_0_25_Data_10_SetGet);
	thisval = thisval&~(1<<0)|(bitval<<0);
	putValue(A_FSG_4_0_0_25_Data_10_SetGet,thisval);
}

on envVar A_FSG_4_0_0_25_Data_10_SetGet_1
{
	byte bitval;
	//thisval steht hier fuer den bitfield-wert, 
	//aus Generierungsgruenden hier keine einheitliche Bezeichnung moeglich.
	byte thisval; // DisplaySectionSelection4
	bitval= getValue(this);
	thisval = getValue(A_FSG_4_0_0_25_Data_10_SetGet);
	thisval = thisval&~(1<<1)|(bitval<<1);
	putValue(A_FSG_4_0_0_25_Data_10_SetGet,thisval);
}

on envVar A_FSG_4_0_0_25_Data_10_SetGet_2
{
	byte bitval;
	//thisval steht hier fuer den bitfield-wert, 
	//aus Generierungsgruenden hier keine einheitliche Bezeichnung moeglich.
	byte thisval; // DisplaySectionSelection4
	bitval= getValue(this);
	thisval = getValue(A_FSG_4_0_0_25_Data_10_SetGet);
	thisval = thisval&~(1<<2)|(bitval<<2);
	putValue(A_FSG_4_0_0_25_Data_10_SetGet,thisval);
}

on envVar A_FSG_4_0_0_25_Data_10_SetGet_3
{
	byte bitval;
	//thisval steht hier fuer den bitfield-wert, 
	//aus Generierungsgruenden hier keine einheitliche Bezeichnung moeglich.
	byte thisval; // DisplaySectionSelection4
	bitval= getValue(this);
	thisval = getValue(A_FSG_4_0_0_25_Data_10_SetGet);
	thisval = thisval&~(1<<3)|(bitval<<3);
	putValue(A_FSG_4_0_0_25_Data_10_SetGet,thisval);
}

on envVar A_FSG_4_0_0_25_Data_10_SetGet
{

	//Update Childvalue (BitField)
	byte mask=0x01;
	int i = 0;
	byte thisval; // DisplaySectionSelection4
	thisval = getValue(this);
	if(thisval&(mask<<0))
		putValue(A_FSG_4_0_0_25_Data_10_SetGet_0, 1);
	else
		putValue(A_FSG_4_0_0_25_Data_10_SetGet_0, 0);
	if(thisval&(mask<<1))
		putValue(A_FSG_4_0_0_25_Data_10_SetGet_1, 1);
	else
		putValue(A_FSG_4_0_0_25_Data_10_SetGet_1, 0);
	if(thisval&(mask<<2))
		putValue(A_FSG_4_0_0_25_Data_10_SetGet_2, 1);
	else
		putValue(A_FSG_4_0_0_25_Data_10_SetGet_2, 0);
	if(thisval&(mask<<3))
		putValue(A_FSG_4_0_0_25_Data_10_SetGet_3, 1);
	else
		putValue(A_FSG_4_0_0_25_Data_10_SetGet_3, 0);
    A_FSG_4_0_0_25_ArrayDataList[getValue(A_FSG_4_0_0_25_DataIndex_SetGet)].Param10 = thisval;
}
// Ruecksetzen des Fehlerstatus durch manuelle Fehlereingabe
on envVar P_FSG_4_0_0_26_ErrCode
{
       if(gP_FSG_4_0_0_26_ErrCode) 
       {
           setControlBackColor(panel_name,"errfield_P_FSG_4_0_0_26", MakeRGB(255,255,255));
       }
       gP_FSG_4_0_0_26_ErrCode = 1;
}
on envVar P_FSG_4_0_0_26Status_BTN
{
	byte BAPTemp[18];
    if (P_FSG_4_0_0_26Status_BTN_already_pressed == 0)
    {
        putValue(P_FSG_4_0_0_26_ErrCode,0);
        SetControlBackColor(panel_name,"errField_P_FSG_4_0_0_26",MakeRGB(255,255,255));
        P_FSG_4_0_0_26Status_BTN_already_pressed = 1;
    }
    else
    {
		P_FSG_4_0_0_26_BuildFct();
        getValue(P_FSG_4_0_0_26, BAPTemp);
        Request_ByteSequence(LSGID, P_FSG_4_0_0_26_ID, Data_REQ, BAPTemp, getValueSize(P_FSG_4_0_0_26));
        if(getValue(P_FSG_4_0_0_26_IntTlgEn)) //getValue(IT))
        {
           intertelegram_err(P_FSG_4_0_0_26_ID);
        }
        if(getValue(P_FSG_4_0_0_26_SegmEn))   //getvalue(SG)
        {
           sequence_err(P_FSG_4_0_0_26_ID,elCount(BAPTemp));
        }
       P_FSG_4_0_0_26Status_BTN_already_pressed = 0;
    }
}
on envVar P_FSG_4_0_0_26_FctEn
{
    long data[3];
    data[0]=LSGID;
    data[1]=P_FSG_4_0_0_26_ID;
    data[2]=getValue(P_FSG_4_0_0_26_FctEn);
    ChangeConfig(0x0031,data);
}
// De-Aktivierung der Eingabefelder der FCTID P_FSG_4_0_0_26
on envVar P_FSG_4_0_0_26_FctLstItemEn
{
       if(getValue(this)) 
       {
           EnableControl(panel_name,"panel_FSG_4_0_0_26",1);
           EnableControl(panel_name,"errfield_P_FSG_4_0_0_26",1);
           EnableControl(panel_name,"panel_P_FSG_4_0_0_26",1);
           setControlForeColor(panel_name, "checkbox_P_FSG_4_0_0_26", MakeRGB(0,240,0));
       }
       else
       {
           EnableControl(panel_name,"panel_FSG_4_0_0_26",0);
           EnableControl(panel_name,"errfield_P_FSG_4_0_0_26",0);
           EnableControl(panel_name,"panel_P_FSG_4_0_0_26",0);
           setControlForeColor(panel_name, "checkbox_P_FSG_4_0_0_26", MakeRGB(250,0,0));
       }
}
// Man darf gleichzeitig nur Checkbox fuer SegmError oder IntertelegramError aktiviert werden
on envVar P_FSG_4_0_0_26_IntTlgEn
{
       if(getValue(this)) 
       {
           putValue(P_FSG_4_0_0_26_SegmEn,0);
           intertelegram_err(P_FSG_4_0_0_26_ID);
       }
       else
       {
           intertelegram_err_off(P_FSG_4_0_0_26_ID);
       }
}
// Man darf gleichzeitig nur Checkbox fuer SegmError oder IntertelegramError aktiviert werden
on envVar P_FSG_4_0_0_26_SegmEn
{
       if(getValue(this)) 
       {
           putValue(P_FSG_4_0_0_26_IntTlgEn,0);
           sequence_err(P_FSG_4_0_0_26_ID,getValueSize(P_FSG_4_0_0_26_SegmEn));
       }
       else
       {
              sequence_err_off(P_FSG_4_0_0_26_ID);
       }
}
on envVar P_FSG_4_0_0_26 // bus value of CollectiveDisplayedTopics (26).
{
	// opcodes: Error-Status
	byte param1; // ModificationReasonACC
	byte param2; // ACC
	byte param3; // ModificationReasonNightvision
	byte param4; // Nightvision
	byte param5; // ModificationReasonRSD
	byte param6; // RoadSignDetection
	byte param7; // ModificationReasonRGI
	byte param8; // RouteGuidanceInfo
	byte param9; // ModificationReasonHeadingControl
	byte param10; // HeadingControl
	byte param11; // ModificationReasonGRA
	byte param12; // GRA
	byte param13; // ModificationReasonEfficiencyAssist
	byte param14; // EfficiencyAssist
	byte param15; // ModificationReasonSpeedLimiter
	byte param16; // SpeedLimiter
	byte param17; // ModificationReasonNAI_in_HUD
	byte param18; // NavigationAdditionalInfoInHUD
	byte param19; // Extension1
	byte param20; // Extension2
	byte param21; // Extension3
	byte param22; // Extension4
	byte param23; // Extension5
	byte param24; // Extension6
	byte param25; // Extension7
	byte param26; // Extension8
	byte param27; // Extension9
	// DATATYPE_BYTESEQUENCE / DATATYPE_FIXEDBYTESEQUENCE
	dword i;
	byte superval[18];
	dword currentPos;
	currentPos = 0;
	for( i = 0; i < 18; i++ ) {
		superval[i] = 0;
	}
	getValue(P_FSG_4_0_0_26, superval);
	///////// Start param1 - NIBBLE /////////
	param1 = (superval[currentPos] & 0xf0)>>4;
	putValue(P_FSG_4_0_0_26_1, param1);
	///////// Start param2 - NIBBLE /////////
	param2 = superval[currentPos++] & 0x0f;
	putValue(P_FSG_4_0_0_26_2, param2);
	///////// Start param3 - NIBBLE /////////
	param3 = (superval[currentPos] & 0xf0)>>4;
	putValue(P_FSG_4_0_0_26_3, param3);
	///////// Start param4 - NIBBLE /////////
	param4 = superval[currentPos++] & 0x0f;
	putValue(P_FSG_4_0_0_26_4, param4);
	///////// Start param5 - NIBBLE /////////
	param5 = (superval[currentPos] & 0xf0)>>4;
	putValue(P_FSG_4_0_0_26_5, param5);
	///////// Start param6 - NIBBLE /////////
	param6 = superval[currentPos++] & 0x0f;
	putValue(P_FSG_4_0_0_26_6, param6);
	///////// Start param7 - NIBBLE /////////
	param7 = (superval[currentPos] & 0xf0)>>4;
	putValue(P_FSG_4_0_0_26_7, param7);
	///////// Start param8 - NIBBLE /////////
	param8 = superval[currentPos++] & 0x0f;
	putValue(P_FSG_4_0_0_26_8, param8);
	///////// Start param9 - NIBBLE /////////
	param9 = (superval[currentPos] & 0xf0)>>4;
	putValue(P_FSG_4_0_0_26_9, param9);
	///////// Start param10 - NIBBLE /////////
	param10 = superval[currentPos++] & 0x0f;
	putValue(P_FSG_4_0_0_26_10, param10);
	///////// Start param11 - NIBBLE /////////
	param11 = (superval[currentPos] & 0xf0)>>4;
	putValue(P_FSG_4_0_0_26_11, param11);
	///////// Start param12 - NIBBLE /////////
	param12 = superval[currentPos++] & 0x0f;
	putValue(P_FSG_4_0_0_26_12, param12);
	///////// Start param13 - NIBBLE /////////
	param13 = (superval[currentPos] & 0xf0)>>4;
	putValue(P_FSG_4_0_0_26_13, param13);
	///////// Start param14 - NIBBLE /////////
	param14 = superval[currentPos++] & 0x0f;
	putValue(P_FSG_4_0_0_26_14, param14);
	///////// Start param15 - NIBBLE /////////
	param15 = (superval[currentPos] & 0xf0)>>4;
	putValue(P_FSG_4_0_0_26_15, param15);
	///////// Start param16 - NIBBLE /////////
	param16 = superval[currentPos++] & 0x0f;
	putValue(P_FSG_4_0_0_26_16, param16);
	///////// Start param17 - NIBBLE /////////
	param17 = (superval[currentPos] & 0xf0)>>4;
	putValue(P_FSG_4_0_0_26_17, param17);
	///////// Start param18 - NIBBLE /////////
	param18 = superval[currentPos++] & 0x0f;
	putValue(P_FSG_4_0_0_26_18, param18);
	///////// Start param19 - UINT8 /////////
	param19 = superval[currentPos++];
	putValue(P_FSG_4_0_0_26_19, round((param19 * 1.0) - (0) + (0), 1.0));
	///////// Start param20 - UINT8 /////////
	param20 = superval[currentPos++];
	putValue(P_FSG_4_0_0_26_20, round((param20 * 1.0) - (0) + (0), 1.0));
	///////// Start param21 - UINT8 /////////
	param21 = superval[currentPos++];
	putValue(P_FSG_4_0_0_26_21, round((param21 * 1.0) - (0) + (0), 1.0));
	///////// Start param22 - UINT8 /////////
	param22 = superval[currentPos++];
	putValue(P_FSG_4_0_0_26_22, round((param22 * 1.0) - (0) + (0), 1.0));
	///////// Start param23 - UINT8 /////////
	param23 = superval[currentPos++];
	putValue(P_FSG_4_0_0_26_23, round((param23 * 1.0) - (0) + (0), 1.0));
	///////// Start param24 - UINT8 /////////
	param24 = superval[currentPos++];
	putValue(P_FSG_4_0_0_26_24, round((param24 * 1.0) - (0) + (0), 1.0));
	///////// Start param25 - UINT8 /////////
	param25 = superval[currentPos++];
	putValue(P_FSG_4_0_0_26_25, round((param25 * 1.0) - (0) + (0), 1.0));
	///////// Start param26 - UINT8 /////////
	param26 = superval[currentPos++];
	putValue(P_FSG_4_0_0_26_26, round((param26 * 1.0) - (0) + (0), 1.0));
	///////// Start param27 - UINT8 /////////
	param27 = superval[currentPos++];
	putValue(P_FSG_4_0_0_26_27, round((param27 * 1.0) - (0) + (0), 1.0));
}

// Updates the bus value field and other dependencies.
P_FSG_4_0_0_26_BuildFct()
{
	byte param1; // ModificationReasonACC
	byte param2; // ACC
	byte param3; // ModificationReasonNightvision
	byte param4; // Nightvision
	byte param5; // ModificationReasonRSD
	byte param6; // RoadSignDetection
	byte param7; // ModificationReasonRGI
	byte param8; // RouteGuidanceInfo
	byte param9; // ModificationReasonHeadingControl
	byte param10; // HeadingControl
	byte param11; // ModificationReasonGRA
	byte param12; // GRA
	byte param13; // ModificationReasonEfficiencyAssist
	byte param14; // EfficiencyAssist
	byte param15; // ModificationReasonSpeedLimiter
	byte param16; // SpeedLimiter
	byte param17; // ModificationReasonNAI_in_HUD
	byte param18; // NavigationAdditionalInfoInHUD
	byte param19; // Extension1
	byte param20; // Extension2
	byte param21; // Extension3
	byte param22; // Extension4
	byte param23; // Extension5
	byte param24; // Extension6
	byte param25; // Extension7
	byte param26; // Extension8
	byte param27; // Extension9

	dword i;
	byte superval[18];
	dword currentPos;
	currentPos = 0;
// gen_BuildFunc_SetSuperVals 
	param1 = getValue(P_FSG_4_0_0_26_1);
	param1 = param1 & 0x0f;
	superval[currentPos]= superval[currentPos]&0x0f;
	superval[currentPos]= superval[currentPos]|(param1<<4);
// gen_BuildFunc_SetSuperVals 
	param2 = getValue(P_FSG_4_0_0_26_2);
	param2 = param2 & 0x0f;
	superval[currentPos]= superval[currentPos]&0xf0;
	superval[currentPos]= superval[currentPos]|param2;
	currentPos++;
// gen_BuildFunc_SetSuperVals 
	param3 = getValue(P_FSG_4_0_0_26_3);
	param3 = param3 & 0x0f;
	superval[currentPos]= superval[currentPos]&0x0f;
	superval[currentPos]= superval[currentPos]|(param3<<4);
// gen_BuildFunc_SetSuperVals 
	param4 = getValue(P_FSG_4_0_0_26_4);
	param4 = param4 & 0x0f;
	superval[currentPos]= superval[currentPos]&0xf0;
	superval[currentPos]= superval[currentPos]|param4;
	currentPos++;
// gen_BuildFunc_SetSuperVals 
	param5 = getValue(P_FSG_4_0_0_26_5);
	param5 = param5 & 0x0f;
	superval[currentPos]= superval[currentPos]&0x0f;
	superval[currentPos]= superval[currentPos]|(param5<<4);
// gen_BuildFunc_SetSuperVals 
	param6 = getValue(P_FSG_4_0_0_26_6);
	param6 = param6 & 0x0f;
	superval[currentPos]= superval[currentPos]&0xf0;
	superval[currentPos]= superval[currentPos]|param6;
	currentPos++;
// gen_BuildFunc_SetSuperVals 
	param7 = getValue(P_FSG_4_0_0_26_7);
	param7 = param7 & 0x0f;
	superval[currentPos]= superval[currentPos]&0x0f;
	superval[currentPos]= superval[currentPos]|(param7<<4);
// gen_BuildFunc_SetSuperVals 
	param8 = getValue(P_FSG_4_0_0_26_8);
	param8 = param8 & 0x0f;
	superval[currentPos]= superval[currentPos]&0xf0;
	superval[currentPos]= superval[currentPos]|param8;
	currentPos++;
// gen_BuildFunc_SetSuperVals 
	param9 = getValue(P_FSG_4_0_0_26_9);
	param9 = param9 & 0x0f;
	superval[currentPos]= superval[currentPos]&0x0f;
	superval[currentPos]= superval[currentPos]|(param9<<4);
// gen_BuildFunc_SetSuperVals 
	param10 = getValue(P_FSG_4_0_0_26_10);
	param10 = param10 & 0x0f;
	superval[currentPos]= superval[currentPos]&0xf0;
	superval[currentPos]= superval[currentPos]|param10;
	currentPos++;
// gen_BuildFunc_SetSuperVals 
	param11 = getValue(P_FSG_4_0_0_26_11);
	param11 = param11 & 0x0f;
	superval[currentPos]= superval[currentPos]&0x0f;
	superval[currentPos]= superval[currentPos]|(param11<<4);
// gen_BuildFunc_SetSuperVals 
	param12 = getValue(P_FSG_4_0_0_26_12);
	param12 = param12 & 0x0f;
	superval[currentPos]= superval[currentPos]&0xf0;
	superval[currentPos]= superval[currentPos]|param12;
	currentPos++;
// gen_BuildFunc_SetSuperVals 
	param13 = getValue(P_FSG_4_0_0_26_13);
	param13 = param13 & 0x0f;
	superval[currentPos]= superval[currentPos]&0x0f;
	superval[currentPos]= superval[currentPos]|(param13<<4);
// gen_BuildFunc_SetSuperVals 
	param14 = getValue(P_FSG_4_0_0_26_14);
	param14 = param14 & 0x0f;
	superval[currentPos]= superval[currentPos]&0xf0;
	superval[currentPos]= superval[currentPos]|param14;
	currentPos++;
// gen_BuildFunc_SetSuperVals 
	param15 = getValue(P_FSG_4_0_0_26_15);
	param15 = param15 & 0x0f;
	superval[currentPos]= superval[currentPos]&0x0f;
	superval[currentPos]= superval[currentPos]|(param15<<4);
// gen_BuildFunc_SetSuperVals 
	param16 = getValue(P_FSG_4_0_0_26_16);
	param16 = param16 & 0x0f;
	superval[currentPos]= superval[currentPos]&0xf0;
	superval[currentPos]= superval[currentPos]|param16;
	currentPos++;
// gen_BuildFunc_SetSuperVals 
	param17 = getValue(P_FSG_4_0_0_26_17);
	param17 = param17 & 0x0f;
	superval[currentPos]= superval[currentPos]&0x0f;
	superval[currentPos]= superval[currentPos]|(param17<<4);
// gen_BuildFunc_SetSuperVals 
	param18 = getValue(P_FSG_4_0_0_26_18);
	param18 = param18 & 0x0f;
	superval[currentPos]= superval[currentPos]&0xf0;
	superval[currentPos]= superval[currentPos]|param18;
	currentPos++;
// gen_BuildFunc_SetSuperVals 
	@P_FSG_4_0_0_26_19_range = round(@P_FSG_4_0_0_26_19 + (0), 1.0); // slider value + min = real value
	param19 = 0; // underlying parameter has constant value 0.0.
	superval[currentPos++]=param19;
// gen_BuildFunc_SetSuperVals 
	@P_FSG_4_0_0_26_20_range = round(@P_FSG_4_0_0_26_20 + (0), 1.0); // slider value + min = real value
	param20 = 0; // underlying parameter has constant value 0.0.
	superval[currentPos++]=param20;
// gen_BuildFunc_SetSuperVals 
	@P_FSG_4_0_0_26_21_range = round(@P_FSG_4_0_0_26_21 + (0), 1.0); // slider value + min = real value
	param21 = 0; // underlying parameter has constant value 0.0.
	superval[currentPos++]=param21;
// gen_BuildFunc_SetSuperVals 
	@P_FSG_4_0_0_26_22_range = round(@P_FSG_4_0_0_26_22 + (0), 1.0); // slider value + min = real value
	param22 = 0; // underlying parameter has constant value 0.0.
	superval[currentPos++]=param22;
// gen_BuildFunc_SetSuperVals 
	@P_FSG_4_0_0_26_23_range = round(@P_FSG_4_0_0_26_23 + (0), 1.0); // slider value + min = real value
	param23 = 0; // underlying parameter has constant value 0.0.
	superval[currentPos++]=param23;
// gen_BuildFunc_SetSuperVals 
	@P_FSG_4_0_0_26_24_range = round(@P_FSG_4_0_0_26_24 + (0), 1.0); // slider value + min = real value
	param24 = 0; // underlying parameter has constant value 0.0.
	superval[currentPos++]=param24;
// gen_BuildFunc_SetSuperVals 
	@P_FSG_4_0_0_26_25_range = round(@P_FSG_4_0_0_26_25 + (0), 1.0); // slider value + min = real value
	param25 = 0; // underlying parameter has constant value 0.0.
	superval[currentPos++]=param25;
// gen_BuildFunc_SetSuperVals 
	@P_FSG_4_0_0_26_26_range = round(@P_FSG_4_0_0_26_26 + (0), 1.0); // slider value + min = real value
	param26 = 0; // underlying parameter has constant value 0.0.
	superval[currentPos++]=param26;
// gen_BuildFunc_SetSuperVals 
	@P_FSG_4_0_0_26_27_range = round(@P_FSG_4_0_0_26_27 + (0), 1.0); // slider value + min = real value
	param27 = 0; // underlying parameter has constant value 0.0.
	superval[currentPos++]=param27;
	putValue(P_FSG_4_0_0_26, superval, currentPos);
}


on envVar P_FSG_4_0_0_26_1 // CollectiveDisplayedTopics.ModificationReasonACC
{
	P_FSG_4_0_0_26_BuildFct();
}

on envVar P_FSG_4_0_0_26_2 // CollectiveDisplayedTopics.ACC
{
	P_FSG_4_0_0_26_BuildFct();
}

on envVar P_FSG_4_0_0_26_3 // CollectiveDisplayedTopics.ModificationReasonNightvision
{
	P_FSG_4_0_0_26_BuildFct();
}

on envVar P_FSG_4_0_0_26_4 // CollectiveDisplayedTopics.Nightvision
{
	P_FSG_4_0_0_26_BuildFct();
}

on envVar P_FSG_4_0_0_26_5 // CollectiveDisplayedTopics.ModificationReasonRSD
{
	P_FSG_4_0_0_26_BuildFct();
}

on envVar P_FSG_4_0_0_26_6 // CollectiveDisplayedTopics.RoadSignDetection
{
	P_FSG_4_0_0_26_BuildFct();
}

on envVar P_FSG_4_0_0_26_7 // CollectiveDisplayedTopics.ModificationReasonRGI
{
	P_FSG_4_0_0_26_BuildFct();
}

on envVar P_FSG_4_0_0_26_8 // CollectiveDisplayedTopics.RouteGuidanceInfo
{
	P_FSG_4_0_0_26_BuildFct();
}

on envVar P_FSG_4_0_0_26_9 // CollectiveDisplayedTopics.ModificationReasonHeadingControl
{
	P_FSG_4_0_0_26_BuildFct();
}

on envVar P_FSG_4_0_0_26_10 // CollectiveDisplayedTopics.HeadingControl
{
	P_FSG_4_0_0_26_BuildFct();
}

on envVar P_FSG_4_0_0_26_11 // CollectiveDisplayedTopics.ModificationReasonGRA
{
	P_FSG_4_0_0_26_BuildFct();
}

on envVar P_FSG_4_0_0_26_12 // CollectiveDisplayedTopics.GRA
{
	P_FSG_4_0_0_26_BuildFct();
}

on envVar P_FSG_4_0_0_26_13 // CollectiveDisplayedTopics.ModificationReasonEfficiencyAssist
{
	P_FSG_4_0_0_26_BuildFct();
}

on envVar P_FSG_4_0_0_26_14 // CollectiveDisplayedTopics.EfficiencyAssist
{
	P_FSG_4_0_0_26_BuildFct();
}

on envVar P_FSG_4_0_0_26_15 // CollectiveDisplayedTopics.ModificationReasonSpeedLimiter
{
	P_FSG_4_0_0_26_BuildFct();
}

on envVar P_FSG_4_0_0_26_16 // CollectiveDisplayedTopics.SpeedLimiter
{
	P_FSG_4_0_0_26_BuildFct();
}

on envVar P_FSG_4_0_0_26_17 // CollectiveDisplayedTopics.ModificationReasonNAI_in_HUD
{
	P_FSG_4_0_0_26_BuildFct();
}

on envVar P_FSG_4_0_0_26_18 // CollectiveDisplayedTopics.NavigationAdditionalInfoInHUD
{
	P_FSG_4_0_0_26_BuildFct();
}

// Ueberwachung der Darstellungsvariable der Range.
on envVar P_FSG_4_0_0_26_19_range // CollectiveDisplayedTopics.Extension1 
{
	@P_FSG_4_0_0_26_19 = @P_FSG_4_0_0_26_19_range - (0); // slider = range - min
}

on envVar P_FSG_4_0_0_26_19 // CollectiveDisplayedTopics.Extension1
{
	P_FSG_4_0_0_26_BuildFct();
}

// Ueberwachung der Darstellungsvariable der Range.
on envVar P_FSG_4_0_0_26_20_range // CollectiveDisplayedTopics.Extension2 
{
	@P_FSG_4_0_0_26_20 = @P_FSG_4_0_0_26_20_range - (0); // slider = range - min
}

on envVar P_FSG_4_0_0_26_20 // CollectiveDisplayedTopics.Extension2
{
	P_FSG_4_0_0_26_BuildFct();
}

// Ueberwachung der Darstellungsvariable der Range.
on envVar P_FSG_4_0_0_26_21_range // CollectiveDisplayedTopics.Extension3 
{
	@P_FSG_4_0_0_26_21 = @P_FSG_4_0_0_26_21_range - (0); // slider = range - min
}

on envVar P_FSG_4_0_0_26_21 // CollectiveDisplayedTopics.Extension3
{
	P_FSG_4_0_0_26_BuildFct();
}

// Ueberwachung der Darstellungsvariable der Range.
on envVar P_FSG_4_0_0_26_22_range // CollectiveDisplayedTopics.Extension4 
{
	@P_FSG_4_0_0_26_22 = @P_FSG_4_0_0_26_22_range - (0); // slider = range - min
}

on envVar P_FSG_4_0_0_26_22 // CollectiveDisplayedTopics.Extension4
{
	P_FSG_4_0_0_26_BuildFct();
}

// Ueberwachung der Darstellungsvariable der Range.
on envVar P_FSG_4_0_0_26_23_range // CollectiveDisplayedTopics.Extension5 
{
	@P_FSG_4_0_0_26_23 = @P_FSG_4_0_0_26_23_range - (0); // slider = range - min
}

on envVar P_FSG_4_0_0_26_23 // CollectiveDisplayedTopics.Extension5
{
	P_FSG_4_0_0_26_BuildFct();
}

// Ueberwachung der Darstellungsvariable der Range.
on envVar P_FSG_4_0_0_26_24_range // CollectiveDisplayedTopics.Extension6 
{
	@P_FSG_4_0_0_26_24 = @P_FSG_4_0_0_26_24_range - (0); // slider = range - min
}

on envVar P_FSG_4_0_0_26_24 // CollectiveDisplayedTopics.Extension6
{
	P_FSG_4_0_0_26_BuildFct();
}

// Ueberwachung der Darstellungsvariable der Range.
on envVar P_FSG_4_0_0_26_25_range // CollectiveDisplayedTopics.Extension7 
{
	@P_FSG_4_0_0_26_25 = @P_FSG_4_0_0_26_25_range - (0); // slider = range - min
}

on envVar P_FSG_4_0_0_26_25 // CollectiveDisplayedTopics.Extension7
{
	P_FSG_4_0_0_26_BuildFct();
}

// Ueberwachung der Darstellungsvariable der Range.
on envVar P_FSG_4_0_0_26_26_range // CollectiveDisplayedTopics.Extension8 
{
	@P_FSG_4_0_0_26_26 = @P_FSG_4_0_0_26_26_range - (0); // slider = range - min
}

on envVar P_FSG_4_0_0_26_26 // CollectiveDisplayedTopics.Extension8
{
	P_FSG_4_0_0_26_BuildFct();
}

// Ueberwachung der Darstellungsvariable der Range.
on envVar P_FSG_4_0_0_26_27_range // CollectiveDisplayedTopics.Extension9 
{
	@P_FSG_4_0_0_26_27 = @P_FSG_4_0_0_26_27_range - (0); // slider = range - min
}

on envVar P_FSG_4_0_0_26_27 // CollectiveDisplayedTopics.Extension9
{
	P_FSG_4_0_0_26_BuildFct();
}

// Ruecksetzen des Fehlerstatus durch manuelle Fehlereingabe
on envVar A_FSG_4_0_0_27_ErrCode
{
       if(gA_FSG_4_0_0_27_ErrCode) 
       {
           setControlBackColor(panel_name,"errfield_A_FSG_4_0_0_27", MakeRGB(255,255,255));
       }
       gA_FSG_4_0_0_27_ErrCode = 1;
}
on envVar A_FSG_4_0_0_27Changed_BTN
{
    byte data[36]; 
    byte stringValue[36];
    byte head[5];
    dword i;
    int headLength;
    long tempValue;
    dword currentPos;
    word startVal;
    word elementsVal;
  byte nibbleSetted;
    if (A_FSG_4_0_0_27Changed_BTN_already_pressed == 0)
    {
        putValue(A_FSG_4_0_0_27_ErrCode,0);
        SetControlBackColor(panel_name,"errField_A_FSG_4_0_0_27",MakeRGB(255,255,255));
        A_FSG_4_0_0_27Changed_BTN_already_pressed = 1;
    }
    else 
    {
        currentPos = 0;
        //Einzelparameter: Operation
        tempValue = getValue(A_FSG_4_0_0_27_1_Changed);
        //voriger Parameter war ein first nibble, bei 1 Byte Werten Position incr
        if(nibbleSetted == 1) currentPos++;
        nibbleSetted = 0;
        data[currentPos++] = tempValue;
        //Einzelparameter: Type
        tempValue = getValue(A_FSG_4_0_0_27_2_Changed);
        //voriger Parameter war ein first nibble, bei 1 Byte Werten Position incr
        if(nibbleSetted == 1) currentPos++;
        nibbleSetted = 0;
        data[currentPos++] = tempValue;
        //Einzelparameter: Slot
        tempValue = getValue(A_FSG_4_0_0_27_3_Changed);
        //voriger Parameter war ein first nibble, bei 1 Byte Werten Position incr
        if(nibbleSetted == 1) currentPos++;
        nibbleSetted = 0;
        data[currentPos++] = tempValue;
        //head Parameter
        headLength = getValueSize(A_FSG_4_0_0_27_Changed);
        getValue(A_FSG_4_0_0_27_Changed,head);
        for(i=0; i< headLength; i++)
        {
            data[currentPos++] = head[i];
        }

       Request_ByteSequence(LSGID, A_FSG_4_0_0_27_ID, Changed_REQ, data, currentPos);
       if(getValue(A_FSG_4_0_0_27_IntTlgEn)) //getValue(IT))
       {
           intertelegram_err(A_FSG_4_0_0_27_ID);
       }
       if(getValue(A_FSG_4_0_0_27_SegmEn))   //getvalue(SG)
       {
             sequence_err(A_FSG_4_0_0_27_ID,getValueSize(A_FSG_4_0_0_27_Changed));
       }
        A_FSG_4_0_0_27Changed_BTN_already_pressed = 0;
    }
}
on envVar A_FSG_4_0_0_27Status_BTN
{
    byte data[36 + 5]; // array header (3 or 5 bytes), followed by payload.
    byte stringValue[36];
    byte head[5];
    dword i = 0;
    dword j = 0;
    dword StringLength = 0;
    int headLength;
    long tempValue;
    dword currentPos;
    word startVal;
    word elementsVal;
    byte nibbleSetted;
    if (A_FSG_4_0_0_27Status_BTN_already_pressed == 0)
    {
        putValue(A_FSG_4_0_0_27_ErrCode,0);
        SetControlBackColor(panel_name,"errField_A_FSG_4_0_0_27",MakeRGB(255,255,255));
        A_FSG_4_0_0_27Status_BTN_already_pressed = 1;
    }
    else
    {
        currentPos = 0;
        //Einzelparameter: Operation
        tempValue = getValue(A_FSG_4_0_0_27_1);
        //voriger Parameter war ein first nibble, bei 1 Byte Werten Position incr
        if(nibbleSetted == 1) currentPos++;
        nibbleSetted = 0;
        data[currentPos++] = tempValue;
        //Einzelparameter: Type
        tempValue = getValue(A_FSG_4_0_0_27_2);
        //voriger Parameter war ein first nibble, bei 1 Byte Werten Position incr
        if(nibbleSetted == 1) currentPos++;
        nibbleSetted = 0;
        data[currentPos++] = tempValue;
        //Einzelparameter: Slot
        tempValue = getValue(A_FSG_4_0_0_27_3);
        //voriger Parameter war ein first nibble, bei 1 Byte Werten Position incr
        if(nibbleSetted == 1) currentPos++;
        nibbleSetted = 0;
        data[currentPos++] = tempValue;
        //Einzelparameter: State
        tempValue = getValue(A_FSG_4_0_0_27_4);
        //voriger Parameter war ein first nibble, bei 1 Byte Werten Position incr
        if(nibbleSetted == 1) currentPos++;
        nibbleSetted = 0;
        data[currentPos++] = tempValue;
        //Einzelparameter: ASG_ID
        tempValue = getValue(A_FSG_4_0_0_27_5);
    if(nibbleSetted == 1)
    {
        //voriger Parameter war ein Nibble, => second nibble, Pos incr und Flag zuruecksetzen
        data[currentPos] = (tempValue &0x0F) | (data[currentPos] &0xF0);
        currentPos++;
        nibbleSetted = 0;
    }
    else
    {
        //first nibble, kein increment, Flag setzen
        data[currentPos] = (tempValue<<4) &0xF0;
        nibbleSetted = 1;
    }
        //Einzelparameter: TAID
        tempValue = getValue(A_FSG_4_0_0_27_6);
    if(nibbleSetted == 1)
    {
        //voriger Parameter war ein Nibble, => second nibble, Pos incr und Flag zuruecksetzen
        data[currentPos] = (tempValue &0x0F) | (data[currentPos] &0xF0);
        currentPos++;
        nibbleSetted = 0;
    }
    else
    {
        //first nibble, kein increment, Flag setzen
        data[currentPos] = (tempValue<<4) &0xF0;
        nibbleSetted = 1;
    }
        //Einzelparameter: TotalNumListElements
        tempValue = getValue(A_FSG_4_0_0_27_7);
        //voriger Parameter war ein first nibble, bei 1 Byte Werten Position incr
        if(nibbleSetted == 1) currentPos++;
        nibbleSetted = 0;
        data[currentPos++] = (tempValue ) & 0xFF;
        data[currentPos++] = (tempValue >> 8) & 0xFF;
        //head Parameter
        headLength = getValueSize(A_FSG_4_0_0_27);
        getValue(A_FSG_4_0_0_27,head);
        for(i=0; i< headLength; i++)
        {
            data[currentPos++] = head[i];
        }
    //data Parameter
     startVal = getValue(A_FSG_4_0_0_27_Start);
     elementsVal = getValue(A_FSG_4_0_0_27_Elements);
     nibbleSetted = 0;
    if( (head[0]&0x20) == 0)
    {
     if( (head[0] & 0x10) > 0)
     {
        startVal++;
     }
     for( i = startVal ; i < startVal + elementsVal ; i++)
     {
       if( i < 0 || i >= A_FSG_4_0_0_27_ArrayDataList_Length )
       {
         write("Array index ausserhalb der Grenzen, Fct: 27");
         break;
       }
      if(nibbleSetted == 1) currentPos++;
      nibbleSetted = 0;
     if( (head[0]&0x40) == 0){ /* Transmit_Pos = 0, keine Positionsdaten */ }
     else
     {
        if( (head[0]&0x80) == 0)
        {
           //IndexSize = 0, Pos als 1 Byte Wert
           //Kein POS definiert
        }
        else
        {
           //IndexSize = 1, Pos als 2 Byte Wert
           //Kein POS definiert
        }
     }
      // Check if the current value of RecAdr enables the variable Parameter_ID:
      if( 0 || 1 == getValue( A_FSG_4_0_0_27_RecAdr ) || 2 == getValue( A_FSG_4_0_0_27_RecAdr ) || 3 == getValue( A_FSG_4_0_0_27_RecAdr ) )
      {
        //Sollte vor einem 4 Byte Wert 1 Nibble kommen, muss der index um 1 incrementiert werden!
        if( nibbleSetted==1) currentPos++;
        nibbleSetted = 0;
        data[currentPos++] = (A_FSG_4_0_0_27_ArrayDataList[i].Param1      ) & 0xFF;
        data[currentPos++] = (A_FSG_4_0_0_27_ArrayDataList[i].Param1 >>  8) & 0xFF;
        data[currentPos++] = (A_FSG_4_0_0_27_ArrayDataList[i].Param1 >> 16) & 0xFF;
        data[currentPos++] = (A_FSG_4_0_0_27_ArrayDataList[i].Param1 >> 24) & 0xFF;
       }
      // Check if the current value of RecAdr enables the variable DataDescription:
      if( 0 || 1 == getValue( A_FSG_4_0_0_27_RecAdr ) || 2 == getValue( A_FSG_4_0_0_27_RecAdr ) || 3 == getValue( A_FSG_4_0_0_27_RecAdr ) )
      {
        //Sollte vor einem 1 Byte Wert 1 Nibble kommen, muss der index um 1 incrementiert werden!
        if( nibbleSetted==1) currentPos++;
        nibbleSetted = 0;
        data[currentPos++] = (A_FSG_4_0_0_27_ArrayDataList[i].Param2 ) & 0xFF;
       }
      // Check if the current value of RecAdr enables the variable DataTag:
      if( 0 || 2 == getValue( A_FSG_4_0_0_27_RecAdr ) || 3 == getValue( A_FSG_4_0_0_27_RecAdr ) )
      {
        //Sollte vor einem 1 Byte Wert 1 Nibble kommen, muss der index um 1 incrementiert werden!
        if( nibbleSetted==1) currentPos++;
        nibbleSetted = 0;
        data[currentPos++] = (A_FSG_4_0_0_27_ArrayDataList[i].Param3 ) & 0xFF;
       }
      // Check if the current value of RecAdr enables the variable Data:
      if( 0 || 3 == getValue( A_FSG_4_0_0_27_RecAdr ) )
      {
        //Sollte vor einem String Wert 1 Nibble kommen, muss der index um 1 incrementiert werden!
        if( nibbleSetted==1) currentPos++;
        nibbleSetted = 0;
        StringLength =A_FSG_4_0_0_27_ArrayDataList[i].Param4_Length;
		data[currentPos++] = (StringLength )& 0xFF;
		data[currentPos++] = (StringLength >> 8)& 0xFF;
		data[currentPos++] = (StringLength >> 16) & 0xFF;
		data[currentPos++] = (StringLength >> 24)& 0xFF;
        for(j=0; j < StringLength ; j++)
        {
            data[currentPos++] = A_FSG_4_0_0_27_ArrayDataList[i].Param4[j];
        }
       }
    //sollte der letzte Parameter ein first nibble gewesen sein, muss noch 1 increment durchgefuehrt werden
    if( nibbleSetted==1) currentPos++;
    nibbleSetted = 0;
     }
    }
    else
    {
     if( (head[0] & 0x10) > 0)
     {
        if(startVal != 0) startVal--;
        else
        {
           startVal = A_FSG_4_0_0_27_ArrayDataList_Length -1;
        }
     }
     for( i = startVal ; i > startVal - elementsVal ; i--)
     {
       if( i < 0 || i >= A_FSG_4_0_0_27_ArrayDataList_Length )
       {
         write("Array index ausserhalb der Grenzen, Fct: 27");
         break;
       }
      if(nibbleSetted == 1) currentPos++;
      nibbleSetted = 0;
     if( (head[0]&0x40) == 0){ /* Transmit_Pos = 0, keine Positionsdaten */ }
     else
     {
        if( (head[0]&0x80) == 0)
        {
           //IndexSize = 0, Pos als 1 Byte Wert
           //Kein POS definiert
        }
        else
        {
           //IndexSize = 1, Pos als 2 Byte Wert
           //Kein POS definiert
        }
     }
      // Check if the current value of RecAdr enables the variable Parameter_ID:
      if( 0 || 1 == getValue( A_FSG_4_0_0_27_RecAdr ) || 2 == getValue( A_FSG_4_0_0_27_RecAdr ) || 3 == getValue( A_FSG_4_0_0_27_RecAdr ) )
      {
        //Sollte vor einem 4 Byte Wert 1 Nibble kommen, muss der index um 1 incrementiert werden!
        if( nibbleSetted==1) currentPos++;
        nibbleSetted = 0;
        data[currentPos++] = (A_FSG_4_0_0_27_ArrayDataList[i].Param1      ) & 0xFF;
        data[currentPos++] = (A_FSG_4_0_0_27_ArrayDataList[i].Param1 >>  8) & 0xFF;
        data[currentPos++] = (A_FSG_4_0_0_27_ArrayDataList[i].Param1 >> 16) & 0xFF;
        data[currentPos++] = (A_FSG_4_0_0_27_ArrayDataList[i].Param1 >> 24) & 0xFF;
       }
      // Check if the current value of RecAdr enables the variable DataDescription:
      if( 0 || 1 == getValue( A_FSG_4_0_0_27_RecAdr ) || 2 == getValue( A_FSG_4_0_0_27_RecAdr ) || 3 == getValue( A_FSG_4_0_0_27_RecAdr ) )
      {
        //Sollte vor einem 1 Byte Wert 1 Nibble kommen, muss der index um 1 incrementiert werden!
        if( nibbleSetted==1) currentPos++;
        nibbleSetted = 0;
        data[currentPos++] = (A_FSG_4_0_0_27_ArrayDataList[i].Param2 ) & 0xFF;
       }
      // Check if the current value of RecAdr enables the variable DataTag:
      if( 0 || 2 == getValue( A_FSG_4_0_0_27_RecAdr ) || 3 == getValue( A_FSG_4_0_0_27_RecAdr ) )
      {
        //Sollte vor einem 1 Byte Wert 1 Nibble kommen, muss der index um 1 incrementiert werden!
        if( nibbleSetted==1) currentPos++;
        nibbleSetted = 0;
        data[currentPos++] = (A_FSG_4_0_0_27_ArrayDataList[i].Param3 ) & 0xFF;
       }
      // Check if the current value of RecAdr enables the variable Data:
      if( 0 || 3 == getValue( A_FSG_4_0_0_27_RecAdr ) )
      {
        //Sollte vor einem String Wert 1 Nibble kommen, muss der index um 1 incrementiert werden!
        if( nibbleSetted==1) currentPos++;
        nibbleSetted = 0;
        StringLength =A_FSG_4_0_0_27_ArrayDataList[i].Param4_Length;
		data[currentPos++] = (StringLength )& 0xFF;
		data[currentPos++] = (StringLength >> 8)& 0xFF;
		data[currentPos++] = (StringLength >> 16) & 0xFF;
		data[currentPos++] = (StringLength >> 24)& 0xFF;
        for(j=0; j < StringLength ; j++)
        {
            data[currentPos++] = A_FSG_4_0_0_27_ArrayDataList[i].Param4[j];
        }
       }
    //sollte der letzte Parameter ein first nibble gewesen sein, muss noch 1 increment durchgefuehrt werden
    if( nibbleSetted==1) currentPos++;
    nibbleSetted = 0;
     }
    }

        //getValue(A_FSG_4_0_0_27, data);
        Request_ByteSequence(LSGID, A_FSG_4_0_0_27_ID, Data_REQ, data,currentPos);
        if(getValue(A_FSG_4_0_0_27_IntTlgEn)) //getValue(IT))
        {
            intertelegram_err(A_FSG_4_0_0_27_ID);
        }
        if(getValue(A_FSG_4_0_0_27_SegmEn))   //getvalue(SG)
        {
            sequence_err(A_FSG_4_0_0_27_ID,getValueSize(A_FSG_4_0_0_27));
        }
        A_FSG_4_0_0_27Status_BTN_already_pressed = 0;
    }
}
A_FSG_4_0_0_27_SendStatus()
{
    dword currentPos;
    word headLength;
    dword i;
    dword j;
    dword StringLength;
    long tempValue;
    word startVal;
    word elementsVal;
    byte data[36];
    byte stringValue[36];
    byte head[5];
    byte nibbleSetted;
    nibbleSetted = 0;
        currentPos = 0;
        //Einzelparameter: Operation
        tempValue = getValue(A_FSG_4_0_0_27_1);
        //voriger Parameter war ein first nibble, bei 1 Byte Werten Position incr
        if(nibbleSetted == 1) currentPos++;
        nibbleSetted = 0;
        data[currentPos++] = tempValue;
        //Einzelparameter: Type
        tempValue = getValue(A_FSG_4_0_0_27_2);
        //voriger Parameter war ein first nibble, bei 1 Byte Werten Position incr
        if(nibbleSetted == 1) currentPos++;
        nibbleSetted = 0;
        data[currentPos++] = tempValue;
        //Einzelparameter: Slot
        tempValue = getValue(A_FSG_4_0_0_27_3);
        //voriger Parameter war ein first nibble, bei 1 Byte Werten Position incr
        if(nibbleSetted == 1) currentPos++;
        nibbleSetted = 0;
        data[currentPos++] = tempValue;
        //Einzelparameter: State
        tempValue = getValue(A_FSG_4_0_0_27_4);
        //voriger Parameter war ein first nibble, bei 1 Byte Werten Position incr
        if(nibbleSetted == 1) currentPos++;
        nibbleSetted = 0;
        data[currentPos++] = tempValue;
        //Einzelparameter: ASG_ID
        tempValue = getValue(A_FSG_4_0_0_27_5);
    if(nibbleSetted == 1)
    {
        //voriger Parameter war ein Nibble, => second nibble, Pos incr und Flag zuruecksetzen
        data[currentPos] = (tempValue &0x0F) | (data[currentPos] &0xF0);
        currentPos++;
        nibbleSetted = 0;
    }
    else
    {
        //first nibble, kein increment, Flag setzen
        data[currentPos] = (tempValue<<4) &0xF0;
        nibbleSetted = 1;
    }
        //Einzelparameter: TAID
        tempValue = getValue(A_FSG_4_0_0_27_6);
    if(nibbleSetted == 1)
    {
        //voriger Parameter war ein Nibble, => second nibble, Pos incr und Flag zuruecksetzen
        data[currentPos] = (tempValue &0x0F) | (data[currentPos] &0xF0);
        currentPos++;
        nibbleSetted = 0;
    }
    else
    {
        //first nibble, kein increment, Flag setzen
        data[currentPos] = (tempValue<<4) &0xF0;
        nibbleSetted = 1;
    }
        //Einzelparameter: TotalNumListElements
        tempValue = getValue(A_FSG_4_0_0_27_7);
        //voriger Parameter war ein first nibble, bei 1 Byte Werten Position incr
        if(nibbleSetted == 1) currentPos++;
        nibbleSetted = 0;
        data[currentPos++] = (tempValue ) & 0xFF;
        data[currentPos++] = (tempValue >> 8) & 0xFF;
        //head Parameter
        headLength = getValueSize(A_FSG_4_0_0_27);
        getValue(A_FSG_4_0_0_27,head);
        for(i=0; i< headLength; i++)
        {
            data[currentPos++] = head[i];
        }
    //data Parameter
     startVal = getValue(A_FSG_4_0_0_27_Start);
     elementsVal = getValue(A_FSG_4_0_0_27_Elements);
     nibbleSetted = 0;
    if( (head[0]&0x20) == 0)
    {
     if( (head[0] & 0x10) > 0)
     {
        startVal++;
     }
     for( i = startVal ; i < startVal + elementsVal ; i++)
     {
       if( i < 0 || i >= A_FSG_4_0_0_27_ArrayDataList_Length )
       {
         write("Array index ausserhalb der Grenzen, Fct: 27");
         break;
       }
      if(nibbleSetted == 1) currentPos++;
      nibbleSetted = 0;
     if( (head[0]&0x40) == 0){ /* Transmit_Pos = 0, keine Positionsdaten */ }
     else
     {
        if( (head[0]&0x80) == 0)
        {
           //IndexSize = 0, Pos als 1 Byte Wert
           //Kein POS definiert
        }
        else
        {
           //IndexSize = 1, Pos als 2 Byte Wert
           //Kein POS definiert
        }
     }
      // Check if the current value of RecAdr enables the variable Parameter_ID:
      if( 0 || 1 == getValue( A_FSG_4_0_0_27_RecAdr ) || 2 == getValue( A_FSG_4_0_0_27_RecAdr ) || 3 == getValue( A_FSG_4_0_0_27_RecAdr ) )
      {
        //Sollte vor einem 4 Byte Wert 1 Nibble kommen, muss der index um 1 incrementiert werden!
        if( nibbleSetted==1) currentPos++;
        nibbleSetted = 0;
        data[currentPos++] = (A_FSG_4_0_0_27_ArrayDataList[i].Param1      ) & 0xFF;
        data[currentPos++] = (A_FSG_4_0_0_27_ArrayDataList[i].Param1 >>  8) & 0xFF;
        data[currentPos++] = (A_FSG_4_0_0_27_ArrayDataList[i].Param1 >> 16) & 0xFF;
        data[currentPos++] = (A_FSG_4_0_0_27_ArrayDataList[i].Param1 >> 24) & 0xFF;
       }
      // Check if the current value of RecAdr enables the variable DataDescription:
      if( 0 || 1 == getValue( A_FSG_4_0_0_27_RecAdr ) || 2 == getValue( A_FSG_4_0_0_27_RecAdr ) || 3 == getValue( A_FSG_4_0_0_27_RecAdr ) )
      {
        //Sollte vor einem 1 Byte Wert 1 Nibble kommen, muss der index um 1 incrementiert werden!
        if( nibbleSetted==1) currentPos++;
        nibbleSetted = 0;
        data[currentPos++] = (A_FSG_4_0_0_27_ArrayDataList[i].Param2 ) & 0xFF;
       }
      // Check if the current value of RecAdr enables the variable DataTag:
      if( 0 || 2 == getValue( A_FSG_4_0_0_27_RecAdr ) || 3 == getValue( A_FSG_4_0_0_27_RecAdr ) )
      {
        //Sollte vor einem 1 Byte Wert 1 Nibble kommen, muss der index um 1 incrementiert werden!
        if( nibbleSetted==1) currentPos++;
        nibbleSetted = 0;
        data[currentPos++] = (A_FSG_4_0_0_27_ArrayDataList[i].Param3 ) & 0xFF;
       }
      // Check if the current value of RecAdr enables the variable Data:
      if( 0 || 3 == getValue( A_FSG_4_0_0_27_RecAdr ) )
      {
        //Sollte vor einem String Wert 1 Nibble kommen, muss der index um 1 incrementiert werden!
        if( nibbleSetted==1) currentPos++;
        nibbleSetted = 0;
        StringLength =A_FSG_4_0_0_27_ArrayDataList[i].Param4_Length;
		data[currentPos++] = (StringLength )& 0xFF;
		data[currentPos++] = (StringLength >> 8)& 0xFF;
		data[currentPos++] = (StringLength >> 16) & 0xFF;
		data[currentPos++] = (StringLength >> 24)& 0xFF;
        for(j=0; j < StringLength ; j++)
        {
            data[currentPos++] = A_FSG_4_0_0_27_ArrayDataList[i].Param4[j];
        }
       }
    //sollte der letzte Parameter ein first nibble gewesen sein, muss noch 1 increment durchgefuehrt werden
    if( nibbleSetted==1) currentPos++;
    nibbleSetted = 0;
     }
    }
    else
    {
     if( (head[0] & 0x10) > 0)
     {
        if(startVal != 0) startVal--;
        else
        {
           startVal = A_FSG_4_0_0_27_ArrayDataList_Length -1;
        }
     }
     for( i = startVal ; i > startVal - elementsVal ; i--)
     {
       if( i < 0 || i >= A_FSG_4_0_0_27_ArrayDataList_Length )
       {
         write("Array index ausserhalb der Grenzen, Fct: 27");
         break;
       }
      if(nibbleSetted == 1) currentPos++;
      nibbleSetted = 0;
     if( (head[0]&0x40) == 0){ /* Transmit_Pos = 0, keine Positionsdaten */ }
     else
     {
        if( (head[0]&0x80) == 0)
        {
           //IndexSize = 0, Pos als 1 Byte Wert
           //Kein POS definiert
        }
        else
        {
           //IndexSize = 1, Pos als 2 Byte Wert
           //Kein POS definiert
        }
     }
      // Check if the current value of RecAdr enables the variable Parameter_ID:
      if( 0 || 1 == getValue( A_FSG_4_0_0_27_RecAdr ) || 2 == getValue( A_FSG_4_0_0_27_RecAdr ) || 3 == getValue( A_FSG_4_0_0_27_RecAdr ) )
      {
        //Sollte vor einem 4 Byte Wert 1 Nibble kommen, muss der index um 1 incrementiert werden!
        if( nibbleSetted==1) currentPos++;
        nibbleSetted = 0;
        data[currentPos++] = (A_FSG_4_0_0_27_ArrayDataList[i].Param1      ) & 0xFF;
        data[currentPos++] = (A_FSG_4_0_0_27_ArrayDataList[i].Param1 >>  8) & 0xFF;
        data[currentPos++] = (A_FSG_4_0_0_27_ArrayDataList[i].Param1 >> 16) & 0xFF;
        data[currentPos++] = (A_FSG_4_0_0_27_ArrayDataList[i].Param1 >> 24) & 0xFF;
       }
      // Check if the current value of RecAdr enables the variable DataDescription:
      if( 0 || 1 == getValue( A_FSG_4_0_0_27_RecAdr ) || 2 == getValue( A_FSG_4_0_0_27_RecAdr ) || 3 == getValue( A_FSG_4_0_0_27_RecAdr ) )
      {
        //Sollte vor einem 1 Byte Wert 1 Nibble kommen, muss der index um 1 incrementiert werden!
        if( nibbleSetted==1) currentPos++;
        nibbleSetted = 0;
        data[currentPos++] = (A_FSG_4_0_0_27_ArrayDataList[i].Param2 ) & 0xFF;
       }
      // Check if the current value of RecAdr enables the variable DataTag:
      if( 0 || 2 == getValue( A_FSG_4_0_0_27_RecAdr ) || 3 == getValue( A_FSG_4_0_0_27_RecAdr ) )
      {
        //Sollte vor einem 1 Byte Wert 1 Nibble kommen, muss der index um 1 incrementiert werden!
        if( nibbleSetted==1) currentPos++;
        nibbleSetted = 0;
        data[currentPos++] = (A_FSG_4_0_0_27_ArrayDataList[i].Param3 ) & 0xFF;
       }
      // Check if the current value of RecAdr enables the variable Data:
      if( 0 || 3 == getValue( A_FSG_4_0_0_27_RecAdr ) )
      {
        //Sollte vor einem String Wert 1 Nibble kommen, muss der index um 1 incrementiert werden!
        if( nibbleSetted==1) currentPos++;
        nibbleSetted = 0;
        StringLength =A_FSG_4_0_0_27_ArrayDataList[i].Param4_Length;
		data[currentPos++] = (StringLength )& 0xFF;
		data[currentPos++] = (StringLength >> 8)& 0xFF;
		data[currentPos++] = (StringLength >> 16) & 0xFF;
		data[currentPos++] = (StringLength >> 24)& 0xFF;
        for(j=0; j < StringLength ; j++)
        {
            data[currentPos++] = A_FSG_4_0_0_27_ArrayDataList[i].Param4[j];
        }
       }
    //sollte der letzte Parameter ein first nibble gewesen sein, muss noch 1 increment durchgefuehrt werden
    if( nibbleSetted==1) currentPos++;
    nibbleSetted = 0;
     }
    }
    Request_byteSequence(LSGID, A_FSG_4_0_0_27_ID, Data_REQ, data, currentPos);
}
on envVar A_FSG_4_0_0_27
{
    byte temp[36];
    getValue(A_FSG_4_0_0_27, temp);
    putValue(A_FSG_4_0_0_27_RecAdr, 0x0F & temp[0]); //Record Address = Bit 0-3 von Byte 0
    if ( (0x10 & temp[0]) >0)
        putValue(A_FSG_4_0_0_27_Shift, 1); //Shift = Bit 4 von Byte 0
    else
        putValue(A_FSG_4_0_0_27_Shift, 0); //Shift = Bit 4 von Byte 0
    if ( (0x20 & temp[0]) >0)
        putValue(A_FSG_4_0_0_27_Direction, 1); //Direction = Bit 5 von Byte 0
    else
        putValue(A_FSG_4_0_0_27_Direction, 0); //Direction = Bit 5 von Byte 0
    if ( (0x40 & temp[0]) >0)
        putValue(A_FSG_4_0_0_27_TransPos, 1); //Transmission Pos = Bit 6 von Byte 0
    else
        putValue(A_FSG_4_0_0_27_TransPos, 0); //Transmission Pos = Bit 6 von Byte 0
    if ( (0x80 & temp[0]) >0)
        putValue(A_FSG_4_0_0_27_IndexSize, 1); //IndexSize = Bit 7 von Byte 0
    else
        putValue(A_FSG_4_0_0_27_IndexSize, 0); //IndexSize = Bit 7 von Byte 0
    if(getValue(A_FSG_4_0_0_27_IndexSize))
    {
        putValue(A_FSG_4_0_0_27_Start, ((temp[2]<<8)| temp[1]) ); // Array Start index, 2 Byte.
        putValue(A_FSG_4_0_0_27_Elements, ((temp[4]<<8)| temp[3]) ); // Array element count, 2 Byte.
    }
    else
    {
        putValue(A_FSG_4_0_0_27_Start, temp[1]); // Array Start index, 1 Byte.
        putValue(A_FSG_4_0_0_27_Elements, temp[2]); // Array element count, 1 Byte.
    }
}
A_FSG_4_0_0_27_GenerateStatus()
{
    byte head[5];
    int i = 0;
    int headLength;
    long tempValue;
    int currentPos;
    //Record Address in Byte 0 Bit 0-3 kopieren - MAX Wert = 0x0F
    if(getValue(A_FSG_4_0_0_27_RecAdr) > 0x0F)
        putValue(A_FSG_4_0_0_27_RecAdr , 0x0F);
    head[0] = (head[0] & 0xF0) | getValue(A_FSG_4_0_0_27_RecAdr);
    //Shift Bit in Byte 0 Bit 4 kopieren
    if( getValue(A_FSG_4_0_0_27_Shift) > 0) head[0] = head[0] | 0x10;
    else head[0] = head[0] & 0xEF;
    // Direction Bit in Byte 0 Bit 5 kopieren
    if( getValue(A_FSG_4_0_0_27_Direction) > 0) head[0] = head[0] | 0x20;
    else head[0] = head[0] & 0xDF;
    // TransmissionPos Bit in Byte 0 Bit 6 kopieren
    if( getValue(A_FSG_4_0_0_27_TransPos) > 0) head[0] = head[0] | 0x40;
    else head[0] = head[0] & 0xBF;
    if( getValue(A_FSG_4_0_0_27_IndexSize) > 0)
    {
        // 5 Byte Header
        head[0] = head[0] | 0x80;
        head[1] =  getValue(A_FSG_4_0_0_27_Start) & 0xFF;
        head[2] = (getValue(A_FSG_4_0_0_27_Start) >> 8 ) & 0xFF;
        head[3] =  getValue(A_FSG_4_0_0_27_Elements) & 0xFF;
        head[4] = (getValue(A_FSG_4_0_0_27_Elements)  >> 8 ) & 0xFF;
        //ToDo: DATA - derzeit einfach laenge = 5
        headLength = 5;
    }
    else 
    {
        // 3 Byte Header
        head[0] = head[0] & 0x7F;
        head[1] = getValue(A_FSG_4_0_0_27_Start) & 0xFF;
        head[2] = getValue(A_FSG_4_0_0_27_Elements) & 0xFF;
        //ToDo: DATA - derzeit einfach laenge = 3
        headLength = 3;
    }

    currentPos = 0;

    putValue(A_FSG_4_0_0_27, head, headLength); 
}

on envVar A_FSG_4_0_0_27_RecAdr
{
    A_FSG_4_0_0_27_GenerateStatus();
}

on envVar A_FSG_4_0_0_27_Shift
{
    A_FSG_4_0_0_27_GenerateStatus();
}

on envVar A_FSG_4_0_0_27_Direction
{
    A_FSG_4_0_0_27_GenerateStatus();
}

on envVar A_FSG_4_0_0_27_Start
{
    A_FSG_4_0_0_27_GenerateStatus();
}

on envVar A_FSG_4_0_0_27_Elements
{
    A_FSG_4_0_0_27_GenerateStatus();
}

on envVar A_FSG_4_0_0_27_IndexSize
{
    A_FSG_4_0_0_27_GenerateStatus();
}
on envVar A_FSG_4_0_0_27_TransPos
{
    A_FSG_4_0_0_27_GenerateStatus();
}
A_FSG_4_0_0_27_Changed_GenerateChanged()
{
    byte head[5];
    //Record Address in Byte 0 Bit 0-3 kopieren - MAX Wert = 0x0F
    if(getValue(A_FSG_4_0_0_27_Changed_RecAdr) > 0x0F)
        putValue(A_FSG_4_0_0_27_Changed_RecAdr , 0x0F);
    head[0] = (head[0] & 0xF0) | getValue(A_FSG_4_0_0_27_Changed_RecAdr);
    //Shift Bit in Byte 0 Bit 4 kopieren
    if( getValue(A_FSG_4_0_0_27_Changed_Shift) > 0) head[0] = head[0] | 0x10;
    else head[0] = head[0] & 0xEF;
    // Direction Bit in Byte 0 Bit 5 kopieren
    if( getValue(A_FSG_4_0_0_27_Changed_Direction) > 0) head[0] = head[0] | 0x20;
    else head[0] = head[0] & 0xDF;
    // TransmissionPos Bit in Byte 0 Bit 6 kopieren
    if( getValue(A_FSG_4_0_0_27_Changed_TransPos) > 0) head[0] = head[0] | 0x40;
    else head[0] = head[0] & 0xBF;
    if( getValue(A_FSG_4_0_0_27_Changed_IndexSize) > 0)
    {
        // 5 Byte Header
        head[0] = head[0] | 0x80;
        head[1] =  getValue(A_FSG_4_0_0_27_Changed_Start) & 0xFF;
        head[2] = (getValue(A_FSG_4_0_0_27_Changed_Start) >> 8 ) & 0xFF;
        head[3] =  getValue(A_FSG_4_0_0_27_Changed_Elements) & 0xFF;
        head[4] = (getValue(A_FSG_4_0_0_27_Changed_Elements)  >> 8 ) & 0xFF;
        //ToDo: DATA - derzeit einfach laenge = 5
        putValue(A_FSG_4_0_0_27_Changed, head, 5); 
    }
    else 
    {
        // 3 Byte Header
        head[0] = head[0] & 0x7F;
        head[1] = getValue(A_FSG_4_0_0_27_Changed_Start) & 0xFF;
        head[2] = getValue(A_FSG_4_0_0_27_Changed_Elements) & 0xFF;
        //ToDo: DATA - derzeit einfach laenge = 3
        putValue(A_FSG_4_0_0_27_Changed, head, 3); 
    }
}

on envVar A_FSG_4_0_0_27_Changed_RecAdr
{
    A_FSG_4_0_0_27_Changed_GenerateChanged();
}

on envVar A_FSG_4_0_0_27_Changed_Shift
{
    A_FSG_4_0_0_27_Changed_GenerateChanged();
}

on envVar A_FSG_4_0_0_27_Changed_Direction
{
    A_FSG_4_0_0_27_Changed_GenerateChanged();
}

on envVar A_FSG_4_0_0_27_Changed_Start
{
    A_FSG_4_0_0_27_Changed_GenerateChanged();
}

on envVar A_FSG_4_0_0_27_Changed_Elements
{
    A_FSG_4_0_0_27_Changed_GenerateChanged();
}

on envVar A_FSG_4_0_0_27_Changed_IndexSize
{
    A_FSG_4_0_0_27_Changed_GenerateChanged();
}
on envVar A_FSG_4_0_0_27_Changed_TransPos
{
    A_FSG_4_0_0_27_Changed_GenerateChanged();
}
on envVar A_FSG_4_0_0_27_SetGet
{
    byte temp[36];
    getValue(A_FSG_4_0_0_27_SetGet, temp);
    putValue(A_FSG_4_0_0_27_SetGet_RecAdr, 0x0F & temp[0]); //Record Address = Bit 0-3 von Byte 0
    if ( (0x10 & temp[0]) >0)
        putValue(A_FSG_4_0_0_27_SetGet_Shift, 1); //Shift = Bit 4 von Byte 0
    else
        putValue(A_FSG_4_0_0_27_SetGet_Shift, 0); //Shift = Bit 4 von Byte 0
    if ( (0x20 & temp[0]) >0)
        putValue(A_FSG_4_0_0_27_SetGet_Direction, 1); //Direction = Bit 5 von Byte 0
    else
        putValue(A_FSG_4_0_0_27_SetGet_Direction, 0); //Direction = Bit 5 von Byte 0
    // Bit 6 von Byte 0 = reserved
    if ( (0x80 & temp[0]) >0)
        putValue(A_FSG_4_0_0_27_SetGet_IndexSize, 1); //IndexSize = Bit 7 von Byte 0
    else
        putValue(A_FSG_4_0_0_27_SetGet_IndexSize, 0); //IndexSize = Bit 7 von Byte 0
    if(getValue(A_FSG_4_0_0_27_SetGet_IndexSize))
    {
        putValue(A_FSG_4_0_0_27_SetGet_Start, ((temp[2]<<8)| temp[1]) ); //Start Wert, 2 Byte lang
        putValue(A_FSG_4_0_0_27_SetGet_Elements, ((temp[4]<<8)| temp[3]) ); //Elements Wert, 2 Byte lang
    }
    else
    {
        putValue(A_FSG_4_0_0_27_SetGet_Start, temp[1]); //Start Wert, 1 Byte lang
        putValue(A_FSG_4_0_0_27_SetGet_Elements, temp[2]); //Start Wert, 1 Byte lang
    }
}
A_FSG_4_0_0_27_LoadArray()
{
	/********* Statische Deklarationen ***********/
	dword CSVfileHandle;
	dword filePos;
	dword paramPos;
	dword Num_of_csv_byte;
	dword element;
	dword current_CSV_line;
	byte buffer_byte[0xFFFF];
	dword i;
	dword j;
	char CSV_filename[255];

	/********* Param Puffer Deklarationen ***********/
	char temp1[25];
	char temp2[25];
	char temp3[25];

	/********* Initialisierungen ***********/
	CSVfileHandle = 0;
	filePos = 0;
	paramPos = 0;
	Num_of_csv_byte = 0;
	element = 1;
	current_CSV_line = 0;
	for(i = 0; i < A_FSG_4_0_0_27_ArrayDataList_Length; i++)
	{ /* Initialisierung von den Ziel-Strukturen */
		A_FSG_4_0_0_27_ArrayDataList[i].Param1 = 0;
		A_FSG_4_0_0_27_ArrayDataList[i].Param2 = 0;
		A_FSG_4_0_0_27_ArrayDataList[i].Param3 = 0;
		for(j=0; j<5; j++)
			A_FSG_4_0_0_27_ArrayDataList[i].Param4[j] = 0;
		A_FSG_4_0_0_27_ArrayDataList[i].Param4_Length = 0;
		A_FSG_4_0_0_27_Data_4_LenList[i] = 0;
	}

	/********* Laden der CSV-Datei ***********/
	getValue(A_FSG_4_0_0_27_fileSelector, CSV_filename);
	CSVfileHandle = openFileRead(CSV_filename, 1); //open *.csv (binary-mode ->get the ASCII/UTF-8 code)

	if (CSVfileHandle!=0) //*.csv file access successful
	{
		writelineEx(gBAP_Trace, 0,"Dateizugriff auf '%s' erfolgreich", CSV_filename);    //output result
		//get data from *.csv and store the total number of byte in *.csv-file
		Num_of_csv_byte = fileGetBinaryBlock (buffer_byte, elcount(buffer_byte), CSVfileHandle);

		for (filePos = 0; filePos < Num_of_csv_byte; filePos++) //copy data into "LastDestList"
		{
			if (buffer_byte[filePos] != 0x3B) //read data if no ";" is detected
			{
				//nextline in *.csv (next "record element" in LastDestList) -> "LF" and "CR" detected -> copy (transform string -> long) data from help values in global values
				if(buffer_byte[filePos] == 0x0D && buffer_byte[filePos+1] == 0x0A)
				{
					if(current_CSV_line > 0 && current_CSV_line < 31) //ignore first line in *.csv file
					{
						A_FSG_4_0_0_27_ArrayDataList[current_CSV_line-1].Param1 = atol(temp1); //Parameter_ID
						A_FSG_4_0_0_27_ArrayDataList[current_CSV_line-1].Param2 = atol(temp2); //DataDescription
						A_FSG_4_0_0_27_ArrayDataList[current_CSV_line-1].Param3 = atol(temp3); //DataTag
						for(i = 0; i < 25; i++)
						{ /* Temp-Puffer Initialisierung zur Vermeidung von Nebeneffekte */
							temp1[i]=0;
							temp2[i]=0;
							temp3[i]=0;
						}
					}
					current_CSV_line++; //next line in *.csv file
					element = 1; //start at 'POS' (first record element of "array data")
					paramPos = 0; //reset value
				}
 				//copy data from "buffer_byte" (data from *.csv file) in help values and "name" until end of line is not detected
				else if(current_CSV_line > 0 && current_CSV_line < 31)
				{
					//writelineEx(gBAP_Trace, 0, "Element %x  Index %x", element, j);
					switch (element)
					{
						case 1: //Parameter_ID
								if( paramPos >= elCount(temp1) ){
									writelineEx(gBAP_Trace, 0, "Param%x in Zeile %d in der Input CSV Datei, enthaelt mehr Zeichen als erlaubt. Bearbeitung abgebrochen!", element, current_CSV_line);
									return; //False
								}else{
									temp1[paramPos] = buffer_byte[filePos];
									paramPos++;
								}
							break;
						case 2: //DataDescription
								if( paramPos >= elCount(temp2) ){
									writelineEx(gBAP_Trace, 0, "Param%x in Zeile %d in der Input CSV Datei, enthaelt mehr Zeichen als erlaubt. Bearbeitung abgebrochen!", element, current_CSV_line);
									return; //False
								}else{
									temp2[paramPos] = buffer_byte[filePos];
									paramPos++;
								}
							break;
						case 3: //DataTag
								if( paramPos >= elCount(temp3) ){
									writelineEx(gBAP_Trace, 0, "Param%x in Zeile %d in der Input CSV Datei, enthaelt mehr Zeichen als erlaubt. Bearbeitung abgebrochen!", element, current_CSV_line);
									return; //False
								}else{
									temp3[paramPos] = buffer_byte[filePos];
									paramPos++;
								}
							break;
						case 4: //Data
								if(paramPos < 1)
								{
									A_FSG_4_0_0_27_ArrayDataList[current_CSV_line-1].Param4[paramPos] = buffer_byte[filePos];
									A_FSG_4_0_0_27_ArrayDataList[current_CSV_line-1].Param4_Length = paramPos +1;
								}
								paramPos++;
						break;
						default:
						break;
					}
				}
			}
			else  // ";" is detected ->next record element of "array data"
			{
				//writelineEx(gBAP_Trace, 0, "naechstes Element %d Bytes",element);
				element++;
				paramPos=0; //reset value
			}
		}

		if(fileClose (CSVfileHandle) !=0) //close *.csv file
			writelineEx(gBAP_Trace, 0,"Datei '%s' geschlossen", CSV_filename); //output result
		else
			writelineEx(gBAP_Trace, 0,"Fehler beim Schliessen der Datei '%s'", CSV_filename);//output result
	}
	else //*.csv file access not successful
	{
		writelineEx(gBAP_Trace, 0,"Fehler beim Dateizugriff auf '%s'",CSV_filename); //output result
	}
}

on envVar A_FSG_4_0_0_27_loadArray_Btn
{
	char filePath[255];
	if (A_FSG_4_0_0_27_generateData_Btn_already_pressed == 0)
	{
		A_FSG_4_0_0_27_generateData_Btn_already_pressed = 1;
	}
	else
	{
		A_FSG_4_0_0_27_generateData_Btn_already_pressed = 0;
		getValue(A_FSG_4_0_0_27_fileSelector, filePath);
		if(0 == strlen(filePath))
		{
			writelineEx(gBAP_Trace, 0, "Invalid file path!");
		}
		else
		{
			A_FSG_4_0_0_27_LoadArray();
			writelineEx(gBAP_Trace, 0, "Load array from CSV file: %s", filePath);
		}
		putValue(A_FSG_4_0_0_27_Data_1, A_FSG_4_0_0_27_ArrayDataList[ getValue( A_FSG_4_0_0_27_DataIndex) ].Param1);
	putValue(A_FSG_4_0_0_27_Data_2, A_FSG_4_0_0_27_ArrayDataList[ getValue( A_FSG_4_0_0_27_DataIndex) ].Param2);
	putValue(A_FSG_4_0_0_27_Data_3, A_FSG_4_0_0_27_ArrayDataList[ getValue( A_FSG_4_0_0_27_DataIndex) ].Param3);
	putValue(A_FSG_4_0_0_27_Data_4, A_FSG_4_0_0_27_ArrayDataList[ getValue( A_FSG_4_0_0_27_DataIndex) ].Param4, A_FSG_4_0_0_27_ArrayDataList[getValue(A_FSG_4_0_0_27_DataIndex)].Param4_Length);
	}
}


on envVar A_FSG_4_0_0_27_generateData_Btn
{
	word i;
	dword elementsArray[5] = {4, 1, 1, 5, 2};
	byte elementsTypeArray[5] = {0, 0, 0, 0xC, 0xD};
	dword elementsMaxSizeArray[5] = {4294967295LL, 255, 0xFF, 0, 0};
	byte tempArray[450];
	if (A_FSG_4_0_0_27_generateData_Btn_already_pressed == 0)
	{
		A_FSG_4_0_0_27_generateData_Btn_already_pressed = 1;
	}
	else
	{
		initStruct(tempArray, elementsArray, elementsTypeArray, elementsMaxSizeArray, 27, 30 );
		for(i = 0; i < 30; i++)
		{
			memcpy(A_FSG_4_0_0_27_ArrayDataList[i], tempArray, (i * 15) );
			if(A_FSG_4_0_0_27_ArrayDataList[i].Param4_Length > 127 )
				A_FSG_4_0_0_27_Data_4_CntList[i] = 1;
		}
		A_FSG_4_0_0_27_generateData_Btn_already_pressed = 0;
	putValue(A_FSG_4_0_0_27_Data_1, A_FSG_4_0_0_27_ArrayDataList[ getValue( A_FSG_4_0_0_27_DataIndex) ].Param1);
	putValue(A_FSG_4_0_0_27_Data_2, A_FSG_4_0_0_27_ArrayDataList[ getValue( A_FSG_4_0_0_27_DataIndex) ].Param2);
	putValue(A_FSG_4_0_0_27_Data_3, A_FSG_4_0_0_27_ArrayDataList[ getValue( A_FSG_4_0_0_27_DataIndex) ].Param3);
	putValue(A_FSG_4_0_0_27_Data_4, A_FSG_4_0_0_27_ArrayDataList[ getValue( A_FSG_4_0_0_27_DataIndex) ].Param4, A_FSG_4_0_0_27_ArrayDataList[getValue(A_FSG_4_0_0_27_DataIndex)].Param4_Length);
	}
}
// HME generateCaplOnEnv (3131)
on envVar A_FSG_4_0_0_27_DataIndex
{
    long index;
    long maxIndex = 30-1;
    index = getValue(this);
    if(index >= maxIndex) index = maxIndex;
    else if(index < 0) index = 0;
    putValue(this, index);
    putValue(A_FSG_4_0_0_27_Data_1, A_FSG_4_0_0_27_ArrayDataList[index].Param1*(1.0)-(0.0));
    putValue(A_FSG_4_0_0_27_Data_2, A_FSG_4_0_0_27_ArrayDataList[index].Param2*(1.0)-(0.0));
    putValue(A_FSG_4_0_0_27_Data_3, A_FSG_4_0_0_27_ArrayDataList[index].Param3);
    putValue(A_FSG_4_0_0_27_Data_4_len, A_FSG_4_0_0_27_Data_4_LenList[index]);
    putValue(A_FSG_4_0_0_27_Data_4, A_FSG_4_0_0_27_ArrayDataList[index].Param4, A_FSG_4_0_0_27_ArrayDataList[index].Param4_Length);

}
on envVar A_FSG_4_0_0_27_DataIndex_Incr
{
    long index;
    if(A_FSG_4_0_0_27_DataIndex_Incr_already_pressed == 0)
    {
        A_FSG_4_0_0_27_DataIndex_Incr_already_pressed = 1;
    }
    else
    {
        index = getValue(A_FSG_4_0_0_27_DataIndex);
        index++;
        putValue(A_FSG_4_0_0_27_DataIndex, index);
        A_FSG_4_0_0_27_DataIndex_Incr_already_pressed = 0;
    }
}
on envVar A_FSG_4_0_0_27_DataIndex_Decr
{
    long index;
    if(A_FSG_4_0_0_27_DataIndex_Decr_already_pressed == 0)
    {
        A_FSG_4_0_0_27_DataIndex_Decr_already_pressed = 1;
    }
    else
    {
        index = getValue(A_FSG_4_0_0_27_DataIndex);
        index--;
        putValue(A_FSG_4_0_0_27_DataIndex, index);
        A_FSG_4_0_0_27_DataIndex_Decr_already_pressed = 0;
    }
}
// HME generateCaplOnEnv (3160)
on envVar A_FSG_4_0_0_27_DataIndex_SetGet
{
    long index;
    long maxIndex = 30-1;
    index = getValue(this);
    if(index >= maxIndex) index = maxIndex;
    else if(index < 0) index = 0;
    putValue(this, index);
    putValue(A_FSG_4_0_0_27_Data_1_SetGet, A_FSG_4_0_0_27_ArrayDataList[index].Param1*(1.0)-(0.0));
    putValue(A_FSG_4_0_0_27_Data_2_SetGet, A_FSG_4_0_0_27_ArrayDataList[index].Param2*(1.0)-(0.0));
    putValue(A_FSG_4_0_0_27_Data_3_SetGet, A_FSG_4_0_0_27_ArrayDataList[index].Param3);
    putValue(A_FSG_4_0_0_27_Data_4_SetGet_len, A_FSG_4_0_0_27_Data_4_SetGet_LenList[index]);
    putValue(A_FSG_4_0_0_27_Data_4_SetGet, A_FSG_4_0_0_27_ArrayDataList[index].Param4, A_FSG_4_0_0_27_ArrayDataList[index].Param4_Length);

}
on envVar A_FSG_4_0_0_27_DataIndex_SetGet_Incr
{
    long index;
    if(A_FSG_4_0_0_27_DataIndex_SetGet_Incr_already_pressed == 0)
    {
        A_FSG_4_0_0_27_DataIndex_SetGet_Incr_already_pressed = 1;
    }
    else
    {
        index = getValue(A_FSG_4_0_0_27_DataIndex_SetGet);
        index++;
        putValue(A_FSG_4_0_0_27_DataIndex_SetGet, index);
        A_FSG_4_0_0_27_DataIndex_SetGet_Incr_already_pressed = 0;
    }
}
on envVar A_FSG_4_0_0_27_DataIndex_SetGet_Decr
{
    long index;
    if(A_FSG_4_0_0_27_DataIndex_SetGet_Decr_already_pressed == 0)
    {
        A_FSG_4_0_0_27_DataIndex_SetGet_Decr_already_pressed = 1;
    }
    else
    {
        index = getValue(A_FSG_4_0_0_27_DataIndex_SetGet);
        index--;
        putValue(A_FSG_4_0_0_27_DataIndex_SetGet, index);
        A_FSG_4_0_0_27_DataIndex_SetGet_Decr_already_pressed = 0;
    }
}
on envVar A_FSG_4_0_0_27_FctEn
{
    long data[3];
    data[0]=LSGID;
    data[1]=A_FSG_4_0_0_27_ID;
    data[2]=getValue(A_FSG_4_0_0_27_FctEn);
    ChangeConfig(0x0031,data);
}
// De-Aktivierung der Eingabefelder der FCTID A_FSG_4_0_0_27
on envVar A_FSG_4_0_0_27_FctLstItemEn
{
       if(getValue(this)) 
       {
           EnableControl(panel_name,"panel_FSG_4_0_0_27",1);
           EnableControl(panel_name,"panel_A_FSG_4_0_0_27_Status",1);
           EnableControl(panel_name,"errfield_A_FSG_4_0_0_27",1);
           EnableControl(panel_name,"panel_A_FSG_4_0_0_27",1);
           EnableControl(panel_name,"panel_A_FSG_4_0_0_27_Changed",1);
           EnableControl(panel_name,"panel_A_FSG_4_0_0_27_SetGet",1);
           setControlForeColor(panel_name, "checkbox_A_FSG_4_0_0_27", MakeRGB(0,240,0));
       }
       else
       {
           EnableControl(panel_name,"panel_FSG_4_0_0_27",0);
           EnableControl(panel_name,"panel_A_FSG_4_0_0_27_Status",0);
           EnableControl(panel_name,"errfield_A_FSG_4_0_0_27",0);
           EnableControl(panel_name,"panel_A_FSG_4_0_0_27",0);
           EnableControl(panel_name,"panel_A_FSG_4_0_0_27_Changed",0);
           EnableControl(panel_name,"panel_A_FSG_4_0_0_27_SetGet",0);
           setControlForeColor(panel_name, "checkbox_A_FSG_4_0_0_27", MakeRGB(250,0,0));
       }
}
// Man darf gleichzeitig nur Checkbox fuer SegmError oder IntertelegramError aktiviert werden
on envVar A_FSG_4_0_0_27_IntTlgEn
{
       if(getValue(this)) 
       {
           putValue(A_FSG_4_0_0_27_SegmEn,0);
           intertelegram_err(A_FSG_4_0_0_27_ID);
       }
       else
       {
           intertelegram_err_off(A_FSG_4_0_0_27_ID);
       }
}
// Man darf gleichzeitig nur Checkbox fuer SegmError oder IntertelegramError aktiviert werden
on envVar A_FSG_4_0_0_27_SegmEn
{
       if(getValue(this)) 
       {
           putValue(A_FSG_4_0_0_27_IntTlgEn,0);
           sequence_err(A_FSG_4_0_0_27_ID,getValueSize(A_FSG_4_0_0_27_SegmEn));
       }
       else
       {
              sequence_err_off(A_FSG_4_0_0_27_ID);
       }
}

// [XL] Ueberwachung der CheckBox fuer AT
on envVar A_FSG_4_0_0_27_AT
{
	if(getValue(this))
	{
		EnableControl(panel_name,"panel_A_FSG_4_0_0_27_Status",0);
	}
	else
	{
   	EnableControl(panel_name,"panel_A_FSG_4_0_0_27_Status",1);
 	}
}



A_FSG_4_0_0_27_SetInd () { /* leere Function*/ }

A_FSG_4_0_0_27_SetGetInd()
{
    dword currentPos;
    byte head[5];
    byte stringTempValue[36];
    dword i;
    dword j;
    int startVal;
    int elementsVal;
    byte recordAddressVal;
    byte transmitPosVal;
    long tempValue;
    long index;
    byte nibbleSetted;
    currentPos = 0;
    nibbleSetted = 0;
    //Einzelparameter: Operation
    //voriger Parameter war ein first nibble, bei 1 Byte Werten Position incr
    if(nibbleSetted == 1) currentPos++;
    nibbleSetted = 0;
    tempValue = gBAP_Indication_data[currentPos++];
    putValue(A_FSG_4_0_0_27_1_SetGet, tempValue);
    //Einzelparameter: Type
    //voriger Parameter war ein first nibble, bei 1 Byte Werten Position incr
    if(nibbleSetted == 1) currentPos++;
    nibbleSetted = 0;
    tempValue = gBAP_Indication_data[currentPos++];
    putValue(A_FSG_4_0_0_27_2_SetGet, tempValue);
    //Einzelparameter: Slot
    //voriger Parameter war ein first nibble, bei 1 Byte Werten Position incr
    if(nibbleSetted == 1) currentPos++;
    nibbleSetted = 0;
    tempValue = gBAP_Indication_data[currentPos++];
    putValue(A_FSG_4_0_0_27_3_SetGet, tempValue);
    //Einzelparameter: ASG_ID
    if(nibbleSetted == 1)
    {
        //voriger Parameter war ein Nibble, => second nibble, Pos incr und Flag zuruecksetzen
        tempValue = (gBAP_Indication_data[currentPos++] &0xF);
        nibbleSetted = 0;
    }
    else
    {
        //first nibble, kein increment, Flag setzen
        tempValue = ((gBAP_Indication_data[currentPos]>>4) &0xF);
        nibbleSetted = 1;
    }
    putValue(A_FSG_4_0_0_27_4_SetGet, tempValue);
    //Einzelparameter: TAID
    if(nibbleSetted == 1)
    {
        //voriger Parameter war ein Nibble, => second nibble, Pos incr und Flag zuruecksetzen
        tempValue = (gBAP_Indication_data[currentPos++] &0xF);
        nibbleSetted = 0;
    }
    else
    {
        //first nibble, kein increment, Flag setzen
        tempValue = ((gBAP_Indication_data[currentPos]>>4) &0xF);
        nibbleSetted = 1;
    }
    putValue(A_FSG_4_0_0_27_5_SetGet, tempValue);
    //head Parameter
    if(gBAP_Indication_header[4] >= (3+currentPos))
    {
        if( (gBAP_Indication_data[currentPos] & 0x80) > 0)
            if(gBAP_Indication_header[4] >= (5+currentPos))
            {
                for(i = 0; i < 5; i++) head[i] = gBAP_Indication_data[currentPos++];
                putValue(A_FSG_4_0_0_27_SetGet, head, 5);
                if(getValue(A_FSG_4_0_0_27_AT))
                {
                    putValue(A_FSG_4_0_0_27,head,5);
                }
                startVal = (head[2]<<8) | head[1];
                elementsVal = (head[4]<<8) | head[3];
            }
            else write("received Data Error");
        else
        {
            for(i = 0; i < 3; i++) head[i] = gBAP_Indication_data[currentPos++];
            putValue(A_FSG_4_0_0_27_SetGet, head, 3);
            if(getValue(A_FSG_4_0_0_27_AT))
            {
                putValue(A_FSG_4_0_0_27,head,3);
            }
                startVal = head[1];
                elementsVal = head[2];
        }
        recordAddressVal = head[0] & 0x0F;
        transmitPosVal = head[0] & 0x40;
        if(getValue(A_FSG_4_0_0_27_AT))
        {
            putValue(A_FSG_4_0_0_27_RecAdr,recordAddressVal);
            putValue(A_FSG_4_0_0_27_Start, startVal);
            putValue(A_FSG_4_0_0_27_Elements, elementsVal);
            putValue(A_FSG_4_0_0_27_TransPos, transmitPosVal);
        }
    }
    //data Parameter
     nibbleSetted = 0;
    if( (head[0] & 0x20) == 0) { // array header: increasing indices (Direction = 0).
      if( (head[0] & 0x10) > 0) { // array header: first element is one after specified start element (Shift = 1, Direction = 0).
        startVal++;
      }
      for ( i = startVal ; i < startVal + elementsVal ; i++) {
        if ( i < 0 || i >= A_FSG_4_0_0_27_ArrayDataList_Length ) {
          write("Array index ausserhalb der Grenzen, Fct: 27");
          break;
        }
        if(nibbleSetted == 1) currentPos++;
        nibbleSetted = 0;
     if( (head[0]&0x40) == 0){ /* Transmit_Pos = 0, keine Positionsdaten */ }
     else
     {
        if( (head[0]&0x80) == 0)
        {
           //IndexSize = 0, Pos als 1 Byte Wert
           //Kein POS definiert
        }
        else
        {
           //IndexSize = 1, Pos als 2 Byte Wert
           //Kein POS definiert
        }
     }
      // 0 - es kann vorkommen, dass das if leer ist dies wuerde zum Fehler fuehren. => automatische generierung der 0
      if( 0 || 1 == recordAddressVal || 2 == recordAddressVal || 3 == recordAddressVal )
      {
        //Sollte vor einem 4 Byte Wert 1 Nibble kommen, muss der index um 1 incrementiert werden!
        if( nibbleSetted==1) currentPos++;
        nibbleSetted = 0;
        A_FSG_4_0_0_27_ArrayDataList[i].Param1 = (gBAP_Indication_data[currentPos++] & 0xFF) + ((gBAP_Indication_data[currentPos++] & 0xFF) <<8) + ((gBAP_Indication_data[currentPos++] & 0xFF) <<16) + ((gBAP_Indication_data[currentPos++] & 0xFF) <<24);
      }
      // 0 - es kann vorkommen, dass das if leer ist dies wuerde zum Fehler fuehren. => automatische generierung der 0
      if( 0 || 1 == recordAddressVal || 2 == recordAddressVal || 3 == recordAddressVal )
      {
        //Sollte vor einem 1 Byte Wert 1 Nibble kommen, muss der index um 1 incrementiert werden!
        if( nibbleSetted==1) currentPos++;
        nibbleSetted = 0;
        A_FSG_4_0_0_27_ArrayDataList[i].Param2 = (gBAP_Indication_data[currentPos++] & 0xFF);
      }
      // 0 - es kann vorkommen, dass das if leer ist dies wuerde zum Fehler fuehren. => automatische generierung der 0
      if( 0 || 2 == recordAddressVal || 3 == recordAddressVal )
      {
        //Sollte vor einem 1 Byte Wert 1 Nibble kommen, muss der index um 1 incrementiert werden!
        if( nibbleSetted==1) currentPos++;
        nibbleSetted = 0;
        A_FSG_4_0_0_27_ArrayDataList[i].Param3 = (gBAP_Indication_data[currentPos++] & 0xFF);
      }
      // 0 - es kann vorkommen, dass das if leer ist dies wuerde zum Fehler fuehren. => automatische generierung der 0
      if( 0 || 3 == recordAddressVal )
      {
        //voriger Parameter war ein first nibble, bei String Werten Position incr
        if(nibbleSetted == 1) currentPos++;
        nibbleSetted = 0;
        A_FSG_4_0_0_27_ArrayDataList[i].Param4_Length =  ((dword)(gBAP_Indication_data[currentPos++]) & 0xFF);
        A_FSG_4_0_0_27_ArrayDataList[i].Param4_Length += ((dword)(gBAP_Indication_data[currentPos++]) & 0xFF) << 8;
        A_FSG_4_0_0_27_ArrayDataList[i].Param4_Length += ((dword)(gBAP_Indication_data[currentPos++]) & 0xFF) << 16;
        A_FSG_4_0_0_27_ArrayDataList[i].Param4_Length += ((dword)(gBAP_Indication_data[currentPos++]) & 0xFF) <<24;
        for(j = 0; j < A_FSG_4_0_0_27_ArrayDataList[i].Param4_Length; j++)
        {
            A_FSG_4_0_0_27_ArrayDataList[i].Param4[j] = gBAP_Indication_data[currentPos++];
        }
      }
      } // for
    } else { // array header: decreasing indices (Direction = 1).
      if( (head[0] & 0x10) > 0) { // array header: first element is one before specified start element (Shift = 1, Direction = 1).
        if(startVal != 0) {          startVal--;
        } else {
          startVal = A_FSG_4_0_0_27_ArrayDataList_Length -1;
        }
      }
      for ( i = startVal ; i > startVal - elementsVal ; i--) {
        if ( i < 0 || i >= A_FSG_4_0_0_27_ArrayDataList_Length ) {
          write("Array index ausserhalb der Grenzen, Fct: 27");
          break;
        }
        if(nibbleSetted == 1) currentPos++;
        nibbleSetted = 0;
     if( (head[0]&0x40) == 0){ /* Transmit_Pos = 0, keine Positionsdaten */ }
     else
     {
        if( (head[0]&0x80) == 0)
        {
           //IndexSize = 0, Pos als 1 Byte Wert
           //Kein POS definiert
        }
        else
        {
           //IndexSize = 1, Pos als 2 Byte Wert
           //Kein POS definiert
        }
     }
      // 0 - es kann vorkommen, dass das if leer ist dies wuerde zum Fehler fuehren. => automatische generierung der 0
      if( 0 || 1 == recordAddressVal || 2 == recordAddressVal || 3 == recordAddressVal )
      {
        //Sollte vor einem 4 Byte Wert 1 Nibble kommen, muss der index um 1 incrementiert werden!
        if( nibbleSetted==1) currentPos++;
        nibbleSetted = 0;
        A_FSG_4_0_0_27_ArrayDataList[i].Param1 = (gBAP_Indication_data[currentPos++] & 0xFF) + ((gBAP_Indication_data[currentPos++] & 0xFF) <<8) + ((gBAP_Indication_data[currentPos++] & 0xFF) <<16) + ((gBAP_Indication_data[currentPos++] & 0xFF) <<24);
      }
      // 0 - es kann vorkommen, dass das if leer ist dies wuerde zum Fehler fuehren. => automatische generierung der 0
      if( 0 || 1 == recordAddressVal || 2 == recordAddressVal || 3 == recordAddressVal )
      {
        //Sollte vor einem 1 Byte Wert 1 Nibble kommen, muss der index um 1 incrementiert werden!
        if( nibbleSetted==1) currentPos++;
        nibbleSetted = 0;
        A_FSG_4_0_0_27_ArrayDataList[i].Param2 = (gBAP_Indication_data[currentPos++] & 0xFF);
      }
      // 0 - es kann vorkommen, dass das if leer ist dies wuerde zum Fehler fuehren. => automatische generierung der 0
      if( 0 || 2 == recordAddressVal || 3 == recordAddressVal )
      {
        //Sollte vor einem 1 Byte Wert 1 Nibble kommen, muss der index um 1 incrementiert werden!
        if( nibbleSetted==1) currentPos++;
        nibbleSetted = 0;
        A_FSG_4_0_0_27_ArrayDataList[i].Param3 = (gBAP_Indication_data[currentPos++] & 0xFF);
      }
      // 0 - es kann vorkommen, dass das if leer ist dies wuerde zum Fehler fuehren. => automatische generierung der 0
      if( 0 || 3 == recordAddressVal )
      {
        //voriger Parameter war ein first nibble, bei String Werten Position incr
        if(nibbleSetted == 1) currentPos++;
        nibbleSetted = 0;
        A_FSG_4_0_0_27_ArrayDataList[i].Param4_Length =  ((dword)(gBAP_Indication_data[currentPos++]) & 0xFF);
        A_FSG_4_0_0_27_ArrayDataList[i].Param4_Length += ((dword)(gBAP_Indication_data[currentPos++]) & 0xFF) << 8;
        A_FSG_4_0_0_27_ArrayDataList[i].Param4_Length += ((dword)(gBAP_Indication_data[currentPos++]) & 0xFF) << 16;
        A_FSG_4_0_0_27_ArrayDataList[i].Param4_Length += ((dword)(gBAP_Indication_data[currentPos++]) & 0xFF) <<24;
        for(j = 0; j < A_FSG_4_0_0_27_ArrayDataList[i].Param4_Length; j++)
        {
            A_FSG_4_0_0_27_ArrayDataList[i].Param4[j] = gBAP_Indication_data[currentPos++];
        }
      }
      } // for
    }
    nibbleSetted = 0;
index = getValue(A_FSG_4_0_0_27_DataIndex);
    putValue(A_FSG_4_0_0_27_Data_1, A_FSG_4_0_0_27_ArrayDataList[index].Param1*(1.0)-(0.0));
    putValue(A_FSG_4_0_0_27_Data_2, A_FSG_4_0_0_27_ArrayDataList[index].Param2*(1.0)-(0.0));
    putValue(A_FSG_4_0_0_27_Data_3, A_FSG_4_0_0_27_ArrayDataList[index].Param3);
    putValue(A_FSG_4_0_0_27_Data_4_len, A_FSG_4_0_0_27_Data_4_LenList[index]);
    putValue(A_FSG_4_0_0_27_Data_4, A_FSG_4_0_0_27_ArrayDataList[index].Param4, A_FSG_4_0_0_27_ArrayDataList[index].Param4_Length);
}

A_FSG_4_0_0_27_GetInd()
{
    dword currentPos;
    byte head[5];
    byte stringTempValue[36];
    dword i;
    dword j;
    int startVal;
    int elementsVal;
    byte recordAddressVal;
    byte transmitPosVal;
    long tempValue;
    long index;
    byte nibbleSetted;
    currentPos = 0;
    nibbleSetted = 0;
    //Einzelparameter: Operation
    //voriger Parameter war ein first nibble, bei 1 Byte Werten Position incr
    if(nibbleSetted == 1) currentPos++;
    nibbleSetted = 0;
    tempValue = gBAP_Indication_data[currentPos++];
    putValue(A_FSG_4_0_0_27_1_SetGet, tempValue);
    //Einzelparameter: Type
    //voriger Parameter war ein first nibble, bei 1 Byte Werten Position incr
    if(nibbleSetted == 1) currentPos++;
    nibbleSetted = 0;
    tempValue = gBAP_Indication_data[currentPos++];
    putValue(A_FSG_4_0_0_27_2_SetGet, tempValue);
    //Einzelparameter: Slot
    //voriger Parameter war ein first nibble, bei 1 Byte Werten Position incr
    if(nibbleSetted == 1) currentPos++;
    nibbleSetted = 0;
    tempValue = gBAP_Indication_data[currentPos++];
    putValue(A_FSG_4_0_0_27_3_SetGet, tempValue);
    //Einzelparameter: ASG_ID
    if(nibbleSetted == 1)
    {
        //voriger Parameter war ein Nibble, => second nibble, Pos incr und Flag zuruecksetzen
        tempValue = (gBAP_Indication_data[currentPos++] &0xF);
        nibbleSetted = 0;
    }
    else
    {
        //first nibble, kein increment, Flag setzen
        tempValue = ((gBAP_Indication_data[currentPos]>>4) &0xF);
        nibbleSetted = 1;
    }
    putValue(A_FSG_4_0_0_27_4_SetGet, tempValue);
    //Einzelparameter: TAID
    if(nibbleSetted == 1)
    {
        //voriger Parameter war ein Nibble, => second nibble, Pos incr und Flag zuruecksetzen
        tempValue = (gBAP_Indication_data[currentPos++] &0xF);
        nibbleSetted = 0;
    }
    else
    {
        //first nibble, kein increment, Flag setzen
        tempValue = ((gBAP_Indication_data[currentPos]>>4) &0xF);
        nibbleSetted = 1;
    }
    putValue(A_FSG_4_0_0_27_5_SetGet, tempValue);
    //head Parameter
    if(gBAP_Indication_header[4] >= (3+currentPos))
    {
        if( (gBAP_Indication_data[currentPos] & 0x80) > 0)
            if(gBAP_Indication_header[4] >= (5+currentPos))
            {
                for(i = 0; i < 5; i++) head[i] = gBAP_Indication_data[currentPos++];
                putValue(A_FSG_4_0_0_27_SetGet, head, 5);
                if(getValue(A_FSG_4_0_0_27_AT))
                {
                    putValue(A_FSG_4_0_0_27,head,5);
                }
                startVal = (head[2]<<8) | head[1];
                elementsVal = (head[4]<<8) | head[3];
            }
            else write("received Data Error");
        else
        {
            for(i = 0; i < 3; i++) head[i] = gBAP_Indication_data[currentPos++];
            putValue(A_FSG_4_0_0_27_SetGet, head, 3);
            if(getValue(A_FSG_4_0_0_27_AT))
            {
                putValue(A_FSG_4_0_0_27,head,3);
            }
                startVal = head[1];
                elementsVal = head[2];
        }
        recordAddressVal = head[0] & 0x0F;
        transmitPosVal = head[0] & 0x40;
        if(getValue(A_FSG_4_0_0_27_AT))
        {
            putValue(A_FSG_4_0_0_27_RecAdr,recordAddressVal);
            putValue(A_FSG_4_0_0_27_Start, startVal);
            putValue(A_FSG_4_0_0_27_Elements, elementsVal);
            putValue(A_FSG_4_0_0_27_TransPos, transmitPosVal);
        }
    }
}

on envVar A_FSG_4_0_0_27_1
{

	//Update Childvalue (Enum)
	byte thisval; // Operation
	thisval = getValue(this);
}
on envVar A_FSG_4_0_0_27_2
{

	//Update Childvalue (Enum)
	byte thisval; // Type
	thisval = getValue(this);
}
// Ueberwachung der Darstellungsvariable der Range.
on envVar A_FSG_4_0_0_27_3_range // PSO_ImExport.Slot 
{
	@A_FSG_4_0_0_27_3 = @A_FSG_4_0_0_27_3_range - (1); // slider = range - min
}

on envVar A_FSG_4_0_0_27_3
{

	//Update Childvalue (Number)
	byte thisval; // Slot
	float slider_value;

	slider_value = round(@A_FSG_4_0_0_27_3, 1.0);
	@A_FSG_4_0_0_27_3_range = slider_value + (1); // real value := slider value + range min.
	thisval = (byte)round((slider_value + (1) - (1)) / (1.0), 1); // bus value := (slider value + min - offset) / step.
}
on envVar A_FSG_4_0_0_27_4_0
{
	byte bitval;
	//thisval steht hier fuer den bitfield-wert, 
	//aus Generierungsgruenden hier keine einheitliche Bezeichnung moeglich.
	byte thisval; // State
	bitval= getValue(this);
	thisval = getValue(A_FSG_4_0_0_27_4);
	thisval = thisval&~(1<<0)|(bitval<<0);
	putValue(A_FSG_4_0_0_27_4,thisval);
}

on envVar A_FSG_4_0_0_27_4_1
{
	byte bitval;
	//thisval steht hier fuer den bitfield-wert, 
	//aus Generierungsgruenden hier keine einheitliche Bezeichnung moeglich.
	byte thisval; // State
	bitval= getValue(this);
	thisval = getValue(A_FSG_4_0_0_27_4);
	thisval = thisval&~(1<<1)|(bitval<<1);
	putValue(A_FSG_4_0_0_27_4,thisval);
}

on envVar A_FSG_4_0_0_27_4_2
{
	byte bitval;
	//thisval steht hier fuer den bitfield-wert, 
	//aus Generierungsgruenden hier keine einheitliche Bezeichnung moeglich.
	byte thisval; // State
	bitval= getValue(this);
	thisval = getValue(A_FSG_4_0_0_27_4);
	thisval = thisval&~(1<<2)|(bitval<<2);
	putValue(A_FSG_4_0_0_27_4,thisval);
}

on envVar A_FSG_4_0_0_27_4
{

	//Update Childvalue (BitField)
	byte mask=0x01;
	int i = 0;
	byte thisval; // State
	thisval = getValue(this);
	if(thisval&(mask<<0))
		putValue(A_FSG_4_0_0_27_4_0, 1);
	else
		putValue(A_FSG_4_0_0_27_4_0, 0);
	if(thisval&(mask<<1))
		putValue(A_FSG_4_0_0_27_4_1, 1);
	else
		putValue(A_FSG_4_0_0_27_4_1, 0);
	if(thisval&(mask<<2))
		putValue(A_FSG_4_0_0_27_4_2, 1);
	else
		putValue(A_FSG_4_0_0_27_4_2, 0);
}
on envVar A_FSG_4_0_0_27_5
{

	//Update Childvalue (Enum)
	byte thisval; // ASG_ID
	thisval = 0x0f & getValue(this);
}
// Ueberwachung der Darstellungsvariable der Range.
on envVar A_FSG_4_0_0_27_6_range // PSO_ImExport.TAID 
{
	@A_FSG_4_0_0_27_6 = @A_FSG_4_0_0_27_6_range - (0); // slider = range - min
}

on envVar A_FSG_4_0_0_27_6
{

	//Update Childvalue (Number)
	byte thisval; // TAID
	float slider_value;

	slider_value = round(@A_FSG_4_0_0_27_6, 1.0);
	@A_FSG_4_0_0_27_6_range = slider_value + (0); // real value := slider value + range min.
	thisval = (byte)round((slider_value + (0) - (0)) / (1.0), 1); // bus value := (slider value + min - offset) / step.
}
// Ueberwachung der Darstellungsvariable der Range.
on envVar A_FSG_4_0_0_27_7_range // PSO_ImExport.TotalNumListElements 
{
	@A_FSG_4_0_0_27_7 = @A_FSG_4_0_0_27_7_range - (0); // slider = range - min
}

on envVar A_FSG_4_0_0_27_7
{

	//Update Childvalue (Number)
	word thisval; // TotalNumListElements
	float slider_value;

	slider_value = round(@A_FSG_4_0_0_27_7, 1.0);
	@A_FSG_4_0_0_27_7_range = slider_value + (0); // real value := slider value + range min.
	thisval = (word)round((slider_value + (0) - (0)) / (1.0), 1); // bus value := (slider value + min - offset) / step.
}
// Ueberwachung der Darstellungsvariable der Range.
on envVar A_FSG_4_0_0_27_Data_1_range // PSO_ImExport.Parameter_ID 
{
	@A_FSG_4_0_0_27_Data_1 = @A_FSG_4_0_0_27_Data_1_range - (0); // slider = range - min
}

on envVar A_FSG_4_0_0_27_Data_1
{

	//Update Childvalue (Number)
	dword thisval; // Parameter_ID
	float slider_value;

	slider_value = round(@A_FSG_4_0_0_27_Data_1, 1.0);
	@A_FSG_4_0_0_27_Data_1_range = slider_value + (0); // real value := slider value + range min.
	thisval = (dword)round((slider_value + (0) - (0)) / (1.0), 1); // bus value := (slider value + min - offset) / step.
    A_FSG_4_0_0_27_ArrayDataList[getValue(A_FSG_4_0_0_27_DataIndex)].Param1 = thisval;
}
// Ueberwachung der Darstellungsvariable der Range.
on envVar A_FSG_4_0_0_27_Data_2_range // PSO_ImExport.DataDescription 
{
	@A_FSG_4_0_0_27_Data_2 = @A_FSG_4_0_0_27_Data_2_range - (0); // slider = range - min
}

on envVar A_FSG_4_0_0_27_Data_2
{

	//Update Childvalue (Number)
	byte thisval; // DataDescription
	float slider_value;

	slider_value = round(@A_FSG_4_0_0_27_Data_2, 1.0);
	@A_FSG_4_0_0_27_Data_2_range = slider_value + (0); // real value := slider value + range min.
	thisval = (byte)round((slider_value + (0) - (0)) / (1.0), 1); // bus value := (slider value + min - offset) / step.
    A_FSG_4_0_0_27_ArrayDataList[getValue(A_FSG_4_0_0_27_DataIndex)].Param2 = thisval;
}
on envVar A_FSG_4_0_0_27_Data_3_0
{
	byte bitval;
	//thisval steht hier fuer den bitfield-wert, 
	//aus Generierungsgruenden hier keine einheitliche Bezeichnung moeglich.
	byte thisval; // DataTag
	bitval= getValue(this);
	thisval = getValue(A_FSG_4_0_0_27_Data_3);
	thisval = thisval&~(1<<0)|(bitval<<0);
	putValue(A_FSG_4_0_0_27_Data_3,thisval);
}

on envVar A_FSG_4_0_0_27_Data_3_1
{
	byte bitval;
	//thisval steht hier fuer den bitfield-wert, 
	//aus Generierungsgruenden hier keine einheitliche Bezeichnung moeglich.
	byte thisval; // DataTag
	bitval= getValue(this);
	thisval = getValue(A_FSG_4_0_0_27_Data_3);
	thisval = thisval&~(1<<1)|(bitval<<1);
	putValue(A_FSG_4_0_0_27_Data_3,thisval);
}

on envVar A_FSG_4_0_0_27_Data_3_4
{
	byte bitval;
	//thisval steht hier fuer den bitfield-wert, 
	//aus Generierungsgruenden hier keine einheitliche Bezeichnung moeglich.
	byte thisval; // DataTag
	bitval= getValue(this);
	thisval = getValue(A_FSG_4_0_0_27_Data_3);
	thisval = thisval&~(1<<4)|(bitval<<4);
	putValue(A_FSG_4_0_0_27_Data_3,thisval);
}

on envVar A_FSG_4_0_0_27_Data_3_5
{
	byte bitval;
	//thisval steht hier fuer den bitfield-wert, 
	//aus Generierungsgruenden hier keine einheitliche Bezeichnung moeglich.
	byte thisval; // DataTag
	bitval= getValue(this);
	thisval = getValue(A_FSG_4_0_0_27_Data_3);
	thisval = thisval&~(1<<5)|(bitval<<5);
	putValue(A_FSG_4_0_0_27_Data_3,thisval);
}

on envVar A_FSG_4_0_0_27_Data_3_6
{
	byte bitval;
	//thisval steht hier fuer den bitfield-wert, 
	//aus Generierungsgruenden hier keine einheitliche Bezeichnung moeglich.
	byte thisval; // DataTag
	bitval= getValue(this);
	thisval = getValue(A_FSG_4_0_0_27_Data_3);
	thisval = thisval&~(1<<6)|(bitval<<6);
	putValue(A_FSG_4_0_0_27_Data_3,thisval);
}

on envVar A_FSG_4_0_0_27_Data_3_7
{
	byte bitval;
	//thisval steht hier fuer den bitfield-wert, 
	//aus Generierungsgruenden hier keine einheitliche Bezeichnung moeglich.
	byte thisval; // DataTag
	bitval= getValue(this);
	thisval = getValue(A_FSG_4_0_0_27_Data_3);
	thisval = thisval&~(1<<7)|(bitval<<7);
	putValue(A_FSG_4_0_0_27_Data_3,thisval);
}

on envVar A_FSG_4_0_0_27_Data_3
{

	//Update Childvalue (BitField)
	byte mask=0x01;
	int i = 0;
	byte thisval; // DataTag
	thisval = getValue(this);
	if(thisval&(mask<<0))
		putValue(A_FSG_4_0_0_27_Data_3_0, 1);
	else
		putValue(A_FSG_4_0_0_27_Data_3_0, 0);
	if(thisval&(mask<<1))
		putValue(A_FSG_4_0_0_27_Data_3_1, 1);
	else
		putValue(A_FSG_4_0_0_27_Data_3_1, 0);
	if(thisval&(mask<<4))
		putValue(A_FSG_4_0_0_27_Data_3_4, 1);
	else
		putValue(A_FSG_4_0_0_27_Data_3_4, 0);
	if(thisval&(mask<<5))
		putValue(A_FSG_4_0_0_27_Data_3_5, 1);
	else
		putValue(A_FSG_4_0_0_27_Data_3_5, 0);
	if(thisval&(mask<<6))
		putValue(A_FSG_4_0_0_27_Data_3_6, 1);
	else
		putValue(A_FSG_4_0_0_27_Data_3_6, 0);
	if(thisval&(mask<<7))
		putValue(A_FSG_4_0_0_27_Data_3_7, 1);
	else
		putValue(A_FSG_4_0_0_27_Data_3_7, 0);
    A_FSG_4_0_0_27_ArrayDataList[getValue(A_FSG_4_0_0_27_DataIndex)].Param3 = thisval;
}
on envVar A_FSG_4_0_0_27_Data_4_len
{
	long thisval;
	thisval = getValue(this);

	/* wenn die Laenge ausserhalb des erlaubten Bereich liegt, wird diese begrenzt */
	if(thisval > 1 || thisval < 0 )
	{
		writelineEx(gBAP_Trace, 0, "Eingegebene Laenge: %d von A_FSG_4_0_0_27_Data_4 ist ungueltig. Die max. erlaubte Laenge ist %d. ", thisval, 1);
		thisval = 1;
	}

	A_FSG_4_0_0_27_ArrayDataList[getValue(A_FSG_4_0_0_27_DataIndex)].Param4_Length = thisval;
	A_FSG_4_0_0_27_Data_4_LenList[ getValue(A_FSG_4_0_0_27_DataIndex) ] = thisval;
	putValue(A_FSG_4_0_0_27_Data_4_len, thisval);

}

on envVar A_FSG_4_0_0_27_Data_4
{

	//Update Childvalue (Large String)
	dword i;
	byte thisval[5];
	getValue(this, thisval);
    for(i = 0; i < getValueSize(this); i++)
        A_FSG_4_0_0_27_ArrayDataList[getValue(A_FSG_4_0_0_27_DataIndex)].Param4[i] = thisval[i];
    A_FSG_4_0_0_27_ArrayDataList[getValue(A_FSG_4_0_0_27_DataIndex)].Param4_Length = getValueSize(this);
    A_FSG_4_0_0_27_Data_4_LenList[getValue(A_FSG_4_0_0_27_DataIndex)]= getValueSize(this);
    putValue(A_FSG_4_0_0_27_Data_4_len, getValueSize(this));
}
on envVar A_FSG_4_0_0_27_1_Changed
{

	//Update Childvalue (Enum)
	byte thisval; // Operation
	thisval = getValue(this);
}
on envVar A_FSG_4_0_0_27_2_Changed
{

	//Update Childvalue (Enum)
	byte thisval; // Type
	thisval = getValue(this);
}
// Ueberwachung der Darstellungsvariable der Range.
on envVar A_FSG_4_0_0_27_3_Changed_range // PSO_ImExport.Slot 
{
	@A_FSG_4_0_0_27_3_Changed = @A_FSG_4_0_0_27_3_Changed_range - (1); // slider = range - min
}

on envVar A_FSG_4_0_0_27_3_Changed
{

	//Update Childvalue (Number)
	byte thisval; // Slot
	float slider_value;

	slider_value = round(@A_FSG_4_0_0_27_3_Changed, 1.0);
	@A_FSG_4_0_0_27_3_Changed_range = slider_value + (1); // real value := slider value + range min.
	thisval = (byte)round((slider_value + (1) - (1)) / (1.0), 1); // bus value := (slider value + min - offset) / step.
}
on envVar A_FSG_4_0_0_27_1_SetGet
{

	//Update Childvalue (Enum)
	byte thisval; // Operation
	thisval = getValue(this);
}
on envVar A_FSG_4_0_0_27_2_SetGet
{

	//Update Childvalue (Enum)
	byte thisval; // Type
	thisval = getValue(this);
}
// Ueberwachung der Darstellungsvariable der Range.
on envVar A_FSG_4_0_0_27_3_SetGet_range // PSO_ImExport.Slot 
{
	@A_FSG_4_0_0_27_3_SetGet = @A_FSG_4_0_0_27_3_SetGet_range - (1); // slider = range - min
}

on envVar A_FSG_4_0_0_27_3_SetGet
{

	//Update Childvalue (Number)
	byte thisval; // Slot
	float slider_value;

	slider_value = round(@A_FSG_4_0_0_27_3_SetGet, 1.0);
	@A_FSG_4_0_0_27_3_SetGet_range = slider_value + (1); // real value := slider value + range min.
	thisval = (byte)round((slider_value + (1) - (1)) / (1.0), 1); // bus value := (slider value + min - offset) / step.
}
on envVar A_FSG_4_0_0_27_4_SetGet
{

	//Update Childvalue (Enum)
	byte thisval; // ASG_ID
	thisval = 0x0f & getValue(this);
}
// Ueberwachung der Darstellungsvariable der Range.
on envVar A_FSG_4_0_0_27_5_SetGet_range // PSO_ImExport.TAID 
{
	@A_FSG_4_0_0_27_5_SetGet = @A_FSG_4_0_0_27_5_SetGet_range - (0); // slider = range - min
}

on envVar A_FSG_4_0_0_27_5_SetGet
{

	//Update Childvalue (Number)
	byte thisval; // TAID
	float slider_value;

	slider_value = round(@A_FSG_4_0_0_27_5_SetGet, 1.0);
	@A_FSG_4_0_0_27_5_SetGet_range = slider_value + (0); // real value := slider value + range min.
	thisval = (byte)round((slider_value + (0) - (0)) / (1.0), 1); // bus value := (slider value + min - offset) / step.
}
// Ueberwachung der Darstellungsvariable der Range.
on envVar A_FSG_4_0_0_27_Data_1_SetGet_range // PSO_ImExport.Parameter_ID 
{
	@A_FSG_4_0_0_27_Data_1_SetGet = @A_FSG_4_0_0_27_Data_1_SetGet_range - (0); // slider = range - min
}

on envVar A_FSG_4_0_0_27_Data_1_SetGet
{

	//Update Childvalue (Number)
	dword thisval; // Parameter_ID
	float slider_value;

	slider_value = round(@A_FSG_4_0_0_27_Data_1_SetGet, 1.0);
	@A_FSG_4_0_0_27_Data_1_SetGet_range = slider_value + (0); // real value := slider value + range min.
	thisval = (dword)round((slider_value + (0) - (0)) / (1.0), 1); // bus value := (slider value + min - offset) / step.
    A_FSG_4_0_0_27_ArrayDataList[getValue(A_FSG_4_0_0_27_DataIndex_SetGet)].Param1 = thisval;
}
// Ueberwachung der Darstellungsvariable der Range.
on envVar A_FSG_4_0_0_27_Data_2_SetGet_range // PSO_ImExport.DataDescription 
{
	@A_FSG_4_0_0_27_Data_2_SetGet = @A_FSG_4_0_0_27_Data_2_SetGet_range - (0); // slider = range - min
}

on envVar A_FSG_4_0_0_27_Data_2_SetGet
{

	//Update Childvalue (Number)
	byte thisval; // DataDescription
	float slider_value;

	slider_value = round(@A_FSG_4_0_0_27_Data_2_SetGet, 1.0);
	@A_FSG_4_0_0_27_Data_2_SetGet_range = slider_value + (0); // real value := slider value + range min.
	thisval = (byte)round((slider_value + (0) - (0)) / (1.0), 1); // bus value := (slider value + min - offset) / step.
    A_FSG_4_0_0_27_ArrayDataList[getValue(A_FSG_4_0_0_27_DataIndex_SetGet)].Param2 = thisval;
}
on envVar A_FSG_4_0_0_27_Data_3_SetGet_0
{
	byte bitval;
	//thisval steht hier fuer den bitfield-wert, 
	//aus Generierungsgruenden hier keine einheitliche Bezeichnung moeglich.
	byte thisval; // DataTag
	bitval= getValue(this);
	thisval = getValue(A_FSG_4_0_0_27_Data_3_SetGet);
	thisval = thisval&~(1<<0)|(bitval<<0);
	putValue(A_FSG_4_0_0_27_Data_3_SetGet,thisval);
}

on envVar A_FSG_4_0_0_27_Data_3_SetGet_1
{
	byte bitval;
	//thisval steht hier fuer den bitfield-wert, 
	//aus Generierungsgruenden hier keine einheitliche Bezeichnung moeglich.
	byte thisval; // DataTag
	bitval= getValue(this);
	thisval = getValue(A_FSG_4_0_0_27_Data_3_SetGet);
	thisval = thisval&~(1<<1)|(bitval<<1);
	putValue(A_FSG_4_0_0_27_Data_3_SetGet,thisval);
}

on envVar A_FSG_4_0_0_27_Data_3_SetGet_4
{
	byte bitval;
	//thisval steht hier fuer den bitfield-wert, 
	//aus Generierungsgruenden hier keine einheitliche Bezeichnung moeglich.
	byte thisval; // DataTag
	bitval= getValue(this);
	thisval = getValue(A_FSG_4_0_0_27_Data_3_SetGet);
	thisval = thisval&~(1<<4)|(bitval<<4);
	putValue(A_FSG_4_0_0_27_Data_3_SetGet,thisval);
}

on envVar A_FSG_4_0_0_27_Data_3_SetGet_5
{
	byte bitval;
	//thisval steht hier fuer den bitfield-wert, 
	//aus Generierungsgruenden hier keine einheitliche Bezeichnung moeglich.
	byte thisval; // DataTag
	bitval= getValue(this);
	thisval = getValue(A_FSG_4_0_0_27_Data_3_SetGet);
	thisval = thisval&~(1<<5)|(bitval<<5);
	putValue(A_FSG_4_0_0_27_Data_3_SetGet,thisval);
}

on envVar A_FSG_4_0_0_27_Data_3_SetGet_6
{
	byte bitval;
	//thisval steht hier fuer den bitfield-wert, 
	//aus Generierungsgruenden hier keine einheitliche Bezeichnung moeglich.
	byte thisval; // DataTag
	bitval= getValue(this);
	thisval = getValue(A_FSG_4_0_0_27_Data_3_SetGet);
	thisval = thisval&~(1<<6)|(bitval<<6);
	putValue(A_FSG_4_0_0_27_Data_3_SetGet,thisval);
}

on envVar A_FSG_4_0_0_27_Data_3_SetGet_7
{
	byte bitval;
	//thisval steht hier fuer den bitfield-wert, 
	//aus Generierungsgruenden hier keine einheitliche Bezeichnung moeglich.
	byte thisval; // DataTag
	bitval= getValue(this);
	thisval = getValue(A_FSG_4_0_0_27_Data_3_SetGet);
	thisval = thisval&~(1<<7)|(bitval<<7);
	putValue(A_FSG_4_0_0_27_Data_3_SetGet,thisval);
}

on envVar A_FSG_4_0_0_27_Data_3_SetGet
{

	//Update Childvalue (BitField)
	byte mask=0x01;
	int i = 0;
	byte thisval; // DataTag
	thisval = getValue(this);
	if(thisval&(mask<<0))
		putValue(A_FSG_4_0_0_27_Data_3_SetGet_0, 1);
	else
		putValue(A_FSG_4_0_0_27_Data_3_SetGet_0, 0);
	if(thisval&(mask<<1))
		putValue(A_FSG_4_0_0_27_Data_3_SetGet_1, 1);
	else
		putValue(A_FSG_4_0_0_27_Data_3_SetGet_1, 0);
	if(thisval&(mask<<4))
		putValue(A_FSG_4_0_0_27_Data_3_SetGet_4, 1);
	else
		putValue(A_FSG_4_0_0_27_Data_3_SetGet_4, 0);
	if(thisval&(mask<<5))
		putValue(A_FSG_4_0_0_27_Data_3_SetGet_5, 1);
	else
		putValue(A_FSG_4_0_0_27_Data_3_SetGet_5, 0);
	if(thisval&(mask<<6))
		putValue(A_FSG_4_0_0_27_Data_3_SetGet_6, 1);
	else
		putValue(A_FSG_4_0_0_27_Data_3_SetGet_6, 0);
	if(thisval&(mask<<7))
		putValue(A_FSG_4_0_0_27_Data_3_SetGet_7, 1);
	else
		putValue(A_FSG_4_0_0_27_Data_3_SetGet_7, 0);
    A_FSG_4_0_0_27_ArrayDataList[getValue(A_FSG_4_0_0_27_DataIndex_SetGet)].Param3 = thisval;
}
on envVar A_FSG_4_0_0_27_Data_4_SetGet_len
{
	long thisval;
	thisval = getValue(this);

	/* wenn die Laenge ausserhalb des erlaubten Bereich liegt, wird diese begrenzt */
	if(thisval > 1 || thisval < 0 )
	{
		writelineEx(gBAP_Trace, 0, "Eingegebene Laenge: %d von A_FSG_4_0_0_27_Data_4_SetGet ist ungueltig. Die max. erlaubte Laenge ist %d. ", thisval, 1);
		thisval = 1;
	}

	A_FSG_4_0_0_27_ArrayDataList[getValue(A_FSG_4_0_0_27_DataIndex_SetGet)].Param4_Length = thisval;
	A_FSG_4_0_0_27_Data_4_SetGet_LenList[ getValue(A_FSG_4_0_0_27_DataIndex_SetGet) ] = thisval;
	putValue(A_FSG_4_0_0_27_Data_4_SetGet_len, thisval);

}

on envVar A_FSG_4_0_0_27_Data_4_SetGet
{

	//Update Childvalue (Large String)
	dword i;
	byte thisval[5];
	getValue(this, thisval);
    for(i = 0; i < getValueSize(this); i++)
        A_FSG_4_0_0_27_ArrayDataList[getValue(A_FSG_4_0_0_27_DataIndex_SetGet)].Param4[i] = thisval[i];
    A_FSG_4_0_0_27_ArrayDataList[getValue(A_FSG_4_0_0_27_DataIndex_SetGet)].Param4_Length = getValueSize(this);
    A_FSG_4_0_0_27_Data_4_SetGet_LenList[getValue(A_FSG_4_0_0_27_DataIndex_SetGet)]= getValueSize(this);
    putValue(A_FSG_4_0_0_27_Data_4_SetGet_len, getValueSize(this));
}
// Ruecksetzen des Fehlerstatus durch manuelle Fehlereingabe
on envVar P_FSG_4_0_0_28_ErrCode
{
       if(gP_FSG_4_0_0_28_ErrCode) 
       {
           setControlBackColor(panel_name,"errfield_P_FSG_4_0_0_28", MakeRGB(255,255,255));
       }
       gP_FSG_4_0_0_28_ErrCode = 1;
}
on envVar P_FSG_4_0_0_28Status_BTN
{
	byte BAPTemp[2];
   if (P_FSG_4_0_0_28Status_BTN_already_pressed == 0)
   {
      putValue(P_FSG_4_0_0_28_ErrCode,0);
      SetControlBackColor(panel_name,"errField_P_FSG_4_0_0_28",MakeRGB(255,255,255));
      P_FSG_4_0_0_28Status_BTN_already_pressed = 1;
   }
   else
   {
      getValue(P_FSG_4_0_0_28, BAPTemp);
      Request_ByteSequence(LSGID, P_FSG_4_0_0_28_ID, Data_REQ, BAPTemp, getValueSize(P_FSG_4_0_0_28));
      P_FSG_4_0_0_28Status_BTN_already_pressed = 0;
   }
}
on envVar P_FSG_4_0_0_28_FctEn
{
    long data[3];
    data[0]=LSGID;
    data[1]=P_FSG_4_0_0_28_ID;
    data[2]=getValue(P_FSG_4_0_0_28_FctEn);
    ChangeConfig(0x0031,data);
}
// De-Aktivierung der Eingabefelder der FCTID P_FSG_4_0_0_28
on envVar P_FSG_4_0_0_28_FctLstItemEn
{
       if(getValue(this)) 
       {
           EnableControl(panel_name,"panel_FSG_4_0_0_28",1);
           EnableControl(panel_name,"errfield_P_FSG_4_0_0_28",1);
           EnableControl(panel_name,"panel_P_FSG_4_0_0_28",1);
           setControlForeColor(panel_name, "checkbox_P_FSG_4_0_0_28", MakeRGB(0,240,0));
       }
       else
       {
           EnableControl(panel_name,"panel_FSG_4_0_0_28",0);
           EnableControl(panel_name,"errfield_P_FSG_4_0_0_28",0);
           EnableControl(panel_name,"panel_P_FSG_4_0_0_28",0);
           setControlForeColor(panel_name, "checkbox_P_FSG_4_0_0_28", MakeRGB(250,0,0));
       }
}
on envVar P_FSG_4_0_0_28 // bus value of AutoSkinSwitch (28).
{
	// opcodes: Error-Status
	byte param1; // Setup
	byte param2; // ModificationReason
	byte param3; // ModificationState
	// DATATYPE_BYTESEQUENCE / DATATYPE_FIXEDBYTESEQUENCE
	dword i;
	byte superval[2];
	dword currentPos;
	currentPos = 0;
	for( i = 0; i < 2; i++ ) {
		superval[i] = 0;
	}
	getValue(P_FSG_4_0_0_28, superval);
	///////// Start param1 - UINT8 /////////
	param1 = superval[currentPos++];
	putValue(P_FSG_4_0_0_28_1, param1);
	///////// Start param2 - NIBBLE /////////
	param2 = (superval[currentPos] & 0xf0)>>4;
	putValue(P_FSG_4_0_0_28_2, param2);
	///////// Start param3 - NIBBLE /////////
	param3 = superval[currentPos++] & 0x0f;
	putValue(P_FSG_4_0_0_28_3, param3);
}

on envVar P_FSG_4_0_0_28_1_0
{
	byte bitval;
	//thisval steht hier fuer den bitfield-wert, 
	//aus Generierungsgruenden hier keine einheitliche Bezeichnung moeglich.
	byte thisval; // Setup
	bitval= getValue(this);
	thisval = getValue(P_FSG_4_0_0_28_1);
	thisval = thisval&~(1<<0)|(bitval<<0);
	putValue(P_FSG_4_0_0_28_1,thisval);
}

on envVar P_FSG_4_0_0_28_1 // AutoSkinSwitch.Setup
{
	byte superval[2];

	//Update Childvalue (BitField)
	byte mask=0x01;
	int i = 0;
	byte thisval; // Setup
	thisval = getValue(this);
	if(thisval&(mask<<0))
		putValue(P_FSG_4_0_0_28_1_0, 1);
	else
		putValue(P_FSG_4_0_0_28_1_0, 0);

    // Update superval
	getValue(P_FSG_4_0_0_28, superval);
	superval[0]=thisval;
	putValue(P_FSG_4_0_0_28,superval);
}

on envVar P_FSG_4_0_0_28_2 // AutoSkinSwitch.ModificationReason
{
	byte superval[2];

	//Update Childvalue (Enum)
	byte thisval; // ModificationReason
	thisval = 0x0f & getValue(this);

    // Update superval
	getValue(P_FSG_4_0_0_28, superval);
	superval[1]= superval[1]&0x0f;
	superval[1]= superval[1]|(thisval<<4);
	putValue(P_FSG_4_0_0_28,superval);
}

on envVar P_FSG_4_0_0_28_3_0
{
	byte bitval;
	//thisval steht hier fuer den bitfield-wert, 
	//aus Generierungsgruenden hier keine einheitliche Bezeichnung moeglich.
	byte thisval; // ModificationState
	bitval= getValue(this);
	thisval = getValue(P_FSG_4_0_0_28_3);
	thisval = thisval&~(1<<0)|(bitval<<0);
	putValue(P_FSG_4_0_0_28_3,thisval);
}

on envVar P_FSG_4_0_0_28_3 // AutoSkinSwitch.ModificationState
{
	byte superval[2];

	//Update Childvalue (BitField)
	byte mask=0x01;
	int i = 0;
	byte thisval; // ModificationState
	thisval = getValue(this);
	if(thisval&(mask<<0))
		putValue(P_FSG_4_0_0_28_3_0, 1);
	else
		putValue(P_FSG_4_0_0_28_3_0, 0);

    // Update superval
	getValue(P_FSG_4_0_0_28, superval);
	superval[1]= superval[1]&0xf0;
	superval[1]= superval[1]|thisval;
	putValue(P_FSG_4_0_0_28,superval);
}

// Ruecksetzen des Fehlerstatus durch manuelle Fehlereingabe
on envVar P_FSG_4_0_0_29_ErrCode
{
       if(gP_FSG_4_0_0_29_ErrCode) 
       {
           setControlBackColor(panel_name,"errfield_P_FSG_4_0_0_29", MakeRGB(255,255,255));
       }
       gP_FSG_4_0_0_29_ErrCode = 1;
}
on envVar P_FSG_4_0_0_29Status_BTN
{
	byte BAPTemp[6];
   if (P_FSG_4_0_0_29Status_BTN_already_pressed == 0)
   {
      putValue(P_FSG_4_0_0_29_ErrCode,0);
      SetControlBackColor(panel_name,"errField_P_FSG_4_0_0_29",MakeRGB(255,255,255));
      P_FSG_4_0_0_29Status_BTN_already_pressed = 1;
   }
   else
   {
      getValue(P_FSG_4_0_0_29, BAPTemp);
      Request_ByteSequence(LSGID, P_FSG_4_0_0_29_ID, Data_REQ, BAPTemp, getValueSize(P_FSG_4_0_0_29));
      P_FSG_4_0_0_29Status_BTN_already_pressed = 0;
   }
}
on envVar P_FSG_4_0_0_29_FctEn
{
    long data[3];
    data[0]=LSGID;
    data[1]=P_FSG_4_0_0_29_ID;
    data[2]=getValue(P_FSG_4_0_0_29_FctEn);
    ChangeConfig(0x0031,data);
}
// De-Aktivierung der Eingabefelder der FCTID P_FSG_4_0_0_29
on envVar P_FSG_4_0_0_29_FctLstItemEn
{
       if(getValue(this)) 
       {
           EnableControl(panel_name,"panel_FSG_4_0_0_29",1);
           EnableControl(panel_name,"errfield_P_FSG_4_0_0_29",1);
           EnableControl(panel_name,"panel_P_FSG_4_0_0_29",1);
           setControlForeColor(panel_name, "checkbox_P_FSG_4_0_0_29", MakeRGB(0,240,0));
       }
       else
       {
           EnableControl(panel_name,"panel_FSG_4_0_0_29",0);
           EnableControl(panel_name,"errfield_P_FSG_4_0_0_29",0);
           EnableControl(panel_name,"panel_P_FSG_4_0_0_29",0);
           setControlForeColor(panel_name, "checkbox_P_FSG_4_0_0_29", MakeRGB(250,0,0));
       }
}
on envVar P_FSG_4_0_0_29 // bus value of ConfigurationMode (29).
{
	// opcodes: Error-Status
	byte param1; // HUDConfigurationMode
	byte param2; // Extension1
	byte param3; // Extension2
	byte param4; // Extension3
	byte param5; // Extension4
	byte param6; // ModificationReason
	byte param7; // ModificationState
	// DATATYPE_BYTESEQUENCE / DATATYPE_FIXEDBYTESEQUENCE
	dword i;
	byte superval[6];
	dword currentPos;
	currentPos = 0;
	for( i = 0; i < 6; i++ ) {
		superval[i] = 0;
	}
	getValue(P_FSG_4_0_0_29, superval);
	///////// Start param1 - UINT8 /////////
	param1 = superval[currentPos++];
	putValue(P_FSG_4_0_0_29_1, param1);
	///////// Start param2 - UINT8 /////////
	param2 = superval[currentPos++];
	putValue(P_FSG_4_0_0_29_2, round((param2 * 1.0) - (0) + (0), 1.0));
	///////// Start param3 - UINT8 /////////
	param3 = superval[currentPos++];
	putValue(P_FSG_4_0_0_29_3, round((param3 * 1.0) - (0) + (0), 1.0));
	///////// Start param4 - UINT8 /////////
	param4 = superval[currentPos++];
	putValue(P_FSG_4_0_0_29_4, round((param4 * 1.0) - (0) + (0), 1.0));
	///////// Start param5 - UINT8 /////////
	param5 = superval[currentPos++];
	putValue(P_FSG_4_0_0_29_5, round((param5 * 1.0) - (0) + (0), 1.0));
	///////// Start param6 - NIBBLE /////////
	param6 = (superval[currentPos] & 0xf0)>>4;
	putValue(P_FSG_4_0_0_29_6, param6);
	///////// Start param7 - NIBBLE /////////
	param7 = superval[currentPos++] & 0x0f;
	putValue(P_FSG_4_0_0_29_7, param7);
}

on envVar P_FSG_4_0_0_29_1_0
{
	byte bitval;
	//thisval steht hier fuer den bitfield-wert, 
	//aus Generierungsgruenden hier keine einheitliche Bezeichnung moeglich.
	byte thisval; // HUDConfigurationMode
	bitval= getValue(this);
	thisval = getValue(P_FSG_4_0_0_29_1);
	thisval = thisval&~(1<<0)|(bitval<<0);
	putValue(P_FSG_4_0_0_29_1,thisval);
}

on envVar P_FSG_4_0_0_29_1 // ConfigurationMode.HUDConfigurationMode
{
	byte superval[6];

	//Update Childvalue (BitField)
	byte mask=0x01;
	int i = 0;
	byte thisval; // HUDConfigurationMode
	thisval = getValue(this);
	if(thisval&(mask<<0))
		putValue(P_FSG_4_0_0_29_1_0, 1);
	else
		putValue(P_FSG_4_0_0_29_1_0, 0);

    // Update superval
	getValue(P_FSG_4_0_0_29, superval);
	superval[0]=thisval;
	putValue(P_FSG_4_0_0_29,superval);
}

// Ueberwachung der Darstellungsvariable der Range.
on envVar P_FSG_4_0_0_29_2_range // ConfigurationMode.Extension1 
{
	@P_FSG_4_0_0_29_2 = @P_FSG_4_0_0_29_2_range - (0); // slider = range - min
}

on envVar P_FSG_4_0_0_29_2 // ConfigurationMode.Extension1
{
	byte superval[6];

	//Update Childvalue (Number)
	byte thisval; // Extension1
	float slider_value;

	slider_value = 0; // Konstanter Parameter.
	@P_FSG_4_0_0_29_2_range = slider_value + (0); // real value := slider value + range min.
	thisval = (byte)round((slider_value + (0) - (0)) / (1.0), 1); // bus value := (slider value + min - offset) / step.

    // Update superval
	getValue(P_FSG_4_0_0_29, superval);
	superval[1]=thisval;
	putValue(P_FSG_4_0_0_29,superval);
}

// Ueberwachung der Darstellungsvariable der Range.
on envVar P_FSG_4_0_0_29_3_range // ConfigurationMode.Extension2 
{
	@P_FSG_4_0_0_29_3 = @P_FSG_4_0_0_29_3_range - (0); // slider = range - min
}

on envVar P_FSG_4_0_0_29_3 // ConfigurationMode.Extension2
{
	byte superval[6];

	//Update Childvalue (Number)
	byte thisval; // Extension2
	float slider_value;

	slider_value = 0; // Konstanter Parameter.
	@P_FSG_4_0_0_29_3_range = slider_value + (0); // real value := slider value + range min.
	thisval = (byte)round((slider_value + (0) - (0)) / (1.0), 1); // bus value := (slider value + min - offset) / step.

    // Update superval
	getValue(P_FSG_4_0_0_29, superval);
	superval[2]=thisval;
	putValue(P_FSG_4_0_0_29,superval);
}

// Ueberwachung der Darstellungsvariable der Range.
on envVar P_FSG_4_0_0_29_4_range // ConfigurationMode.Extension3 
{
	@P_FSG_4_0_0_29_4 = @P_FSG_4_0_0_29_4_range - (0); // slider = range - min
}

on envVar P_FSG_4_0_0_29_4 // ConfigurationMode.Extension3
{
	byte superval[6];

	//Update Childvalue (Number)
	byte thisval; // Extension3
	float slider_value;

	slider_value = 0; // Konstanter Parameter.
	@P_FSG_4_0_0_29_4_range = slider_value + (0); // real value := slider value + range min.
	thisval = (byte)round((slider_value + (0) - (0)) / (1.0), 1); // bus value := (slider value + min - offset) / step.

    // Update superval
	getValue(P_FSG_4_0_0_29, superval);
	superval[3]=thisval;
	putValue(P_FSG_4_0_0_29,superval);
}

// Ueberwachung der Darstellungsvariable der Range.
on envVar P_FSG_4_0_0_29_5_range // ConfigurationMode.Extension4 
{
	@P_FSG_4_0_0_29_5 = @P_FSG_4_0_0_29_5_range - (0); // slider = range - min
}

on envVar P_FSG_4_0_0_29_5 // ConfigurationMode.Extension4
{
	byte superval[6];

	//Update Childvalue (Number)
	byte thisval; // Extension4
	float slider_value;

	slider_value = 0; // Konstanter Parameter.
	@P_FSG_4_0_0_29_5_range = slider_value + (0); // real value := slider value + range min.
	thisval = (byte)round((slider_value + (0) - (0)) / (1.0), 1); // bus value := (slider value + min - offset) / step.

    // Update superval
	getValue(P_FSG_4_0_0_29, superval);
	superval[4]=thisval;
	putValue(P_FSG_4_0_0_29,superval);
}

on envVar P_FSG_4_0_0_29_6 // ConfigurationMode.ModificationReason
{
	byte superval[6];

	//Update Childvalue (Enum)
	byte thisval; // ModificationReason
	thisval = 0x0f & getValue(this);

    // Update superval
	getValue(P_FSG_4_0_0_29, superval);
	superval[5]= superval[5]&0x0f;
	superval[5]= superval[5]|(thisval<<4);
	putValue(P_FSG_4_0_0_29,superval);
}

on envVar P_FSG_4_0_0_29_7_0
{
	byte bitval;
	//thisval steht hier fuer den bitfield-wert, 
	//aus Generierungsgruenden hier keine einheitliche Bezeichnung moeglich.
	byte thisval; // ModificationState
	bitval= getValue(this);
	thisval = getValue(P_FSG_4_0_0_29_7);
	thisval = thisval&~(1<<0)|(bitval<<0);
	putValue(P_FSG_4_0_0_29_7,thisval);
}

on envVar P_FSG_4_0_0_29_7 // ConfigurationMode.ModificationState
{
	byte superval[6];

	//Update Childvalue (BitField)
	byte mask=0x01;
	int i = 0;
	byte thisval; // ModificationState
	thisval = getValue(this);
	if(thisval&(mask<<0))
		putValue(P_FSG_4_0_0_29_7_0, 1);
	else
		putValue(P_FSG_4_0_0_29_7_0, 0);

    // Update superval
	getValue(P_FSG_4_0_0_29, superval);
	superval[5]= superval[5]&0xf0;
	superval[5]= superval[5]|thisval;
	putValue(P_FSG_4_0_0_29,superval);
}



/**
*
* Template-Funktion zum automatischen befuellen der Array-Daten, die in einer Arrayfunktion genutzt werden.
* Die Funktion wird durch den von BAPSimGen generierten Code aufgerufen.
*
* Parameter:
* - structArray: Muss mindestens nMax * Arraygroesse Bytes Platz haben, wird vom BAPSimGen automatisch generiert
* - structElementsSizeArray: Enthaelt die Groesseangabe jedes Array-Elements. Die Arraygroesse entspricht der Elementanzahl im Array.
*       Byte & Nibble = 1; Word = 2; usw. Bei Strings wird die maximale Stringlaenge angegeben.
* - structElementsTypeArray: Gibt den Datentyp eines Array-Elements zurueck. Die Arraygroesse entspricht der Elmentanzahl im Array.
*                               0x0 = Zahlenwert, also ein Slider, Enum, Bitfield,...
*                               0xE = String (darauf folgt immer eine 2, mit der Angabe der benutzen Bytes im String)
*                               0xF = Laenge der Nutzdaten des Strings, nur return Wert
* - fctID: Kann zur Fallunterscheidung der Funktions-IDs verwendet werden.
* - nMax: Array-Index
*
* Die Funktion kann im Switch-Case beliebig erweitert werden. Der Switch-Case wertet den Parameter fctID aus.
*           
*                    
**/
initStruct(byte structArray[], dword structElementsSizeArray[], byte structElementsTypeArray[], dword structElementsMaxSizeArray[], word fctID, word nMax )
{
    byte rand8;
    word rand16;
    dword randSize;
    word index;           //indexNr die an die String Parameter angehaengt wird.
    dword destArraySize;   //groesse von structArray
    dword destStructSize;  //groesse eines "Structs" also destArraySize / Anzahl Elemente (nMax))
    dword rand32;    
    dword i;
    dword pos;    //aktuelle Position im structArray
    dword elpos;  //aktuelle Position in den structElementsXXXArray's
    
    destArraySize = elCount(structArray);
    destStructSize = destArraySize / nMax;    

    Switch(fctID){

        //Idee ist, die Arrays je nach Funcion-ID speziell initalisieren zu koennen.
        //hierbei koennten die Daten z.B. aus einer Datei eingelesen werden,
        //oder auch ueber spezielle init Funktionen mit festen Werten initialisiert werden.
        //Der Default-Fall befuellt das Array mit Random-Werten und Strings mit einem vordefinierten Wort (hier test,)

        default :
        {
            pos = 0; 
            for(i = 1; i <= nMax; i++)
            {
                //walk through the array
                elpos = 0;
                while(pos < (destStructSize * i) )
                {   
                    //check Element type
                    if( structElementsTypeArray[elpos] == 0x0)          
                    { //Params like int, word, etc.
                        //check element length
                        
                        Switch(structElementsSizeArray[elpos])
                        {
                            case(1) : //byte / nibble
                                rand8 = random(structElementsMaxSizeArray[elpos]);
                                structArray[pos] = rand8;
                                pos++;
                                break;

                            case(2) : //word / int
                                rand16 = random(structElementsMaxSizeArray[elpos]);
                                int2byte(structArray, pos, rand16);
                                pos += 2;
                                break;

                            case (4) : //dword / long
                                rand32 = random(structElementsMaxSizeArray[elpos]);
                                long2byte(structArray, pos, rand32);
                                pos += 4;
                                break;                        
                         }

                    }
                    else if(structElementsTypeArray[elpos] == 0xC)          
                    { //String Params like byte[]
                        randSize = random(structElementsSizeArray[elpos]);
                        if(randSize < 4) randSize = 4; 
                        index = i-1;
                        setRandomString(structArray ,pos ,structElementsSizeArray[elpos], randSize, index);
                        pos += structElementsSizeArray[elpos];
                    }
                    else if(structElementsTypeArray[elpos] == 0xD)          
                    { 
                        structArray[pos++] = randSize & 0xFF;
                        structArray[pos++] = (randSize >> 8) & 0xFF;
                        structArray[pos++] = (randSize >> 16) & 0xFF;
                        structArray[pos++] = (randSize >> 24) & 0xFF;
                    }
                    else if(structElementsTypeArray[elpos] == 0xE)          
                    { //String Params like byte[]
                        randSize = random(structElementsSizeArray[elpos]);
                        
                        if(randSize < 2) randSize = 2; 
                        index = i-1;
                        setRandomString(structArray ,pos ,structElementsSizeArray[elpos], randSize, index);
                        pos += structElementsSizeArray[elpos];
                    }
                    else if(structElementsTypeArray[elpos] == 0xF)          
                    {
                        int2byte(structArray, pos, randSize);
                        pos += 2;
                        //write("Pos: %d Strlth: %d Type: %d ",pos-1,randSize,structElementsTypeArray[elpos]);
                    }
                    elpos++;
                }
            }   
        break;
        }            
    }
}

long2Byte(byte in[], dword pos, dword value)
{
    if( (elCount(in)-pos) < 4)
        write("Array out ouf bounds - too small!");
    in[pos] = value;
    in[++pos] = (value >> 8);
    in[++pos] = (value >> 16);
    in[++pos] = (value >> 24);
}

int2byte (byte in[],dword pos,word value)
{
    if( (elCount(in)-pos) < 2 )
        write("Array out of bounds - too small!");
    in[pos] = value;
    in[++pos] = (value >> 8);        
}

setRandomString (byte in[], dword pos, word strSize, dword randSize, dword count)
{
    dword endPos, endString, j;
    byte testString[4]={'t','e','s','t'};
    
    endPos = pos + strSize;
    endString = pos + randSize;
    j=0;
    
    int2ascii(in, pos, count);
    pos += 2;
    
    for(pos; pos < endPos ;pos ++)
    {
        if(j > 3 )
            j = 0;
        if(pos < endString)
            in[pos] = testString[j++];
        else
            in[pos] = 0x0;
    }
}

int2ascii (byte in[], dword pos, word value)
{
    //Konvertiert nur die erste und zweite Dezimalstelle, also Zahlen zw. 0 und 99.
    
    //auf 2 Stellen kuerzen
    value = value%100;
    //10er schreiben
    in[pos] = (value/10) + 48;    //  0x30 hex = 48 dez = ascii null
    //1er schreiben
    in[pos+1] = (value%10) + 48;  //  0x30 hex = 48 dez = ascii null
}

