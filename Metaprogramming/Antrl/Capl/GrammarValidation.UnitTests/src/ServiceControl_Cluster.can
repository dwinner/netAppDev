/*@!Encoding:1252*/

variables
{
  msTimer tSend_ServiceDiscovery_Offer_ICAS1Gateway; // fd53:7cb8:383:3::10
  msTimer tSend_ServiceDiscovery_Offer_ICAS1Sys01;   // fd53:7cb8:383:3::106
  msTimer tSend_ServiceDiscovery_Offer_ICAS3IVI;     // fd53:7cb8:383:3::108
  msTimer tSend_ServiceDiscovery_Find_ICAS1Sys02;    // fd53:7cb8:383:4::107
  //msTimer tSend_ServiceDiscovery_Subscribe_ICAS1Sys02;
  byte    buffer[2000];
  word    i, j, k, l;
  
  word    tag_dataID;
  char    buffer_MAC[18];
  byte    buffer_ipv6[16];
  byte    buffer_uuid[16];
  char    buffer_char[100];
  dword   ipv6_len;
  byte    ret;
  char    someip_buffer[5000];
  byte    someip_payload_buffer[5000];
  word    payload_rx_counter;
  
  // Service Time //
  word    Time_payload_length_timeSettings;
  byte    Time_payload_buffer_timeSettings[1000];
  word    Time_payload_length_times;
  byte    Time_payload_buffer_times[1000];
  
  word    Time_array_timeSettings_array_element_length[10];
  word    Time_array_timeSettings_struct_element_length;
  byte    Time_array_timeSettings_id[10][16];
  byte    Time_array_timeSettings_dstActive[10];
	dword   Time_array_timeSettings_timeMode[10];
	dword   Time_array_timeSettings_timeZoneOffset[10];
  word    Time_array_times_array_element_length[10];
  word    Time_array_times_struct_element_length;
  dword   Time_array_times_type[10];
	char  	Time_array_times_date[10][100];
  qword   Time_array_times_pltOffset[10];
  char  	Time_array_times_time[10][100];
  qword   Time_array_times_unix[10];
  dword   Time_array_times_standby[10];
  
  byte    Time_array_timeSettings_available_functions[10];
  byte    Time_array_timeSettings_id_available[10];
  byte    Time_array_timeSettings_dstActive_available[10];
  byte    Time_array_timeSettings_timeMode_available[10];
  byte    Time_array_timeSettings_timeZoneOffset_available[10];
  byte    Time_array_times_available_functions[10];
  byte    Time_array_times_type_available[10];
  byte    Time_array_times_date_available[10];
  byte    Time_array_times_pltOffset_available[10];
  byte    Time_array_times_time_available[10];
  byte    Time_array_times_unix_available[10];
  byte    Time_array_times_standby_available[10];
  
  mstimer Time_Segmentation_delay;
  word    Time_Segmentation_Method_ID;
  
  mstimer tTime_Notification_timeSettings_Send;
  mstimer tTime_Notification_time_Send;
  
  
  // Service Distance //
  word    Distance_payload_length_distances;
  byte    Distance_payload_buffer_distances[1000];
  word    Distance_payload_length_notifications;
  byte    Distance_payload_buffer_notifications[1000];
  
  word    Distance_array_distances_array_element_length[10];
  word    Distance_array_distances_struct_element_length;
  dword   Distance_array_distances_distanceName[10];
	qword   Distance_array_distances_currentValue[10];
	dword   Distance_array_distances_restrictionReason[10];
	dword   Distance_array_distances_unit[10];
  word    Distance_array_notifications_array_element_length[10];
  word    Distance_array_notifications_struct_element_length;
  dword   Distance_array_notifications_type[10];
	dword   Distance_array_notifications_value[10];
  
  byte    Distance_array_distances_available_functions[10];
  byte    Distance_array_distances_distanceName_available[10];
	byte    Distance_array_distances_currentValue_available[10];
	byte    Distance_array_distances_restrictionReason_available[10];
	byte    Distance_array_distances_unit_available[10];
  byte    Distance_array_notifications_available_functions[10];
  byte    Distance_array_notifications_type_available[10];
	byte    Distance_array_notifications_value_available[10];
  
  mstimer Distance_Segmentation_delay;
  word    Distance_Segmentation_Method_ID;
  
  mstimer tDistance_Notification_distances_Send;
  mstimer tDistance_Notification_notifications_Send;
  

  // Service Odometry //
  word    Odometry_payload_length_speeds;
  byte    Odometry_payload_buffer_speeds[1000];
  word    Odometry_payload_length_velocities;
  byte    Odometry_payload_buffer_velocities[1000];
  word    Odometry_payload_length_pose2D;
  byte    Odometry_payload_buffer_pose2D[1000];
  word    Odometry_payload_length_additionalVehicleMotionInformations;
  byte    Odometry_payload_buffer_additionalVehicleMotionInformations[1000];
  word    Odometry_payload_length_wheelCorrections;
  byte    Odometry_payload_buffer_wheelCorrections[1000];
  word    Odometry_payload_length_accelerations;
  byte    Odometry_payload_buffer_accelerations[1000];
  word    Odometry_payload_length_angularRates;
  byte    Odometry_payload_buffer_angularRates[1000];
  
  word    Odometry_array_speeds_array_element_length[10];
  word    Odometry_array_speeds_struct_element_length;
  dword   Odometry_array_speeds_type[10];
	float   Odometry_array_speeds_value[10];
	dword   Odometry_array_speeds_confidence[10];
	qword   Odometry_array_speeds_timestamp[10];
  word    Odometry_array_velocities_array_element_length[10];
  word    Odometry_array_velocities_struct_element_length;
  dword   Odometry_array_velocities_type[10];
	qword   Odometry_array_velocities_timestamp[10];
	float   Odometry_array_velocities_value[10];
	float   Odometry_array_velocities_variance[10];
	dword   Odometry_array_velocities_confidence[10];
  word    Odometry_array_pose2D_array_element_length[10];
  word    Odometry_array_pose2D_struct_element_length;
	qword   Odometry_array_pose2D_timestamp[10];
	double  Odometry_array_pose2D_positionX[10];
	double  Odometry_array_pose2D_positionY[10];
	float   Odometry_array_pose2D_yawAngle[10];
	float   Odometry_array_pose2D_positionXVariance[10];
	float   Odometry_array_pose2D_positionYVariance[10];
	float   Odometry_array_pose2D_yawAngleVariance[10];
	dword   Odometry_array_pose2D_pose2dConfidence[10];
  word    Odometry_array_additionalVehicleMotionInformations_array_element_length[10];
  word    Odometry_array_additionalVehicleMotionInformations_struct_element_length;
	qword   Odometry_array_additionalVehicleMotionInformations_timestamp[10];
	float   Odometry_array_additionalVehicleMotionInformations_drivingDirectionProbabilityRange[10];
	dword   Odometry_array_additionalVehicleMotionInformations_drivingDirectionProbabilityRangeConfidence[10];
	float   Odometry_array_additionalVehicleMotionInformations_standStillProbabilityRange[10];
	dword   Odometry_array_additionalVehicleMotionInformations_standStillProbabilityRangeConfidence[10];
  word    Odometry_array_wheelCorrections_array_element_length[10];
  word    Odometry_array_wheelCorrections_struct_element_length;
	qword   Odometry_array_wheelCorrections_timestamp[10];
	float   Odometry_array_wheelCorrections_wheelCorrectionFactorFrontLeft[10];
	float   Odometry_array_wheelCorrections_wheelCorrectionFactorFrontRight[10];
	float   Odometry_array_wheelCorrections_wheelCorrectionFactorRearLeft[10];
	float   Odometry_array_wheelCorrections_wheelCorrectionFactorRearRight[10];
	byte    Odometry_array_wheelCorrections_wheelCorrectionFactorEstimatorStatus[10];
	dword   Odometry_array_wheelCorrections_wheelCorrectionFactorEstimatorStatusConfidence[10];
	dword   Odometry_array_wheelCorrections_wheelCorrectionFactorFrontLeftConfidence[10];
	dword   Odometry_array_wheelCorrections_wheelCorrectionFactorFrontRightConfidence[10];
	dword   Odometry_array_wheelCorrections_wheelCorrectionFactoRearLeftConfidence[10];
	dword   Odometry_array_wheelCorrections_wheelCorrectionFactoRearRightConfidence[10];
	word    Odometry_array_wheelCorrections_wheelCircumferenceStatic[10];
	dword   Odometry_array_wheelCorrections_wheelCircumferenceStaticConfidence[10];
  word    Odometry_array_accelerations_array_element_length[10];
  word    Odometry_array_accelerations_struct_element_length;
	dword   Odometry_array_accelerations_type[10];
	qword   Odometry_array_accelerations_timestamp[10];
	float   Odometry_array_accelerations_acceleration[10];
	float   Odometry_array_accelerations_variance[10];
	dword   Odometry_array_accelerations_confidence[10];
  word    Odometry_array_angularRates_array_element_length[10];
  word    Odometry_array_angularRates_struct_element_length;
	dword   Odometry_array_angularRates_type[10];
	qword   Odometry_array_angularRates_timestamp[10];
	float   Odometry_array_angularRates_angularrate[10];
	float   Odometry_array_angularRates_variance[10];
	dword   Odometry_array_angularRates_confidence[10];
  
  byte    Odometry_array_speeds_available_functions[10];
	byte    Odometry_array_speeds_type_available[10];
	byte    Odometry_array_speeds_value_available[10];
	byte    Odometry_array_speeds_confidence_available[10];
	byte    Odometry_array_speeds_timestamp_available[10];
  byte    Odometry_array_velocities_available_functions[10];
	byte    Odometry_array_velocities_type_available[10];
	byte    Odometry_array_velocities_timestamp_available[10];
	byte    Odometry_array_velocities_value_available[10];
	byte    Odometry_array_velocities_variance_available[10];
	byte    Odometry_array_velocities_confidence_available[10];
  byte    Odometry_array_pose2D_available_functions[10];
	byte    Odometry_array_pose2D_timestamp_available[10];
	byte    Odometry_array_pose2D_positionX_available[10];
	byte    Odometry_array_pose2D_positionY_available[10];
	byte    Odometry_array_pose2D_yawAngle_available[10];
	byte    Odometry_array_pose2D_positionXVariance_available[10];
	byte    Odometry_array_pose2D_positionYVariance_available[10];
	byte    Odometry_array_pose2D_yawAngleVariance_available[10];
	byte    Odometry_array_pose2D_pose2dConfidence_available[10];
  byte    Odometry_array_additionalVehicleMotionInformations_available_functions[10];
	byte    Odometry_array_additionalVehicleMotionInformations_timestamp_available[10];
	byte    Odometry_array_additionalVehicleMotionInformations_drivingDirectionProbabilityRange_available[10];
	byte    Odometry_array_additionalVehicleMotionInformations_drivingDirectionProbabilityRangeConfidence_available[10];
	byte    Odometry_array_additionalVehicleMotionInformations_standStillProbabilityRange_available[10];
	byte    Odometry_array_additionalVehicleMotionInformations_standStillProbabilityRangeConfidence_available[10];
  byte    Odometry_array_wheelCorrections_available_functions[10];
	byte    Odometry_array_wheelCorrections_timestamp_available[10];
	byte    Odometry_array_wheelCorrections_wheelCorrectionFactorFrontLeft_available[10];
	byte    Odometry_array_wheelCorrections_wheelCorrectionFactorFrontRight_available[10];
	byte    Odometry_array_wheelCorrections_wheelCorrectionFactorRearLeft_available[10];
	byte    Odometry_array_wheelCorrections_wheelCorrectionFactorRearRight_available[10];
	byte    Odometry_array_wheelCorrections_wheelCorrectionFactorEstimatorStatus_available[10];
	byte    Odometry_array_wheelCorrections_wheelCorrectionFactorEstimatorStatusConfidence_available[10];
	byte    Odometry_array_wheelCorrections_wheelCorrectionFactorFrontLeftConfidence_available[10];
	byte    Odometry_array_wheelCorrections_wheelCorrectionFactorFrontRightConfidence_available[10];
	byte    Odometry_array_wheelCorrections_wheelCorrectionFactoRearLeftConfidence_available[10];
	byte    Odometry_array_wheelCorrections_wheelCorrectionFactoRearRightConfidence_available[10];
	byte    Odometry_array_wheelCorrections_wheelCircumferenceStatic_available[10];
	byte    Odometry_array_wheelCorrections_wheelCircumferenceStaticConfidence_available[10];
  byte    Odometry_array_accelerations_available_functions[10];
	byte    Odometry_array_accelerations_type_available[10];
	byte    Odometry_array_accelerations_timestamp_available[10];
	byte    Odometry_array_accelerations_acceleration_available[10];
	byte    Odometry_array_accelerations_variance_available[10];
	byte    Odometry_array_accelerations_confidence_available[10];
  byte    Odometry_array_angularRates_available_functions[10];
	byte    Odometry_array_angularRates_type_available[10];
	byte    Odometry_array_angularRates_timestamp_available[10];
	byte    Odometry_array_angularRates_angularrate_available[10];
	byte    Odometry_array_angularRates_variance_available[10];
	byte    Odometry_array_angularRates_confidence_available[10];
  
  mstimer Odometry_Segmentation_delay;
  word    Odometry_Segmentation_Method_ID;
  
  mstimer tOdometry_Notification_speeds_Send;
  mstimer tOdometry_Notification_velocities_Send;
  mstimer tOdometry_Notification_pose2D_Send;
  mstimer tOdometry_Notification_additionalVehicleMotionInformations_Send;
  mstimer tOdometry_Notification_wheelCorrections_Send;
  mstimer tOdometry_Notification_accelerations_Send;
  mstimer tOdometry_Notification_angularRates_Send;

  
  // Service ChargingManagementCore
  word    ChargingManagementCore_payload_length_immediateChargingOptions;
  byte    ChargingManagementCore_payload_buffer_immediateChargingOptions[2000];
  word    ChargingManagementCore_payload_length_chargingProcessInformation;
  byte    ChargingManagementCore_payload_buffer_chargingProcessInformation[6000];
  word    ChargingManagementCore_payload_length_chargingPlugs;
  byte    ChargingManagementCore_payload_buffer_chargingPlugs[1000];
  word    ChargingManagementCore_payload_length_immediateActions;
  byte    ChargingManagementCore_payload_buffer_immediateActions[2000];
  word    ChargingManagementCore_payload_length_notificationMarkers;
  byte    ChargingManagementCore_payload_buffer_notificationMarkers[1000];
  word    ChargingManagementCore_payload_length_notifications;
  byte    ChargingManagementCore_payload_buffer_notifications[1000];
  word    ChargingManagementCore_payload_length_pastErrorInformation;
  byte    ChargingManagementCore_payload_buffer_pastErrorInformation[1000];
  word    ChargingManagementCore_payload_length_views;
  byte    ChargingManagementCore_payload_buffer_views[1000];
  word    ChargingManagementCore_payload_length_oruUpdateApprovals;
  byte    ChargingManagementCore_payload_buffer_oruUpdateApprovals[1000];
  word    ChargingManagementCore_payload_length_switchControls;
  byte    ChargingManagementCore_payload_buffer_switchControls[2000];
  word    ChargingManagementCore_payload_length_valueControls;
  byte    ChargingManagementCore_payload_buffer_valueControls[2000];
  word    ChargingManagementCore_payload_length_valueIndications;
  byte    ChargingManagementCore_payload_buffer_valueIndications[2000];
  word    ChargingManagementCore_payload_length_resetToFactoryData;
  byte    ChargingManagementCore_payload_buffer_resetToFactoryData[1000];
  
  word    ChargingManagementCore_array_immediateChargingOptions_array_element_length[10];
  word    ChargingManagementCore_array_immediateChargingOptions_struct_element_length;
  dword   ChargingManagementCore_array_immediateChargingOptions_type[10];
  word    ChargingManagementCore_array_immediateChargingOptions_targetSoc_serviceId[10];
  word    ChargingManagementCore_array_immediateChargingOptions_targetSoc_serviceInstanceId[10];
  word    ChargingManagementCore_array_immediateChargingOptions_targetSoc_resourceId[10];
  byte    ChargingManagementCore_array_immediateChargingOptions_targetSoc_elementId[10][16];
  word    ChargingManagementCore_array_immediateChargingOptions_targetRange_serviceId[10];
  word    ChargingManagementCore_array_immediateChargingOptions_targetRange_serviceInstanceId[10];
  word    ChargingManagementCore_array_immediateChargingOptions_targetRange_resourceId[10];
  byte    ChargingManagementCore_array_immediateChargingOptions_targetRange_elementId[10][16];
  word    ChargingManagementCore_array_immediateChargingOptions_maxChargeCurrentAc_serviceId[10];
  word    ChargingManagementCore_array_immediateChargingOptions_maxChargeCurrentAc_serviceInstanceId[10];
  word    ChargingManagementCore_array_immediateChargingOptions_maxChargeCurrentAc_resourceId[10];
  byte    ChargingManagementCore_array_immediateChargingOptions_maxChargeCurrentAc_elementId[10][16];
  word    ChargingManagementCore_array_immediateChargingOptions_autounlockAc_serviceId[10];
  word    ChargingManagementCore_array_immediateChargingOptions_autounlockAc_serviceInstanceId[10];
  word    ChargingManagementCore_array_immediateChargingOptions_autounlockAc_resourceId[10];
  byte    ChargingManagementCore_array_immediateChargingOptions_autounlockAc_elementId[10][16];
  word    ChargingManagementCore_array_immediateChargingOptions_autounlockDc_serviceId[10];
  word    ChargingManagementCore_array_immediateChargingOptions_autounlockDc_serviceInstanceId[10];
  word    ChargingManagementCore_array_immediateChargingOptions_autounlockDc_resourceId[10];
  byte    ChargingManagementCore_array_immediateChargingOptions_autounlockDc_elementId[10][16];
  word    ChargingManagementCore_array_immediateChargingOptions_chargeModeSelection_serviceId[10];
  word    ChargingManagementCore_array_immediateChargingOptions_chargeModeSelection_serviceInstanceId[10];
  word    ChargingManagementCore_array_immediateChargingOptions_chargeModeSelection_resourceId[10];
  byte    ChargingManagementCore_array_immediateChargingOptions_chargeModeSelection_elementId[10][16];
  word    ChargingManagementCore_array_chargingProcessInformation_array_element_length[10];
  word    ChargingManagementCore_array_chargingProcessInformation_struct_element_length;
  dword   ChargingManagementCore_array_chargingProcessInformation_type[10];
  dword   ChargingManagementCore_array_chargingProcessInformation_currentChargeState[10];
  word    ChargingManagementCore_array_chargingProcessInformation_currentSoc_serviceId[10];
  word    ChargingManagementCore_array_chargingProcessInformation_currentSoc_serviceInstanceId[10];
  word    ChargingManagementCore_array_chargingProcessInformation_currentSoc_resourceId[10];
  byte    ChargingManagementCore_array_chargingProcessInformation_currentSoc_elementId[10][16];
  word    ChargingManagementCore_array_chargingProcessInformation_remainingChargeTimeBulk_serviceId[10];
  word    ChargingManagementCore_array_chargingProcessInformation_remainingChargeTimeBulk_serviceInstanceId[10];
  word    ChargingManagementCore_array_chargingProcessInformation_remainingChargeTimeBulk_resourceId[10];
  byte    ChargingManagementCore_array_chargingProcessInformation_remainingChargeTimeBulk_elementId[10][16];
  dword   ChargingManagementCore_array_chargingProcessInformation_chargeBulkThreshold[10];
  word    ChargingManagementCore_array_chargingProcessInformation_remainingChargeTimeComplete_serviceId[10];
  word    ChargingManagementCore_array_chargingProcessInformation_remainingChargeTimeComplete_serviceInstanceId[10];
  word    ChargingManagementCore_array_chargingProcessInformation_remainingChargeTimeComplete_resourceId[10];
  byte    ChargingManagementCore_array_chargingProcessInformation_remainingChargeTimeComplete_elementId[10][16];
  dword   ChargingManagementCore_array_chargingProcessInformation_chargeMode[10];
  dword   ChargingManagementCore_array_chargingProcessInformation_profileChargeReason[10];
  dword   ChargingManagementCore_array_chargingProcessInformation_chargeType[10];
  word    ChargingManagementCore_array_chargingProcessInformation_chargeEnergy_serviceId[10];
  word    ChargingManagementCore_array_chargingProcessInformation_chargeEnergy_serviceInstanceId[10];
  word    ChargingManagementCore_array_chargingProcessInformation_chargeEnergy_resourceId[10];
  byte    ChargingManagementCore_array_chargingProcessInformation_chargeEnergy_elementId[10][16];
  word    ChargingManagementCore_array_chargingProcessInformation_chargeRate_serviceId[10];
  word    ChargingManagementCore_array_chargingProcessInformation_chargeRate_serviceInstanceId[10];
  word    ChargingManagementCore_array_chargingProcessInformation_chargeRate_resourceId[10];
  byte    ChargingManagementCore_array_chargingProcessInformation_chargeRate_elementId[10][16];
  word    ChargingManagementCore_array_chargingProcessInformation_chargePower_serviceId[10];
  word    ChargingManagementCore_array_chargingProcessInformation_chargePower_serviceInstanceId[10];
  word    ChargingManagementCore_array_chargingProcessInformation_chargePower_resourceId[10];
  byte    ChargingManagementCore_array_chargingProcessInformation_chargePower_elementId[10][16];
  dword   ChargingManagementCore_array_chargingProcessInformation_chargingScenario[10];
  word    ChargingManagementCore_array_chargingProcessInformation_chargeTargetTime_serviceId[10];
  word    ChargingManagementCore_array_chargingProcessInformation_chargeTargetTime_serviceInstanceId[10];
  word    ChargingManagementCore_array_chargingProcessInformation_chargeTargetTime_resourceId[10];
  byte    ChargingManagementCore_array_chargingProcessInformation_chargeTargetTime_elementId[10][16];
  word    ChargingManagementCore_array_chargingProcessInformation_chargeTargetTimeOffset_serviceId[10];
  word    ChargingManagementCore_array_chargingProcessInformation_chargeTargetTimeOffset_serviceInstanceId[10];
  word    ChargingManagementCore_array_chargingProcessInformation_chargeTargetTimeOffset_resourceId[10];
  byte    ChargingManagementCore_array_chargingProcessInformation_chargeTargetTimeOffset_elementId[10][16];
  word    ChargingManagementCore_array_chargingProcessInformation_maxPowerChargingStation_serviceId[10];
  word    ChargingManagementCore_array_chargingProcessInformation_maxPowerChargingStation_serviceInstanceId[10];
  word    ChargingManagementCore_array_chargingProcessInformation_maxPowerChargingStation_resourceId[10];
  byte    ChargingManagementCore_array_chargingProcessInformation_maxPowerChargingStation_elementId[10][16];
  word    ChargingManagementCore_array_chargingPlugs_array_element_length[10];
  word    ChargingManagementCore_array_chargingPlugs_struct_element_length;
  dword   ChargingManagementCore_array_chargingPlugs_type[10];
  word    ChargingManagementCore_array_chargingPlugs_plugLockState_serviceId[10];
  word    ChargingManagementCore_array_chargingPlugs_plugLockState_serviceInstanceId[10];
  word    ChargingManagementCore_array_chargingPlugs_plugLockState_resourceId[10];
  byte    ChargingManagementCore_array_chargingPlugs_plugLockState_elementId[10][16];
  word    ChargingManagementCore_array_chargingPlugs_flapLockState_serviceId[10];
  word    ChargingManagementCore_array_chargingPlugs_flapLockState_serviceInstanceId[10];
  word    ChargingManagementCore_array_chargingPlugs_flapLockState_resourceId[10];
  byte    ChargingManagementCore_array_chargingPlugs_flapLockState_elementId[10][16];
  dword   ChargingManagementCore_array_chargingPlugs_plugType[10];
  dword   ChargingManagementCore_array_chargingPlugs_plugConnectionState[10];
  dword   ChargingManagementCore_array_chargingPlugs_infrastructureState[10];
  word    ChargingManagementCore_array_immediateActions_array_element_length[10];
  word    ChargingManagementCore_array_immediateActions_struct_element_length;
  dword   ChargingManagementCore_array_immediateActions_type[10];
  word    ChargingManagementCore_array_immediateActions_immediateActionSoc_serviceId[10];
  word    ChargingManagementCore_array_immediateActions_immediateActionSoc_serviceInstanceId[10];
  word    ChargingManagementCore_array_immediateActions_immediateActionSoc_resourceId[10];
  byte    ChargingManagementCore_array_immediateActions_immediateActionSoc_elementId[10][16];
  word    ChargingManagementCore_array_immediateActions_immediateActionRange_serviceId[10];
  word    ChargingManagementCore_array_immediateActions_immediateActionRange_serviceInstanceId[10];
  word    ChargingManagementCore_array_immediateActions_immediateActionRange_resourceId[10];
  byte    ChargingManagementCore_array_immediateActions_immediateActionRange_elementId[10][16];
  word    ChargingManagementCore_array_immediateActions_immediateActionTime_serviceId[10];
  word    ChargingManagementCore_array_immediateActions_immediateActionTime_serviceInstanceId[10];
  word    ChargingManagementCore_array_immediateActions_immediateActionTime_resourceId[10];
  byte    ChargingManagementCore_array_immediateActions_immediateActionTime_elementId[10][16];
  word    ChargingManagementCore_array_immediateActions_startStopCharging_serviceId[10];
  word    ChargingManagementCore_array_immediateActions_startStopCharging_serviceInstanceId[10];
  word    ChargingManagementCore_array_immediateActions_startStopCharging_resourceId[10];
  byte    ChargingManagementCore_array_immediateActions_startStopCharging_elementId[10][16];
  word    ChargingManagementCore_array_notificationMarkers_array_element_length[10];
  word    ChargingManagementCore_array_notificationMarkers_struct_element_length;
  dword   ChargingManagementCore_array_notificationMarkers_type[10];
  word    ChargingManagementCore_array_notificationMarkers_notificationSocValue_serviceId[10];
  word    ChargingManagementCore_array_notificationMarkers_notificationSocValue_serviceInstanceId[10];
  word    ChargingManagementCore_array_notificationMarkers_notificationSocValue_resourceId[10];
  byte    ChargingManagementCore_array_notificationMarkers_notificationSocValue_elementId[10][16];
  word    ChargingManagementCore_array_notificationMarkers_notificationRangeValue_serviceId[10];
  word    ChargingManagementCore_array_notificationMarkers_notificationRangeValue_serviceInstanceId[10];
  word    ChargingManagementCore_array_notificationMarkers_notificationRangeValue_resourceId[10];
  byte    ChargingManagementCore_array_notificationMarkers_notificationRangeValue_elementId[10][16];
  word    ChargingManagementCore_array_notificationMarkers_notificationTimeValue_serviceId[10];
  word    ChargingManagementCore_array_notificationMarkers_notificationTimeValue_serviceInstanceId[10];
  word    ChargingManagementCore_array_notificationMarkers_notificationTimeValue_resourceId[10];
  byte    ChargingManagementCore_array_notificationMarkers_notificationTimeValue_elementId[10][16];
  byte    ChargingManagementCore_array_notificationMarkers_isToBeNotified[10];
  word    ChargingManagementCore_array_notifications_array_element_length[10];
  word    ChargingManagementCore_array_notifications_struct_element_length;
  dword   ChargingManagementCore_array_notifications_type[10];
  dword   ChargingManagementCore_array_notifications_value[10];
  dword   ChargingManagementCore_array_notifications_additionalInformation[10];
  word    ChargingManagementCore_array_pastErrorInformation_array_element_length[10];
  word    ChargingManagementCore_array_pastErrorInformation_struct_element_length;
  dword   ChargingManagementCore_array_pastErrorInformation_type[10];
  dword   ChargingManagementCore_array_pastErrorInformation_value[10];
  dword   ChargingManagementCore_array_pastErrorInformation_additionalInformation[10];
  byte    ChargingManagementCore_array_pastErrorInformation_confirmedByUser[10];
  word    ChargingManagementCore_array_views_array_element_length[10];
  word    ChargingManagementCore_array_views_struct_element_length;
  dword   ChargingManagementCore_array_views_type[10];
  dword   ChargingManagementCore_array_views_content[10];
  dword   ChargingManagementCore_array_views_visibility[10];
  word    ChargingManagementCore_array_oruUpdateApprovals_array_element_length[10];
  word    ChargingManagementCore_array_oruUpdateApprovals_struct_element_length;
  dword   ChargingManagementCore_array_oruUpdateApprovals_type[10];
  byte    ChargingManagementCore_array_oruUpdateApprovals_updateApproval[10];
  word    ChargingManagementCore_array_switchControls_array_element_length[10];
  word    ChargingManagementCore_array_switchControls_struct_element_length;
  byte    ChargingManagementCore_array_switchControls_id[10][16];
  dword   ChargingManagementCore_array_switchControls_switchValue[10];
  dword   ChargingManagementCore_array_switchControls_switchValueConfiguration[10][10];
  dword   ChargingManagementCore_array_switchControls_restrictionReason[10];
  dword   ChargingManagementCore_array_switchControls_type[10];
  word    ChargingManagementCore_array_valueControls_array_element_length[10];
  word    ChargingManagementCore_array_valueControls_struct_element_length;
  byte    ChargingManagementCore_array_valueControls_id[10][16];
	dword   ChargingManagementCore_array_valueControls_currentValue[10];
	dword   ChargingManagementCore_array_valueControls_maxValue[10];
	dword   ChargingManagementCore_array_valueControls_minValue[10];
	dword   ChargingManagementCore_array_valueControls_unitPercent[10];
	dword   ChargingManagementCore_array_valueControls_unitDistance[10];
	dword   ChargingManagementCore_array_valueControls_unitTime[10];
	dword   ChargingManagementCore_array_valueControls_resolution[10];
	dword   ChargingManagementCore_array_valueControls_restrictionReason[10];
	dword   ChargingManagementCore_array_valueControls_type[10];
	dword   ChargingManagementCore_array_valueControls_specialState[10];
	byte    ChargingManagementCore_array_valueControls_specialStateConfiguration[10][10];
  word    ChargingManagementCore_array_valueIndications_array_element_length[10];
  word    ChargingManagementCore_array_valueIndications_struct_element_length;
  byte    ChargingManagementCore_array_valueIndications_id[10][16];
	float   ChargingManagementCore_array_valueIndications_currentValue[10];
	float   ChargingManagementCore_array_valueIndications_maxValue[10];
	float   ChargingManagementCore_array_valueIndications_minValue[10];
	char    ChargingManagementCore_array_valueIndications_currentTimeDateValue[10][100];
	dword   ChargingManagementCore_array_valueIndications_unitPercent[10];
	dword   ChargingManagementCore_array_valueIndications_unitTime[10];
	dword   ChargingManagementCore_array_valueIndications_unitSpeed[10];
	dword   ChargingManagementCore_array_valueIndications_unitPower[10];
	dword   ChargingManagementCore_array_valueIndications_unitEnergy[10];
	dword   ChargingManagementCore_array_valueIndications_restrictionReason[10];
	dword   ChargingManagementCore_array_valueIndications_type[10];
  word    ChargingManagementCore_array_resetToFactoryData_array_element_length[10];
  word    ChargingManagementCore_array_resetToFactoryData_struct_element_length;
  byte    ChargingManagementCore_array_resetToFactoryData_id[10][16];
	dword   ChargingManagementCore_array_resetToFactoryData_resetToFactoryData[10];
  
  byte    ChargingManagementCore_array_switchControls_switchValueConfiguration_nr_of_elements[10];
  byte    ChargingManagementCore_array_valueControls_specialStateConfiguration_nr_of_elements[10];
  
  byte    ChargingManagementCore_array_immediateChargingOptions_available_functions[10];
  byte    ChargingManagementCore_array_immediateChargingOptions_type_available[10];
  byte    ChargingManagementCore_array_immediateChargingOptions_targetSoc_available[10];
  byte    ChargingManagementCore_array_immediateChargingOptions_targetRange_available[10];
  byte    ChargingManagementCore_array_immediateChargingOptions_maxChargeCurrentAc_available[10];
  byte    ChargingManagementCore_array_immediateChargingOptions_autounlockAc_available[10];
  byte    ChargingManagementCore_array_immediateChargingOptions_autounlockDc_available[10];
  byte    ChargingManagementCore_array_immediateChargingOptions_chargeModeSelection_available[10];
  byte    ChargingManagementCore_array_chargingProcessInformation_available_functions[10];
  byte    ChargingManagementCore_array_chargingProcessInformation_type_available[10];
  byte    ChargingManagementCore_array_chargingProcessInformation_currentChargeState_available[10];
  byte    ChargingManagementCore_array_chargingProcessInformation_currentSoc_available[10];
  byte    ChargingManagementCore_array_chargingProcessInformation_remainingChargeTimeBulk_available[10];
  byte    ChargingManagementCore_array_chargingProcessInformation_chargeBulkThreshold_available[10];
  byte    ChargingManagementCore_array_chargingProcessInformation_remainingChargeTimeComplete_available[10];
  byte    ChargingManagementCore_array_chargingProcessInformation_chargeMode_available[10];
  byte    ChargingManagementCore_array_chargingProcessInformation_profileChargeReason_available[10];
  byte    ChargingManagementCore_array_chargingProcessInformation_chargeType_available[10];
  byte    ChargingManagementCore_array_chargingProcessInformation_chargeEnergy_available[10];
  byte    ChargingManagementCore_array_chargingProcessInformation_chargeRate_available[10];
  byte    ChargingManagementCore_array_chargingProcessInformation_chargePower_available[10];
  byte    ChargingManagementCore_array_chargingProcessInformation_chargingScenario_available[10];
  byte    ChargingManagementCore_array_chargingProcessInformation_chargeTargetTime_available[10];
  byte    ChargingManagementCore_array_chargingProcessInformation_chargeTargetTimeOffset_available[10];
  byte    ChargingManagementCore_array_chargingProcessInformation_maxPowerChargingStation_available[10];
  byte    ChargingManagementCore_array_chargingPlugs_available_functions[10];
  byte    ChargingManagementCore_array_chargingPlugs_type_available[10];
  byte    ChargingManagementCore_array_chargingPlugs_plugLockState_available[10];
  byte    ChargingManagementCore_array_chargingPlugs_flapLockState_available[10];
  byte    ChargingManagementCore_array_chargingPlugs_plugType_available[10];
  byte    ChargingManagementCore_array_chargingPlugs_plugConnectionState_available[10];
  byte    ChargingManagementCore_array_chargingPlugs_infrastructureState_available[10];
  byte    ChargingManagementCore_array_immediateActions_available_functions[10];
  byte    ChargingManagementCore_array_immediateActions_type_available[10];
  byte    ChargingManagementCore_array_immediateActions_immediateActionSoc_available[10];
  byte    ChargingManagementCore_array_immediateActions_immediateActionRange_available[10];
  byte    ChargingManagementCore_array_immediateActions_immediateActionTime_available[10];
  byte    ChargingManagementCore_array_immediateActions_startStopCharging_available[10];
  byte    ChargingManagementCore_array_notificationMarkers_available_functions[10];
  byte    ChargingManagementCore_array_notificationMarkers_type_available[10];
  byte    ChargingManagementCore_array_notificationMarkers_notificationSocValue_available[10];
  byte    ChargingManagementCore_array_notificationMarkers_notificationRangeValue_available[10];
  byte    ChargingManagementCore_array_notificationMarkers_notificationTimeValue_available[10];
  byte    ChargingManagementCore_array_notificationMarkers_isToBeNotified_available[10];
  byte    ChargingManagementCore_array_notifications_available_functions[10];
  byte    ChargingManagementCore_array_notifications_type_available[10];
  byte    ChargingManagementCore_array_notifications_value_available[10];
  byte    ChargingManagementCore_array_notifications_additionalInformation_available[10];
  byte    ChargingManagementCore_array_pastErrorInformation_available_functions[10];
  byte    ChargingManagementCore_array_pastErrorInformation_type_available[10];
  byte    ChargingManagementCore_array_pastErrorInformation_value_available[10];
  byte    ChargingManagementCore_array_pastErrorInformation_additionalInformation_available[10];
  byte    ChargingManagementCore_array_pastErrorInformation_confirmedByUser_available[10];
  byte    ChargingManagementCore_array_views_available_functions[10];
  byte    ChargingManagementCore_array_views_type_available[10];
  byte    ChargingManagementCore_array_views_content_available[10];
  byte    ChargingManagementCore_array_views_visibility_available[10];
  byte    ChargingManagementCore_array_oruUpdateApprovals_available_functions[10];
  byte    ChargingManagementCore_array_oruUpdateApprovals_type_available[10];
  byte    ChargingManagementCore_array_oruUpdateApprovals_updateApproval_available[10];
  byte    ChargingManagementCore_array_switchControls_available_functions[10];
  byte    ChargingManagementCore_array_switchControls_id_available[10];
  byte    ChargingManagementCore_array_switchControls_switchValue_available[10];
  byte    ChargingManagementCore_array_switchControls_switchValueConfiguration_available[10];
  byte    ChargingManagementCore_array_switchControls_restrictionReason_available[10];
  byte    ChargingManagementCore_array_switchControls_type_available[10];
  byte    ChargingManagementCore_array_valueControls_available_functions[10];
  byte    ChargingManagementCore_array_valueControls_id_available[10];
  byte    ChargingManagementCore_array_valueControls_currentValue_available[10];
  byte    ChargingManagementCore_array_valueControls_maxValue_available[10];
  byte    ChargingManagementCore_array_valueControls_minValue_available[10];
  byte    ChargingManagementCore_array_valueControls_unitPercent_available[10];
  byte    ChargingManagementCore_array_valueControls_unitDistance_available[10];
  byte    ChargingManagementCore_array_valueControls_unitTime_available[10];
  byte    ChargingManagementCore_array_valueControls_resolution_available[10];
  byte    ChargingManagementCore_array_valueControls_restrictionReason_available[10];
  byte    ChargingManagementCore_array_valueControls_type_available[10];
  byte    ChargingManagementCore_array_valueControls_specialState_available[10];
  byte    ChargingManagementCore_array_valueControls_specialStateConfiguration_available[10];
  byte    ChargingManagementCore_array_valueIndications_available_functions[10];
  byte    ChargingManagementCore_array_valueIndications_id_available[10];
  byte    ChargingManagementCore_array_valueIndications_currentValue_available[10];
  byte    ChargingManagementCore_array_valueIndications_maxValue_available[10];
  byte    ChargingManagementCore_array_valueIndications_minValue_available[10];
  byte    ChargingManagementCore_array_valueIndications_currentTimeDateValue_available[10];
  byte    ChargingManagementCore_array_valueIndications_unitPercent_available[10];
  byte    ChargingManagementCore_array_valueIndications_unitTime_available[10];
  byte    ChargingManagementCore_array_valueIndications_unitSpeed_available[10];
  byte    ChargingManagementCore_array_valueIndications_unitPower_available[10];
  byte    ChargingManagementCore_array_valueIndications_unitEnergy_available[10];
  byte    ChargingManagementCore_array_valueIndications_restrictionReason_available[10];
  byte    ChargingManagementCore_array_valueIndications_type_available[10];
  byte    ChargingManagementCore_array_resetToFactoryData_available_functions[10];
  byte    ChargingManagementCore_array_resetToFactoryData_id_available[10];
  byte    ChargingManagementCore_array_resetToFactoryData_resetToFactoryData_available[10];
  
  dword   ChargingManagementCore_array_switchControls_switchValueConfiguration_length;
  dword   ChargingManagementCore_array_valueControls_specialStateConfiguration_length;
  
  mstimer ChargingManagementCore_Segmentation_delay;
  word    ChargingManagementCore_Segmentation_Method_ID;
  
  mstimer tChargingManagementCore_Notification_immediateChargingOptions_Send;
  mstimer tChargingManagementCore_Notification_chargingProcessInformation_Send;
  mstimer tChargingManagementCore_Notification_chargingPlugs_Send;
  mstimer tChargingManagementCore_Notification_immediateActions_Send;
  mstimer tChargingManagementCore_Notification_notificationMarkers_Send;
  mstimer tChargingManagementCore_Notification_notifications_Send;
  mstimer tChargingManagementCore_Notification_pastErrorInformation_Send;
  mstimer tChargingManagementCore_Notification_views_Send;
  mstimer tChargingManagementCore_Notification_oruUpdateApprovals_Send;
  mstimer tChargingManagementCore_Notification_switchControls_Send;
  mstimer tChargingManagementCore_Notification_valueControls_Send;
  mstimer tChargingManagementCore_Notification_valueIndications_Send;
  mstimer tChargingManagementCore_Notification_resetToFactoryData_Send;
  
  // Service ChargingManagementExtendedSync
  word    ChargingManagementExtendedSync_payload_length_estimatedTimesAndInfos;
  byte    ChargingManagementExtendedSync_payload_buffer_estimatedTimesAndInfos[2000];
  word    ChargingManagementExtendedSync_payload_length_activeChargingProfiles;
  byte    ChargingManagementExtendedSync_payload_buffer_activeChargingProfiles[2000];
  word    ChargingManagementExtendedSync_payload_length_nextChargingTimers;
  byte    ChargingManagementExtendedSync_payload_buffer_nextChargingTimers[2000];
  word    ChargingManagementExtendedSync_payload_length_preferredChargingTimes;
  byte    ChargingManagementExtendedSync_payload_buffer_preferredChargingTimes[1000];
  
  word    ChargingManagementExtendedSync_array_estimatedTimesAndInfos_array_element_length[10];
  word    ChargingManagementExtendedSync_array_estimatedTimesAndInfos_struct_element_length;
  dword   ChargingManagementExtendedSync_array_estimatedTimesAndInfos_elementId[10];
  byte    ChargingManagementExtendedSync_array_estimatedTimesAndInfos_isExternalServiceAvailable[10];
  byte    ChargingManagementExtendedSync_array_estimatedTimesAndInfos_isEstimatedStartTimeRelevant[10];
  dword   ChargingManagementExtendedSync_array_estimatedTimesAndInfos_estimatedStartTimeYear[10];
  dword   ChargingManagementExtendedSync_array_estimatedTimesAndInfos_estimatedStartTimeMonth[10];
  dword   ChargingManagementExtendedSync_array_estimatedTimesAndInfos_estimatedStartTimeDay[10];
  dword   ChargingManagementExtendedSync_array_estimatedTimesAndInfos_estimatedStartTimeHour[10];
  dword   ChargingManagementExtendedSync_array_estimatedTimesAndInfos_estimatedStartTimeMinute[10];
  byte    ChargingManagementExtendedSync_array_estimatedTimesAndInfos_isEstimatedFinishTimeRelevant[10];
  dword   ChargingManagementExtendedSync_array_estimatedTimesAndInfos_estimatedFinishTimeYear[10];
  dword   ChargingManagementExtendedSync_array_estimatedTimesAndInfos_estimatedFinishTimeMonth[10];
  dword   ChargingManagementExtendedSync_array_estimatedTimesAndInfos_estimatedFinishTimeDay[10];
  dword   ChargingManagementExtendedSync_array_estimatedTimesAndInfos_estimatedFinishTimeHour[10];
  dword   ChargingManagementExtendedSync_array_estimatedTimesAndInfos_estimatedFinishTimeMinute[10];
  dword   ChargingManagementExtendedSync_array_estimatedTimesAndInfos_targetReachable[10];
  word    ChargingManagementExtendedSync_array_activeChargingProfiles_array_element_length[10];
  word    ChargingManagementExtendedSync_array_activeChargingProfiles_struct_element_length;
  dword   ChargingManagementExtendedSync_array_activeChargingProfiles_elementId[10];
  byte    ChargingManagementExtendedSync_array_activeChargingProfiles_isOwnCurrentUsed[10];
  byte    ChargingManagementExtendedSync_array_activeChargingProfiles_isSmartChargingUsed[10];
  dword   ChargingManagementExtendedSync_array_activeChargingProfiles_targetSoc[10];
  dword   ChargingManagementExtendedSync_array_activeChargingProfiles_targetRange[10];
  dword   ChargingManagementExtendedSync_array_activeChargingProfiles_minSoc[10];
  dword   ChargingManagementExtendedSync_array_activeChargingProfiles_maxChargeCurrent[10];
  dword   ChargingManagementExtendedSync_array_activeChargingProfiles_autounlockAc[10];
  dword   ChargingManagementExtendedSync_array_activeChargingProfiles_autounlockDc[10];
  word    ChargingManagementExtendedSync_array_nextChargingTimers_array_element_length[10];
  word    ChargingManagementExtendedSync_array_nextChargingTimers_struct_element_length;
  dword   ChargingManagementExtendedSync_array_nextChargingTimers_elementId[10];
  byte    ChargingManagementExtendedSync_array_nextChargingTimers_isActivated[10];
  dword   ChargingManagementExtendedSync_array_nextChargingTimers_nextChargingTimerYear[10];
  dword   ChargingManagementExtendedSync_array_nextChargingTimers_nextChargingTimerMonth[10];
  dword   ChargingManagementExtendedSync_array_nextChargingTimers_nextChargingTimerDay[10];
  dword   ChargingManagementExtendedSync_array_nextChargingTimers_nextChargingTimerHour[10];
  dword   ChargingManagementExtendedSync_array_nextChargingTimers_nextChargingTimerMinute[10];
  byte    ChargingManagementExtendedSync_array_nextChargingTimers_isClimatingNeeded[10];
  byte    ChargingManagementExtendedSync_array_nextChargingTimers_isChargingNeeded[10];
  word    ChargingManagementExtendedSync_array_preferredChargingTimes_array_element_length[10];
  word    ChargingManagementExtendedSync_array_preferredChargingTimes_struct_element_length;
  dword   ChargingManagementExtendedSync_array_preferredChargingTimes_elementId[10];
  byte    ChargingManagementExtendedSync_array_preferredChargingTimes_isActivated[10];
  dword   ChargingManagementExtendedSync_array_preferredChargingTimes_startHour[10];
  dword   ChargingManagementExtendedSync_array_preferredChargingTimes_startMinute[10];
  dword   ChargingManagementExtendedSync_array_preferredChargingTimes_endHour[10];
  dword   ChargingManagementExtendedSync_array_preferredChargingTimes_endMinute[10];
  
  byte    ChargingManagementExtendedSync_array_estimatedTimesAndInfos_available_functions[10];
  byte    ChargingManagementExtendedSync_array_estimatedTimesAndInfos_elementId_available[10];
  byte    ChargingManagementExtendedSync_array_estimatedTimesAndInfos_isExternalServiceAvailable_available[10];
  byte    ChargingManagementExtendedSync_array_estimatedTimesAndInfos_isEstimatedStartTimeRelevant_available[10];
  byte    ChargingManagementExtendedSync_array_estimatedTimesAndInfos_estimatedStartTimeYear_available[10];
  byte    ChargingManagementExtendedSync_array_estimatedTimesAndInfos_estimatedStartTimeMonth_available[10];
  byte    ChargingManagementExtendedSync_array_estimatedTimesAndInfos_estimatedStartTimeDay_available[10];
  byte    ChargingManagementExtendedSync_array_estimatedTimesAndInfos_estimatedStartTimeHour_available[10];
  byte    ChargingManagementExtendedSync_array_estimatedTimesAndInfos_estimatedStartTimeMinute_available[10];
  byte    ChargingManagementExtendedSync_array_estimatedTimesAndInfos_isEstimatedFinishTimeRelevant_available[10];
  byte    ChargingManagementExtendedSync_array_estimatedTimesAndInfos_estimatedFinishTimeYear_available[10];
  byte    ChargingManagementExtendedSync_array_estimatedTimesAndInfos_estimatedFinishTimeMonth_available[10];
  byte    ChargingManagementExtendedSync_array_estimatedTimesAndInfos_estimatedFinishTimeDay_available[10];
  byte    ChargingManagementExtendedSync_array_estimatedTimesAndInfos_estimatedFinishTimeHour_available[10];
  byte    ChargingManagementExtendedSync_array_estimatedTimesAndInfos_estimatedFinishTimeMinute_available[10];
  byte    ChargingManagementExtendedSync_array_estimatedTimesAndInfos_targetReachable_available[10];
  byte    ChargingManagementExtendedSync_array_activeChargingProfiles_available_functions[10];
  byte    ChargingManagementExtendedSync_array_activeChargingProfiles_elementId_available[10];
  byte    ChargingManagementExtendedSync_array_activeChargingProfiles_isOwnCurrentUsed_available[10];
  byte    ChargingManagementExtendedSync_array_activeChargingProfiles_isSmartChargingUsed_available[10];
  byte    ChargingManagementExtendedSync_array_activeChargingProfiles_targetSoc_available[10];
  byte    ChargingManagementExtendedSync_array_activeChargingProfiles_targetRange_available[10];
  byte    ChargingManagementExtendedSync_array_activeChargingProfiles_minSoc_available[10];
  byte    ChargingManagementExtendedSync_array_activeChargingProfiles_maxChargeCurrent_available[10];
  byte    ChargingManagementExtendedSync_array_activeChargingProfiles_autounlockAc_available[10];
  byte    ChargingManagementExtendedSync_array_activeChargingProfiles_autounlockDc_available[10];
  byte    ChargingManagementExtendedSync_array_nextChargingTimers_available_functions[10];
  byte    ChargingManagementExtendedSync_array_nextChargingTimers_elementId_available[10];
  byte    ChargingManagementExtendedSync_array_nextChargingTimers_isActivated_available[10];
  byte    ChargingManagementExtendedSync_array_nextChargingTimers_nextChargingTimerYear_available[10];
  byte    ChargingManagementExtendedSync_array_nextChargingTimers_nextChargingTimerMonth_available[10];
  byte    ChargingManagementExtendedSync_array_nextChargingTimers_nextChargingTimerDay_available[10];
  byte    ChargingManagementExtendedSync_array_nextChargingTimers_nextChargingTimerHour_available[10];
  byte    ChargingManagementExtendedSync_array_nextChargingTimers_nextChargingTimerMinute_available[10];
  byte    ChargingManagementExtendedSync_array_nextChargingTimers_isClimatingNeeded_available[10];
  byte    ChargingManagementExtendedSync_array_nextChargingTimers_isChargingNeeded_available[10];
  byte    ChargingManagementExtendedSync_array_preferredChargingTimes_available_functions[10];
  byte    ChargingManagementExtendedSync_array_preferredChargingTimes_elementId_available[10];
  byte    ChargingManagementExtendedSync_array_preferredChargingTimes_isActivated_available[10];
  byte    ChargingManagementExtendedSync_array_preferredChargingTimes_startHour_available[10];
  byte    ChargingManagementExtendedSync_array_preferredChargingTimes_startMinute_available[10];
  byte    ChargingManagementExtendedSync_array_preferredChargingTimes_endHour_available[10];
  byte    ChargingManagementExtendedSync_array_preferredChargingTimes_endMinute_available[10];

  mstimer ChargingManagementExtendedSync_Segmentation_delay;
  word    ChargingManagementExtendedSync_Segmentation_Method_ID;
  
  mstimer tChargingManagementExtendedSync_Notification_estimatedTimesAndInfos_Send;
  mstimer tChargingManagementExtendedSync_Notification_activeChargingProfiles_Send;
  mstimer tChargingManagementExtendedSync_Notification_nextChargingTimers_Send;
  mstimer tChargingManagementExtendedSync_Notification_preferredChargingTimes_Send;
  
  
  // Service UnitMaster
  word    UnitMaster_payload_length_units;
  byte    UnitMaster_payload_buffer_units[5000];
  byte    UnitMaster_units_data_length_element_num;
  
  word    UnitMaster_array_units_array_element_length[20];
  word    UnitMaster_array_units_struct_element_length;
  byte    UnitMaster_array_units_id[20][16];
  char    UnitMaster_array_units_name[20][100];
  dword   UnitMaster_array_units_dateFormat[20];
  dword   UnitMaster_array_units_dateFormatConfiguration[20][20];
  dword   UnitMaster_array_units_distanceUnit[20];
	dword   UnitMaster_array_units_distanceUnitConfiguration[20][20];
	dword   UnitMaster_array_units_pressureUnit[20];
	dword   UnitMaster_array_units_pressureUnitConfiguration[20][20];
	dword   UnitMaster_array_units_restrictionReason[20];
	dword   UnitMaster_array_units_speedUnitTachometer[20];
	dword   UnitMaster_array_units_speedUnit[20];
	dword   UnitMaster_array_units_speedUnitConfiguration[20][20];
	dword   UnitMaster_array_units_temperatureUnit[20];
	dword   UnitMaster_array_units_temperatureUnitConfiguration[20][20];
	dword   UnitMaster_array_units_timeFormat[20];
	dword   UnitMaster_array_units_timeFormatConfiguration[20][20];
	dword   UnitMaster_array_units_volumeUnit[20];
	dword   UnitMaster_array_units_volumeUnitConfiguration[20][20];
	dword   UnitMaster_array_units_consumptionUnit[20];
	dword   UnitMaster_array_units_consumptionUnitConfiguration[20][20];
	dword   UnitMaster_array_units_consumptionUnitElectr[20];
	dword   UnitMaster_array_units_consumptionUnitElectrConfiguration[20][20];
	dword   UnitMaster_array_units_consumptionUnitGas[20];
	dword   UnitMaster_array_units_consumptionUnitGasConfiguration[20][20];
	dword   UnitMaster_array_units_massUnit[20];
	dword   UnitMaster_array_units_massUnitConfiguration[20][20];
  
  byte    UnitMaster_array_units_available_functions[20];
  byte    UnitMaster_array_units_id_available[20];
	byte    UnitMaster_array_units_name_available[20];
	byte    UnitMaster_array_units_dateFormat_available[20];
	byte    UnitMaster_array_units_dateFormatConfiguration_available[20];
	byte    UnitMaster_array_units_distanceUnit_available[20];
	byte    UnitMaster_array_units_distanceUnitConfiguration_available[20];
	byte    UnitMaster_array_units_pressureUnit_available[20];
	byte    UnitMaster_array_units_pressureUnitConfiguration_available[20];
	byte    UnitMaster_array_units_restrictionReason_available[20];
	byte    UnitMaster_array_units_speedUnitTachometer_available[20];
	byte    UnitMaster_array_units_speedUnit_available[20];
	byte    UnitMaster_array_units_speedUnitConfiguration_available[20];
	byte    UnitMaster_array_units_temperatureUnit_available[20];
	byte    UnitMaster_array_units_temperatureUnitConfiguration_available[20];
	byte    UnitMaster_array_units_timeFormat_available[20];
	byte    UnitMaster_array_units_timeFormatConfiguration_available[20];
	byte    UnitMaster_array_units_volumeUnit_available[20];
	byte    UnitMaster_array_units_volumeUnitConfiguration_available[20];
	byte    UnitMaster_array_units_consumptionUnit_available[20];
	byte    UnitMaster_array_units_consumptionUnitConfiguration_available[20];
	byte    UnitMaster_array_units_consumptionUnitElectr_available[20];
	byte    UnitMaster_array_units_consumptionUnitElectrConfiguration_available[20];
	byte    UnitMaster_array_units_consumptionUnitGas_available[20];
	byte    UnitMaster_array_units_consumptionUnitGasConfiguration_available[20];
	byte    UnitMaster_array_units_massUnit_available[20];
	byte    UnitMaster_array_units_massUnitConfiguration_available[20];
  
  byte    UnitMaster_array_units_dateFormatConfiguration_nr_of_elements[20];
	byte    UnitMaster_array_units_distanceUnitConfiguration_nr_of_elements[20];
	byte    UnitMaster_array_units_pressureUnitConfiguration_nr_of_elements[20];
	byte    UnitMaster_array_units_speedUnitConfiguration_nr_of_elements[20];
	byte    UnitMaster_array_units_temperatureUnitConfiguration_nr_of_elements[20];
	byte    UnitMaster_array_units_timeFormatConfiguration_nr_of_elements[20];
	byte    UnitMaster_array_units_volumeUnitConfiguration_nr_of_elements[20];
	byte    UnitMaster_array_units_consumptionUnitConfiguration_nr_of_elements[20];
	byte    UnitMaster_array_units_consumptionUnitElectrConfiguration_nr_of_elements[20];
	byte    UnitMaster_array_units_consumptionUnitGasConfiguration_nr_of_elements[20];
	byte    UnitMaster_array_units_massUnitConfiguration_nr_of_elements[20];
  
  word    UnitMaster_array_units_dateFormatConfiguration_length;
  word    UnitMaster_array_units_distanceUnitConfiguration_length;
  word    UnitMaster_array_units_pressureUnitConfiguration_length;
  word    UnitMaster_array_units_speedUnitConfiguration_length;
  word    UnitMaster_array_units_temperatureUnitConfiguration_length;
  word    UnitMaster_array_units_timeFormatConfiguration_length;
  word    UnitMaster_array_units_volumeUnitConfiguration_length;
  word    UnitMaster_array_units_consumptionUnitConfiguration_length;
  word    UnitMaster_array_units_consumptionUnitElectrConfiguration_length;
  word    UnitMaster_array_units_consumptionUnitGasConfiguration_length;
  word    UnitMaster_array_units_massUnitConfiguration_length;
  
  word    UnitMaster_array_units_dateFormatConfiguration_array_length[20];
  word    UnitMaster_array_units_distanceUnitConfiguration_array_length[20];
  word    UnitMaster_array_units_pressureUnitConfiguration_array_length[20];
  word    UnitMaster_array_units_speedUnitConfiguration_array_length[20];
  word    UnitMaster_array_units_temperatureUnitConfiguration_array_length[20];
  word    UnitMaster_array_units_timeFormatConfiguration_array_length[20];
  word    UnitMaster_array_units_volumeUnitConfiguration_array_length[20];
  word    UnitMaster_array_units_consumptionUnitConfiguration_array_length[20];
  word    UnitMaster_array_units_consumptionUnitElectrConfiguration_array_length[20];
  word    UnitMaster_array_units_consumptionUnitGasConfiguration_array_length[20];
  word    UnitMaster_array_units_massUnitConfiguration_array_length[20];
  
  mstimer UnitMaster_Segmentation_delay;
  word    UnitMaster_Segmentation_Method_ID;
  
  
  // Service DisplaySpeed
  word    DisplaySpeed_payload_length_speeds;
  byte    DisplaySpeed_payload_buffer_speeds[1000];
  byte    DisplaySpeed_speeds_data_length_element_num;
  word    DisplaySpeed_payload_length_speedWarnings;
  byte    DisplaySpeed_payload_buffer_speedWarnings[1000];
  byte    DisplaySpeed_speedWarnings_data_length_element_num;
  word    DisplaySpeed_payload_length_speedBlockings;
  byte    DisplaySpeed_payload_buffer_speedBlockings[1000];
  byte    DisplaySpeed_speedBlockings_data_length_element_num;
  
  word    DisplaySpeed_array_speeds_array_element_length[20];
  word    DisplaySpeed_array_speeds_struct_element_length;
  dword   DisplaySpeed_array_speeds_type[10];
	float   DisplaySpeed_array_speeds_currentValue[10];
	dword   DisplaySpeed_array_speeds_restrictionReason[10];
	dword   DisplaySpeed_array_speeds_unit[10];
	byte    DisplaySpeed_array_speeds_isDisplayActivated[10];
	dword   DisplaySpeed_array_speeds_maxValue[10];
	dword   DisplaySpeed_array_speeds_minValue[10];
	float   DisplaySpeed_array_speeds_resolution[10];
  word    DisplaySpeed_array_speedWarnings_array_element_length[20];
  word    DisplaySpeed_array_speedWarnings_struct_element_length;
	dword   DisplaySpeed_array_speedWarnings_type[10];
	byte    DisplaySpeed_array_speedWarnings_isActivated[10];
	dword   DisplaySpeed_array_speedWarnings_threshold[10];
	dword   DisplaySpeed_array_speedWarnings_unit[10];
	dword   DisplaySpeed_array_speedWarnings_restrictionReason[10];
	dword   DisplaySpeed_array_speedWarnings_maxValue[10];
	dword   DisplaySpeed_array_speedWarnings_minValue[10];
	dword   DisplaySpeed_array_speedWarnings_resolution[10];
  word    DisplaySpeed_array_speedBlockings_array_element_length[20];
  word    DisplaySpeed_array_speedBlockings_struct_element_length;
	dword   DisplaySpeed_array_speedBlockings_type[10];
	byte    DisplaySpeed_array_speedBlockings_isActivated[10];
	byte    DisplaySpeed_array_speedBlockings_isCodedStrict[10];
	dword   DisplaySpeed_array_speedBlockings_threshold[10];
	dword   DisplaySpeed_array_speedBlockings_unit[10];
	dword   DisplaySpeed_array_speedBlockings_restrictionReason[10];
  
  byte    DisplaySpeed_array_speeds_available_functions[10];
	byte    DisplaySpeed_array_speeds_type_available[10];
	byte    DisplaySpeed_array_speeds_currentValue_available[10];
	byte    DisplaySpeed_array_speeds_restrictionReason_available[10];
	byte    DisplaySpeed_array_speeds_unit_available[10];
	byte    DisplaySpeed_array_speeds_isDisplayActivated_available[10];
	byte    DisplaySpeed_array_speeds_maxValue_available[10];
	byte    DisplaySpeed_array_speeds_minValue_available[10];
	byte    DisplaySpeed_array_speeds_resolution_available[10];
  byte    DisplaySpeed_array_speedWarnings_available_functions[10];
	byte    DisplaySpeed_array_speedWarnings_type_available[10];
	byte    DisplaySpeed_array_speedWarnings_isActivated_available[10];
	byte    DisplaySpeed_array_speedWarnings_threshold_available[10];
	byte    DisplaySpeed_array_speedWarnings_unit_available[10];
	byte    DisplaySpeed_array_speedWarnings_restrictionReason_available[10];
	byte    DisplaySpeed_array_speedWarnings_maxValue_available[10];
	byte    DisplaySpeed_array_speedWarnings_minValue_available[10];
	byte    DisplaySpeed_array_speedWarnings_resolution_available[10];
  byte    DisplaySpeed_array_speedBlockings_available_functions[10];
	byte    DisplaySpeed_array_speedBlockings_type_available[10];
	byte    DisplaySpeed_array_speedBlockings_isActivated_available[10];
	byte    DisplaySpeed_array_speedBlockings_isCodedStrict_available[10];
	byte    DisplaySpeed_array_speedBlockings_threshold_available[10];
	byte    DisplaySpeed_array_speedBlockings_unit_available[10];
	byte    DisplaySpeed_array_speedBlockings_restrictionReason_available[10];

  mstimer DisplaySpeed_Segmentation_delay;
  word    DisplaySpeed_Segmentation_Method_ID;
  
  
  // Service Temperature
  word    Temperature_payload_length_temperatures;
  byte    Temperature_payload_buffer_temperatures[1000];
  byte    Temperature_temperatures_data_length_element_num;
  word    Temperature_payload_length_temperatureWarnings;
  byte    Temperature_payload_buffer_temperatureWarnings[1000];
  byte    Temperature_temperatureWarnings_data_length_element_num;
  
  word    Temperature_array_temperatures_array_element_length[20];
  word    Temperature_array_temperatures_struct_element_length;
  dword   Temperature_array_temperatures_type[10];
	float   Temperature_array_temperatures_currentValue[10];
	dword   Temperature_array_temperatures_restrictionReason[10];
	dword   Temperature_array_temperatures_unit[10];
  float   Temperature_array_temperatures_minValue[10];
	float   Temperature_array_temperatures_maxValue[10];
	float   Temperature_array_temperatures_resolution[10];
  byte    Temperature_array_temperatures_isValueInvalid[10];
  word    Temperature_array_temperatureWarnings_array_element_length[20];
  word    Temperature_array_temperatureWarnings_struct_element_length;
  dword   Temperature_array_temperatureWarnings_type[10];
	word    Temperature_array_temperatureWarnings_temperature_serviceId[10];
  word    Temperature_array_temperatureWarnings_temperature_serviceInstanceId[10];
  word    Temperature_array_temperatureWarnings_temperature_resourceId[10];
  byte    Temperature_array_temperatureWarnings_temperature_elementId[10][16];
  byte    Temperature_array_temperatureWarnings_isToBeNotified[10];
  
  byte    Temperature_array_temperatures_available_functions[10];
  byte    Temperature_array_temperatures_type_available[10];
  byte    Temperature_array_temperatures_currentValue_available[10];
  byte    Temperature_array_temperatures_restrictionReason_available[10];
  byte    Temperature_array_temperatures_unit_available[10];
  byte    Temperature_array_temperatures_minValue_available[10];
  byte    Temperature_array_temperatures_maxValue_available[10];
  byte    Temperature_array_temperatures_resolution_available[10];
  byte    Temperature_array_temperatures_isValueInvalid_available[10];
  byte    Temperature_array_temperatureWarnings_available_functions[10];
  byte    Temperature_array_temperatureWarnings_type_available[10];
  byte    Temperature_array_temperatureWarnings_temperature_available[10];
  byte    Temperature_array_temperatureWarnings_isToBeNotified_available[10];
  
  mstimer Temperature_Segmentation_delay;
  word    Temperature_Segmentation_Method_ID;
  
  
  // Service DrivingStatistics
  word    DrivingStatistics_payload_length_speeds;
  byte    DrivingStatistics_payload_buffer_speeds[1000];
  byte    DrivingStatistics_speeds_data_length_element_num;
  word    DrivingStatistics_payload_length_distances;
  byte    DrivingStatistics_payload_buffer_distances[1000];
  byte    DrivingStatistics_distances_data_length_element_num;
  word    DrivingStatistics_payload_length_durations;
  byte    DrivingStatistics_payload_buffer_durations[1000];
  byte    DrivingStatistics_durations_data_length_element_num;
  
  word    DrivingStatistics_array_speeds_array_element_length[20];
  word    DrivingStatistics_array_speeds_struct_element_length;
  dword   DrivingStatistics_array_speeds_memoryLevel[10];
	float   DrivingStatistics_array_speeds_currentValue[10];
	dword   DrivingStatistics_array_speeds_state[10];
  word    DrivingStatistics_array_distances_array_element_length[20];
  word    DrivingStatistics_array_distances_struct_element_length;
	dword   DrivingStatistics_array_distances_memoryLevel[10];
	dword   DrivingStatistics_array_distances_currentValue[10];
	dword   DrivingStatistics_array_distances_state[10];
  word    DrivingStatistics_array_durations_array_element_length[20];
  word    DrivingStatistics_array_durations_struct_element_length;
	dword   DrivingStatistics_array_durations_memoryLevel[10];
	dword   DrivingStatistics_array_durations_currentValue[10];
	dword   DrivingStatistics_array_durations_state[10];
  
  byte    DrivingStatistics_array_speeds_available_functions[10];
  byte    DrivingStatistics_array_speeds_memoryLevel_available[10];
  byte    DrivingStatistics_array_speeds_currentValue_available[10];
  byte    DrivingStatistics_array_speeds_state_available[10];
  byte    DrivingStatistics_array_distances_available_functions[10];
  byte    DrivingStatistics_array_distances_memoryLevel_available[10];
  byte    DrivingStatistics_array_distances_currentValue_available[10];
  byte    DrivingStatistics_array_distances_state_available[10];
  byte    DrivingStatistics_array_durations_available_functions[10];
  byte    DrivingStatistics_array_durations_memoryLevel_available[10];
  byte    DrivingStatistics_array_durations_currentValue_available[10];
  byte    DrivingStatistics_array_durations_state_available[10];
  
  mstimer DrivingStatistics_Segmentation_delay;
  word    DrivingStatistics_Segmentation_Method_ID;
  
  
  // Service DiagnosticNotification
  word    DiagnosticNotification_payload_length_notifications;
  byte    DiagnosticNotification_payload_buffer_notifications[1000];
  byte    DiagnosticNotification_notifications_data_length_element_num;
  
  word    DiagnosticNotification_array_notifications_array_element_length[20];
  word    DiagnosticNotification_array_notifications_struct_element_length;
  dword   DiagnosticNotification_array_notifications_listId[10];
	dword   DiagnosticNotification_array_notifications_notificationIds[10][10];
  
  byte    DiagnosticNotification_array_notifications_notificationIds_nr_of_elements[10];
  
  byte    DiagnosticNotification_array_notifications_available_functions[10];
  byte    DiagnosticNotification_array_notifications_listId_available[10];
	byte    DiagnosticNotification_array_notifications_notificationIds_available[10];
  
  dword   DiagnosticNotification_array_notifications_notificationIds_length;
  
  mstimer DiagnosticNotification_Segmentation_delay;
  word    DiagnosticNotification_Segmentation_Method_ID;
  
  
  
  
  const   max_number_of_offered_services_by_ICAS1Gateway = 2;
  byte    servicediscovery_offer_ICAS1Gateway_entries_array_type[max_number_of_offered_services_by_ICAS1Gateway];
  byte    servicediscovery_offer_ICAS1Gateway_entries_array_index_1st_options[max_number_of_offered_services_by_ICAS1Gateway];
  byte    servicediscovery_offer_ICAS1Gateway_entries_array_index_2nd_options[max_number_of_offered_services_by_ICAS1Gateway];
  byte    servicediscovery_offer_ICAS1Gateway_entries_array_nr_of_opt_1[max_number_of_offered_services_by_ICAS1Gateway];
  byte    servicediscovery_offer_ICAS1Gateway_entries_array_nr_of_opt_2[max_number_of_offered_services_by_ICAS1Gateway];
  word    servicediscovery_offer_ICAS1Gateway_entries_array_service_id[max_number_of_offered_services_by_ICAS1Gateway];
  word    servicediscovery_offer_ICAS1Gateway_entries_array_instance_id[max_number_of_offered_services_by_ICAS1Gateway];
  byte    servicediscovery_offer_ICAS1Gateway_entries_array_major_version[max_number_of_offered_services_by_ICAS1Gateway];
  dword   servicediscovery_offer_ICAS1Gateway_entries_array_ttl[max_number_of_offered_services_by_ICAS1Gateway];
  dword   servicediscovery_offer_ICAS1Gateway_entries_array_minor_version[max_number_of_offered_services_by_ICAS1Gateway];
  
  const   max_number_of_offered_services_by_ICAS1Sys01 = 2;
  byte    servicediscovery_offer_ICAS1Sys01_entries_array_type[max_number_of_offered_services_by_ICAS1Sys01];
  byte    servicediscovery_offer_ICAS1Sys01_entries_array_index_1st_options[max_number_of_offered_services_by_ICAS1Sys01];
  byte    servicediscovery_offer_ICAS1Sys01_entries_array_index_2nd_options[max_number_of_offered_services_by_ICAS1Sys01];
  byte    servicediscovery_offer_ICAS1Sys01_entries_array_nr_of_opt_1[max_number_of_offered_services_by_ICAS1Sys01];
  byte    servicediscovery_offer_ICAS1Sys01_entries_array_nr_of_opt_2[max_number_of_offered_services_by_ICAS1Sys01];
  word    servicediscovery_offer_ICAS1Sys01_entries_array_service_id[max_number_of_offered_services_by_ICAS1Sys01];
  word    servicediscovery_offer_ICAS1Sys01_entries_array_instance_id[max_number_of_offered_services_by_ICAS1Sys01];
  byte    servicediscovery_offer_ICAS1Sys01_entries_array_major_version[max_number_of_offered_services_by_ICAS1Sys01];
  dword   servicediscovery_offer_ICAS1Sys01_entries_array_ttl[max_number_of_offered_services_by_ICAS1Sys01];
  dword   servicediscovery_offer_ICAS1Sys01_entries_array_minor_version[max_number_of_offered_services_by_ICAS1Sys01];
  
  const   max_number_of_offered_services_by_ICAS3IVI = 1;
  byte    servicediscovery_offer_ICAS3IVI_entries_array_type[max_number_of_offered_services_by_ICAS3IVI];
  byte    servicediscovery_offer_ICAS3IVI_entries_array_index_1st_options[max_number_of_offered_services_by_ICAS3IVI];
  byte    servicediscovery_offer_ICAS3IVI_entries_array_index_2nd_options[max_number_of_offered_services_by_ICAS3IVI];
  byte    servicediscovery_offer_ICAS3IVI_entries_array_nr_of_opt_1[max_number_of_offered_services_by_ICAS3IVI];
  byte    servicediscovery_offer_ICAS3IVI_entries_array_nr_of_opt_2[max_number_of_offered_services_by_ICAS3IVI];
  word    servicediscovery_offer_ICAS3IVI_entries_array_service_id[max_number_of_offered_services_by_ICAS3IVI];
  word    servicediscovery_offer_ICAS3IVI_entries_array_instance_id[max_number_of_offered_services_by_ICAS3IVI];
  byte    servicediscovery_offer_ICAS3IVI_entries_array_major_version[max_number_of_offered_services_by_ICAS3IVI];
  dword   servicediscovery_offer_ICAS3IVI_entries_array_ttl[max_number_of_offered_services_by_ICAS3IVI];
  dword   servicediscovery_offer_ICAS3IVI_entries_array_minor_version[max_number_of_offered_services_by_ICAS3IVI];
  
  const   max_number_of_found_services_by_ICAS1Sys02 = 5;
  byte    servicediscovery_find_ICAS1Sys02_entries_array_type[max_number_of_found_services_by_ICAS1Sys02];
  byte    servicediscovery_find_ICAS1Sys02_entries_array_index_1st_options[max_number_of_found_services_by_ICAS1Sys02];
  byte    servicediscovery_find_ICAS1Sys02_entries_array_index_2nd_options[max_number_of_found_services_by_ICAS1Sys02];
  byte    servicediscovery_find_ICAS1Sys02_entries_array_nr_of_opt_1[max_number_of_found_services_by_ICAS1Sys02];
  byte    servicediscovery_find_ICAS1Sys02_entries_array_nr_of_opt_2[max_number_of_found_services_by_ICAS1Sys02];
  word    servicediscovery_find_ICAS1Sys02_entries_array_service_id[max_number_of_found_services_by_ICAS1Sys02];
  word    servicediscovery_find_ICAS1Sys02_entries_array_instance_id[max_number_of_found_services_by_ICAS1Sys02];
  byte    servicediscovery_find_ICAS1Sys02_entries_array_major_version[max_number_of_found_services_by_ICAS1Sys02];
  dword   servicediscovery_find_ICAS1Sys02_entries_array_ttl[max_number_of_found_services_by_ICAS1Sys02];
  dword   servicediscovery_find_ICAS1Sys02_entries_array_minor_version[max_number_of_found_services_by_ICAS1Sys02];
  
  byte    servicediscovery_rx_entries_array_type[20];
  byte    servicediscovery_rx_entries_array_index_1st_options[20];
  byte    servicediscovery_rx_entries_array_index_2nd_options[20];
  byte    servicediscovery_rx_entries_array_nr_of_opt_1[20];
  byte    servicediscovery_rx_entries_array_nr_of_opt_2[20];
  word    servicediscovery_rx_entries_array_service_id[20];
  word    servicediscovery_rx_entries_array_instance_id[20];
  byte    servicediscovery_rx_entries_array_major_version[20];
  dword   servicediscovery_rx_entries_array_ttl[20];
  word    servicediscovery_rx_entries_array_counter[20];
  word    servicediscovery_rx_entries_array_eventgroup_id[20];
  
  byte    servicediscovery_sub_tx_entries_array_type[20];
  byte    servicediscovery_sub_tx_entries_array_index_1st_options[20];
  byte    servicediscovery_sub_tx_entries_array_index_2nd_options[20];
  byte    servicediscovery_sub_tx_entries_array_nr_of_opt_1[20];
  byte    servicediscovery_sub_tx_entries_array_nr_of_opt_2[20];
  word    servicediscovery_sub_tx_entries_array_service_id[20];
  word    servicediscovery_sub_tx_entries_array_instance_id[20];
  byte    servicediscovery_sub_tx_entries_array_major_version[20];
  dword   servicediscovery_sub_tx_entries_array_ttl[20];
  word    servicediscovery_sub_tx_entries_array_counter[20];
  word    servicediscovery_sub_tx_entries_array_eventgroup_id[20];
  
  dword   temp_converttodword;
  qword   temp_converttoqword;
  dword   temp_64bit_high;
  dword   temp_64bit_low;
  
  byte    number_of_offered_services_by_ICAS1Gateway;
  byte    number_of_offered_services_by_ICAS1Sys01;
  byte    number_of_offered_services_by_ICAS3IVI;
  byte    number_of_offered_services_by_Cluster;
  byte    number_of_found_services_by_ICAS1Sys02;
  byte    number_of_subscribed_services_by_ICAS1Sys02;
  byte    service_counter;
  byte    number_of_entries_array_elements;
  
  mstimer UnitMaster_available_reset;
  mstimer DisplaySpeed_available_reset;
  mstimer Temperature_available_reset;
  mstimer DrivingStatistics_available_reset;
  mstimer DiagnosticNotification_available_reset;
  
  byte    UnitMaster_SubscribeStatus_units                     = 0;
  byte    DisplaySpeed_SubscribeStatus_speeds                  = 0;
  byte    DisplaySpeed_SubscribeStatus_speedWarnings           = 0;
  byte    DisplaySpeed_SubscribeStatus_speedBlockings          = 0;
  byte    Temperature_SubscribeStatus_temperatures             = 0;
  byte    Temperature_SubscribeStatus_temperatureWarnings      = 0;
  byte    DrivingStatistics_SubscribeStatus_speeds             = 0;
  byte    DrivingStatistics_SubscribeStatus_distances          = 0;
  byte    DrivingStatistics_SubscribeStatus_durations          = 0;
  byte    DiagnosticNotification_SubscribeStatus_notifications = 0;

  
  byte    UDP_Segments_total;
  byte    UDP_Segments_left;
  
  byte    seg_id_flag;
  byte    get_subAck_flag;
  mstimer get_subAck_flag_reset;
}

on start
{
  @Send_ServiceDiscovery_Offer                                           = 1;
  @Send_ServiceDiscovery_Offer_Time                                      = 1000;
  
  @Send_ServiceDiscovery_Find                                            = 1;
  @Send_ServiceDiscovery_Find_Time                                       = 1000;
  
  // Ethernet Packet
  putValue (ServiceDiscovery_EthernetPacket_MAC_Source_ICAS1Gateway,     "02:7D:FA:00:10:00");
  putValue (ServiceDiscovery_EthernetPacket_MAC_Source_ICAS1Sys01,       "02:7D:FA:01:06:00");
  putValue (ServiceDiscovery_EthernetPacket_MAC_Source_ICAS1Sys02,       "02:7D:FA:01:07:00");
  putValue (ServiceDiscovery_EthernetPacket_MAC_Source_ICAS3IVI,         "02:7D:FA:01:08:00");
  putValue (ServiceDiscovery_EthernetPacket_MAC_Destination,             "02:7D:FA:00:14:00"); // Platzhalter, wird mit Adresse von Kombi überschrieben
  @ServiceDiscovery_EthernetPacket_VLAN_TPID                             = 0x8100;
  @ServiceDiscovery_EthernetPacket_VLAN_TCI                              = 0x0003;//0x6003;
  @ServiceDiscovery_EthernetPacket_Type                                  = 0x86DD;
                                                                         
  // IPv6 Packet                                                         
  @ServiceDiscovery_IPv6Packet_Version                                   = 6;
  @ServiceDiscovery_IPv6Packet_Traffic_Class                             = 0;
  @ServiceDiscovery_IPv6Packet_Flow_Label                                = 0;
  @ServiceDiscovery_IPv6Packet_Payload_Length                            = 64; // wird automatisch berechnet
  @ServiceDiscovery_IPv6Packet_Next_Header                               = 17; // UDP
  @ServiceDiscovery_IPv6Packet_Hop_Limit                                 = 64;
  @ServiceDiscovery_IPv6Packet_IP_Source_ICAS1Gateway_01                 = 0xFD53; // "fd53:7cb8:383:3::10"
  @ServiceDiscovery_IPv6Packet_IP_Source_ICAS1Gateway_02                 = 0x7CB8;
  @ServiceDiscovery_IPv6Packet_IP_Source_ICAS1Gateway_03                 = 0x0383;
  @ServiceDiscovery_IPv6Packet_IP_Source_ICAS1Gateway_04                 = 0x0003;
  @ServiceDiscovery_IPv6Packet_IP_Source_ICAS1Gateway_05                 = 0x0000;
  @ServiceDiscovery_IPv6Packet_IP_Source_ICAS1Gateway_06                 = 0x0000;
  @ServiceDiscovery_IPv6Packet_IP_Source_ICAS1Gateway_07                 = 0x0000;
  @ServiceDiscovery_IPv6Packet_IP_Source_ICAS1Gateway_08                 = 0x0010;
  @ServiceDiscovery_IPv6Packet_IP_Source_ICAS1Sys01_01                   = 0xFD53; // "fd53:7cb8:383:3::106"
  @ServiceDiscovery_IPv6Packet_IP_Source_ICAS1Sys01_02                   = 0x7CB8;
  @ServiceDiscovery_IPv6Packet_IP_Source_ICAS1Sys01_03                   = 0x0383;
  @ServiceDiscovery_IPv6Packet_IP_Source_ICAS1Sys01_04                   = 0x0003;
  @ServiceDiscovery_IPv6Packet_IP_Source_ICAS1Sys01_05                   = 0x0000;
  @ServiceDiscovery_IPv6Packet_IP_Source_ICAS1Sys01_06                   = 0x0000;
  @ServiceDiscovery_IPv6Packet_IP_Source_ICAS1Sys01_07                   = 0x0000;
  @ServiceDiscovery_IPv6Packet_IP_Source_ICAS1Sys01_08                   = 0x0106;
  @ServiceDiscovery_IPv6Packet_IP_Source_ICAS1Sys02_01                   = 0xFD53; // "fd53:7cb8:383:4::107"
  @ServiceDiscovery_IPv6Packet_IP_Source_ICAS1Sys02_02                   = 0x7CB8;
  @ServiceDiscovery_IPv6Packet_IP_Source_ICAS1Sys02_03                   = 0x0383;
  @ServiceDiscovery_IPv6Packet_IP_Source_ICAS1Sys02_04                   = 0x0004;
  @ServiceDiscovery_IPv6Packet_IP_Source_ICAS1Sys02_05                   = 0x0000;
  @ServiceDiscovery_IPv6Packet_IP_Source_ICAS1Sys02_06                   = 0x0000;
  @ServiceDiscovery_IPv6Packet_IP_Source_ICAS1Sys02_07                   = 0x0000;
  @ServiceDiscovery_IPv6Packet_IP_Source_ICAS1Sys02_08                   = 0x0107;
  @ServiceDiscovery_IPv6Packet_IP_Source_ICAS3IVI_01                     = 0xFD53; // "fd53:7cb8:383:3::108"
  @ServiceDiscovery_IPv6Packet_IP_Source_ICAS3IVI_02                     = 0x7CB8;
  @ServiceDiscovery_IPv6Packet_IP_Source_ICAS3IVI_03                     = 0x0383;
  @ServiceDiscovery_IPv6Packet_IP_Source_ICAS3IVI_04                     = 0x0003;
  @ServiceDiscovery_IPv6Packet_IP_Source_ICAS3IVI_05                     = 0x0000;
  @ServiceDiscovery_IPv6Packet_IP_Source_ICAS3IVI_06                     = 0x0000;
  @ServiceDiscovery_IPv6Packet_IP_Source_ICAS3IVI_07                     = 0x0000;
  @ServiceDiscovery_IPv6Packet_IP_Source_ICAS3IVI_08                     = 0x0108;
  @ServiceDiscovery_IPv6Packet_IP_Destination_Multicast_01               = 0xFF14; // "ff14::4:0"
  @ServiceDiscovery_IPv6Packet_IP_Destination_Multicast_02               = 0x0000;
  @ServiceDiscovery_IPv6Packet_IP_Destination_Multicast_03               = 0x0000;
  @ServiceDiscovery_IPv6Packet_IP_Destination_Multicast_04               = 0x0000;
  @ServiceDiscovery_IPv6Packet_IP_Destination_Multicast_05               = 0x0000;
  @ServiceDiscovery_IPv6Packet_IP_Destination_Multicast_06               = 0x0000;
  @ServiceDiscovery_IPv6Packet_IP_Destination_Multicast_07               = 0x0004;
  @ServiceDiscovery_IPv6Packet_IP_Destination_Multicast_08               = 0x0000;
  @ServiceDiscovery_IPv6Packet_IP_Destination_Unicast_01                 = 0xFD53; // "fd53:7cb8:383:3::14"
  @ServiceDiscovery_IPv6Packet_IP_Destination_Unicast_02                 = 0x7CB8;
  @ServiceDiscovery_IPv6Packet_IP_Destination_Unicast_03                 = 0x0383;
  @ServiceDiscovery_IPv6Packet_IP_Destination_Unicast_04                 = 0x0003;
  @ServiceDiscovery_IPv6Packet_IP_Destination_Unicast_05                 = 0x0000;
  @ServiceDiscovery_IPv6Packet_IP_Destination_Unicast_06                 = 0x0000;
  @ServiceDiscovery_IPv6Packet_IP_Destination_Unicast_07                 = 0x0000;
  @ServiceDiscovery_IPv6Packet_IP_Destination_Unicast_08                 = 0x0014;
  
  // UDP Packet
  @ServiceDiscovery_UDPPacket_Port_Source                                = 30490;
  @ServiceDiscovery_UDPPacket_Port_Destination                           = 30490;
  @ServiceDiscovery_UDPPacket_Length                                     = 64; // wird automatisch berechnet
  //@ServiceDiscovery_UDPPacket_Checksum                                 = 0; // wird automatisch berechnet
  
  @ServiceDiscovery_SOMEIPPacket_Request_ID_Session_ID                   = 0;
  
  // SOMEIPPacket
  @ServiceDiscovery_SOMEIPPacket_Find_ICAS1Sys02_Message_ID_Service_ID              = 0xFFFF;
  @ServiceDiscovery_SOMEIPPacket_Find_ICAS1Sys02_Message_ID_Method_ID               = 0x8100;
  @ServiceDiscovery_SOMEIPPacket_Find_ICAS1Sys02_Length                             = 32;
  @ServiceDiscovery_SOMEIPPacket_Find_ICAS1Sys02_Request_ID_Client_ID               = 0;
  @ServiceDiscovery_SOMEIPPacket_Find_ICAS1Sys02_Protocol_Version                   = 1;
  @ServiceDiscovery_SOMEIPPacket_Find_ICAS1Sys02_Interface_Version                  = 1;
  @ServiceDiscovery_SOMEIPPacket_Find_ICAS1Sys02_Message_Type                       = 2; // 0x00 REQUEST / 0x01 REQUEST_NO_RETURN / 0x02 NOTIFICATION / 0x80 RESPONSE / 0x81 ERROR / 0x42 NOTIFICATION_ACK
  @ServiceDiscovery_SOMEIPPacket_Find_ICAS1Sys02_Return_Code                        = 0;
  @ServiceDiscovery_SOMEIPPacket_Find_ICAS1Sys02_Flags                              = 0x80;
  @ServiceDiscovery_SOMEIPPacket_Find_ICAS1Sys02_Entries_Array_Element              = 0;
  @ServiceDiscovery_SOMEIPPacket_Find_ICAS1Sys02_Entries_Array_Type                 = 0;
  @ServiceDiscovery_SOMEIPPacket_Find_ICAS1Sys02_Entries_Array_Index_1st_options    = 0;
  @ServiceDiscovery_SOMEIPPacket_Find_ICAS1Sys02_Entries_Array_Index_2nd_options    = 0;
  @ServiceDiscovery_SOMEIPPacket_Find_ICAS1Sys02_Entries_Array_Nr_of_opt_1          = 0;
  @ServiceDiscovery_SOMEIPPacket_Find_ICAS1Sys02_Entries_Array_Nr_of_opt_2          = 0;
  @ServiceDiscovery_SOMEIPPacket_Find_ICAS1Sys02_Entries_Array_Service_ID           = 0;
  @ServiceDiscovery_SOMEIPPacket_Find_ICAS1Sys02_Entries_Array_Instance_ID          = 0;
  @ServiceDiscovery_SOMEIPPacket_Find_ICAS1Sys02_Entries_Array_Major_Version        = 0;
  @ServiceDiscovery_SOMEIPPacket_Find_ICAS1Sys02_Entries_Array_TTL                  = 0;
  @ServiceDiscovery_SOMEIPPacket_Find_ICAS1Sys02_Entries_Array_Minor_Version        = 0;
  @ServiceDiscovery_SOMEIPPacket_Find_ICAS1Sys02_Options_Array_On_Off               = 1;
  @ServiceDiscovery_SOMEIPPacket_Find_ICAS1Sys02_Options_Array_Length               = 0;
  @ServiceDiscovery_SOMEIPPacket_Find_ICAS1Sys02_Options_Array_Option1_Length       = 21;
  @ServiceDiscovery_SOMEIPPacket_Find_ICAS1Sys02_Options_Array_Option1_Type         = 6;
  @ServiceDiscovery_SOMEIPPacket_Find_ICAS1Sys02_Options_Array_Option1_IPv6_01      = 0xFD53; // "fd53:7cb8:383:4::107"
  @ServiceDiscovery_SOMEIPPacket_Find_ICAS1Sys02_Options_Array_Option1_IPv6_02      = 0x7CB8;
  @ServiceDiscovery_SOMEIPPacket_Find_ICAS1Sys02_Options_Array_Option1_IPv6_03      = 0x0383;
  @ServiceDiscovery_SOMEIPPacket_Find_ICAS1Sys02_Options_Array_Option1_IPv6_04      = 0x0004;
  @ServiceDiscovery_SOMEIPPacket_Find_ICAS1Sys02_Options_Array_Option1_IPv6_05      = 0x0000;
  @ServiceDiscovery_SOMEIPPacket_Find_ICAS1Sys02_Options_Array_Option1_IPv6_06      = 0x0000;
  @ServiceDiscovery_SOMEIPPacket_Find_ICAS1Sys02_Options_Array_Option1_IPv6_07      = 0x0000;
  @ServiceDiscovery_SOMEIPPacket_Find_ICAS1Sys02_Options_Array_Option1_IPv6_08      = 0x0107;
  @ServiceDiscovery_SOMEIPPacket_Find_ICAS1Sys02_Options_Array_Option1_L4_Proto     = 17; // UDP
  @ServiceDiscovery_SOMEIPPacket_Find_ICAS1Sys02_Options_Array_Option1_Port_Number  = 42810;
  
  @ServiceDiscovery_SOMEIPPacket_Offer_ICAS1Gateway_Message_ID_Service_ID             = 0xFFFF;
  @ServiceDiscovery_SOMEIPPacket_Offer_ICAS1Gateway_Message_ID_Method_ID              = 0x8100;
  @ServiceDiscovery_SOMEIPPacket_Offer_ICAS1Gateway_Length                            = 32;
  @ServiceDiscovery_SOMEIPPacket_Offer_ICAS1Gateway_Request_ID_Client_ID              = 0;
  @ServiceDiscovery_SOMEIPPacket_Offer_ICAS1Gateway_Protocol_Version                  = 1;
  @ServiceDiscovery_SOMEIPPacket_Offer_ICAS1Gateway_Interface_Version                 = 1;
  @ServiceDiscovery_SOMEIPPacket_Offer_ICAS1Gateway_Message_Type                      = 2; // 0x00 REQUEST / 0x01 REQUEST_NO_RETURN / 0x02 NOTIFICATION / 0x80 RESPONSE / 0x81 ERROR / 0x42 NOTIFICATION_ACK
  @ServiceDiscovery_SOMEIPPacket_Offer_ICAS1Gateway_Return_Code                       = 0;
  @ServiceDiscovery_SOMEIPPacket_Offer_ICAS1Gateway_Flags                             = 0x80;
  @ServiceDiscovery_SOMEIPPacket_Offer_ICAS1Gateway_Entries_Array_Element             = 0;
  @ServiceDiscovery_SOMEIPPacket_Offer_ICAS1Gateway_Entries_Array_Type                = 0;
  @ServiceDiscovery_SOMEIPPacket_Offer_ICAS1Gateway_Entries_Array_Index_1st_options   = 0;
  @ServiceDiscovery_SOMEIPPacket_Offer_ICAS1Gateway_Entries_Array_Index_2nd_options   = 0;
  @ServiceDiscovery_SOMEIPPacket_Offer_ICAS1Gateway_Entries_Array_Nr_of_opt_1         = 0;
  @ServiceDiscovery_SOMEIPPacket_Offer_ICAS1Gateway_Entries_Array_Nr_of_opt_2         = 0;
  @ServiceDiscovery_SOMEIPPacket_Offer_ICAS1Gateway_Entries_Array_Service_ID          = 0;
  @ServiceDiscovery_SOMEIPPacket_Offer_ICAS1Gateway_Entries_Array_Instance_ID         = 0;
  @ServiceDiscovery_SOMEIPPacket_Offer_ICAS1Gateway_Entries_Array_Major_Version       = 0;
  @ServiceDiscovery_SOMEIPPacket_Offer_ICAS1Gateway_Entries_Array_TTL                 = 0;
  @ServiceDiscovery_SOMEIPPacket_Offer_ICAS1Gateway_Entries_Array_Minor_Version       = 0;
  @ServiceDiscovery_SOMEIPPacket_Offer_ICAS1Gateway_Options_Array_On_Off              = 1;
  @ServiceDiscovery_SOMEIPPacket_Offer_ICAS1Gateway_Options_Array_Length              = 0;
  @ServiceDiscovery_SOMEIPPacket_Offer_ICAS1Gateway_Options_Array_Option1_Length      = 21;
  @ServiceDiscovery_SOMEIPPacket_Offer_ICAS1Gateway_Options_Array_Option1_Type        = 6;
  @ServiceDiscovery_SOMEIPPacket_Offer_ICAS1Gateway_Options_Array_Option1_IPv6_01     = 0xFD53; // "fd53:7cb8:383:3::10"
  @ServiceDiscovery_SOMEIPPacket_Offer_ICAS1Gateway_Options_Array_Option1_IPv6_02     = 0x7CB8;
  @ServiceDiscovery_SOMEIPPacket_Offer_ICAS1Gateway_Options_Array_Option1_IPv6_03     = 0x0383;
  @ServiceDiscovery_SOMEIPPacket_Offer_ICAS1Gateway_Options_Array_Option1_IPv6_04     = 0x0003;
  @ServiceDiscovery_SOMEIPPacket_Offer_ICAS1Gateway_Options_Array_Option1_IPv6_05     = 0x0000;
  @ServiceDiscovery_SOMEIPPacket_Offer_ICAS1Gateway_Options_Array_Option1_IPv6_06     = 0x0000;
  @ServiceDiscovery_SOMEIPPacket_Offer_ICAS1Gateway_Options_Array_Option1_IPv6_07     = 0x0000;
  @ServiceDiscovery_SOMEIPPacket_Offer_ICAS1Gateway_Options_Array_Option1_IPv6_08     = 0x0010;
  @ServiceDiscovery_SOMEIPPacket_Offer_ICAS1Gateway_Options_Array_Option1_L4_Proto    = 17; // UDP
  @ServiceDiscovery_SOMEIPPacket_Offer_ICAS1Gateway_Options_Array_Option1_Port_Number = 30501;//42810;
  @ServiceDiscovery_SOMEIPPacket_Offer_ICAS1Sys01_Message_ID_Service_ID               = 0xFFFF;
  @ServiceDiscovery_SOMEIPPacket_Offer_ICAS1Sys01_Message_ID_Method_ID                = 0x8100;
  @ServiceDiscovery_SOMEIPPacket_Offer_ICAS1Sys01_Length                              = 32;
  @ServiceDiscovery_SOMEIPPacket_Offer_ICAS1Sys01_Request_ID_Client_ID                = 0;
  @ServiceDiscovery_SOMEIPPacket_Offer_ICAS1Sys01_Protocol_Version                    = 1;
  @ServiceDiscovery_SOMEIPPacket_Offer_ICAS1Sys01_Interface_Version                   = 1;
  @ServiceDiscovery_SOMEIPPacket_Offer_ICAS1Sys01_Message_Type                        = 2; // 0x00 REQUEST / 0x01 REQUEST_NO_RETURN / 0x02 NOTIFICATION / 0x80 RESPONSE / 0x81 ERROR / 0x42 NOTIFICATION_ACK
  @ServiceDiscovery_SOMEIPPacket_Offer_ICAS1Sys01_Return_Code                         = 0;
  @ServiceDiscovery_SOMEIPPacket_Offer_ICAS1Sys01_Flags                               = 0x80;
  @ServiceDiscovery_SOMEIPPacket_Offer_ICAS1Sys01_Array_Element                       = 0;
  @ServiceDiscovery_SOMEIPPacket_Offer_ICAS1Sys01_Entries_Array_Type                  = 0;
  @ServiceDiscovery_SOMEIPPacket_Offer_ICAS1Sys01_Entries_Array_Index_1st_options     = 0;
  @ServiceDiscovery_SOMEIPPacket_Offer_ICAS1Sys01_Entries_Array_Index_2nd_options     = 0;
  @ServiceDiscovery_SOMEIPPacket_Offer_ICAS1Sys01_Entries_Array_Nr_of_opt_1           = 0;
  @ServiceDiscovery_SOMEIPPacket_Offer_ICAS1Sys01_Entries_Array_Nr_of_opt_2           = 0;
  @ServiceDiscovery_SOMEIPPacket_Offer_ICAS1Sys01_Entries_Array_Service_ID            = 0;
  @ServiceDiscovery_SOMEIPPacket_Offer_ICAS1Sys01_Entries_Array_Instance_ID           = 0;
  @ServiceDiscovery_SOMEIPPacket_Offer_ICAS1Sys01_Entries_Array_Major_Version         = 0;
  @ServiceDiscovery_SOMEIPPacket_Offer_ICAS1Sys01_Entries_Array_TTL                   = 0;
  @ServiceDiscovery_SOMEIPPacket_Offer_ICAS1Sys01_Entries_Array_Minor_Version         = 0;
  @ServiceDiscovery_SOMEIPPacket_Offer_ICAS1Sys01_Options_Array_On_Off                = 1;
  @ServiceDiscovery_SOMEIPPacket_Offer_ICAS1Sys01_Options_Array_Length                = 0;
  @ServiceDiscovery_SOMEIPPacket_Offer_ICAS1Sys01_Options_Array_Option1_Length        = 21;
  @ServiceDiscovery_SOMEIPPacket_Offer_ICAS1Sys01_Options_Array_Option1_Type          = 6;
  @ServiceDiscovery_SOMEIPPacket_Offer_ICAS1Sys01_Options_Array_Option1_IPv6_01       = 0xFD53; // "fd53:7cb8:383:3::106"
  @ServiceDiscovery_SOMEIPPacket_Offer_ICAS1Sys01_Options_Array_Option1_IPv6_02       = 0x7CB8;
  @ServiceDiscovery_SOMEIPPacket_Offer_ICAS1Sys01_Options_Array_Option1_IPv6_03       = 0x0383;
  @ServiceDiscovery_SOMEIPPacket_Offer_ICAS1Sys01_Options_Array_Option1_IPv6_04       = 0x0003;
  @ServiceDiscovery_SOMEIPPacket_Offer_ICAS1Sys01_Options_Array_Option1_IPv6_05       = 0x0000;
  @ServiceDiscovery_SOMEIPPacket_Offer_ICAS1Sys01_Options_Array_Option1_IPv6_06       = 0x0000;
  @ServiceDiscovery_SOMEIPPacket_Offer_ICAS1Sys01_Options_Array_Option1_IPv6_07       = 0x0000;
  @ServiceDiscovery_SOMEIPPacket_Offer_ICAS1Sys01_Options_Array_Option1_IPv6_08       = 0x0106;
  @ServiceDiscovery_SOMEIPPacket_Offer_ICAS1Sys01_Options_Array_Option1_L4_Proto      = 17; // UDP
  @ServiceDiscovery_SOMEIPPacket_Offer_ICAS1Sys01_Options_Array_Option1_Port_Number   = 30501;//42810;
  @ServiceDiscovery_SOMEIPPacket_Offer_ICAS3IVI_Message_ID_Service_ID                 = 0xFFFF;
  @ServiceDiscovery_SOMEIPPacket_Offer_ICAS3IVI_Message_ID_Method_ID                  = 0x8100;
  @ServiceDiscovery_SOMEIPPacket_Offer_ICAS3IVI_Length                                = 32;
  @ServiceDiscovery_SOMEIPPacket_Offer_ICAS3IVI_Request_ID_Client_ID                  = 0;
  @ServiceDiscovery_SOMEIPPacket_Offer_ICAS3IVI_Protocol_Version                      = 1;
  @ServiceDiscovery_SOMEIPPacket_Offer_ICAS3IVI_Interface_Version                     = 1;
  @ServiceDiscovery_SOMEIPPacket_Offer_ICAS3IVI_Message_Type                          = 2; // 0x00 REQUEST / 0x01 REQUEST_NO_RETURN / 0x02 NOTIFICATION / 0x80 RESPONSE / 0x81 ERROR / 0x42 NOTIFICATION_ACK
  @ServiceDiscovery_SOMEIPPacket_Offer_ICAS3IVI_Return_Code                           = 0;
  @ServiceDiscovery_SOMEIPPacket_Offer_ICAS3IVI_Flags                                 = 0x80;
  @ServiceDiscovery_SOMEIPPacket_Offer_ICAS3IVI_Array_Element                         = 0;
  @ServiceDiscovery_SOMEIPPacket_Offer_ICAS3IVI_Entries_Array_Type                    = 0;
  @ServiceDiscovery_SOMEIPPacket_Offer_ICAS3IVI_Entries_Array_Index_1st_options       = 0;
  @ServiceDiscovery_SOMEIPPacket_Offer_ICAS3IVI_Entries_Array_Index_2nd_options       = 0;
  @ServiceDiscovery_SOMEIPPacket_Offer_ICAS3IVI_Entries_Array_Nr_of_opt_1             = 0;
  @ServiceDiscovery_SOMEIPPacket_Offer_ICAS3IVI_Entries_Array_Nr_of_opt_2             = 0;
  @ServiceDiscovery_SOMEIPPacket_Offer_ICAS3IVI_Entries_Array_Service_ID              = 0;
  @ServiceDiscovery_SOMEIPPacket_Offer_ICAS3IVI_Entries_Array_Instance_ID             = 0;
  @ServiceDiscovery_SOMEIPPacket_Offer_ICAS3IVI_Entries_Array_Major_Version           = 0;
  @ServiceDiscovery_SOMEIPPacket_Offer_ICAS3IVI_Entries_Array_TTL                     = 0;
  @ServiceDiscovery_SOMEIPPacket_Offer_ICAS3IVI_Entries_Array_Minor_Version           = 0;
  @ServiceDiscovery_SOMEIPPacket_Offer_ICAS3IVI_Options_Array_On_Off                  = 1;
  @ServiceDiscovery_SOMEIPPacket_Offer_ICAS3IVI_Options_Array_Length                  = 0;
  @ServiceDiscovery_SOMEIPPacket_Offer_ICAS3IVI_Options_Array_Option1_Length          = 21;
  @ServiceDiscovery_SOMEIPPacket_Offer_ICAS3IVI_Options_Array_Option1_Type            = 6;
  @ServiceDiscovery_SOMEIPPacket_Offer_ICAS3IVI_Options_Array_Option1_IPv6_01         = 0xFD53; // "fd53:7cb8:383:3::108"
  @ServiceDiscovery_SOMEIPPacket_Offer_ICAS3IVI_Options_Array_Option1_IPv6_02         = 0x7CB8;
  @ServiceDiscovery_SOMEIPPacket_Offer_ICAS3IVI_Options_Array_Option1_IPv6_03         = 0x0383;
  @ServiceDiscovery_SOMEIPPacket_Offer_ICAS3IVI_Options_Array_Option1_IPv6_04         = 0x0003;
  @ServiceDiscovery_SOMEIPPacket_Offer_ICAS3IVI_Options_Array_Option1_IPv6_05         = 0x0000;
  @ServiceDiscovery_SOMEIPPacket_Offer_ICAS3IVI_Options_Array_Option1_IPv6_06         = 0x0000;
  @ServiceDiscovery_SOMEIPPacket_Offer_ICAS3IVI_Options_Array_Option1_IPv6_07         = 0x0000;
  @ServiceDiscovery_SOMEIPPacket_Offer_ICAS3IVI_Options_Array_Option1_IPv6_08         = 0x0108;
  @ServiceDiscovery_SOMEIPPacket_Offer_ICAS3IVI_Options_Array_Option1_L4_Proto        = 17; // UDP
  @ServiceDiscovery_SOMEIPPacket_Offer_ICAS3IVI_Options_Array_Option1_Port_Number     = 30501;//42820;

  @ServiceDiscovery_SOMEIPPacket_Sub_ICAS1Sys02_Message_ID_Service_ID               = 0xFFFF;
  @ServiceDiscovery_SOMEIPPacket_Sub_ICAS1Sys02_Message_ID_Method_ID                = 0x8100;
  @ServiceDiscovery_SOMEIPPacket_Sub_ICAS1Sys02_Length                              = 36;
  @ServiceDiscovery_SOMEIPPacket_Sub_ICAS1Sys02_Request_ID_Client_ID                = 0;
  @ServiceDiscovery_SOMEIPPacket_Sub_ICAS1Sys02_Protocol_Version                    = 1;
  @ServiceDiscovery_SOMEIPPacket_Sub_ICAS1Sys02_Interface_Version                   = 1;
  @ServiceDiscovery_SOMEIPPacket_Sub_ICAS1Sys02_Message_Type                        = 2; // 0x00 REQUEST / 0x01 REQUEST_NO_RETURN / 0x02 NOTIFICATION / 0x80 RESPONSE / 0x81 ERROR / 0x42 NOTIFICATION_ACK
  @ServiceDiscovery_SOMEIPPacket_Sub_ICAS1Sys02_Return_Code                         = 0;
  @ServiceDiscovery_SOMEIPPacket_Sub_ICAS1Sys02_Flags                               = 0x40;
  @ServiceDiscovery_SOMEIPPacket_Sub_ICAS1Sys02_Entries_Array_Length                = 16;
  @ServiceDiscovery_SOMEIPPacket_Sub_ICAS1Sys02_Entries_Array_Type                  = 7; // SubscribeAck
  @ServiceDiscovery_SOMEIPPacket_Sub_ICAS1Sys02_Entries_Array_Index_1st_options     = 0;
  @ServiceDiscovery_SOMEIPPacket_Sub_ICAS1Sys02_Entries_Array_Index_2nd_options     = 0;
  @ServiceDiscovery_SOMEIPPacket_Sub_ICAS1Sys02_Entries_Array_Nr_of_opt_1           = 1;
  @ServiceDiscovery_SOMEIPPacket_Sub_ICAS1Sys02_Entries_Array_Nr_of_opt_2           = 0;
  @ServiceDiscovery_SOMEIPPacket_Sub_ICAS1Sys02_Entries_Array_Service_ID            = 0;
  @ServiceDiscovery_SOMEIPPacket_Sub_ICAS1Sys02_Entries_Array_Instance_ID           = 0;
  @ServiceDiscovery_SOMEIPPacket_Sub_ICAS1Sys02_Entries_Array_Major_Version         = 0;
  @ServiceDiscovery_SOMEIPPacket_Sub_ICAS1Sys02_Entries_Array_TTL                   = 0;
  @ServiceDiscovery_SOMEIPPacket_Sub_ICAS1Sys02_Entries_Array_Counter               = 0;
  @ServiceDiscovery_SOMEIPPacket_Sub_ICAS1Sys02_Entries_Array_Eventgroup_ID         = 0; // Platzhalter, wird nach Anfrage befüllt
  @ServiceDiscovery_SOMEIPPacket_Sub_ICAS1Sys02_Options_Array_Length                = 24;
  @ServiceDiscovery_SOMEIPPacket_Sub_ICAS1Sys02_Options_Array_Option1_Length        = 21;
  @ServiceDiscovery_SOMEIPPacket_Sub_ICAS1Sys02_Options_Array_Option1_Type          = 0x6;
  @ServiceDiscovery_SOMEIPPacket_Sub_ICAS1Sys02_Options_Array_Option1_IPv6_01       = 0xFD53; // "fd53:7cb8:383:4::107"
  @ServiceDiscovery_SOMEIPPacket_Sub_ICAS1Sys02_Options_Array_Option1_IPv6_02       = 0x7CB8;
  @ServiceDiscovery_SOMEIPPacket_Sub_ICAS1Sys02_Options_Array_Option1_IPv6_03       = 0x0383;
  @ServiceDiscovery_SOMEIPPacket_Sub_ICAS1Sys02_Options_Array_Option1_IPv6_04       = 0x0004;
  @ServiceDiscovery_SOMEIPPacket_Sub_ICAS1Sys02_Options_Array_Option1_IPv6_05       = 0x0000;
  @ServiceDiscovery_SOMEIPPacket_Sub_ICAS1Sys02_Options_Array_Option1_IPv6_06       = 0x0000;
  @ServiceDiscovery_SOMEIPPacket_Sub_ICAS1Sys02_Options_Array_Option1_IPv6_07       = 0x0000;
  @ServiceDiscovery_SOMEIPPacket_Sub_ICAS1Sys02_Options_Array_Option1_IPv6_08       = 0x0107;
  @ServiceDiscovery_SOMEIPPacket_Sub_ICAS1Sys02_Options_Array_Option1_L4_Proto      = 17; // UDP
  @ServiceDiscovery_SOMEIPPacket_Sub_ICAS1Sys02_Options_Array_Option1_Port_Number   = 42810;
  
  @ServiceDiscovery_SOMEIPPacket_SubACK_ICAS1Gateway_Message_ID_Service_ID             = 0xFFFF;
  @ServiceDiscovery_SOMEIPPacket_SubACK_ICAS1Gateway_Message_ID_Method_ID              = 0x8100;
  @ServiceDiscovery_SOMEIPPacket_SubACK_ICAS1Gateway_Length                            = 36;
  @ServiceDiscovery_SOMEIPPacket_SubACK_ICAS1Gateway_Request_ID_Client_ID              = 0;
  @ServiceDiscovery_SOMEIPPacket_SubACK_ICAS1Gateway_Protocol_Version                  = 1;
  @ServiceDiscovery_SOMEIPPacket_SubACK_ICAS1Gateway_Interface_Version                 = 1;
  @ServiceDiscovery_SOMEIPPacket_SubACK_ICAS1Gateway_Message_Type                      = 2; // 0x00 REQUEST / 0x01 REQUEST_NO_RETURN / 0x02 NOTIFICATION / 0x80 RESPONSE / 0x81 ERROR / 0x42 NOTIFICATION_ACK
  @ServiceDiscovery_SOMEIPPacket_SubACK_ICAS1Gateway_Return_Code                       = 0;
  @ServiceDiscovery_SOMEIPPacket_SubACK_ICAS1Gateway_Flags                             = 0x40;
  @ServiceDiscovery_SOMEIPPacket_SubACK_ICAS1Gateway_Entries_Array_Length              = 16;
  @ServiceDiscovery_SOMEIPPacket_SubACK_ICAS1Gateway_Entries_Array_Type                = 7; // SubscribeAck
  @ServiceDiscovery_SOMEIPPacket_SubACK_ICAS1Gateway_Entries_Array_Index_1st_options   = 0;
  @ServiceDiscovery_SOMEIPPacket_SubACK_ICAS1Gateway_Entries_Array_Index_2nd_options   = 0;
  @ServiceDiscovery_SOMEIPPacket_SubACK_ICAS1Gateway_Entries_Array_Nr_of_opt_1         = 1;
  @ServiceDiscovery_SOMEIPPacket_SubACK_ICAS1Gateway_Entries_Array_Nr_of_opt_2         = 0;
  @ServiceDiscovery_SOMEIPPacket_SubACK_ICAS1Gateway_Entries_Array_Service_ID          = 0;
  @ServiceDiscovery_SOMEIPPacket_SubACK_ICAS1Gateway_Entries_Array_Instance_ID         = 0;
  @ServiceDiscovery_SOMEIPPacket_SubACK_ICAS1Gateway_Entries_Array_Major_Version       = 0;
  @ServiceDiscovery_SOMEIPPacket_SubACK_ICAS1Gateway_Entries_Array_TTL                 = 0;
  @ServiceDiscovery_SOMEIPPacket_SubACK_ICAS1Gateway_Entries_Array_Counter             = 0;
  @ServiceDiscovery_SOMEIPPacket_SubACK_ICAS1Gateway_Entries_Array_Eventgroup_ID       = 0; // Platzhalter, wird nach Anfrage befüllt
  @ServiceDiscovery_SOMEIPPacket_SubACK_ICAS1Gateway_Options_Array_Length              = 24;
  @ServiceDiscovery_SOMEIPPacket_SubACK_ICAS1Gateway_Options_Array_Option1_Length      = 21;
  @ServiceDiscovery_SOMEIPPacket_SubACK_ICAS1Gateway_Options_Array_Option1_Type        = 0x16;
  @ServiceDiscovery_SOMEIPPacket_SubACK_ICAS1Gateway_Options_Array_Option1_IPv6_01     = 0xFD53; // "fd53:7cb8:383:3::10"
  @ServiceDiscovery_SOMEIPPacket_SubACK_ICAS1Gateway_Options_Array_Option1_IPv6_02     = 0x7CB8;
  @ServiceDiscovery_SOMEIPPacket_SubACK_ICAS1Gateway_Options_Array_Option1_IPv6_03     = 0x0383;
  @ServiceDiscovery_SOMEIPPacket_SubACK_ICAS1Gateway_Options_Array_Option1_IPv6_04     = 0x0003;
  @ServiceDiscovery_SOMEIPPacket_SubACK_ICAS1Gateway_Options_Array_Option1_IPv6_05     = 0x0000;
  @ServiceDiscovery_SOMEIPPacket_SubACK_ICAS1Gateway_Options_Array_Option1_IPv6_06     = 0x0000;
  @ServiceDiscovery_SOMEIPPacket_SubACK_ICAS1Gateway_Options_Array_Option1_IPv6_07     = 0x0000;
  @ServiceDiscovery_SOMEIPPacket_SubACK_ICAS1Gateway_Options_Array_Option1_IPv6_08     = 0x0010;
  @ServiceDiscovery_SOMEIPPacket_SubACK_ICAS1Gateway_Options_Array_Option1_L4_Proto    = 17; // UDP
  @ServiceDiscovery_SOMEIPPacket_SubACK_ICAS1Gateway_Options_Array_Option1_Port_Number = 30501;
  @ServiceDiscovery_SOMEIPPacket_SubACK_ICAS1Sys01_Message_ID_Service_ID               = 0xFFFF;
  @ServiceDiscovery_SOMEIPPacket_SubACK_ICAS1Sys01_Message_ID_Method_ID                = 0x8100;
  @ServiceDiscovery_SOMEIPPacket_SubACK_ICAS1Sys01_Length                              = 36;
  @ServiceDiscovery_SOMEIPPacket_SubACK_ICAS1Sys01_Request_ID_Client_ID                = 0;
  @ServiceDiscovery_SOMEIPPacket_SubACK_ICAS1Sys01_Protocol_Version                    = 1;
  @ServiceDiscovery_SOMEIPPacket_SubACK_ICAS1Sys01_Interface_Version                   = 1;
  @ServiceDiscovery_SOMEIPPacket_SubACK_ICAS1Sys01_Message_Type                        = 2; // 0x00 REQUEST / 0x01 REQUEST_NO_RETURN / 0x02 NOTIFICATION / 0x80 RESPONSE / 0x81 ERROR / 0x42 NOTIFICATION_ACK
  @ServiceDiscovery_SOMEIPPacket_SubACK_ICAS1Sys01_Return_Code                         = 0;
  @ServiceDiscovery_SOMEIPPacket_SubACK_ICAS1Sys01_Flags                               = 0x40;
  @ServiceDiscovery_SOMEIPPacket_SubACK_ICAS1Sys01_Entries_Array_Length                = 16;
  @ServiceDiscovery_SOMEIPPacket_SubACK_ICAS1Sys01_Entries_Array_Type                  = 7; // SubscribeAck
  @ServiceDiscovery_SOMEIPPacket_SubACK_ICAS1Sys01_Entries_Array_Index_1st_options     = 0;
  @ServiceDiscovery_SOMEIPPacket_SubACK_ICAS1Sys01_Entries_Array_Index_2nd_options     = 0;
  @ServiceDiscovery_SOMEIPPacket_SubACK_ICAS1Sys01_Entries_Array_Nr_of_opt_1           = 1;
  @ServiceDiscovery_SOMEIPPacket_SubACK_ICAS1Sys01_Entries_Array_Nr_of_opt_2           = 0;
  @ServiceDiscovery_SOMEIPPacket_SubACK_ICAS1Sys01_Entries_Array_Service_ID            = 0;
  @ServiceDiscovery_SOMEIPPacket_SubACK_ICAS1Sys01_Entries_Array_Instance_ID           = 0;
  @ServiceDiscovery_SOMEIPPacket_SubACK_ICAS1Sys01_Entries_Array_Major_Version         = 0;
  @ServiceDiscovery_SOMEIPPacket_SubACK_ICAS1Sys01_Entries_Array_TTL                   = 0;
  @ServiceDiscovery_SOMEIPPacket_SubACK_ICAS1Sys01_Entries_Array_Counter               = 0;
  @ServiceDiscovery_SOMEIPPacket_SubACK_ICAS1Sys01_Entries_Array_Eventgroup_ID         = 0; // Platzhalter, wird nach Anfrage befüllt
  @ServiceDiscovery_SOMEIPPacket_SubACK_ICAS1Sys01_Options_Array_Length                = 24;
  @ServiceDiscovery_SOMEIPPacket_SubACK_ICAS1Sys01_Options_Array_Option1_Length        = 21;
  @ServiceDiscovery_SOMEIPPacket_SubACK_ICAS1Sys01_Options_Array_Option1_Type          = 0x16;
  @ServiceDiscovery_SOMEIPPacket_SubACK_ICAS1Sys01_Options_Array_Option1_IPv6_01       = 0xFD53; // "fd53:7cb8:383:3::106"
  @ServiceDiscovery_SOMEIPPacket_SubACK_ICAS1Sys01_Options_Array_Option1_IPv6_02       = 0x7CB8;
  @ServiceDiscovery_SOMEIPPacket_SubACK_ICAS1Sys01_Options_Array_Option1_IPv6_03       = 0x0383;
  @ServiceDiscovery_SOMEIPPacket_SubACK_ICAS1Sys01_Options_Array_Option1_IPv6_04       = 0x0003;
  @ServiceDiscovery_SOMEIPPacket_SubACK_ICAS1Sys01_Options_Array_Option1_IPv6_05       = 0x0000;
  @ServiceDiscovery_SOMEIPPacket_SubACK_ICAS1Sys01_Options_Array_Option1_IPv6_06       = 0x0000;
  @ServiceDiscovery_SOMEIPPacket_SubACK_ICAS1Sys01_Options_Array_Option1_IPv6_07       = 0x0000;
  @ServiceDiscovery_SOMEIPPacket_SubACK_ICAS1Sys01_Options_Array_Option1_IPv6_08       = 0x0106;
  @ServiceDiscovery_SOMEIPPacket_SubACK_ICAS1Sys01_Options_Array_Option1_L4_Proto      = 17; // UDP
  @ServiceDiscovery_SOMEIPPacket_SubACK_ICAS1Sys01_Options_Array_Option1_Port_Number   = 30501;
  @ServiceDiscovery_SOMEIPPacket_SubACK_ICAS3IVI_Message_ID_Service_ID                 = 0xFFFF;
  @ServiceDiscovery_SOMEIPPacket_SubACK_ICAS3IVI_Message_ID_Method_ID                  = 0x8100;
  @ServiceDiscovery_SOMEIPPacket_SubACK_ICAS3IVI_Length                                = 36;
  @ServiceDiscovery_SOMEIPPacket_SubACK_ICAS3IVI_Request_ID_Client_ID                  = 0;
  @ServiceDiscovery_SOMEIPPacket_SubACK_ICAS3IVI_Protocol_Version                      = 1;
  @ServiceDiscovery_SOMEIPPacket_SubACK_ICAS3IVI_Interface_Version                     = 1;
  @ServiceDiscovery_SOMEIPPacket_SubACK_ICAS3IVI_Message_Type                          = 2; // 0x00 REQUEST / 0x01 REQUEST_NO_RETURN / 0x02 NOTIFICATION / 0x80 RESPONSE / 0x81 ERROR / 0x42 NOTIFICATION_ACK
  @ServiceDiscovery_SOMEIPPacket_SubACK_ICAS3IVI_Return_Code                           = 0;
  @ServiceDiscovery_SOMEIPPacket_SubACK_ICAS3IVI_Flags                                 = 0x40;
  @ServiceDiscovery_SOMEIPPacket_SubACK_ICAS3IVI_Entries_Array_Length                  = 16;
  @ServiceDiscovery_SOMEIPPacket_SubACK_ICAS3IVI_Entries_Array_Type                    = 7; // SubscribeAck
  @ServiceDiscovery_SOMEIPPacket_SubACK_ICAS3IVI_Entries_Array_Index_1st_options       = 0;
  @ServiceDiscovery_SOMEIPPacket_SubACK_ICAS3IVI_Entries_Array_Index_2nd_options       = 0;
  @ServiceDiscovery_SOMEIPPacket_SubACK_ICAS3IVI_Entries_Array_Nr_of_opt_1             = 1;
  @ServiceDiscovery_SOMEIPPacket_SubACK_ICAS3IVI_Entries_Array_Nr_of_opt_2             = 0;
  @ServiceDiscovery_SOMEIPPacket_SubACK_ICAS3IVI_Entries_Array_Service_ID              = 0;
  @ServiceDiscovery_SOMEIPPacket_SubACK_ICAS3IVI_Entries_Array_Instance_ID             = 0;
  @ServiceDiscovery_SOMEIPPacket_SubACK_ICAS3IVI_Entries_Array_Major_Version           = 0;
  @ServiceDiscovery_SOMEIPPacket_SubACK_ICAS3IVI_Entries_Array_TTL                     = 0;
  @ServiceDiscovery_SOMEIPPacket_SubACK_ICAS3IVI_Entries_Array_Counter                 = 0;
  @ServiceDiscovery_SOMEIPPacket_SubACK_ICAS3IVI_Entries_Array_Eventgroup_ID           = 0; // Platzhalter, wird nach Anfrage befüllt
  @ServiceDiscovery_SOMEIPPacket_SubACK_ICAS3IVI_Options_Array_Length                  = 24;
  @ServiceDiscovery_SOMEIPPacket_SubACK_ICAS3IVI_Options_Array_Option1_Length          = 21;
  @ServiceDiscovery_SOMEIPPacket_SubACK_ICAS3IVI_Options_Array_Option1_Type            = 0x16;
  @ServiceDiscovery_SOMEIPPacket_SubACK_ICAS3IVI_Options_Array_Option1_IPv6_01         = 0xFD53; // "fd53:7cb8:383:3::108"
  @ServiceDiscovery_SOMEIPPacket_SubACK_ICAS3IVI_Options_Array_Option1_IPv6_02         = 0x7CB8;
  @ServiceDiscovery_SOMEIPPacket_SubACK_ICAS3IVI_Options_Array_Option1_IPv6_03         = 0x0383;
  @ServiceDiscovery_SOMEIPPacket_SubACK_ICAS3IVI_Options_Array_Option1_IPv6_04         = 0x0003;
  @ServiceDiscovery_SOMEIPPacket_SubACK_ICAS3IVI_Options_Array_Option1_IPv6_05         = 0x0000;
  @ServiceDiscovery_SOMEIPPacket_SubACK_ICAS3IVI_Options_Array_Option1_IPv6_06         = 0x0000;
  @ServiceDiscovery_SOMEIPPacket_SubACK_ICAS3IVI_Options_Array_Option1_IPv6_07         = 0x0000;
  @ServiceDiscovery_SOMEIPPacket_SubACK_ICAS3IVI_Options_Array_Option1_IPv6_08         = 0x0108;
  @ServiceDiscovery_SOMEIPPacket_SubACK_ICAS3IVI_Options_Array_Option1_L4_Proto        = 17; // UDP
  @ServiceDiscovery_SOMEIPPacket_SubACK_ICAS3IVI_Options_Array_Option1_Port_Number     = 30501;
  
  
  // Service Time //
  @Time_Notification_Port_Source                                                 = 42810;
  @Time_Notification_Port_Destination                                            = 42810;
  @Time_Notification_Message_ID_Service_ID                                       = 0x6009;
  @Time_Notification_Message_ID_Method_ID                                        = 0; // Platzhalter
  @Time_Notification_Length                                                      = 0; // Platzhalter
  @Time_Notification_Request_ID_Client_ID                                        = 0;
  @Time_Notification_Protocol_Version                                            = 1;
  @Time_Notification_Interface_Version                                           = 4;
  @Time_Notification_Message_Type                                                = 2; // 0x02 NOTIFICATION
  @Time_Notification_Return_Code                                                 = 0;
  
  @Time_Notification_Message_ID_Method_ID_timeSettings                           = 0xC010;
  @Time_Notification_Message_ID_Method_ID_times                                  = 0xC020;
  
  @Time_Notification_timeSettings_Element_TotalNum                               = 1;
  @Time_Notification_timeSettings_Element                                        = 0;
  @Time_Notification_times_Element_TotalNum                                      = 1;
  @Time_Notification_times_Element                                               = 0;
  
  @Time_SubscribeStatus_timeSettings                                             = 0;
  @Time_SubscribeStatus_times                                                    = 0;
  
  @Time_Notification_timeSettings_Send_cyclic                                    = 0;
  @Time_Notification_timeSettings_Send_cyclic_cycletime                          = 100;
  @Time_Notification_times_Send_cyclic                                           = 0;
  @Time_Notification_times_Send_cyclic_cycletime                                 = 100;
  
  if (getvaluesize(Time_Notification_times_date)-1>=0)
    putvalue(Time_Notification_times_date, "01.01.2020");
  
  getvalue (Time_Notification_times_date, buffer_char);
  for (j=0; j<10; j++)
  {
    for (k=0; k<getvaluesize(Time_Notification_times_date)-1; k++)
      Time_array_times_date[j][k] = buffer_char[k];
  }
  
  if (getvaluesize(Time_Notification_times_time)-1>=0)
    putvalue(Time_Notification_times_time, "09:30:00");
  
  getvalue (Time_Notification_times_time, buffer_char);
  for (j=0; j<10; j++)
  {
    for (k=0; k<getvaluesize(Time_Notification_times_time)-1; k++)
      Time_array_times_time[j][k] = buffer_char[k];
  }
  
  for (k=0;k<10;k++)
  {
    Time_array_timeSettings_id_available[k]             = 1;
    Time_array_timeSettings_dstActive_available[k]      = 1;
    Time_array_timeSettings_timeMode_available[k]       = 1;
    Time_array_timeSettings_timeZoneOffset_available[k] = 1;
    Time_array_times_type_available[k]                  = 1;
    Time_array_times_date_available[k]                  = 1;
    Time_array_times_pltOffset_available[k]             = 1;
    Time_array_times_time_available[k]                  = 1;
    Time_array_times_unix_available[k]                  = 1;
    Time_array_times_standby_available[k]               = 1;
  }
  
  
  
  
  // Service Distance //
  @Distance_Notification_Port_Source                                                 = 42820;
  @Distance_Notification_Port_Destination                                            = 42820;
  @Distance_Notification_Message_ID_Service_ID                                       = 0x600A;
  @Distance_Notification_Message_ID_Method_ID                                        = 0; // Platzhalter
  @Distance_Notification_Length                                                      = 0; // Platzhalter
  @Distance_Notification_Request_ID_Client_ID                                        = 0;
  @Distance_Notification_Protocol_Version                                            = 1;
  @Distance_Notification_Interface_Version                                           = 5;
  @Distance_Notification_Message_Type                                                = 2; // 0x02 NOTIFICATION
  @Distance_Notification_Return_Code                                                 = 0;
  
  @Distance_Notification_Message_ID_Method_ID_distances                              = 0xC010;
  @Distance_Notification_Message_ID_Method_ID_notifications                          = 0xC020;
  
  @Distance_Notification_distances_Element_TotalNum                                  = 1;
  @Distance_Notification_distances_Element                                           = 0;
  @Distance_Notification_notifications_Element_TotalNum                              = 1;
  @Distance_Notification_notifications_Element                                       = 0;
  
  @Distance_SubscribeStatus_distances                                                = 0;
  @Distance_SubscribeStatus_notification                                             = 0;
  
  @Distance_Notification_distances_Send_cyclic                                       = 1;
  @Distance_Notification_distances_Send_cyclic_cycletime                             = 100;
  @Distance_Notification_notifications_Send_cyclic                                   = 0;
  @Distance_Notification_notifications_Send_cyclic_cycletime                         = 100;
  
  for (k=0;k<10;k++)
  {
    Distance_array_distances_distanceName_available[k]                               = 1;
    Distance_array_distances_currentValue_available[k]                               = 1;
    Distance_array_distances_restrictionReason_available[k]                          = 1;
    Distance_array_distances_unit_available[k]                                       = 1;
    Distance_array_notifications_type_available[k]                                   = 1;
    Distance_array_notifications_value_available[k]                                  = 1;
  }
  
  // Wegstrecke
  Distance_array_distances_distanceName[0]                                           = 4;
  Distance_array_distances_restrictionReason_available[0]                            = 0;
  Distance_array_distances_unit[0]                                                   = 2;
  @Distance_Notification_distances_currentValue_inc                                  = 0;
  
  
  // Service Odometry //
  @Odometry_Notification_Port_Source                                                 = 42810;
  @Odometry_Notification_Port_Destination                                            = 42810;
  @Odometry_Notification_Message_ID_Service_ID                                       = 0x6017;
  @Odometry_Notification_Message_ID_Method_ID                                        = 0; // Platzhalter
  @Odometry_Notification_Length                                                      = 0; // Platzhalter
  @Odometry_Notification_Request_ID_Client_ID                                        = 0;
  @Odometry_Notification_Protocol_Version                                            = 1;
  @Odometry_Notification_Interface_Version                                           = 3;
  @Odometry_Notification_Message_Type                                                = 2; // 0x02 NOTIFICATION
  @Odometry_Notification_Return_Code                                                 = 0;
  
  @Odometry_Notification_Message_ID_Method_ID_speeds                                 = 0xC010;
  @Odometry_Notification_Message_ID_Method_ID_velocities                             = 0xC020;
  @Odometry_Notification_Message_ID_Method_ID_pose2D                                 = 0xC030;
  @Odometry_Notification_Message_ID_Method_ID_additionalVehicleMotionInformations    = 0xC040;
  @Odometry_Notification_Message_ID_Method_ID_wheelCorrections                       = 0xC050;
  @Odometry_Notification_Message_ID_Method_ID_accelerations                          = 0xC060;
  @Odometry_Notification_Message_ID_Method_ID_angularRates                           = 0xC070;
  
  @Odometry_Notification_speeds_Element_TotalNum                                     = 1;
  @Odometry_Notification_speeds_Element                                              = 0;
  @Odometry_Notification_velocities_Element_TotalNum                                 = 1;
  @Odometry_Notification_velocities_Element                                          = 0;
  @Odometry_Notification_pose2D_Element_TotalNum                                     = 1;
  @Odometry_Notification_pose2D_Element                                              = 0;
  @Odometry_Notification_additionalVehicleMotionInformations_Element_TotalNum        = 1;
  @Odometry_Notification_additionalVehicleMotionInformations_Element                 = 0;
  @Odometry_Notification_wheelCorrections_Element_TotalNum                           = 1;
  @Odometry_Notification_wheelCorrections_Element                                    = 0;
  @Odometry_Notification_accelerations_Element_TotalNum                              = 1;
  @Odometry_Notification_accelerations_Element                                       = 0;
  @Odometry_Notification_angularRates_Element_TotalNum                               = 1;
  @Odometry_Notification_angularRates_Element                                        = 0;
  
  @Odometry_SubscribeStatus_speeds                                                   = 0;
  @Odometry_SubscribeStatus_velocities                                               = 0;
  @Odometry_SubscribeStatus_pose2D                                                   = 0;
  @Odometry_SubscribeStatus_additionalVehicleMotionInformations                      = 0;
  @Odometry_SubscribeStatus_wheelCorrections                                         = 0;
  @Odometry_SubscribeStatus_accelerations                                            = 0;
  @Odometry_SubscribeStatus_angularRates                                             = 0;
  
  @Odometry_Notification_speeds_Send_cyclic                                          = 0;
  @Odometry_Notification_speeds_Send_cyclic_cycletime                                = 100;
  @Odometry_Notification_velocities_Send_cyclic                                      = 0;
  @Odometry_Notification_velocities_Send_cyclic_cycletime                            = 100;
  @Odometry_Notification_pose2D_Send_cyclic                                          = 0;
  @Odometry_Notification_pose2D_Send_cyclic_cycletime                                = 100;
  @Odometry_Notification_additionalVehicleMotionInformations_Send_cyclic             = 0;
  @Odometry_Notification_additionalVehicleMotionInformations_Send_cyclic_cycletime   = 100;
  @Odometry_Notification_wheelCorrections_Send_cyclic                                = 0;
  @Odometry_Notification_wheelCorrections_Send_cyclic_cycletime                      = 100;
  @Odometry_Notification_accelerations_Send_cyclic                                   = 0;
  @Odometry_Notification_accelerations_Send_cyclic_cycletime                         = 100;
  @Odometry_Notification_angularRates_Send_cyclic                                    = 0;
  @Odometry_Notification_angularRates_Send_cyclic_cycletime                          = 100;
  
  for (k=0;k<10;k++)
  {
    Odometry_array_speeds_type_available[k]                                                                    = 1;
    Odometry_array_speeds_value_available[k]                                                                   = 1;
    Odometry_array_speeds_confidence_available[k]                                                              = 1;
    Odometry_array_speeds_timestamp_available[k]                                                               = 1;
    Odometry_array_velocities_type_available[k]                                                                = 1;
    Odometry_array_velocities_timestamp_available[k]                                                           = 1;
    Odometry_array_velocities_value_available[k]                                                               = 1;
    Odometry_array_velocities_variance_available[k]                                                            = 1;
    Odometry_array_velocities_confidence_available[k]                                                          = 1;
    Odometry_array_pose2D_timestamp_available[k]                                                               = 1;
    Odometry_array_pose2D_positionX_available[k]                                                               = 1;
    Odometry_array_pose2D_positionY_available[k]                                                               = 1;
    Odometry_array_pose2D_yawAngle_available[k]                                                                = 1;
    Odometry_array_pose2D_positionXVariance_available[k]                                                       = 1;
    Odometry_array_pose2D_positionYVariance_available[k]                                                       = 1;
    Odometry_array_pose2D_yawAngleVariance_available[k]                                                        = 1;
    Odometry_array_pose2D_pose2dConfidence_available[k]                                                        = 1;
    Odometry_array_additionalVehicleMotionInformations_timestamp_available[k]                                  = 1;
    Odometry_array_additionalVehicleMotionInformations_drivingDirectionProbabilityRange_available[k]           = 1;
    Odometry_array_additionalVehicleMotionInformations_drivingDirectionProbabilityRangeConfidence_available[k] = 1;
    Odometry_array_additionalVehicleMotionInformations_standStillProbabilityRange_available[k]                 = 1;
    Odometry_array_additionalVehicleMotionInformations_standStillProbabilityRangeConfidence_available[k]       = 1;
    Odometry_array_wheelCorrections_timestamp_available[k]                                                     = 1;
    Odometry_array_wheelCorrections_wheelCorrectionFactorFrontLeft_available[k]                                = 1;
    Odometry_array_wheelCorrections_wheelCorrectionFactorFrontRight_available[k]                               = 1;
    Odometry_array_wheelCorrections_wheelCorrectionFactorRearLeft_available[k]                                 = 1;
    Odometry_array_wheelCorrections_wheelCorrectionFactorRearRight_available[k]                                = 1;
    Odometry_array_wheelCorrections_wheelCorrectionFactorEstimatorStatus_available[k]                          = 1;
    Odometry_array_wheelCorrections_wheelCorrectionFactorEstimatorStatusConfidence_available[k]                = 1;
    Odometry_array_wheelCorrections_wheelCorrectionFactorFrontLeftConfidence_available[k]                      = 1;
    Odometry_array_wheelCorrections_wheelCorrectionFactorFrontRightConfidence_available[k]                     = 1;
    Odometry_array_wheelCorrections_wheelCorrectionFactoRearLeftConfidence_available[k]                        = 1;
    Odometry_array_wheelCorrections_wheelCorrectionFactoRearRightConfidence_available[k]                       = 1;
    Odometry_array_wheelCorrections_wheelCircumferenceStatic_available[k]                                      = 1;
    Odometry_array_wheelCorrections_wheelCircumferenceStaticConfidence_available[k]                            = 1;
    Odometry_array_accelerations_type_available[k]                                                             = 1;
    Odometry_array_accelerations_timestamp_available[k]                                                        = 1;
    Odometry_array_accelerations_acceleration_available[k]                                                     = 1;
    Odometry_array_accelerations_variance_available[k]                                                         = 1;
    Odometry_array_accelerations_confidence_available[k]                                                       = 1;
    Odometry_array_angularRates_type_available[k]                                                              = 1;
    Odometry_array_angularRates_timestamp_available[k]                                                         = 1;
    Odometry_array_angularRates_angularrate_available[k]                                                       = 1;
    Odometry_array_angularRates_variance_available[k]                                                          = 1;
    Odometry_array_angularRates_confidence_available[k]                                                        = 1;
  }
  
  
  // Service ChargingManagementCore //
  @ChargingManagementCore_Notification_Port_Source           = 42810;
  @ChargingManagementCore_Notification_Port_Destination      = 42810;
  @ChargingManagementCore_Notification_Message_ID_Service_ID = 0x6068;
  @ChargingManagementCore_Notification_Message_ID_Method_ID  = 0; // Platzhalter
  @ChargingManagementCore_Notification_Length                = 0; // Platzhalter
  @ChargingManagementCore_Notification_Request_ID_Client_ID  = 0;
  @ChargingManagementCore_Notification_Protocol_Version      = 1;
  @ChargingManagementCore_Notification_Interface_Version     = 2;
  @ChargingManagementCore_Notification_Message_Type          = 2; // 0x02 NOTIFICATION
  @ChargingManagementCore_Notification_Return_Code           = 0;
  
  @ChargingManagementCore_Notification_Message_ID_Method_ID_immediateChargingOptions   = 0xC010;
  @ChargingManagementCore_Notification_Message_ID_Method_ID_chargingProcessInformation = 0xC020;
  @ChargingManagementCore_Notification_Message_ID_Method_ID_chargingPlugs              = 0xC030;
  @ChargingManagementCore_Notification_Message_ID_Method_ID_immediateActions           = 0xC040;
  @ChargingManagementCore_Notification_Message_ID_Method_ID_notificationMarkers        = 0xC050;
  @ChargingManagementCore_Notification_Message_ID_Method_ID_notifications              = 0xC060;
  @ChargingManagementCore_Notification_Message_ID_Method_ID_pastErrorInformation       = 0xC070;
  @ChargingManagementCore_Notification_Message_ID_Method_ID_views                      = 0xC080;
  @ChargingManagementCore_Notification_Message_ID_Method_ID_oruUpdateApprovals         = 0xC090;
  @ChargingManagementCore_Notification_Message_ID_Method_ID_switchControls             = 0xC0A0;
  @ChargingManagementCore_Notification_Message_ID_Method_ID_valueControls              = 0xC0B0;
  @ChargingManagementCore_Notification_Message_ID_Method_ID_valueIndications           = 0xC0C0;
  @ChargingManagementCore_Notification_Message_ID_Method_ID_resetToFactoryData         = 0xC0D0;
   
  @ChargingManagementCore_Notification_immediateChargingOptions_Element_TotalNum                = 1;
  @ChargingManagementCore_Notification_immediateChargingOptions_Element                         = 0;
  @ChargingManagementCore_Notification_chargingProcessInformation_Element_TotalNum              = 1;
  @ChargingManagementCore_Notification_chargingProcessInformation_Element                       = 0;
  @ChargingManagementCore_Notification_chargingPlugs_Element_TotalNum                           = 1;
  @ChargingManagementCore_Notification_chargingPlugs_Element                                    = 0;
  @ChargingManagementCore_Notification_immediateActions_Element_TotalNum                        = 1;
  @ChargingManagementCore_Notification_immediateActions_Element                                 = 0;
  @ChargingManagementCore_Notification_notificationMarkers_Element_TotalNum                     = 1;
  @ChargingManagementCore_Notification_notificationMarkers_Element                              = 0;
  @ChargingManagementCore_Notification_notifications_Element_TotalNum                           = 1;
  @ChargingManagementCore_Notification_notifications_Element                                    = 0;
  @ChargingManagementCore_Notification_pastErrorInformation_Element_TotalNum                    = 1;
  @ChargingManagementCore_Notification_pastErrorInformation_Element                             = 0;
  @ChargingManagementCore_Notification_views_Element_TotalNum                                   = 1;
  @ChargingManagementCore_Notification_views_Element                                            = 0;
  @ChargingManagementCore_Notification_oruUpdateApprovals_Element_TotalNum                      = 1;
  @ChargingManagementCore_Notification_oruUpdateApprovals_Element                               = 0;
  @ChargingManagementCore_Notification_switchControls_Element_TotalNum                          = 1;
  @ChargingManagementCore_Notification_switchControls_Element                                   = 0;
  @ChargingManagementCore_Notification_switchControls_switchValueConfiguration_Element          = 0;
  @ChargingManagementCore_Notification_switchControls_switchValueConfiguration_Element_TotalNum = 1;
  @ChargingManagementCore_Notification_valueControls_Element_TotalNum                           = 1;
  @ChargingManagementCore_Notification_valueControls_Element                                    = 0;
  @ChargingManagementCore_Notification_valueControls_specialStateConfiguration_Element          = 0;
  @ChargingManagementCore_Notification_valueControls_specialStateConfiguration_Element_TotalNum = 1;
  @ChargingManagementCore_Notification_valueIndications_Element_TotalNum                        = 1;
  @ChargingManagementCore_Notification_valueIndications_Element                                 = 0;
  @ChargingManagementCore_Notification_resetToFactoryData_Element_TotalNum                      = 1;
  @ChargingManagementCore_Notification_resetToFactoryData_Element                               = 0;
  
  if (getvaluesize(ChargingManagementCore_Notification_valueIndications_currentTimeDateValue)-1>=0)
    putvalue(ChargingManagementCore_Notification_valueIndications_currentTimeDateValue, "01.01.2020");
  
  getvalue (ChargingManagementCore_Notification_valueIndications_currentTimeDateValue, buffer_char);
  for (j=0; j<10; j++)
  {
    for (k=0; k<getvaluesize(ChargingManagementCore_Notification_valueIndications_currentTimeDateValue)-1; k++)
      ChargingManagementCore_array_valueIndications_currentTimeDateValue[j][k] = buffer_char[k];
  }
  
  @ChargingManagementCore_SubscribeStatus_immediateChargingOptions   = 0;
  @ChargingManagementCore_SubscribeStatus_chargingProcessInformation = 0;
  @ChargingManagementCore_SubscribeStatus_chargingPlugs              = 0;
  @ChargingManagementCore_SubscribeStatus_immediateActions           = 0;
  @ChargingManagementCore_SubscribeStatus_notificationMarkers        = 0;
  @ChargingManagementCore_SubscribeStatus_notifications              = 0;
  @ChargingManagementCore_SubscribeStatus_pastErrorInformation       = 0;
  @ChargingManagementCore_SubscribeStatus_views                      = 0;
  @ChargingManagementCore_SubscribeStatus_oruUpdateApprovals         = 0;
  @ChargingManagementCore_SubscribeStatus_switchControls             = 0;
  @ChargingManagementCore_SubscribeStatus_valueControls              = 0;
  @ChargingManagementCore_SubscribeStatus_valueIndications           = 0;
  @ChargingManagementCore_SubscribeStatus_resetToFactoryData         = 0;
  
  @ChargingManagementCore_Notification_immediateChargingOptions_Send_cyclic             = 0;
  @ChargingManagementCore_Notification_immediateChargingOptions_Send_cyclic_cycletime   = 100;
  @ChargingManagementCore_Notification_chargingProcessInformation_Send_cyclic           = 0;
  @ChargingManagementCore_Notification_chargingProcessInformation_Send_cyclic_cycletime = 100;
  @ChargingManagementCore_Notification_chargingPlugs_Send_cyclic                        = 0;
  @ChargingManagementCore_Notification_chargingPlugs_Send_cyclic_cycletime              = 100;
  @ChargingManagementCore_Notification_immediateActions_Send_cyclic                     = 0;
  @ChargingManagementCore_Notification_immediateActions_Send_cyclic_cycletime           = 100;
  @ChargingManagementCore_Notification_notificationMarkers_Send_cyclic                  = 0;
  @ChargingManagementCore_Notification_notificationMarkers_Send_cyclic_cycletime        = 100;
  @ChargingManagementCore_Notification_notifications_Send_cyclic                        = 0;
  @ChargingManagementCore_Notification_notifications_Send_cyclic_cycletime              = 100;
  @ChargingManagementCore_Notification_pastErrorInformation_Send_cyclic                 = 0;
  @ChargingManagementCore_Notification_pastErrorInformation_Send_cyclic_cycletime       = 100;
  @ChargingManagementCore_Notification_views_Send_cyclic                                = 0;
  @ChargingManagementCore_Notification_views_Send_cyclic_cycletime                      = 100;
  @ChargingManagementCore_Notification_oruUpdateApprovals_Send_cyclic                   = 0;
  @ChargingManagementCore_Notification_oruUpdateApprovals_Send_cyclic_cycletime         = 100;
  @ChargingManagementCore_Notification_switchControls_Send_cyclic                       = 0;
  @ChargingManagementCore_Notification_switchControls_Send_cyclic_cycletime             = 100;
  @ChargingManagementCore_Notification_valueControls_Send_cyclic                        = 0;
  @ChargingManagementCore_Notification_valueControls_Send_cyclic_cycletime              = 100;
  @ChargingManagementCore_Notification_valueIndications_Send_cyclic                     = 0;
  @ChargingManagementCore_Notification_valueIndications_Send_cyclic_cycletime           = 100;
  @ChargingManagementCore_Notification_resetToFactoryData_Send_cyclic                   = 0;
  @ChargingManagementCore_Notification_resetToFactoryData_Send_cyclic_cycletime         = 100;
  
  for (k=0;k<10;k++)
  {
    ChargingManagementCore_array_immediateChargingOptions_type_available[k]                          = 1;
    ChargingManagementCore_array_immediateChargingOptions_targetSoc_available[k]                     = 1;
    ChargingManagementCore_array_immediateChargingOptions_targetRange_available[k]                   = 1;
    ChargingManagementCore_array_immediateChargingOptions_maxChargeCurrentAc_available[k]            = 1;
    ChargingManagementCore_array_immediateChargingOptions_autounlockAc_available[k]                  = 1;
    ChargingManagementCore_array_immediateChargingOptions_autounlockDc_available[k]                  = 1;
    ChargingManagementCore_array_immediateChargingOptions_chargeModeSelection_available[k]           = 1;
    ChargingManagementCore_array_chargingProcessInformation_type_available[k]                        = 1;
    ChargingManagementCore_array_chargingProcessInformation_currentChargeState_available[k]          = 1;
    ChargingManagementCore_array_chargingProcessInformation_currentSoc_available[k]                  = 1;
    ChargingManagementCore_array_chargingProcessInformation_remainingChargeTimeBulk_available[k]     = 1;
    ChargingManagementCore_array_chargingProcessInformation_chargeBulkThreshold_available[k]         = 1;
    ChargingManagementCore_array_chargingProcessInformation_remainingChargeTimeComplete_available[k] = 1;
    ChargingManagementCore_array_chargingProcessInformation_chargeMode_available[k]                  = 1;
    ChargingManagementCore_array_chargingProcessInformation_profileChargeReason_available[k]         = 1;
    ChargingManagementCore_array_chargingProcessInformation_chargeType_available[k]                  = 1;
    ChargingManagementCore_array_chargingProcessInformation_chargeEnergy_available[k]                = 1;
    ChargingManagementCore_array_chargingProcessInformation_chargeRate_available[k]                  = 1;
    ChargingManagementCore_array_chargingProcessInformation_chargePower_available[k]                 = 1;
    ChargingManagementCore_array_chargingProcessInformation_chargingScenario_available[k]            = 1;
    ChargingManagementCore_array_chargingProcessInformation_chargeTargetTime_available[k]            = 1;
    ChargingManagementCore_array_chargingProcessInformation_chargeTargetTimeOffset_available[k]      = 1;
    ChargingManagementCore_array_chargingProcessInformation_maxPowerChargingStation_available[k]     = 1;
    ChargingManagementCore_array_chargingPlugs_type_available[k]                                     = 1;
    ChargingManagementCore_array_chargingPlugs_plugLockState_available[k]                            = 1;
    ChargingManagementCore_array_chargingPlugs_flapLockState_available[k]                            = 1;
    ChargingManagementCore_array_chargingPlugs_plugType_available[k]                                 = 1;
    ChargingManagementCore_array_chargingPlugs_plugConnectionState_available[k]                      = 1;
    ChargingManagementCore_array_chargingPlugs_infrastructureState_available[k]                      = 1;
    ChargingManagementCore_array_immediateActions_type_available[k]                                  = 1;
    ChargingManagementCore_array_immediateActions_immediateActionSoc_available[k]                    = 1;
    ChargingManagementCore_array_immediateActions_immediateActionRange_available[k]                  = 1;
    ChargingManagementCore_array_immediateActions_immediateActionTime_available[k]                   = 1;
    ChargingManagementCore_array_immediateActions_startStopCharging_available[k]                     = 1;
    ChargingManagementCore_array_notificationMarkers_type_available[k]                               = 1;
    ChargingManagementCore_array_notificationMarkers_notificationSocValue_available[k]               = 1;
    ChargingManagementCore_array_notificationMarkers_notificationRangeValue_available[k]             = 1;
    ChargingManagementCore_array_notificationMarkers_notificationTimeValue_available[k]              = 1;
    ChargingManagementCore_array_notificationMarkers_isToBeNotified_available[k]                     = 1;
    ChargingManagementCore_array_notifications_type_available[k]                                     = 1;
    ChargingManagementCore_array_notifications_value_available[k]                                    = 1;
    ChargingManagementCore_array_notifications_additionalInformation_available[k]                    = 1;
    ChargingManagementCore_array_pastErrorInformation_type_available[k]                              = 1;
    ChargingManagementCore_array_pastErrorInformation_value_available[k]                             = 1;
    ChargingManagementCore_array_pastErrorInformation_additionalInformation_available[k]             = 1;
    ChargingManagementCore_array_pastErrorInformation_confirmedByUser_available[k]                   = 1;
    ChargingManagementCore_array_views_type_available[k]                                             = 1;
    ChargingManagementCore_array_views_content_available[k]                                          = 1;
    ChargingManagementCore_array_views_visibility_available[k]                                       = 1;
    ChargingManagementCore_array_oruUpdateApprovals_type_available[k]                                = 1;
    ChargingManagementCore_array_oruUpdateApprovals_updateApproval_available[k]                      = 1;
    ChargingManagementCore_array_switchControls_id_available[k]                                      = 1;
    ChargingManagementCore_array_switchControls_switchValue_available[k]                             = 1;
    ChargingManagementCore_array_switchControls_switchValueConfiguration_available[k]                = 1;
    ChargingManagementCore_array_switchControls_restrictionReason_available[k]                       = 1;
    ChargingManagementCore_array_switchControls_type_available[k]                                    = 1;
    ChargingManagementCore_array_valueControls_id_available[k]                                       = 1;
    ChargingManagementCore_array_valueControls_currentValue_available[k]                             = 1;
    ChargingManagementCore_array_valueControls_maxValue_available[k]                                 = 1;
    ChargingManagementCore_array_valueControls_minValue_available[k]                                 = 1;
    ChargingManagementCore_array_valueControls_unitPercent_available[k]                              = 1;
    ChargingManagementCore_array_valueControls_unitDistance_available[k]                             = 1;
    ChargingManagementCore_array_valueControls_unitTime_available[k]                                 = 1;
    ChargingManagementCore_array_valueControls_resolution_available[k]                               = 1;
    ChargingManagementCore_array_valueControls_restrictionReason_available[k]                        = 1;
    ChargingManagementCore_array_valueControls_type_available[k]                                     = 1;
    ChargingManagementCore_array_valueControls_specialState_available[k]                             = 1;
    ChargingManagementCore_array_valueControls_specialStateConfiguration_available[k]                = 1;
    ChargingManagementCore_array_valueIndications_id_available[k]                                    = 1;
    ChargingManagementCore_array_valueIndications_currentValue_available[k]                          = 1;
    ChargingManagementCore_array_valueIndications_maxValue_available[k]                              = 1;
    ChargingManagementCore_array_valueIndications_minValue_available[k]                              = 1;
    ChargingManagementCore_array_valueIndications_currentTimeDateValue_available[k]                  = 1;
    ChargingManagementCore_array_valueIndications_unitPercent_available[k]                           = 1;
    ChargingManagementCore_array_valueIndications_unitTime_available[k]                              = 1;
    ChargingManagementCore_array_valueIndications_unitSpeed_available[k]                             = 1;
    ChargingManagementCore_array_valueIndications_unitPower_available[k]                             = 1;
    ChargingManagementCore_array_valueIndications_unitEnergy_available[k]                            = 1;
    ChargingManagementCore_array_valueIndications_restrictionReason_available[k]                     = 1;
    ChargingManagementCore_array_valueIndications_type_available[k]                                  = 1;
    ChargingManagementCore_array_resetToFactoryData_id_available[k]                                  = 1;
    ChargingManagementCore_array_resetToFactoryData_resetToFactoryData_available[k]                  = 1;
    
    ChargingManagementCore_array_switchControls_switchValueConfiguration_nr_of_elements[k]           = 1;
    ChargingManagementCore_array_valueControls_specialStateConfiguration_nr_of_elements[k]           = 1;
  }
  
  
  // Service ChargingManagementExtendedSync //
  @ChargingManagementExtendedSync_Notification_Port_Source                                         = 42810;
  @ChargingManagementExtendedSync_Notification_Port_Destination                                    = 42810;
  @ChargingManagementExtendedSync_Notification_Message_ID_Service_ID                               = 0x6069;
  @ChargingManagementExtendedSync_Notification_Message_ID_Method_ID                                = 0; // Platzhalter
  @ChargingManagementExtendedSync_Notification_Length                                              = 0; // Platzhalter
  @ChargingManagementExtendedSync_Notification_Request_ID_Client_ID                                = 0;
  @ChargingManagementExtendedSync_Notification_Protocol_Version                                    = 1;
  @ChargingManagementExtendedSync_Notification_Interface_Version                                   = 1;
  @ChargingManagementExtendedSync_Notification_Message_Type                                        = 2; // 0x02 NOTIFICATION
  @ChargingManagementExtendedSync_Notification_Return_Code                                         = 0;
  
  @ChargingManagementExtendedSync_Notification_Message_ID_Method_ID_estimatedTimesAndInfos = 0xC010;
  @ChargingManagementExtendedSync_Notification_Message_ID_Method_ID_activeChargingProfiles = 0xC020;
  @ChargingManagementExtendedSync_Notification_Message_ID_Method_ID_nextChargingTimers     = 0xC030;
  @ChargingManagementExtendedSync_Notification_Message_ID_Method_ID_preferredChargingTimes = 0xC040;

  @ChargingManagementExtendedSync_SubscribeStatus_estimatedTimesAndInfos = 0;
  @ChargingManagementExtendedSync_SubscribeStatus_activeChargingProfiles = 0;
  @ChargingManagementExtendedSync_SubscribeStatus_nextChargingTimers     = 0;
  @ChargingManagementExtendedSync_SubscribeStatus_preferredChargingTimes = 0;
  
  @ChargingManagementExtendedSync_Notification_estimatedTimesAndInfos_Send_cyclic           = 0;
  @ChargingManagementExtendedSync_Notification_estimatedTimesAndInfos_Send_cyclic_cycletime = 100;
  @ChargingManagementExtendedSync_Notification_activeChargingProfiles_Send_cyclic           = 0;
  @ChargingManagementExtendedSync_Notification_activeChargingProfiles_Send_cyclic_cycletime = 100;
  @ChargingManagementExtendedSync_Notification_nextChargingTimers_Send_cyclic               = 0;
  @ChargingManagementExtendedSync_Notification_nextChargingTimers_Send_cyclic_cycletime     = 100;
  @ChargingManagementExtendedSync_Notification_preferredChargingTimes_Send_cyclic           = 0;
  @ChargingManagementExtendedSync_Notification_preferredChargingTimes_Send_cyclic_cycletime = 100;
  
  for (k=0;k<10;k++)
  {
    ChargingManagementExtendedSync_array_estimatedTimesAndInfos_elementId_available[k]                     = 1;
    ChargingManagementExtendedSync_array_estimatedTimesAndInfos_isExternalServiceAvailable_available[k]    = 1;
    ChargingManagementExtendedSync_array_estimatedTimesAndInfos_isEstimatedStartTimeRelevant_available[k]  = 1;
    ChargingManagementExtendedSync_array_estimatedTimesAndInfos_estimatedStartTimeYear_available[k]        = 1;
    ChargingManagementExtendedSync_array_estimatedTimesAndInfos_estimatedStartTimeMonth_available[k]       = 1;
    ChargingManagementExtendedSync_array_estimatedTimesAndInfos_estimatedStartTimeDay_available[k]         = 1;
    ChargingManagementExtendedSync_array_estimatedTimesAndInfos_estimatedStartTimeHour_available[k]        = 1;
    ChargingManagementExtendedSync_array_estimatedTimesAndInfos_estimatedStartTimeMinute_available[k]      = 1;
    ChargingManagementExtendedSync_array_estimatedTimesAndInfos_isEstimatedFinishTimeRelevant_available[k] = 1;
    ChargingManagementExtendedSync_array_estimatedTimesAndInfos_estimatedFinishTimeYear_available[k]       = 1;
    ChargingManagementExtendedSync_array_estimatedTimesAndInfos_estimatedFinishTimeMonth_available[k]      = 1;
    ChargingManagementExtendedSync_array_estimatedTimesAndInfos_estimatedFinishTimeDay_available[k]        = 1;
    ChargingManagementExtendedSync_array_estimatedTimesAndInfos_estimatedFinishTimeHour_available[k]       = 1;
    ChargingManagementExtendedSync_array_estimatedTimesAndInfos_estimatedFinishTimeMinute_available[k]     = 1;
    ChargingManagementExtendedSync_array_estimatedTimesAndInfos_targetReachable_available[k]               = 1;
    ChargingManagementExtendedSync_array_activeChargingProfiles_elementId_available[k]                     = 1;
    ChargingManagementExtendedSync_array_activeChargingProfiles_isOwnCurrentUsed_available[k]              = 1;
    ChargingManagementExtendedSync_array_activeChargingProfiles_isSmartChargingUsed_available[k]           = 1;
    ChargingManagementExtendedSync_array_activeChargingProfiles_targetSoc_available[k]                     = 1;
    ChargingManagementExtendedSync_array_activeChargingProfiles_targetRange_available[k]                   = 1;
    ChargingManagementExtendedSync_array_activeChargingProfiles_minSoc_available[k]                        = 1;
    ChargingManagementExtendedSync_array_activeChargingProfiles_maxChargeCurrent_available[k]              = 1;
    ChargingManagementExtendedSync_array_activeChargingProfiles_autounlockAc_available[k]                  = 1;
    ChargingManagementExtendedSync_array_activeChargingProfiles_autounlockDc_available[k]                  = 1;
    ChargingManagementExtendedSync_array_nextChargingTimers_elementId_available[k]                         = 1;
    ChargingManagementExtendedSync_array_nextChargingTimers_isActivated_available[k]                       = 1;
    ChargingManagementExtendedSync_array_nextChargingTimers_nextChargingTimerYear_available[k]             = 1;
    ChargingManagementExtendedSync_array_nextChargingTimers_nextChargingTimerMonth_available[k]            = 1;
    ChargingManagementExtendedSync_array_nextChargingTimers_nextChargingTimerDay_available[k]              = 1;
    ChargingManagementExtendedSync_array_nextChargingTimers_nextChargingTimerHour_available[k]             = 1;
    ChargingManagementExtendedSync_array_nextChargingTimers_nextChargingTimerMinute_available[k]           = 1;
    ChargingManagementExtendedSync_array_nextChargingTimers_isClimatingNeeded_available[k]                 = 1;
    ChargingManagementExtendedSync_array_nextChargingTimers_isChargingNeeded_available[k]                  = 1;
    ChargingManagementExtendedSync_array_preferredChargingTimes_elementId_available[k]                     = 1;
    ChargingManagementExtendedSync_array_preferredChargingTimes_isActivated_available[k]                   = 1;
    ChargingManagementExtendedSync_array_preferredChargingTimes_startHour_available[k]                     = 1;
    ChargingManagementExtendedSync_array_preferredChargingTimes_startMinute_available[k]                   = 1;
    ChargingManagementExtendedSync_array_preferredChargingTimes_endHour_available[k]                       = 1;
    ChargingManagementExtendedSync_array_preferredChargingTimes_endMinute_available[k]                     = 1;
  }
  
  
  // Service UnitMaster //
  @UnitMaster_SetGet_Port_Source                                                 = 42810;
  @UnitMaster_SetGet_Port_Destination                                            = 42810;
  @UnitMaster_SetGet_Message_ID_Service_ID                                       = 0x600E;
  @UnitMaster_SetGet_Message_ID_Method_ID                                        = 0; // Platzhalter
  @UnitMaster_SetGet_Length                                                      = 0; // Platzhalter
  @UnitMaster_SetGet_Request_ID_Client_ID                                        = 0;
  @UnitMaster_SetGet_Protocol_Version                                            = 1;
  @UnitMaster_SetGet_Interface_Version                                           = 3;
  @UnitMaster_SetGet_Message_Type                                                = 0; // 0x00 Request
  @UnitMaster_SetGet_Return_Code                                                 = 0;
  
  @UnitMaster_SetGet_Message_ID_Method_ID_units_Get                              = 0x4010;
  @UnitMaster_SetGet_Message_ID_Method_ID_units_Set                              = 0x4011;
  
  @UnitMaster_SetGet_units_Element_TotalNum                                      = 1;
  @UnitMaster_SetGet_units_Element                                               = 0;
  @UnitMaster_SetGet_units_dateFormatConfiguration_Element_TotalNum              = 1;
  @UnitMaster_SetGet_units_dateFormatConfiguration_Element                       = 0;
  @UnitMaster_SetGet_units_distanceUnitConfiguration_Element_TotalNum            = 1;
  @UnitMaster_SetGet_units_distanceUnitConfiguration_Element                     = 0;
  @UnitMaster_SetGet_units_pressureUnitConfiguration_Element_TotalNum            = 1;
  @UnitMaster_SetGet_units_pressureUnitConfiguration_Element                     = 0;
  @UnitMaster_SetGet_units_speedUnitConfiguration_Element_TotalNum               = 1;
  @UnitMaster_SetGet_units_speedUnitConfiguration_Element                        = 0;
  @UnitMaster_SetGet_units_temperatureUnitConfiguration_Element_TotalNum         = 1;
  @UnitMaster_SetGet_units_temperatureUnitConfiguration_Element                  = 0;
  @UnitMaster_SetGet_units_timeFormatConfiguration_Element_TotalNum              = 1;
  @UnitMaster_SetGet_units_timeFormatConfiguration_Element                       = 0;
  @UnitMaster_SetGet_units_volumeUnitConfiguration_Element_TotalNum              = 1;
  @UnitMaster_SetGet_units_volumeUnitConfiguration_Element                       = 0;
  @UnitMaster_SetGet_units_consumptionUnitConfiguration_Element_TotalNum         = 1;
  @UnitMaster_SetGet_units_consumptionUnitConfiguration_Element                  = 0;
  @UnitMaster_SetGet_units_consumptionUnitElectrConfiguration_Element_TotalNum   = 1;
  @UnitMaster_SetGet_units_consumptionUnitElectrConfiguration_Element            = 0;
  @UnitMaster_SetGet_units_consumptionUnitGasConfiguration_Element_TotalNum      = 1;
  @UnitMaster_SetGet_units_consumptionUnitGasConfiguration_Element               = 0;
  @UnitMaster_SetGet_units_massUnitConfiguration_Element_TotalNum                = 1;
  @UnitMaster_SetGet_units_massUnitConfiguration_Element                         = 0;
  
  for (k=0; k<10; k++)
  {
    UnitMaster_array_units_id_available[k]                                       = 0;
    UnitMaster_array_units_name_available[k]                                     = 0;
    UnitMaster_array_units_dateFormat_available[k]                               = 0;
    UnitMaster_array_units_dateFormatConfiguration_available[k]                  = 0;
    UnitMaster_array_units_distanceUnit_available[k]                             = 0;
    UnitMaster_array_units_distanceUnitConfiguration_available[k]                = 0;
    UnitMaster_array_units_pressureUnit_available[k]                             = 0;
    UnitMaster_array_units_pressureUnitConfiguration_available[k]                = 0;
    UnitMaster_array_units_restrictionReason_available[k]                        = 0;
    UnitMaster_array_units_speedUnitTachometer_available[k]                      = 0;
    UnitMaster_array_units_speedUnit_available[k]                                = 0;
    UnitMaster_array_units_speedUnitConfiguration_available[k]                   = 0;
    UnitMaster_array_units_temperatureUnit_available[k]                          = 0;
    UnitMaster_array_units_temperatureUnitConfiguration_available[k]             = 0;
    UnitMaster_array_units_timeFormat_available[k]                               = 0;
    UnitMaster_array_units_timeFormatConfiguration_available[k]                  = 0;
    UnitMaster_array_units_volumeUnit_available[k]                               = 0;
    UnitMaster_array_units_volumeUnitConfiguration_available[k]                  = 0;
    UnitMaster_array_units_consumptionUnit_available[k]                          = 0;
    UnitMaster_array_units_consumptionUnitConfiguration_available[k]             = 0;
    UnitMaster_array_units_consumptionUnitElectr_available[k]                    = 0;
    UnitMaster_array_units_consumptionUnitElectrConfiguration_available[k]       = 0;
    UnitMaster_array_units_consumptionUnitGas_available[k]                       = 0;
    UnitMaster_array_units_consumptionUnitGasConfiguration_available[k]          = 0;
    UnitMaster_array_units_massUnit_available[k]                                 = 0;
    UnitMaster_array_units_massUnitConfiguration_available[k]                    = 0;
    
    UnitMaster_array_units_dateFormatConfiguration_nr_of_elements[k]             = 1;
    UnitMaster_array_units_distanceUnitConfiguration_nr_of_elements[k]           = 1;
    UnitMaster_array_units_pressureUnitConfiguration_nr_of_elements[k]           = 1;
    UnitMaster_array_units_speedUnitConfiguration_nr_of_elements[k]              = 1;
    UnitMaster_array_units_temperatureUnitConfiguration_nr_of_elements[k]        = 1;
    UnitMaster_array_units_timeFormatConfiguration_nr_of_elements[k]             = 1;
    UnitMaster_array_units_volumeUnitConfiguration_nr_of_elements[k]             = 1;
    UnitMaster_array_units_consumptionUnitConfiguration_nr_of_elements[k]        = 1;
    UnitMaster_array_units_consumptionUnitElectrConfiguration_nr_of_elements[k]  = 1;
    UnitMaster_array_units_consumptionUnitGasConfiguration_nr_of_elements[k]     = 1;
    UnitMaster_array_units_massUnitConfiguration_nr_of_elements[k]               = 1;
  }
  
  
  @UnitMaster_Subscribe_units                                                    = 0;
  
  if (getvaluesize(UnitMaster_SetGet_units_name)-1>=0)
    putvalue(UnitMaster_SetGet_units_name, "name");
  
  getvalue (UnitMaster_SetGet_units_name, buffer_char);
  for (j=0; j<10; j++)
  {
    for (k=0; k<getvaluesize(UnitMaster_SetGet_units_name)-1; k++)
      UnitMaster_array_units_name[j][k] = buffer_char[k];
  }
  
  
  // Service DisplaySpeed //
  @DisplaySpeed_SetGet_Port_Source                                               = 42810;
  @DisplaySpeed_SetGet_Port_Destination                                          = 42810;
  @DisplaySpeed_SetGet_Message_ID_Service_ID                                     = 0x6021;
  @DisplaySpeed_SetGet_Message_ID_Method_ID                                      = 0; // Platzhalter
  @DisplaySpeed_SetGet_Length                                                    = 0; // Platzhalter
  @DisplaySpeed_SetGet_Request_ID_Client_ID                                      = 0;
  @DisplaySpeed_SetGet_Protocol_Version                                          = 1;
  @DisplaySpeed_SetGet_Interface_Version                                         = 4;
  @DisplaySpeed_SetGet_Message_Type                                              = 0; // 0x00 Request
  @DisplaySpeed_SetGet_Return_Code                                               = 0;
  
  @DisplaySpeed_SetGet_Message_ID_Method_ID_speeds_Get                           = 0x4010;
  @DisplaySpeed_SetGet_Message_ID_Method_ID_speedWarnings_Get                    = 0x4020;
  @DisplaySpeed_SetGet_Message_ID_Method_ID_speedWarnings_Set                    = 0x4021;
  @DisplaySpeed_SetGet_Message_ID_Method_ID_speedBlockings_Get                   = 0x4030;
  
  @DisplaySpeed_SetGet_speeds_Element_TotalNum                                   = 1;
  @DisplaySpeed_SetGet_speeds_Element                                            = 0;
  @DisplaySpeed_SetGet_speedWarnings_Element_TotalNum                            = 1;
  @DisplaySpeed_SetGet_speedWarnings_Element                                     = 0;
  @DisplaySpeed_SetGet_speedBlockings_Element_TotalNum                           = 1;
  @DisplaySpeed_SetGet_speedBlockings_Element                                    = 0;
  
  for (k=0; k<10; k++)
  {
    DisplaySpeed_array_speeds_type_available[k]                                  = 0;
    DisplaySpeed_array_speeds_currentValue_available[k]                          = 0;
    DisplaySpeed_array_speeds_restrictionReason_available[k]                     = 0;
    DisplaySpeed_array_speeds_unit_available[k]                                  = 0;
    DisplaySpeed_array_speeds_isDisplayActivated_available[k]                    = 0;
    DisplaySpeed_array_speeds_maxValue_available[k]                              = 0;
    DisplaySpeed_array_speeds_minValue_available[k]                              = 0;
    DisplaySpeed_array_speeds_resolution_available[k]                            = 0;
    DisplaySpeed_array_speedWarnings_type_available[k]                           = 0;
    DisplaySpeed_array_speedWarnings_isActivated_available[k]                    = 0;
    DisplaySpeed_array_speedWarnings_threshold_available[k]                      = 0;
    DisplaySpeed_array_speedWarnings_unit_available[k]                           = 0;
    DisplaySpeed_array_speedWarnings_restrictionReason_available[k]              = 0;
    DisplaySpeed_array_speedWarnings_maxValue_available[k]                       = 0;
    DisplaySpeed_array_speedWarnings_minValue_available[k]                       = 0;
    DisplaySpeed_array_speedWarnings_resolution_available[k]                     = 0;
    DisplaySpeed_array_speedBlockings_type_available[k]                          = 0;
    DisplaySpeed_array_speedBlockings_isActivated_available[k]                   = 0;
    DisplaySpeed_array_speedBlockings_isCodedStrict_available[k]                 = 0;
    DisplaySpeed_array_speedBlockings_threshold_available[k]                     = 0;
    DisplaySpeed_array_speedBlockings_unit_available[k]                          = 0;
    DisplaySpeed_array_speedBlockings_restrictionReason_available[k]             = 0;
  }
  
  
  // Service Temperature //
  @Temperature_SetGet_Port_Source                                                = 42810;
  @Temperature_SetGet_Port_Destination                                           = 42810;
  @Temperature_SetGet_Message_ID_Service_ID                                      = 0x6034;
  @Temperature_SetGet_Message_ID_Method_ID                                       = 0; // Platzhalter
  @Temperature_SetGet_Length                                                     = 0; // Platzhalter
  @Temperature_SetGet_Request_ID_Client_ID                                       = 0;
  @Temperature_SetGet_Protocol_Version                                           = 1;
  @Temperature_SetGet_Interface_Version                                          = 2;
  @Temperature_SetGet_Message_Type                                               = 0; // 0x00 Request
  @Temperature_SetGet_Return_Code                                                = 0;
  
  @Temperature_SetGet_Message_ID_Method_ID_temperatures_Get                      = 0x4010;
  @Temperature_SetGet_Message_ID_Method_ID_temperatureWarnings_Get               = 0x4020;
  
  @Temperature_SetGet_temperatures_Element_TotalNum                              = 1;
  @Temperature_SetGet_temperatures_Element                                       = 0;
  @Temperature_SetGet_temperatureWarnings_Element_TotalNum                       = 1;
  @Temperature_SetGet_temperatureWarnings_Element                                = 0;
  
  for (k=0; k<10; k++)
  {
    Temperature_array_temperatures_type_available[k]                             = 0;
    Temperature_array_temperatures_currentValue_available[k]                     = 0;
    Temperature_array_temperatures_restrictionReason_available[k]                = 0;
    Temperature_array_temperatures_unit_available[k]                             = 0;
    Temperature_array_temperatures_minValue_available[k]                         = 0;
    Temperature_array_temperatures_maxValue_available[k]                         = 0;
    Temperature_array_temperatures_resolution_available[k]                       = 0;
    Temperature_array_temperatures_isValueInvalid_available[k]                   = 0;
    Temperature_array_temperatureWarnings_type_available[k]                      = 0;
    Temperature_array_temperatureWarnings_temperature_available[k]               = 0;
    Temperature_array_temperatureWarnings_isToBeNotified_available[k]            = 0;
  }
  
  
  // Service DrivingStatistics //
  @DrivingStatistics_SetGet_Port_Source                                          = 42810;
  @DrivingStatistics_SetGet_Port_Destination                                     = 42810;
  @DrivingStatistics_SetGet_Message_ID_Service_ID                                = 0x6035;
  @DrivingStatistics_SetGet_Message_ID_Method_ID                                 = 0; // Platzhalter
  @DrivingStatistics_SetGet_Length                                               = 0; // Platzhalter
  @DrivingStatistics_SetGet_Request_ID_Client_ID                                 = 0;
  @DrivingStatistics_SetGet_Protocol_Version                                     = 1;
  @DrivingStatistics_SetGet_Interface_Version                                    = 3;
  @DrivingStatistics_SetGet_Message_Type                                         = 0; // 0x00 Request
  @DrivingStatistics_SetGet_Return_Code                                          = 0;
  
  @DrivingStatistics_SetGet_Message_ID_Method_ID_speeds_Get                      = 0x4010;
  @DrivingStatistics_SetGet_Message_ID_Method_ID_speeds_Set                      = 0x4011;
  @DrivingStatistics_SetGet_Message_ID_Method_ID_distances_Get                   = 0x4020;
  @DrivingStatistics_SetGet_Message_ID_Method_ID_distances_Set                   = 0x4021;
  @DrivingStatistics_SetGet_Message_ID_Method_ID_durations_Get                   = 0x4030;
  @DrivingStatistics_SetGet_Message_ID_Method_ID_durations_Set                   = 0x4031;
  
  @DrivingStatistics_SetGet_speeds_Element_TotalNum                              = 1;
  @DrivingStatistics_SetGet_speeds_Element                                       = 0;
  @DrivingStatistics_SetGet_distances_Element_TotalNum                           = 1;
  @DrivingStatistics_SetGet_distances_Element                                    = 0;
  @DrivingStatistics_SetGet_durations_Element_TotalNum                           = 1;
  @DrivingStatistics_SetGet_durations_Element                                    = 0;
  
  for (k=0; k<10; k++)
  {
    DrivingStatistics_array_speeds_memoryLevel_available[k]                      = 0;
    DrivingStatistics_array_speeds_currentValue_available[k]                     = 0;
    DrivingStatistics_array_speeds_state_available[k]                            = 0;
    DrivingStatistics_array_distances_memoryLevel_available[k]                   = 0;
    DrivingStatistics_array_distances_currentValue_available[k]                  = 0;
    DrivingStatistics_array_distances_state_available[k]                         = 0;
    DrivingStatistics_array_durations_memoryLevel_available[k]                   = 0;
    DrivingStatistics_array_durations_currentValue_available[k]                  = 0;
    DrivingStatistics_array_durations_state_available[k]                         = 0;
  }
  
  
  // Service DiagnosticNotification //
  @DiagnosticNotification_SetGet_Port_Source                                     = 42810;
  @DiagnosticNotification_SetGet_Port_Destination                                = 42810;
  @DiagnosticNotification_SetGet_Message_ID_Service_ID                           = 0x6046;
  @DiagnosticNotification_SetGet_Message_ID_Method_ID                            = 0; // Platzhalter
  @DiagnosticNotification_SetGet_Length                                          = 0; // Platzhalter
  @DiagnosticNotification_SetGet_Request_ID_Client_ID                            = 0;
  @DiagnosticNotification_SetGet_Protocol_Version                                = 1;
  @DiagnosticNotification_SetGet_Interface_Version                               = 1;
  @DiagnosticNotification_SetGet_Message_Type                                    = 0; // 0x00 Request
  @DiagnosticNotification_SetGet_Return_Code                                     = 0;
  
  @DiagnosticNotification_SetGet_notifications_Element_TotalNum                  = 1;
  @DiagnosticNotification_SetGet_notifications_Element                           = 0;
  
  for (k=0; k<10; k++)
  {
    DiagnosticNotification_array_notifications_listId_available[k]               = 0;
    DiagnosticNotification_array_notifications_notificationIds_available[k]      = 0;
    
    DiagnosticNotification_array_notifications_notificationIds_nr_of_elements[k] = 1;
  }

  
  
  
  
  @ServiceDiscovery_Offer_Service_Time                                             = 1;
  @ServiceDiscovery_Offer_Service_Distance                                         = 1;
  @ServiceDiscovery_Offer_Service_Odometry                                         = 1;
  @ServiceDiscovery_Offer_Service_ChargingManagementCore                           = 1;
  @ServiceDiscovery_Offer_Service_ChargingManagementExtendedSync                   = 1;
  @ServiceDiscovery_Find_Service_UnitMaster                                        = 0;
  @ServiceDiscovery_Find_Service_DisplaySpeed                                      = 0;
  @ServiceDiscovery_Find_Service_Temperature                                       = 0;
  @ServiceDiscovery_Find_Service_DrivingStatistics                                 = 0;
  @ServiceDiscovery_Find_Service_DiagnosticNotification                            = 0;
  number_of_offered_services_by_ICAS1Gateway                                       = 0;
  number_of_offered_services_by_ICAS1Sys01                                         = 0;
  number_of_offered_services_by_ICAS3IVI                                           = 0;
  
  //setTimerCyclic(tSend_ServiceDiscovery_Subscribe_ICAS1Sys02,1000);
  ChargingManagementCore_Notification_chargingPlugs_update();
  
  callAllOnEnvVar();
}

on envVar Send_ServiceDiscovery_Offer
{
  if (@this == 1)
  {
    settimercyclic (tSend_ServiceDiscovery_Offer_ICAS1Gateway, @Send_ServiceDiscovery_Offer_Time);
    settimercyclic (tSend_ServiceDiscovery_Offer_ICAS1Sys01,   @Send_ServiceDiscovery_Offer_Time);
    settimercyclic (tSend_ServiceDiscovery_Offer_ICAS3IVI,     @Send_ServiceDiscovery_Offer_Time);
  }
  else
  {
    canceltimer (tSend_ServiceDiscovery_Offer_ICAS1Gateway);
    canceltimer (tSend_ServiceDiscovery_Offer_ICAS1Sys01);
    canceltimer (tSend_ServiceDiscovery_Offer_ICAS3IVI);
  }
}

on timer tSend_ServiceDiscovery_Offer_ICAS1Gateway
{
  Send_ServiceDiscovery_Offer_Service_ICAS1Gateway();
}

Send_ServiceDiscovery_Offer_Service_ICAS1Gateway()
{
  ethernetPacket EthPaket;
  
  number_of_offered_services_by_ICAS1Gateway = @ServiceDiscovery_Offer_Service_Odometry
                                             + @ServiceDiscovery_Offer_Service_ChargingManagementCore;
  
  if (@Env_GlobalAppl == 1 && number_of_offered_services_by_ICAS1Gateway > 0)
  {
    if ((@ServiceDiscovery_SOMEIPPacket_Offer_ICAS1Gateway_Entries_Array_Element > 0) && (@ServiceDiscovery_SOMEIPPacket_Offer_ICAS1Gateway_Entries_Array_Element >= number_of_offered_services_by_ICAS1Gateway))
      @ServiceDiscovery_SOMEIPPacket_Offer_ICAS1Gateway_Entries_Array_Element = number_of_offered_services_by_ICAS1Gateway-1;
    
    // Ethernet Packet - MAC Source address
    getvalue (ServiceDiscovery_EthernetPacket_MAC_Source_ICAS1Gateway, buffer_MAC);
    //EthPaket.source.ParseAddress ( buffer_MAC );
    EthPaket.source = ethGetMacAddressAsNumber (buffer_MAC);
    
    // Ethernet Packet - MAC Destination address
    getvalue (ServiceDiscovery_EthernetPacket_MAC_Destination, buffer_MAC);
    //EthPaket.destination.ParseAddress ( buffer_MAC );
    EthPaket.destination = ethGetMacAddressAsNumber (buffer_MAC);
    
    // Ethernet Packet - VLAN
    EthPaket.SetVlan (@ServiceDiscovery_EthernetPacket_VLAN_TPID, @ServiceDiscovery_EthernetPacket_VLAN_TCI);
    
    // Ethernet Packet - Type
    //EthPaket.ipv6.type = @EthernetPacket_Type;
    if (@ServiceDiscovery_EthernetPacket_Type == 0x86DD) EthPaket.ipv6.Init();
    
    
    // IPv6 Packet - Version
    EthPaket.ipv6.version = @ServiceDiscovery_IPv6Packet_Version;

    // IPv6 Packet - Traffic Class
    EthPaket.ipv6.class = @ServiceDiscovery_IPv6Packet_Traffic_Class;
    
    // IPv6 Packet - Flow Label
    EthPaket.ipv6.flow = @ServiceDiscovery_IPv6Packet_Flow_Label;
    
    // IPv6 Packet - Payload_Length
    EthPaket.ipv6.length = @ServiceDiscovery_IPv6Packet_Payload_Length;
    
    // IPv6 Packet - Next Header
    EthPaket.ipv6.next = @ServiceDiscovery_IPv6Packet_Next_Header;
    if (@ServiceDiscovery_IPv6Packet_Next_Header == 6) EthPaket.tcp.Init();
    if (@ServiceDiscovery_IPv6Packet_Next_Header == 17) EthPaket.udp.Init();
    
    // IPv6 Packet - Hop Limit
    EthPaket.ipv6.hopLimit = @ServiceDiscovery_IPv6Packet_Hop_Limit;

    // IPv6 Packet - IPv6 Destination address    // TODO: char array zu byte array
    buffer_ipv6[0]  = @ServiceDiscovery_IPv6Packet_IP_Destination_Multicast_01>>8 & 0xFF;
    buffer_ipv6[1]  = @ServiceDiscovery_IPv6Packet_IP_Destination_Multicast_01    & 0xFF;
    buffer_ipv6[2]  = @ServiceDiscovery_IPv6Packet_IP_Destination_Multicast_02>>8 & 0xFF;
    buffer_ipv6[3]  = @ServiceDiscovery_IPv6Packet_IP_Destination_Multicast_02    & 0xFF;
    buffer_ipv6[4]  = @ServiceDiscovery_IPv6Packet_IP_Destination_Multicast_03>>8 & 0xFF;
    buffer_ipv6[5]  = @ServiceDiscovery_IPv6Packet_IP_Destination_Multicast_03    & 0xFF;
    buffer_ipv6[6]  = @ServiceDiscovery_IPv6Packet_IP_Destination_Multicast_04>>8 & 0xFF;
    buffer_ipv6[7]  = @ServiceDiscovery_IPv6Packet_IP_Destination_Multicast_04    & 0xFF;
    buffer_ipv6[8]  = @ServiceDiscovery_IPv6Packet_IP_Destination_Multicast_05>>8 & 0xFF;
    buffer_ipv6[9]  = @ServiceDiscovery_IPv6Packet_IP_Destination_Multicast_05    & 0xFF;
    buffer_ipv6[10] = @ServiceDiscovery_IPv6Packet_IP_Destination_Multicast_06>>8 & 0xFF;
    buffer_ipv6[11] = @ServiceDiscovery_IPv6Packet_IP_Destination_Multicast_06    & 0xFF;
    buffer_ipv6[12] = @ServiceDiscovery_IPv6Packet_IP_Destination_Multicast_07>>8 & 0xFF;
    buffer_ipv6[13] = @ServiceDiscovery_IPv6Packet_IP_Destination_Multicast_07    & 0xFF;
    buffer_ipv6[14] = @ServiceDiscovery_IPv6Packet_IP_Destination_Multicast_08>>8 & 0xFF;
    buffer_ipv6[15] = @ServiceDiscovery_IPv6Packet_IP_Destination_Multicast_08    & 0xFF;
    EthPaket.ipv6.destination.SetData ( 0, buffer_ipv6, elcount(buffer_ipv6) );

    // IPv6 Packet - IPv6 Source address    // TODO: char array zu byte array
    buffer_ipv6[0]  = @ServiceDiscovery_IPv6Packet_IP_Source_ICAS1Gateway_01>>8 & 0xFF;
    buffer_ipv6[1]  = @ServiceDiscovery_IPv6Packet_IP_Source_ICAS1Gateway_01    & 0xFF;
    buffer_ipv6[2]  = @ServiceDiscovery_IPv6Packet_IP_Source_ICAS1Gateway_02>>8 & 0xFF;
    buffer_ipv6[3]  = @ServiceDiscovery_IPv6Packet_IP_Source_ICAS1Gateway_02    & 0xFF;
    buffer_ipv6[4]  = @ServiceDiscovery_IPv6Packet_IP_Source_ICAS1Gateway_03>>8 & 0xFF;
    buffer_ipv6[5]  = @ServiceDiscovery_IPv6Packet_IP_Source_ICAS1Gateway_03    & 0xFF;
    buffer_ipv6[6]  = @ServiceDiscovery_IPv6Packet_IP_Source_ICAS1Gateway_04>>8 & 0xFF;
    buffer_ipv6[7]  = @ServiceDiscovery_IPv6Packet_IP_Source_ICAS1Gateway_04    & 0xFF;
    buffer_ipv6[8]  = @ServiceDiscovery_IPv6Packet_IP_Source_ICAS1Gateway_05>>8 & 0xFF;
    buffer_ipv6[9]  = @ServiceDiscovery_IPv6Packet_IP_Source_ICAS1Gateway_05    & 0xFF;
    buffer_ipv6[10] = @ServiceDiscovery_IPv6Packet_IP_Source_ICAS1Gateway_06>>8 & 0xFF;
    buffer_ipv6[11] = @ServiceDiscovery_IPv6Packet_IP_Source_ICAS1Gateway_06    & 0xFF;
    buffer_ipv6[12] = @ServiceDiscovery_IPv6Packet_IP_Source_ICAS1Gateway_07>>8 & 0xFF;
    buffer_ipv6[13] = @ServiceDiscovery_IPv6Packet_IP_Source_ICAS1Gateway_07    & 0xFF;
    buffer_ipv6[14] = @ServiceDiscovery_IPv6Packet_IP_Source_ICAS1Gateway_08>>8 & 0xFF;
    buffer_ipv6[15] = @ServiceDiscovery_IPv6Packet_IP_Source_ICAS1Gateway_08    & 0xFF;
    EthPaket.ipv6.source.SetData ( 0, buffer_ipv6, elcount(buffer_ipv6) );

    
    // UDP Packet - Source Port
    EthPaket.udp.source = @ServiceDiscovery_UDPPacket_Port_Source;
    
    // UDP Packet - Destination Port
    EthPaket.udp.destination = @ServiceDiscovery_UDPPacket_Port_Destination;
    
    // UDP Packet - Length
    EthPaket.udp.length = @ServiceDiscovery_UDPPacket_Length;
    
    
    // SOME/IP Packet aus Rohdaten zusammenbauen (buffer array)
    i=0;
    
    // SOME/IP Packet - Message ID, Service ID [16 bit]
    buffer[i++] = @ServiceDiscovery_SOMEIPPacket_Offer_ICAS1Gateway_Message_ID_Service_ID>>8 & 0xFF;
    buffer[i++] = @ServiceDiscovery_SOMEIPPacket_Offer_ICAS1Gateway_Message_ID_Service_ID    & 0xFF;
    
    // SOME/IP Packet - Message ID, Message ID [16 bit]
    buffer[i++] = @ServiceDiscovery_SOMEIPPacket_Offer_ICAS1Gateway_Message_ID_Method_ID>>8 & 0xFF;
    buffer[i++] = @ServiceDiscovery_SOMEIPPacket_Offer_ICAS1Gateway_Message_ID_Method_ID    & 0xFF;
    
    // SOME/IP Packet - Length [32 bit]
    @ServiceDiscovery_SOMEIPPacket_Offer_ICAS1Gateway_Length = 16 + (16 * number_of_offered_services_by_ICAS1Gateway) + 4 + @ServiceDiscovery_SOMEIPPacket_Offer_ICAS1Gateway_Options_Array_On_Off * 24;
    buffer[i++] = @ServiceDiscovery_SOMEIPPacket_Offer_ICAS1Gateway_Length>>24 & 0xFF;
    buffer[i++] = @ServiceDiscovery_SOMEIPPacket_Offer_ICAS1Gateway_Length>>16 & 0xFF;
    buffer[i++] = @ServiceDiscovery_SOMEIPPacket_Offer_ICAS1Gateway_Length>> 8 & 0xFF;
    buffer[i++] = @ServiceDiscovery_SOMEIPPacket_Offer_ICAS1Gateway_Length     & 0xFF;
    
    // SOME/IP Packet - Request ID, Client ID [16 bit]
    buffer[i++] = @ServiceDiscovery_SOMEIPPacket_Offer_ICAS1Gateway_Request_ID_Client_ID>>8 & 0xFF;
    buffer[i++] = @ServiceDiscovery_SOMEIPPacket_Offer_ICAS1Gateway_Request_ID_Client_ID    & 0xFF;
    
    // SOME/IP Packet - Request ID, Session ID) [16 bit]
    @ServiceDiscovery_SOMEIPPacket_Request_ID_Session_ID = @ServiceDiscovery_SOMEIPPacket_Request_ID_Session_ID + 1;
    if (@ServiceDiscovery_SOMEIPPacket_Request_ID_Session_ID == 0x1000) @ServiceDiscovery_SOMEIPPacket_Request_ID_Session_ID = 1;
    
    buffer[i++] = @ServiceDiscovery_SOMEIPPacket_Request_ID_Session_ID>>8 & 0xFF;
    buffer[i++] = @ServiceDiscovery_SOMEIPPacket_Request_ID_Session_ID    & 0xFF;
    
    // SOME/IP Packet - Protocol Version [8 bit]
    buffer[i++] = @ServiceDiscovery_SOMEIPPacket_Offer_ICAS1Gateway_Protocol_Version;
    
    // SOME/IP Packet - Interface Version [8 bit]
    buffer[i++] = @ServiceDiscovery_SOMEIPPacket_Offer_ICAS1Gateway_Interface_Version;

    // SOME/IP Packet - Message Type [8 bit]
    buffer[i++] = @ServiceDiscovery_SOMEIPPacket_Offer_ICAS1Gateway_Message_Type;
      
    // SOME/IP Packet - Return Code [8 bit]
    buffer[i++] = @ServiceDiscovery_SOMEIPPacket_Offer_ICAS1Gateway_Return_Code;
    
    // SOME/IP Packet - Flags [8 bit]
    buffer[i++] = @ServiceDiscovery_SOMEIPPacket_Offer_ICAS1Gateway_Flags;
    
    // SOME/IP Packet - Reserved [24 bit]
    buffer[i++] = 0x00;
    buffer[i++] = 0x00;
    buffer[i++] = 0x00;
    
    
    // SOME/IP Packet - Entries Array
    
    // SOME/IP Packet - Entries Array - Length [32 bit]
    @ServiceDiscovery_SOMEIPPacket_Offer_ICAS1Gateway_Entries_Array_Length = 16 * number_of_offered_services_by_ICAS1Gateway;
    buffer[i++] = @ServiceDiscovery_SOMEIPPacket_Offer_ICAS1Gateway_Entries_Array_Length>>24 & 0xFF;
    buffer[i++] = @ServiceDiscovery_SOMEIPPacket_Offer_ICAS1Gateway_Entries_Array_Length>>16 & 0xFF;
    buffer[i++] = @ServiceDiscovery_SOMEIPPacket_Offer_ICAS1Gateway_Entries_Array_Length>> 8 & 0xFF;
    buffer[i++] = @ServiceDiscovery_SOMEIPPacket_Offer_ICAS1Gateway_Entries_Array_Length     & 0xFF;
    
    service_counter = 0;
      
    if (@ServiceDiscovery_Offer_Service_Odometry == 1 && service_counter < number_of_offered_services_by_ICAS1Gateway)
    {
      servicediscovery_offer_ICAS1Gateway_entries_array_type[service_counter]                 = 1; // Offer
      servicediscovery_offer_ICAS1Gateway_entries_array_index_1st_options[service_counter]    = 0;
      servicediscovery_offer_ICAS1Gateway_entries_array_index_2nd_options[service_counter]    = 0;
      servicediscovery_offer_ICAS1Gateway_entries_array_nr_of_opt_1[service_counter]          = @ServiceDiscovery_SOMEIPPacket_Offer_ICAS1Gateway_Options_Array_On_Off;
      servicediscovery_offer_ICAS1Gateway_entries_array_nr_of_opt_2[service_counter]          = 0;
      servicediscovery_offer_ICAS1Gateway_entries_array_service_id[service_counter]           = 0x6017;
      servicediscovery_offer_ICAS1Gateway_entries_array_instance_id[service_counter]          = 1;
      servicediscovery_offer_ICAS1Gateway_entries_array_major_version[service_counter]        = 3;
      servicediscovery_offer_ICAS1Gateway_entries_array_ttl[service_counter]                  = 5;
      servicediscovery_offer_ICAS1Gateway_entries_array_minor_version[service_counter]        = 0;

      service_counter++;
    }
    
    if (@ServiceDiscovery_Offer_Service_ChargingManagementCore == 1 && service_counter < number_of_offered_services_by_ICAS1Gateway)
    {
      servicediscovery_offer_ICAS1Gateway_entries_array_type[service_counter]                 = 1; // Offer
      servicediscovery_offer_ICAS1Gateway_entries_array_index_1st_options[service_counter]    = 0;
      servicediscovery_offer_ICAS1Gateway_entries_array_index_2nd_options[service_counter]    = 0;
      servicediscovery_offer_ICAS1Gateway_entries_array_nr_of_opt_1[service_counter]          = @ServiceDiscovery_SOMEIPPacket_Offer_ICAS1Gateway_Options_Array_On_Off;
      servicediscovery_offer_ICAS1Gateway_entries_array_nr_of_opt_2[service_counter]          = 0;
      servicediscovery_offer_ICAS1Gateway_entries_array_service_id[service_counter]           = 0x6068;
      servicediscovery_offer_ICAS1Gateway_entries_array_instance_id[service_counter]          = 1;
      servicediscovery_offer_ICAS1Gateway_entries_array_major_version[service_counter]        = 2;
      servicediscovery_offer_ICAS1Gateway_entries_array_ttl[service_counter]                  = 5;
      servicediscovery_offer_ICAS1Gateway_entries_array_minor_version[service_counter]        = 0;

      service_counter++;
    }
    
    if (number_of_offered_services_by_ICAS1Gateway == 0)
    {
      servicediscovery_offer_ICAS1Gateway_entries_array_type[service_counter]                 = 0;
      servicediscovery_offer_ICAS1Gateway_entries_array_index_1st_options[service_counter]    = 0;
      servicediscovery_offer_ICAS1Gateway_entries_array_index_2nd_options[service_counter]    = 0;
      servicediscovery_offer_ICAS1Gateway_entries_array_nr_of_opt_1[service_counter]          = 0;
      servicediscovery_offer_ICAS1Gateway_entries_array_nr_of_opt_2[service_counter]          = 0;
      servicediscovery_offer_ICAS1Gateway_entries_array_service_id[service_counter]           = 0;
      servicediscovery_offer_ICAS1Gateway_entries_array_instance_id[service_counter]          = 0;
      servicediscovery_offer_ICAS1Gateway_entries_array_major_version[service_counter]        = 0;
      servicediscovery_offer_ICAS1Gateway_entries_array_ttl[service_counter]                  = 0;
      servicediscovery_offer_ICAS1Gateway_entries_array_minor_version[service_counter]        = 0;
    }
      
    for (j = 0; j < number_of_offered_services_by_ICAS1Gateway; j++)
    {
      // SOME/IP Packet - Entries Array - Type [8 bit]
      buffer[i++] = servicediscovery_offer_ICAS1Gateway_entries_array_type[j];
      
      // SOME/IP Packet - Entries Array - Index 1st options [8 bit]
      buffer[i++] = servicediscovery_offer_ICAS1Gateway_entries_array_index_1st_options[j];
      
      // SOME/IP Packet - Entries Array - Index 2nd options [8 bit]
      buffer[i++] = servicediscovery_offer_ICAS1Gateway_entries_array_index_2nd_options[j];
      
      // SOME/IP Packet - Entries Array - # of opt 1 [4 bit] / # of opt 2 [4 bit]
      buffer[i++] = (((servicediscovery_offer_ICAS1Gateway_entries_array_nr_of_opt_1[j]*16)) + (servicediscovery_offer_ICAS1Gateway_entries_array_nr_of_opt_2[j]));
      
      // SOME/IP Packet - Entries Array - Service ID [16 bit]
      buffer[i++] = servicediscovery_offer_ICAS1Gateway_entries_array_service_id[j]>> 8 & 0xFF;
      buffer[i++] = servicediscovery_offer_ICAS1Gateway_entries_array_service_id[j]     & 0xFF;

      // SOME/IP Packet - Entries Array - Instance ID [16 bit]
      buffer[i++] = servicediscovery_offer_ICAS1Gateway_entries_array_instance_id[j]>> 8 & 0xFF;
      buffer[i++] = servicediscovery_offer_ICAS1Gateway_entries_array_instance_id[j]     & 0xFF;
      
      // SOME/IP Packet - Entries Array - Major Version [8 bit]
      buffer[i++] = servicediscovery_offer_ICAS1Gateway_entries_array_major_version[j];
      
      // SOME/IP Packet - Entries Array - TTL [24 bit]
      buffer[i++] = servicediscovery_offer_ICAS1Gateway_entries_array_ttl[j]>>16 & 0xFF;
      buffer[i++] = servicediscovery_offer_ICAS1Gateway_entries_array_ttl[j]>> 8 & 0xFF;
      buffer[i++] = servicediscovery_offer_ICAS1Gateway_entries_array_ttl[j]     & 0xFF;
      
      // SOME/IP Packet - Entries Array - Minor Version [32 bit]
      buffer[i++] = servicediscovery_offer_ICAS1Gateway_entries_array_minor_version[j]>>24 & 0xFF;
      buffer[i++] = servicediscovery_offer_ICAS1Gateway_entries_array_minor_version[j]>>16 & 0xFF;
      buffer[i++] = servicediscovery_offer_ICAS1Gateway_entries_array_minor_version[j]>> 8 & 0xFF;
      buffer[i++] = servicediscovery_offer_ICAS1Gateway_entries_array_minor_version[j]     & 0xFF;
    }
    
    //SOME/IP Packet - Options Array - Length [32 bit]
    buffer[i++] = @ServiceDiscovery_SOMEIPPacket_Offer_ICAS1Gateway_Options_Array_Length>>24 & 0xFF;
    buffer[i++] = @ServiceDiscovery_SOMEIPPacket_Offer_ICAS1Gateway_Options_Array_Length>>16 & 0xFF;
    buffer[i++] = @ServiceDiscovery_SOMEIPPacket_Offer_ICAS1Gateway_Options_Array_Length>> 8 & 0xFF;
    buffer[i++] = @ServiceDiscovery_SOMEIPPacket_Offer_ICAS1Gateway_Options_Array_Length     & 0xFF;
    
    if (@ServiceDiscovery_SOMEIPPacket_Offer_ICAS1Gateway_Options_Array_On_Off == 1)
    {
      //SOME/IP Packet - Options Array - Option1 Length [16 bit]
      buffer[i++] = @ServiceDiscovery_SOMEIPPacket_Offer_ICAS1Gateway_Options_Array_Option1_Length>> 8 & 0xFF;
      buffer[i++] = @ServiceDiscovery_SOMEIPPacket_Offer_ICAS1Gateway_Options_Array_Option1_Length     & 0xFF;
      
      //SOME/IP Packet - Options Array - Option1 Type [8 bit]
      buffer[i++] = @ServiceDiscovery_SOMEIPPacket_Offer_ICAS1Gateway_Options_Array_Option1_Type & 0xFF;
      
      //SOME/IP Packet - Options Array - Reserved [8 bit]
      buffer[i++] = 0x00;
      
      //SOME/IP Packet - Options Array - Option1 IPv6 Address
      buffer[i++] = @ServiceDiscovery_SOMEIPPacket_Offer_ICAS1Gateway_Options_Array_Option1_IPv6_01>>8 & 0xFF;
      buffer[i++] = @ServiceDiscovery_SOMEIPPacket_Offer_ICAS1Gateway_Options_Array_Option1_IPv6_01    & 0xFF;
      buffer[i++] = @ServiceDiscovery_SOMEIPPacket_Offer_ICAS1Gateway_Options_Array_Option1_IPv6_02>>8 & 0xFF;
      buffer[i++] = @ServiceDiscovery_SOMEIPPacket_Offer_ICAS1Gateway_Options_Array_Option1_IPv6_02    & 0xFF;
      buffer[i++] = @ServiceDiscovery_SOMEIPPacket_Offer_ICAS1Gateway_Options_Array_Option1_IPv6_03>>8 & 0xFF;
      buffer[i++] = @ServiceDiscovery_SOMEIPPacket_Offer_ICAS1Gateway_Options_Array_Option1_IPv6_03    & 0xFF;
      buffer[i++] = @ServiceDiscovery_SOMEIPPacket_Offer_ICAS1Gateway_Options_Array_Option1_IPv6_04>>8 & 0xFF;
      buffer[i++] = @ServiceDiscovery_SOMEIPPacket_Offer_ICAS1Gateway_Options_Array_Option1_IPv6_04    & 0xFF;
      buffer[i++] = @ServiceDiscovery_SOMEIPPacket_Offer_ICAS1Gateway_Options_Array_Option1_IPv6_05>>8 & 0xFF;
      buffer[i++] = @ServiceDiscovery_SOMEIPPacket_Offer_ICAS1Gateway_Options_Array_Option1_IPv6_05    & 0xFF;
      buffer[i++] = @ServiceDiscovery_SOMEIPPacket_Offer_ICAS1Gateway_Options_Array_Option1_IPv6_06>>8 & 0xFF;
      buffer[i++] = @ServiceDiscovery_SOMEIPPacket_Offer_ICAS1Gateway_Options_Array_Option1_IPv6_06    & 0xFF;
      buffer[i++] = @ServiceDiscovery_SOMEIPPacket_Offer_ICAS1Gateway_Options_Array_Option1_IPv6_07>>8 & 0xFF;
      buffer[i++] = @ServiceDiscovery_SOMEIPPacket_Offer_ICAS1Gateway_Options_Array_Option1_IPv6_07    & 0xFF;
      buffer[i++] = @ServiceDiscovery_SOMEIPPacket_Offer_ICAS1Gateway_Options_Array_Option1_IPv6_08>>8 & 0xFF;
      buffer[i++] = @ServiceDiscovery_SOMEIPPacket_Offer_ICAS1Gateway_Options_Array_Option1_IPv6_08    & 0xFF;
      
      //SOME/IP Packet - Options Array - Reserved [8 bit]
      buffer[i++] = 0x00;
      
      //SOME/IP Packet - Options Array - Option1 L4-Proto [8 bit]
      buffer[i++] = @ServiceDiscovery_SOMEIPPacket_Offer_ICAS1Gateway_Options_Array_Option1_L4_Proto;
      
      //SOME/IP Packet - Options Array - Option1 Port Number [16 bit]
      buffer[i++] = @ServiceDiscovery_SOMEIPPacket_Offer_ICAS1Gateway_Options_Array_Option1_Port_Number>> 8 & 0xFF;
      buffer[i++] = @ServiceDiscovery_SOMEIPPacket_Offer_ICAS1Gateway_Options_Array_Option1_Port_Number     & 0xFF;
    }
    
    ServiceDiscovery_SOMEIPPacket_Offer_ICAS1Gateway_Entries_Array_update();
    
    // Rohdaten in UDP Paket schreiben
    EthPaket.udp.SetData( 0, buffer, i );

    // calculate UDP and IPv6 checksum and send Ethernet packet
    EthPaket.CompletePacket();
    output( EthPaket );
  }
}

on envVar ServiceDiscovery_SOMEIPPacket_Offer_ICAS1Gateway_Entries_Array_Element_Next
{
  if (@this == 1 && @ServiceDiscovery_SOMEIPPacket_Offer_ICAS1Gateway_Entries_Array_Element < number_of_offered_services_by_ICAS1Gateway-1)
  {
    @ServiceDiscovery_SOMEIPPacket_Offer_ICAS1Gateway_Entries_Array_Element = @ServiceDiscovery_SOMEIPPacket_Offer_ICAS1Gateway_Entries_Array_Element + 1;
    ServiceDiscovery_SOMEIPPacket_Offer_ICAS1Gateway_Entries_Array_update();
  }
}

on envVar ServiceDiscovery_SOMEIPPacket_Offer_ICAS1Gateway_Entries_Array_Element_Previous
{
  if (@this == 1 && @ServiceDiscovery_SOMEIPPacket_Offer_ICAS1Gateway_Entries_Array_Element > 0)
  {
    @ServiceDiscovery_SOMEIPPacket_Offer_ICAS1Gateway_Entries_Array_Element = @ServiceDiscovery_SOMEIPPacket_Offer_ICAS1Gateway_Entries_Array_Element - 1;
    ServiceDiscovery_SOMEIPPacket_Offer_ICAS1Gateway_Entries_Array_update();
  }
}

ServiceDiscovery_SOMEIPPacket_Offer_ICAS1Gateway_Entries_Array_update()
{
  @ServiceDiscovery_SOMEIPPacket_Offer_ICAS1Gateway_Entries_Array_Type              = servicediscovery_offer_ICAS1Gateway_entries_array_type[@ServiceDiscovery_SOMEIPPacket_Offer_ICAS1Gateway_Entries_Array_Element];
  @ServiceDiscovery_SOMEIPPacket_Offer_ICAS1Gateway_Entries_Array_Index_1st_options = servicediscovery_offer_ICAS1Gateway_entries_array_index_1st_options[@ServiceDiscovery_SOMEIPPacket_Offer_ICAS1Gateway_Entries_Array_Element];
  @ServiceDiscovery_SOMEIPPacket_Offer_ICAS1Gateway_Entries_Array_Index_2nd_options = servicediscovery_offer_ICAS1Gateway_entries_array_index_2nd_options[@ServiceDiscovery_SOMEIPPacket_Offer_ICAS1Gateway_Entries_Array_Element];
  @ServiceDiscovery_SOMEIPPacket_Offer_ICAS1Gateway_Entries_Array_Nr_of_opt_1       = servicediscovery_offer_ICAS1Gateway_entries_array_nr_of_opt_1[@ServiceDiscovery_SOMEIPPacket_Offer_ICAS1Gateway_Entries_Array_Element];
  @ServiceDiscovery_SOMEIPPacket_Offer_ICAS1Gateway_Entries_Array_Nr_of_opt_2       = servicediscovery_offer_ICAS1Gateway_entries_array_nr_of_opt_2[@ServiceDiscovery_SOMEIPPacket_Offer_ICAS1Gateway_Entries_Array_Element];
  @ServiceDiscovery_SOMEIPPacket_Offer_ICAS1Gateway_Entries_Array_Service_ID        = servicediscovery_offer_ICAS1Gateway_entries_array_service_id[@ServiceDiscovery_SOMEIPPacket_Offer_ICAS1Gateway_Entries_Array_Element];
  @ServiceDiscovery_SOMEIPPacket_Offer_ICAS1Gateway_Entries_Array_Instance_ID       = servicediscovery_offer_ICAS1Gateway_entries_array_instance_id[@ServiceDiscovery_SOMEIPPacket_Offer_ICAS1Gateway_Entries_Array_Element];
  @ServiceDiscovery_SOMEIPPacket_Offer_ICAS1Gateway_Entries_Array_Major_Version     = servicediscovery_offer_ICAS1Gateway_entries_array_major_version[@ServiceDiscovery_SOMEIPPacket_Offer_ICAS1Gateway_Entries_Array_Element];
  @ServiceDiscovery_SOMEIPPacket_Offer_ICAS1Gateway_Entries_Array_TTL               = servicediscovery_offer_ICAS1Gateway_entries_array_ttl[@ServiceDiscovery_SOMEIPPacket_Offer_ICAS1Gateway_Entries_Array_Element];
  @ServiceDiscovery_SOMEIPPacket_Offer_ICAS1Gateway_Entries_Array_Minor_Version     = servicediscovery_offer_ICAS1Gateway_entries_array_minor_version[@ServiceDiscovery_SOMEIPPacket_Offer_ICAS1Gateway_Entries_Array_Element];
}

on envVar ServiceDiscovery_SOMEIPPacket_Offer_ICAS1Gateway_Entries_Array_Type
{
  servicediscovery_offer_ICAS1Gateway_entries_array_type[@ServiceDiscovery_SOMEIPPacket_Offer_ICAS1Gateway_Entries_Array_Element] = @this;
}
on envVar ServiceDiscovery_SOMEIPPacket_Offer_ICAS1Gateway_Entries_Array_Index_1st_options
{
  servicediscovery_offer_ICAS1Gateway_entries_array_index_1st_options[@ServiceDiscovery_SOMEIPPacket_Offer_ICAS1Gateway_Entries_Array_Element] = @this;
}
on envVar ServiceDiscovery_SOMEIPPacket_Offer_ICAS1Gateway_Entries_Array_Index_2nd_options
{
  servicediscovery_offer_ICAS1Gateway_entries_array_index_2nd_options[@ServiceDiscovery_SOMEIPPacket_Offer_ICAS1Gateway_Entries_Array_Element] = @this;
}
on envVar ServiceDiscovery_SOMEIPPacket_Offer_ICAS1Gateway_Entries_Array_Nr_of_opt_1
{
  servicediscovery_offer_ICAS1Gateway_entries_array_nr_of_opt_1[@ServiceDiscovery_SOMEIPPacket_Offer_ICAS1Gateway_Entries_Array_Element] = @this;
}
on envVar ServiceDiscovery_SOMEIPPacket_Offer_ICAS1Gateway_Entries_Array_Nr_of_opt_2
{
  servicediscovery_offer_ICAS1Gateway_entries_array_nr_of_opt_2[@ServiceDiscovery_SOMEIPPacket_Offer_ICAS1Gateway_Entries_Array_Element] = @this;
}
on envVar ServiceDiscovery_SOMEIPPacket_Offer_ICAS1Gateway_Entries_Array_Service_ID
{
  servicediscovery_offer_ICAS1Gateway_entries_array_service_id[@ServiceDiscovery_SOMEIPPacket_Offer_ICAS1Gateway_Entries_Array_Element] = @this;
}
on envVar ServiceDiscovery_SOMEIPPacket_Offer_ICAS1Gateway_Entries_Array_Instance_ID
{
  servicediscovery_offer_ICAS1Gateway_entries_array_instance_id[@ServiceDiscovery_SOMEIPPacket_Offer_ICAS1Gateway_Entries_Array_Element] = @this;
}
on envVar ServiceDiscovery_SOMEIPPacket_Offer_ICAS1Gateway_Entries_Array_Major_Version
{
  servicediscovery_offer_ICAS1Gateway_entries_array_major_version[@ServiceDiscovery_SOMEIPPacket_Offer_ICAS1Gateway_Entries_Array_Element] = @this;
}
on envVar ServiceDiscovery_SOMEIPPacket_Offer_ICAS1Gateway_Entries_Array_TTL
{
  servicediscovery_offer_ICAS1Gateway_entries_array_ttl[@ServiceDiscovery_SOMEIPPacket_Offer_ICAS1Gateway_Entries_Array_Element] = @this;
}
on envVar ServiceDiscovery_SOMEIPPacket_Offer_ICAS1Gateway_Entries_Array_Minor_Version
{
  servicediscovery_offer_ICAS1Gateway_entries_array_minor_version[@ServiceDiscovery_SOMEIPPacket_Offer_ICAS1Gateway_Entries_Array_Element] = @this;
}

on envVar ServiceDiscovery_SOMEIPPacket_Offer_ICAS1Gateway_Options_Array_On_Off
{
  if (@this == 0)
  {
    @ServiceDiscovery_SOMEIPPacket_Offer_ICAS1Gateway_Options_Array_Length      = 0;
    @ServiceDiscovery_SOMEIPPacket_Offer_ICAS1Gateway_Entries_Array_Nr_of_opt_1 = 0;
  }
  
  if (@this == 1)
  {
    @ServiceDiscovery_SOMEIPPacket_Offer_ICAS1Gateway_Options_Array_Length      = 24;
    @ServiceDiscovery_SOMEIPPacket_Offer_ICAS1Gateway_Entries_Array_Nr_of_opt_1 = 1;
  }
}







on timer tSend_ServiceDiscovery_Offer_ICAS1Sys01
{
  Send_ServiceDiscovery_Offer_Service_ICAS1Sys01();
}

Send_ServiceDiscovery_Offer_Service_ICAS1Sys01()
{
  ethernetPacket EthPaket;
  
  number_of_offered_services_by_ICAS1Sys01 = @ServiceDiscovery_Offer_Service_Time
                                           + @ServiceDiscovery_Offer_Service_ChargingManagementExtendedSync;
  
  if (@Env_GlobalAppl == 1 && number_of_offered_services_by_ICAS1Sys01 > 0)
  {
    if ((@ServiceDiscovery_SOMEIPPacket_Offer_ICAS1Sys01_Entries_Array_Element > 0) && (@ServiceDiscovery_SOMEIPPacket_Offer_ICAS1Sys01_Entries_Array_Element >= number_of_offered_services_by_ICAS1Sys01))
      @ServiceDiscovery_SOMEIPPacket_Offer_ICAS1Sys01_Entries_Array_Element = number_of_offered_services_by_ICAS1Sys01-1;


    // Ethernet Packet - MAC Source address
    getvalue (ServiceDiscovery_EthernetPacket_MAC_Source_ICAS1Sys01, buffer_MAC);
    //EthPaket.source.ParseAddress ( buffer_MAC );
    EthPaket.source = ethGetMacAddressAsNumber (buffer_MAC);
    
    // Ethernet Packet - MAC Destination address
    getvalue (ServiceDiscovery_EthernetPacket_MAC_Destination, buffer_MAC);
    //EthPaket.destination.ParseAddress ( buffer_MAC );
    EthPaket.destination = ethGetMacAddressAsNumber (buffer_MAC);
    
    // Ethernet Packet - VLAN
    EthPaket.SetVlan (@ServiceDiscovery_EthernetPacket_VLAN_TPID, @ServiceDiscovery_EthernetPacket_VLAN_TCI);
    
    // Ethernet Packet - Type
    //EthPaket.ipv6.type = @EthernetPacket_Type;
    if (@ServiceDiscovery_EthernetPacket_Type == 0x86DD) EthPaket.ipv6.Init();
    
    
    // IPv6 Packet - Version
    EthPaket.ipv6.version = @ServiceDiscovery_IPv6Packet_Version;

    // IPv6 Packet - Traffic Class
    EthPaket.ipv6.class = @ServiceDiscovery_IPv6Packet_Traffic_Class;
    
    // IPv6 Packet - Flow Label
    EthPaket.ipv6.flow = @ServiceDiscovery_IPv6Packet_Flow_Label;
    
    // IPv6 Packet - Payload_Length
    EthPaket.ipv6.length = @ServiceDiscovery_IPv6Packet_Payload_Length;
    
    // IPv6 Packet - Next Header
    EthPaket.ipv6.next = @ServiceDiscovery_IPv6Packet_Next_Header;
    if (@ServiceDiscovery_IPv6Packet_Next_Header == 6) EthPaket.tcp.Init();
    if (@ServiceDiscovery_IPv6Packet_Next_Header == 17) EthPaket.udp.Init();
    
    // IPv6 Packet - Hop Limit
    EthPaket.ipv6.hopLimit = @ServiceDiscovery_IPv6Packet_Hop_Limit;

    // IPv6 Packet - IPv6 Destination address    // TODO: char array zu byte array
    buffer_ipv6[0]  = @ServiceDiscovery_IPv6Packet_IP_Destination_Multicast_01>>8 & 0xFF;
    buffer_ipv6[1]  = @ServiceDiscovery_IPv6Packet_IP_Destination_Multicast_01    & 0xFF;
    buffer_ipv6[2]  = @ServiceDiscovery_IPv6Packet_IP_Destination_Multicast_02>>8 & 0xFF;
    buffer_ipv6[3]  = @ServiceDiscovery_IPv6Packet_IP_Destination_Multicast_02    & 0xFF;
    buffer_ipv6[4]  = @ServiceDiscovery_IPv6Packet_IP_Destination_Multicast_03>>8 & 0xFF;
    buffer_ipv6[5]  = @ServiceDiscovery_IPv6Packet_IP_Destination_Multicast_03    & 0xFF;
    buffer_ipv6[6]  = @ServiceDiscovery_IPv6Packet_IP_Destination_Multicast_04>>8 & 0xFF;
    buffer_ipv6[7]  = @ServiceDiscovery_IPv6Packet_IP_Destination_Multicast_04    & 0xFF;
    buffer_ipv6[8]  = @ServiceDiscovery_IPv6Packet_IP_Destination_Multicast_05>>8 & 0xFF;
    buffer_ipv6[9]  = @ServiceDiscovery_IPv6Packet_IP_Destination_Multicast_05    & 0xFF;
    buffer_ipv6[10] = @ServiceDiscovery_IPv6Packet_IP_Destination_Multicast_06>>8 & 0xFF;
    buffer_ipv6[11] = @ServiceDiscovery_IPv6Packet_IP_Destination_Multicast_06    & 0xFF;
    buffer_ipv6[12] = @ServiceDiscovery_IPv6Packet_IP_Destination_Multicast_07>>8 & 0xFF;
    buffer_ipv6[13] = @ServiceDiscovery_IPv6Packet_IP_Destination_Multicast_07    & 0xFF;
    buffer_ipv6[14] = @ServiceDiscovery_IPv6Packet_IP_Destination_Multicast_08>>8 & 0xFF;
    buffer_ipv6[15] = @ServiceDiscovery_IPv6Packet_IP_Destination_Multicast_08    & 0xFF;
    EthPaket.ipv6.destination.SetData ( 0, buffer_ipv6, elcount(buffer_ipv6) );

    // IPv6 Packet - IPv6 Source address    // TODO: char array zu byte array
    buffer_ipv6[0]  = @ServiceDiscovery_IPv6Packet_IP_Source_ICAS1Sys01_01>>8 & 0xFF;
    buffer_ipv6[1]  = @ServiceDiscovery_IPv6Packet_IP_Source_ICAS1Sys01_01    & 0xFF;
    buffer_ipv6[2]  = @ServiceDiscovery_IPv6Packet_IP_Source_ICAS1Sys01_02>>8 & 0xFF;
    buffer_ipv6[3]  = @ServiceDiscovery_IPv6Packet_IP_Source_ICAS1Sys01_02    & 0xFF;
    buffer_ipv6[4]  = @ServiceDiscovery_IPv6Packet_IP_Source_ICAS1Sys01_03>>8 & 0xFF;
    buffer_ipv6[5]  = @ServiceDiscovery_IPv6Packet_IP_Source_ICAS1Sys01_03    & 0xFF;
    buffer_ipv6[6]  = @ServiceDiscovery_IPv6Packet_IP_Source_ICAS1Sys01_04>>8 & 0xFF;
    buffer_ipv6[7]  = @ServiceDiscovery_IPv6Packet_IP_Source_ICAS1Sys01_04    & 0xFF;
    buffer_ipv6[8]  = @ServiceDiscovery_IPv6Packet_IP_Source_ICAS1Sys01_05>>8 & 0xFF;
    buffer_ipv6[9]  = @ServiceDiscovery_IPv6Packet_IP_Source_ICAS1Sys01_05    & 0xFF;
    buffer_ipv6[10] = @ServiceDiscovery_IPv6Packet_IP_Source_ICAS1Sys01_06>>8 & 0xFF;
    buffer_ipv6[11] = @ServiceDiscovery_IPv6Packet_IP_Source_ICAS1Sys01_06    & 0xFF;
    buffer_ipv6[12] = @ServiceDiscovery_IPv6Packet_IP_Source_ICAS1Sys01_07>>8 & 0xFF;
    buffer_ipv6[13] = @ServiceDiscovery_IPv6Packet_IP_Source_ICAS1Sys01_07    & 0xFF;
    buffer_ipv6[14] = @ServiceDiscovery_IPv6Packet_IP_Source_ICAS1Sys01_08>>8 & 0xFF;
    buffer_ipv6[15] = @ServiceDiscovery_IPv6Packet_IP_Source_ICAS1Sys01_08    & 0xFF;
    EthPaket.ipv6.source.SetData ( 0, buffer_ipv6, elcount(buffer_ipv6) );

    
    // UDP Packet - Source Port
    EthPaket.udp.source = @ServiceDiscovery_UDPPacket_Port_Source;
    
    // UDP Packet - Destination Port
    EthPaket.udp.destination = @ServiceDiscovery_UDPPacket_Port_Destination;
    
    // UDP Packet - Length
    EthPaket.udp.length = @ServiceDiscovery_UDPPacket_Length;
    
    
    // SOME/IP Packet aus Rohdaten zusammenbauen (buffer array)
    i=0;
    
    // SOME/IP Packet - Message ID, Service ID [16 bit]
    buffer[i++] = @ServiceDiscovery_SOMEIPPacket_Offer_ICAS1Sys01_Message_ID_Service_ID>>8 & 0xFF;
    buffer[i++] = @ServiceDiscovery_SOMEIPPacket_Offer_ICAS1Sys01_Message_ID_Service_ID    & 0xFF;
    
    // SOME/IP Packet - Message ID, Message ID [16 bit]
    buffer[i++] = @ServiceDiscovery_SOMEIPPacket_Offer_ICAS1Sys01_Message_ID_Method_ID>>8 & 0xFF;
    buffer[i++] = @ServiceDiscovery_SOMEIPPacket_Offer_ICAS1Sys01_Message_ID_Method_ID    & 0xFF;
    
    // SOME/IP Packet - Length [32 bit]
    @ServiceDiscovery_SOMEIPPacket_Offer_ICAS1Sys01_Length = 16 + (16 * number_of_offered_services_by_ICAS1Sys01) + 4 + @ServiceDiscovery_SOMEIPPacket_Offer_ICAS1Sys01_Options_Array_On_Off * 24;
    buffer[i++] = @ServiceDiscovery_SOMEIPPacket_Offer_ICAS1Sys01_Length>>24 & 0xFF;
    buffer[i++] = @ServiceDiscovery_SOMEIPPacket_Offer_ICAS1Sys01_Length>>16 & 0xFF;
    buffer[i++] = @ServiceDiscovery_SOMEIPPacket_Offer_ICAS1Sys01_Length>> 8 & 0xFF;
    buffer[i++] = @ServiceDiscovery_SOMEIPPacket_Offer_ICAS1Sys01_Length     & 0xFF;
    
    // SOME/IP Packet - Request ID, Client ID [16 bit]
    buffer[i++] = @ServiceDiscovery_SOMEIPPacket_Offer_ICAS1Sys01_Request_ID_Client_ID>>8 & 0xFF;
    buffer[i++] = @ServiceDiscovery_SOMEIPPacket_Offer_ICAS1Sys01_Request_ID_Client_ID    & 0xFF;
    
    // SOME/IP Packet - Request ID, Session ID) [16 bit]
    @ServiceDiscovery_SOMEIPPacket_Request_ID_Session_ID = @ServiceDiscovery_SOMEIPPacket_Request_ID_Session_ID + 1;
    if (@ServiceDiscovery_SOMEIPPacket_Request_ID_Session_ID == 0x10000) @ServiceDiscovery_SOMEIPPacket_Request_ID_Session_ID = 1;
    
    buffer[i++] = @ServiceDiscovery_SOMEIPPacket_Request_ID_Session_ID>>8 & 0xFF;
    buffer[i++] = @ServiceDiscovery_SOMEIPPacket_Request_ID_Session_ID    & 0xFF;
    
    // SOME/IP Packet - Protocol Version [8 bit]
    buffer[i++] = @ServiceDiscovery_SOMEIPPacket_Offer_ICAS1Sys01_Protocol_Version;
    
    // SOME/IP Packet - Interface Version [8 bit]
    buffer[i++] = @ServiceDiscovery_SOMEIPPacket_Offer_ICAS1Sys01_Interface_Version;

    // SOME/IP Packet - Message Type [8 bit]
    buffer[i++] = @ServiceDiscovery_SOMEIPPacket_Offer_ICAS1Sys01_Message_Type;
      
    // SOME/IP Packet - Return Code [8 bit]
    buffer[i++] = @ServiceDiscovery_SOMEIPPacket_Offer_ICAS1Sys01_Return_Code;
    
    // SOME/IP Packet - Flags [8 bit]
    buffer[i++] = @ServiceDiscovery_SOMEIPPacket_Offer_ICAS1Sys01_Flags;
    
    // SOME/IP Packet - Reserved [24 bit]
    buffer[i++] = 0x00;
    buffer[i++] = 0x00;
    buffer[i++] = 0x00;
    
    
    // SOME/IP Packet - Entries Array
    
    // SOME/IP Packet - Entries Array - Length [32 bit]
    @ServiceDiscovery_SOMEIPPacket_Offer_ICAS1Sys01_Entries_Array_Length = 16 * number_of_offered_services_by_ICAS1Sys01;
    buffer[i++] = @ServiceDiscovery_SOMEIPPacket_Offer_ICAS1Sys01_Entries_Array_Length>>24 & 0xFF;
    buffer[i++] = @ServiceDiscovery_SOMEIPPacket_Offer_ICAS1Sys01_Entries_Array_Length>>16 & 0xFF;
    buffer[i++] = @ServiceDiscovery_SOMEIPPacket_Offer_ICAS1Sys01_Entries_Array_Length>> 8 & 0xFF;
    buffer[i++] = @ServiceDiscovery_SOMEIPPacket_Offer_ICAS1Sys01_Entries_Array_Length     & 0xFF;
    
    service_counter = 0;
    
    if (@ServiceDiscovery_Offer_Service_Time == 1 && service_counter < number_of_offered_services_by_ICAS1Sys01)
    {
      servicediscovery_offer_ICAS1Sys01_entries_array_type[service_counter]                 = 1; // Offer
      servicediscovery_offer_ICAS1Sys01_entries_array_index_1st_options[service_counter]    = 0;
      servicediscovery_offer_ICAS1Sys01_entries_array_index_2nd_options[service_counter]    = 0;
      servicediscovery_offer_ICAS1Sys01_entries_array_nr_of_opt_1[service_counter]          = @ServiceDiscovery_SOMEIPPacket_Offer_ICAS1Sys01_Options_Array_On_Off;
      servicediscovery_offer_ICAS1Sys01_entries_array_nr_of_opt_2[service_counter]          = 0;
      servicediscovery_offer_ICAS1Sys01_entries_array_service_id[service_counter]           = 0x6009;
      servicediscovery_offer_ICAS1Sys01_entries_array_instance_id[service_counter]          = 1;
      servicediscovery_offer_ICAS1Sys01_entries_array_major_version[service_counter]        = 4;
      servicediscovery_offer_ICAS1Sys01_entries_array_ttl[service_counter]                  = 5;
      servicediscovery_offer_ICAS1Sys01_entries_array_minor_version[service_counter]        = 1;

      service_counter++;
    }
      
    if (@ServiceDiscovery_Offer_Service_ChargingManagementExtendedSync == 1 && service_counter < number_of_offered_services_by_ICAS1Sys01)
    {
      servicediscovery_offer_ICAS1Sys01_entries_array_type[service_counter]                 = 1; // Offer
      servicediscovery_offer_ICAS1Sys01_entries_array_index_1st_options[service_counter]    = 0;
      servicediscovery_offer_ICAS1Sys01_entries_array_index_2nd_options[service_counter]    = 0;
      servicediscovery_offer_ICAS1Sys01_entries_array_nr_of_opt_1[service_counter]          = @ServiceDiscovery_SOMEIPPacket_Offer_ICAS1Sys01_Options_Array_On_Off;
      servicediscovery_offer_ICAS1Sys01_entries_array_nr_of_opt_2[service_counter]          = 0;
      servicediscovery_offer_ICAS1Sys01_entries_array_service_id[service_counter]           = 0x6069;
      servicediscovery_offer_ICAS1Sys01_entries_array_instance_id[service_counter]          = 1;
      servicediscovery_offer_ICAS1Sys01_entries_array_major_version[service_counter]        = 1;
      servicediscovery_offer_ICAS1Sys01_entries_array_ttl[service_counter]                  = 5;
      servicediscovery_offer_ICAS1Sys01_entries_array_minor_version[service_counter]        = 0;

      service_counter++;
    }
    
    if (number_of_offered_services_by_ICAS1Sys01 == 0)
    {
      servicediscovery_offer_ICAS1Sys01_entries_array_type[service_counter]                 = 0;
      servicediscovery_offer_ICAS1Sys01_entries_array_index_1st_options[service_counter]    = 0;
      servicediscovery_offer_ICAS1Sys01_entries_array_index_2nd_options[service_counter]    = 0;
      servicediscovery_offer_ICAS1Sys01_entries_array_nr_of_opt_1[service_counter]          = 0;
      servicediscovery_offer_ICAS1Sys01_entries_array_nr_of_opt_2[service_counter]          = 0;
      servicediscovery_offer_ICAS1Sys01_entries_array_service_id[service_counter]           = 0;
      servicediscovery_offer_ICAS1Sys01_entries_array_instance_id[service_counter]          = 0;
      servicediscovery_offer_ICAS1Sys01_entries_array_major_version[service_counter]        = 0;
      servicediscovery_offer_ICAS1Sys01_entries_array_ttl[service_counter]                  = 0;
      servicediscovery_offer_ICAS1Sys01_entries_array_minor_version[service_counter]        = 0;
    }
      
    for (j = 0; j < number_of_offered_services_by_ICAS1Sys01; j++)
    {
      // SOME/IP Packet - Entries Array - Type [8 bit]
      buffer[i++] = servicediscovery_offer_ICAS1Sys01_entries_array_type[j];
      
      // SOME/IP Packet - Entries Array - Index 1st options [8 bit]
      buffer[i++] = servicediscovery_offer_ICAS1Sys01_entries_array_index_1st_options[j];
      
      // SOME/IP Packet - Entries Array - Index 2nd options [8 bit]
      buffer[i++] = servicediscovery_offer_ICAS1Sys01_entries_array_index_2nd_options[j];
      
      // SOME/IP Packet - Entries Array - # of opt 1 [4 bit] / # of opt 2 [4 bit]
      buffer[i++] = (((servicediscovery_offer_ICAS1Sys01_entries_array_nr_of_opt_1[j]*16)) + (servicediscovery_offer_ICAS1Sys01_entries_array_nr_of_opt_2[j]));
      
      // SOME/IP Packet - Entries Array - Service ID [16 bit]
      buffer[i++] = servicediscovery_offer_ICAS1Sys01_entries_array_service_id[j]>> 8 & 0xFF;
      buffer[i++] = servicediscovery_offer_ICAS1Sys01_entries_array_service_id[j]     & 0xFF;

      // SOME/IP Packet - Entries Array - Instance ID [16 bit]
      buffer[i++] = servicediscovery_offer_ICAS1Sys01_entries_array_instance_id[j]>> 8 & 0xFF;
      buffer[i++] = servicediscovery_offer_ICAS1Sys01_entries_array_instance_id[j]     & 0xFF;
      
      // SOME/IP Packet - Entries Array - Major Version [8 bit]
      buffer[i++] = servicediscovery_offer_ICAS1Sys01_entries_array_major_version[j];
      
      // SOME/IP Packet - Entries Array - TTL [24 bit]
      buffer[i++] = servicediscovery_offer_ICAS1Sys01_entries_array_ttl[j]>>16 & 0xFF;
      buffer[i++] = servicediscovery_offer_ICAS1Sys01_entries_array_ttl[j]>> 8 & 0xFF;
      buffer[i++] = servicediscovery_offer_ICAS1Sys01_entries_array_ttl[j]     & 0xFF;
      
      // SOME/IP Packet - Entries Array - Minor Version [32 bit]
      buffer[i++] = servicediscovery_offer_ICAS1Sys01_entries_array_minor_version[j]>>24 & 0xFF;
      buffer[i++] = servicediscovery_offer_ICAS1Sys01_entries_array_minor_version[j]>>16 & 0xFF;
      buffer[i++] = servicediscovery_offer_ICAS1Sys01_entries_array_minor_version[j]>> 8 & 0xFF;
      buffer[i++] = servicediscovery_offer_ICAS1Sys01_entries_array_minor_version[j]     & 0xFF;
    }
    
    //SOME/IP Packet - Options Array - Length [32 bit]
    buffer[i++] = @ServiceDiscovery_SOMEIPPacket_Offer_ICAS1Sys01_Options_Array_Length>>24 & 0xFF;
    buffer[i++] = @ServiceDiscovery_SOMEIPPacket_Offer_ICAS1Sys01_Options_Array_Length>>16 & 0xFF;
    buffer[i++] = @ServiceDiscovery_SOMEIPPacket_Offer_ICAS1Sys01_Options_Array_Length>> 8 & 0xFF;
    buffer[i++] = @ServiceDiscovery_SOMEIPPacket_Offer_ICAS1Sys01_Options_Array_Length     & 0xFF;
    
    if (@ServiceDiscovery_SOMEIPPacket_Offer_ICAS1Sys01_Options_Array_On_Off == 1)
    {
      //SOME/IP Packet - Options Array - Option1 Length [16 bit]
      buffer[i++] = @ServiceDiscovery_SOMEIPPacket_Offer_ICAS1Sys01_Options_Array_Option1_Length>> 8 & 0xFF;
      buffer[i++] = @ServiceDiscovery_SOMEIPPacket_Offer_ICAS1Sys01_Options_Array_Option1_Length     & 0xFF;
      
      //SOME/IP Packet - Options Array - Option1 Type [8 bit]
      buffer[i++] = @ServiceDiscovery_SOMEIPPacket_Offer_ICAS1Sys01_Options_Array_Option1_Type & 0xFF;
      
      //SOME/IP Packet - Options Array - Reserved [8 bit]
      buffer[i++] = 0x00;
      
      //SOME/IP Packet - Options Array - Option1 IPv6 Address
      buffer[i++] = @ServiceDiscovery_SOMEIPPacket_Offer_ICAS1Sys01_Options_Array_Option1_IPv6_01>>8 & 0xFF;
      buffer[i++] = @ServiceDiscovery_SOMEIPPacket_Offer_ICAS1Sys01_Options_Array_Option1_IPv6_01    & 0xFF;
      buffer[i++] = @ServiceDiscovery_SOMEIPPacket_Offer_ICAS1Sys01_Options_Array_Option1_IPv6_02>>8 & 0xFF;
      buffer[i++] = @ServiceDiscovery_SOMEIPPacket_Offer_ICAS1Sys01_Options_Array_Option1_IPv6_02    & 0xFF;
      buffer[i++] = @ServiceDiscovery_SOMEIPPacket_Offer_ICAS1Sys01_Options_Array_Option1_IPv6_03>>8 & 0xFF;
      buffer[i++] = @ServiceDiscovery_SOMEIPPacket_Offer_ICAS1Sys01_Options_Array_Option1_IPv6_03    & 0xFF;
      buffer[i++] = @ServiceDiscovery_SOMEIPPacket_Offer_ICAS1Sys01_Options_Array_Option1_IPv6_04>>8 & 0xFF;
      buffer[i++] = @ServiceDiscovery_SOMEIPPacket_Offer_ICAS1Sys01_Options_Array_Option1_IPv6_04    & 0xFF;
      buffer[i++] = @ServiceDiscovery_SOMEIPPacket_Offer_ICAS1Sys01_Options_Array_Option1_IPv6_05>>8 & 0xFF;
      buffer[i++] = @ServiceDiscovery_SOMEIPPacket_Offer_ICAS1Sys01_Options_Array_Option1_IPv6_05    & 0xFF;
      buffer[i++] = @ServiceDiscovery_SOMEIPPacket_Offer_ICAS1Sys01_Options_Array_Option1_IPv6_06>>8 & 0xFF;
      buffer[i++] = @ServiceDiscovery_SOMEIPPacket_Offer_ICAS1Sys01_Options_Array_Option1_IPv6_06    & 0xFF;
      buffer[i++] = @ServiceDiscovery_SOMEIPPacket_Offer_ICAS1Sys01_Options_Array_Option1_IPv6_07>>8 & 0xFF;
      buffer[i++] = @ServiceDiscovery_SOMEIPPacket_Offer_ICAS1Sys01_Options_Array_Option1_IPv6_07    & 0xFF;
      buffer[i++] = @ServiceDiscovery_SOMEIPPacket_Offer_ICAS1Sys01_Options_Array_Option1_IPv6_08>>8 & 0xFF;
      buffer[i++] = @ServiceDiscovery_SOMEIPPacket_Offer_ICAS1Sys01_Options_Array_Option1_IPv6_08    & 0xFF;
      
      //SOME/IP Packet - Options Array - Reserved [8 bit]
      buffer[i++] = 0x00;
      
      //SOME/IP Packet - Options Array - Option1 L4-Proto [8 bit]
      buffer[i++] = @ServiceDiscovery_SOMEIPPacket_Offer_ICAS1Sys01_Options_Array_Option1_L4_Proto;
      
      //SOME/IP Packet - Options Array - Option1 Port Number [16 bit]
      buffer[i++] = @ServiceDiscovery_SOMEIPPacket_Offer_ICAS1Sys01_Options_Array_Option1_Port_Number>> 8 & 0xFF;
      buffer[i++] = @ServiceDiscovery_SOMEIPPacket_Offer_ICAS1Sys01_Options_Array_Option1_Port_Number     & 0xFF;
    }
    
    ServiceDiscovery_SOMEIPPacket_Offer_ICAS1Sys01_Entries_Array_update();

    // Rohdaten in UDP Paket schreiben
    EthPaket.udp.SetData( 0, buffer, i );

    // calculate UDP and IPv6 checksum and send Ethernet packet
    EthPaket.CompletePacket();
    output( EthPaket );
  }
}

on envVar ServiceDiscovery_SOMEIPPacket_Offer_ICAS1Sys01_Entries_Array_Element_Next
{
  if (@this == 1 && @ServiceDiscovery_SOMEIPPacket_Offer_ICAS1Sys01_Entries_Array_Element < number_of_offered_services_by_ICAS1Sys01-1)
  {
    @ServiceDiscovery_SOMEIPPacket_Offer_ICAS1Sys01_Entries_Array_Element = @ServiceDiscovery_SOMEIPPacket_Offer_ICAS1Sys01_Entries_Array_Element + 1;
    ServiceDiscovery_SOMEIPPacket_Offer_ICAS1Sys01_Entries_Array_update();
  }
}

on envVar ServiceDiscovery_SOMEIPPacket_Offer_ICAS1Sys01_Entries_Array_Element_Previous
{
  if (@this == 1 && @ServiceDiscovery_SOMEIPPacket_Offer_ICAS1Sys01_Entries_Array_Element > 0)
  {
    @ServiceDiscovery_SOMEIPPacket_Offer_ICAS1Sys01_Entries_Array_Element = @ServiceDiscovery_SOMEIPPacket_Offer_ICAS1Sys01_Entries_Array_Element - 1;
    ServiceDiscovery_SOMEIPPacket_Offer_ICAS1Sys01_Entries_Array_update();
  }
}

ServiceDiscovery_SOMEIPPacket_Offer_ICAS1Sys01_Entries_Array_update()
{
  @ServiceDiscovery_SOMEIPPacket_Offer_ICAS1Sys01_Entries_Array_Type              = servicediscovery_offer_ICAS1Sys01_entries_array_type[@ServiceDiscovery_SOMEIPPacket_Offer_ICAS1Sys01_Entries_Array_Element];
  @ServiceDiscovery_SOMEIPPacket_Offer_ICAS1Sys01_Entries_Array_Index_1st_options = servicediscovery_offer_ICAS1Sys01_entries_array_index_1st_options[@ServiceDiscovery_SOMEIPPacket_Offer_ICAS1Sys01_Entries_Array_Element];
  @ServiceDiscovery_SOMEIPPacket_Offer_ICAS1Sys01_Entries_Array_Index_2nd_options = servicediscovery_offer_ICAS1Sys01_entries_array_index_2nd_options[@ServiceDiscovery_SOMEIPPacket_Offer_ICAS1Sys01_Entries_Array_Element];
  @ServiceDiscovery_SOMEIPPacket_Offer_ICAS1Sys01_Entries_Array_Nr_of_opt_1       = servicediscovery_offer_ICAS1Sys01_entries_array_nr_of_opt_1[@ServiceDiscovery_SOMEIPPacket_Offer_ICAS1Sys01_Entries_Array_Element];
  @ServiceDiscovery_SOMEIPPacket_Offer_ICAS1Sys01_Entries_Array_Nr_of_opt_2       = servicediscovery_offer_ICAS1Sys01_entries_array_nr_of_opt_2[@ServiceDiscovery_SOMEIPPacket_Offer_ICAS1Sys01_Entries_Array_Element];
  @ServiceDiscovery_SOMEIPPacket_Offer_ICAS1Sys01_Entries_Array_Service_ID        = servicediscovery_offer_ICAS1Sys01_entries_array_service_id[@ServiceDiscovery_SOMEIPPacket_Offer_ICAS1Sys01_Entries_Array_Element];
  @ServiceDiscovery_SOMEIPPacket_Offer_ICAS1Sys01_Entries_Array_Instance_ID       = servicediscovery_offer_ICAS1Sys01_entries_array_instance_id[@ServiceDiscovery_SOMEIPPacket_Offer_ICAS1Sys01_Entries_Array_Element];
  @ServiceDiscovery_SOMEIPPacket_Offer_ICAS1Sys01_Entries_Array_Major_Version     = servicediscovery_offer_ICAS1Sys01_entries_array_major_version[@ServiceDiscovery_SOMEIPPacket_Offer_ICAS1Sys01_Entries_Array_Element];
  @ServiceDiscovery_SOMEIPPacket_Offer_ICAS1Sys01_Entries_Array_TTL               = servicediscovery_offer_ICAS1Sys01_entries_array_ttl[@ServiceDiscovery_SOMEIPPacket_Offer_ICAS1Sys01_Entries_Array_Element];
  @ServiceDiscovery_SOMEIPPacket_Offer_ICAS1Sys01_Entries_Array_Minor_Version     = servicediscovery_offer_ICAS1Sys01_entries_array_minor_version[@ServiceDiscovery_SOMEIPPacket_Offer_ICAS1Sys01_Entries_Array_Element];
}

on envVar ServiceDiscovery_SOMEIPPacket_Offer_ICAS1Sys01_Entries_Array_Type
{
  servicediscovery_offer_ICAS1Sys01_entries_array_type[@ServiceDiscovery_SOMEIPPacket_Offer_ICAS1Sys01_Entries_Array_Element] = @this;
}
on envVar ServiceDiscovery_SOMEIPPacket_Offer_ICAS1Sys01_Entries_Array_Index_1st_options
{
  servicediscovery_offer_ICAS1Sys01_entries_array_index_1st_options[@ServiceDiscovery_SOMEIPPacket_Offer_ICAS1Sys01_Entries_Array_Element] = @this;
}
on envVar ServiceDiscovery_SOMEIPPacket_Offer_ICAS1Sys01_Entries_Array_Index_2nd_options
{
  servicediscovery_offer_ICAS1Sys01_entries_array_index_2nd_options[@ServiceDiscovery_SOMEIPPacket_Offer_ICAS1Sys01_Entries_Array_Element] = @this;
}
on envVar ServiceDiscovery_SOMEIPPacket_Offer_ICAS1Sys01_Entries_Array_Nr_of_opt_1
{
  servicediscovery_offer_ICAS1Sys01_entries_array_nr_of_opt_1[@ServiceDiscovery_SOMEIPPacket_Offer_ICAS1Sys01_Entries_Array_Element] = @this;
}
on envVar ServiceDiscovery_SOMEIPPacket_Offer_ICAS1Sys01_Entries_Array_Nr_of_opt_2
{
  servicediscovery_offer_ICAS1Sys01_entries_array_nr_of_opt_2[@ServiceDiscovery_SOMEIPPacket_Offer_ICAS1Sys01_Entries_Array_Element] = @this;
}
on envVar ServiceDiscovery_SOMEIPPacket_Offer_ICAS1Sys01_Entries_Array_Service_ID
{
  servicediscovery_offer_ICAS1Sys01_entries_array_service_id[@ServiceDiscovery_SOMEIPPacket_Offer_ICAS1Sys01_Entries_Array_Element] = @this;
}
on envVar ServiceDiscovery_SOMEIPPacket_Offer_ICAS1Sys01_Entries_Array_Instance_ID
{
  servicediscovery_offer_ICAS1Sys01_entries_array_instance_id[@ServiceDiscovery_SOMEIPPacket_Offer_ICAS1Sys01_Entries_Array_Element] = @this;
}
on envVar ServiceDiscovery_SOMEIPPacket_Offer_ICAS1Sys01_Entries_Array_Major_Version
{
  servicediscovery_offer_ICAS1Sys01_entries_array_major_version[@ServiceDiscovery_SOMEIPPacket_Offer_ICAS1Sys01_Entries_Array_Element] = @this;
}
on envVar ServiceDiscovery_SOMEIPPacket_Offer_ICAS1Sys01_Entries_Array_TTL
{
  servicediscovery_offer_ICAS1Sys01_entries_array_ttl[@ServiceDiscovery_SOMEIPPacket_Offer_ICAS1Sys01_Entries_Array_Element] = @this;
}
on envVar ServiceDiscovery_SOMEIPPacket_Offer_ICAS1Sys01_Entries_Array_Minor_Version
{
  servicediscovery_offer_ICAS1Sys01_entries_array_minor_version[@ServiceDiscovery_SOMEIPPacket_Offer_ICAS1Sys01_Entries_Array_Element] = @this;
}

on envVar ServiceDiscovery_SOMEIPPacket_Offer_ICAS1Sys01_Options_Array_On_Off
{
  if (@this == 0)
  {
    @ServiceDiscovery_SOMEIPPacket_Offer_ICAS1Sys01_Options_Array_Length      = 0;
    @ServiceDiscovery_SOMEIPPacket_Offer_ICAS1Sys01_Entries_Array_Nr_of_opt_1 = 0;
  }
  
  if (@this == 1)
  {
    @ServiceDiscovery_SOMEIPPacket_Offer_ICAS1Sys01_Options_Array_Length      = 24;
    @ServiceDiscovery_SOMEIPPacket_Offer_ICAS1Sys01_Entries_Array_Nr_of_opt_1 = 1;
  }
}






on timer tSend_ServiceDiscovery_Offer_ICAS3IVI
{
  Send_ServiceDiscovery_Offer_Service_ICAS3IVI();
}

Send_ServiceDiscovery_Offer_Service_ICAS3IVI()
{
  ethernetPacket EthPaket;
  
  number_of_offered_services_by_ICAS3IVI = @ServiceDiscovery_Offer_Service_Distance;
  
  if (@Env_GlobalAppl == 1 && number_of_offered_services_by_ICAS3IVI > 0) 
  {  
    if ((@ServiceDiscovery_SOMEIPPacket_Offer_ICAS3IVI_Entries_Array_Element > 0) && (@ServiceDiscovery_SOMEIPPacket_Offer_ICAS3IVI_Entries_Array_Element >= number_of_offered_services_by_ICAS3IVI))
      @ServiceDiscovery_SOMEIPPacket_Offer_ICAS3IVI_Entries_Array_Element = number_of_offered_services_by_ICAS3IVI-1;

    // Ethernet Packet - MAC Source address
    getvalue (ServiceDiscovery_EthernetPacket_MAC_Source_ICAS3IVI, buffer_MAC);
    //EthPaket.source.ParseAddress ( buffer_MAC );
    EthPaket.source = ethGetMacAddressAsNumber (buffer_MAC);
    
    // Ethernet Packet - MAC Destination address
    getvalue (ServiceDiscovery_EthernetPacket_MAC_Destination, buffer_MAC);
    //EthPaket.destination.ParseAddress ( buffer_MAC );
    EthPaket.destination = ethGetMacAddressAsNumber (buffer_MAC);
    
    // Ethernet Packet - VLAN
    EthPaket.SetVlan (@ServiceDiscovery_EthernetPacket_VLAN_TPID, @ServiceDiscovery_EthernetPacket_VLAN_TCI);
    
    // Ethernet Packet - Type
    //EthPaket.ipv6.type = @EthernetPacket_Type;
    if (@ServiceDiscovery_EthernetPacket_Type == 0x86DD) EthPaket.ipv6.Init();
    
    
    // IPv6 Packet - Version
    EthPaket.ipv6.version = @ServiceDiscovery_IPv6Packet_Version;

    // IPv6 Packet - Traffic Class
    EthPaket.ipv6.class = @ServiceDiscovery_IPv6Packet_Traffic_Class;
    
    // IPv6 Packet - Flow Label
    EthPaket.ipv6.flow = @ServiceDiscovery_IPv6Packet_Flow_Label;
    
    // IPv6 Packet - Payload_Length
    EthPaket.ipv6.length = @ServiceDiscovery_IPv6Packet_Payload_Length;
    
    // IPv6 Packet - Next Header
    EthPaket.ipv6.next = @ServiceDiscovery_IPv6Packet_Next_Header;
    if (@ServiceDiscovery_IPv6Packet_Next_Header == 6) EthPaket.tcp.Init();
    if (@ServiceDiscovery_IPv6Packet_Next_Header == 17) EthPaket.udp.Init();
    
    // IPv6 Packet - Hop Limit
    EthPaket.ipv6.hopLimit = @ServiceDiscovery_IPv6Packet_Hop_Limit;

    // IPv6 Packet - IPv6 Destination address    // TODO: char array zu byte array
    buffer_ipv6[0]  = @ServiceDiscovery_IPv6Packet_IP_Destination_Multicast_01>>8 & 0xFF;
    buffer_ipv6[1]  = @ServiceDiscovery_IPv6Packet_IP_Destination_Multicast_01    & 0xFF;
    buffer_ipv6[2]  = @ServiceDiscovery_IPv6Packet_IP_Destination_Multicast_02>>8 & 0xFF;
    buffer_ipv6[3]  = @ServiceDiscovery_IPv6Packet_IP_Destination_Multicast_02    & 0xFF;
    buffer_ipv6[4]  = @ServiceDiscovery_IPv6Packet_IP_Destination_Multicast_03>>8 & 0xFF;
    buffer_ipv6[5]  = @ServiceDiscovery_IPv6Packet_IP_Destination_Multicast_03    & 0xFF;
    buffer_ipv6[6]  = @ServiceDiscovery_IPv6Packet_IP_Destination_Multicast_04>>8 & 0xFF;
    buffer_ipv6[7]  = @ServiceDiscovery_IPv6Packet_IP_Destination_Multicast_04    & 0xFF;
    buffer_ipv6[8]  = @ServiceDiscovery_IPv6Packet_IP_Destination_Multicast_05>>8 & 0xFF;
    buffer_ipv6[9]  = @ServiceDiscovery_IPv6Packet_IP_Destination_Multicast_05    & 0xFF;
    buffer_ipv6[10] = @ServiceDiscovery_IPv6Packet_IP_Destination_Multicast_06>>8 & 0xFF;
    buffer_ipv6[11] = @ServiceDiscovery_IPv6Packet_IP_Destination_Multicast_06    & 0xFF;
    buffer_ipv6[12] = @ServiceDiscovery_IPv6Packet_IP_Destination_Multicast_07>>8 & 0xFF;
    buffer_ipv6[13] = @ServiceDiscovery_IPv6Packet_IP_Destination_Multicast_07    & 0xFF;
    buffer_ipv6[14] = @ServiceDiscovery_IPv6Packet_IP_Destination_Multicast_08>>8 & 0xFF;
    buffer_ipv6[15] = @ServiceDiscovery_IPv6Packet_IP_Destination_Multicast_08    & 0xFF;
    EthPaket.ipv6.destination.SetData ( 0, buffer_ipv6, elcount(buffer_ipv6) );

    // IPv6 Packet - IPv6 Source address    // TODO: char array zu byte array
    buffer_ipv6[0]  = @ServiceDiscovery_IPv6Packet_IP_Source_ICAS3IVI_01>>8 & 0xFF;
    buffer_ipv6[1]  = @ServiceDiscovery_IPv6Packet_IP_Source_ICAS3IVI_01    & 0xFF;
    buffer_ipv6[2]  = @ServiceDiscovery_IPv6Packet_IP_Source_ICAS3IVI_02>>8 & 0xFF;
    buffer_ipv6[3]  = @ServiceDiscovery_IPv6Packet_IP_Source_ICAS3IVI_02    & 0xFF;
    buffer_ipv6[4]  = @ServiceDiscovery_IPv6Packet_IP_Source_ICAS3IVI_03>>8 & 0xFF;
    buffer_ipv6[5]  = @ServiceDiscovery_IPv6Packet_IP_Source_ICAS3IVI_03    & 0xFF;
    buffer_ipv6[6]  = @ServiceDiscovery_IPv6Packet_IP_Source_ICAS3IVI_04>>8 & 0xFF;
    buffer_ipv6[7]  = @ServiceDiscovery_IPv6Packet_IP_Source_ICAS3IVI_04    & 0xFF;
    buffer_ipv6[8]  = @ServiceDiscovery_IPv6Packet_IP_Source_ICAS3IVI_05>>8 & 0xFF;
    buffer_ipv6[9]  = @ServiceDiscovery_IPv6Packet_IP_Source_ICAS3IVI_05    & 0xFF;
    buffer_ipv6[10] = @ServiceDiscovery_IPv6Packet_IP_Source_ICAS3IVI_06>>8 & 0xFF;
    buffer_ipv6[11] = @ServiceDiscovery_IPv6Packet_IP_Source_ICAS3IVI_06    & 0xFF;
    buffer_ipv6[12] = @ServiceDiscovery_IPv6Packet_IP_Source_ICAS3IVI_07>>8 & 0xFF;
    buffer_ipv6[13] = @ServiceDiscovery_IPv6Packet_IP_Source_ICAS3IVI_07    & 0xFF;
    buffer_ipv6[14] = @ServiceDiscovery_IPv6Packet_IP_Source_ICAS3IVI_08>>8 & 0xFF;
    buffer_ipv6[15] = @ServiceDiscovery_IPv6Packet_IP_Source_ICAS3IVI_08    & 0xFF;
    EthPaket.ipv6.source.SetData ( 0, buffer_ipv6, elcount(buffer_ipv6) );

    
    // UDP Packet - Source Port
    EthPaket.udp.source = @ServiceDiscovery_UDPPacket_Port_Source;
    
    // UDP Packet - Destination Port
    EthPaket.udp.destination = @ServiceDiscovery_UDPPacket_Port_Destination;
    
    // UDP Packet - Length
    EthPaket.udp.length = @ServiceDiscovery_UDPPacket_Length;
    
    
    // SOME/IP Packet aus Rohdaten zusammenbauen (buffer array)
    i=0;
    
    // SOME/IP Packet - Message ID, Service ID [16 bit]
    buffer[i++] = @ServiceDiscovery_SOMEIPPacket_Offer_ICAS3IVI_Message_ID_Service_ID>>8 & 0xFF;
    buffer[i++] = @ServiceDiscovery_SOMEIPPacket_Offer_ICAS3IVI_Message_ID_Service_ID    & 0xFF;
    
    // SOME/IP Packet - Message ID, Message ID [16 bit]
    buffer[i++] = @ServiceDiscovery_SOMEIPPacket_Offer_ICAS3IVI_Message_ID_Method_ID>>8 & 0xFF;
    buffer[i++] = @ServiceDiscovery_SOMEIPPacket_Offer_ICAS3IVI_Message_ID_Method_ID    & 0xFF;
    
    // SOME/IP Packet - Length [32 bit]
    @ServiceDiscovery_SOMEIPPacket_Offer_ICAS3IVI_Length = 16 + (16 * number_of_offered_services_by_ICAS3IVI) + 4 + @ServiceDiscovery_SOMEIPPacket_Offer_ICAS3IVI_Options_Array_On_Off * 24;
    buffer[i++] = @ServiceDiscovery_SOMEIPPacket_Offer_ICAS3IVI_Length>>24 & 0xFF;
    buffer[i++] = @ServiceDiscovery_SOMEIPPacket_Offer_ICAS3IVI_Length>>16 & 0xFF;
    buffer[i++] = @ServiceDiscovery_SOMEIPPacket_Offer_ICAS3IVI_Length>> 8 & 0xFF;
    buffer[i++] = @ServiceDiscovery_SOMEIPPacket_Offer_ICAS3IVI_Length     & 0xFF;
    
    // SOME/IP Packet - Request ID, Client ID [16 bit]
    buffer[i++] = @ServiceDiscovery_SOMEIPPacket_Offer_ICAS3IVI_Request_ID_Client_ID>>8 & 0xFF;
    buffer[i++] = @ServiceDiscovery_SOMEIPPacket_Offer_ICAS3IVI_Request_ID_Client_ID    & 0xFF;
    
    // SOME/IP Packet - Request ID, Session ID) [16 bit]
    @ServiceDiscovery_SOMEIPPacket_Request_ID_Session_ID = @ServiceDiscovery_SOMEIPPacket_Request_ID_Session_ID + 1;
    if (@ServiceDiscovery_SOMEIPPacket_Request_ID_Session_ID == 0x10000) @ServiceDiscovery_SOMEIPPacket_Request_ID_Session_ID = 1;
    
    buffer[i++] = @ServiceDiscovery_SOMEIPPacket_Request_ID_Session_ID>>8 & 0xFF;
    buffer[i++] = @ServiceDiscovery_SOMEIPPacket_Request_ID_Session_ID    & 0xFF;
    
    // SOME/IP Packet - Protocol Version [8 bit]
    buffer[i++] = @ServiceDiscovery_SOMEIPPacket_Offer_ICAS3IVI_Protocol_Version;
    
    // SOME/IP Packet - Interface Version [8 bit]
    buffer[i++] = @ServiceDiscovery_SOMEIPPacket_Offer_ICAS3IVI_Interface_Version;

    // SOME/IP Packet - Message Type [8 bit]
    buffer[i++] = @ServiceDiscovery_SOMEIPPacket_Offer_ICAS3IVI_Message_Type;
      
    // SOME/IP Packet - Return Code [8 bit]
    buffer[i++] = @ServiceDiscovery_SOMEIPPacket_Offer_ICAS3IVI_Return_Code;
    
    // SOME/IP Packet - Flags [8 bit]
    buffer[i++] = @ServiceDiscovery_SOMEIPPacket_Offer_ICAS3IVI_Flags;
    
    // SOME/IP Packet - Reserved [24 bit]
    buffer[i++] = 0x00;
    buffer[i++] = 0x00;
    buffer[i++] = 0x00;
    
    
    // SOME/IP Packet - Entries Array
    
    // SOME/IP Packet - Entries Array - Length [32 bit]
    @ServiceDiscovery_SOMEIPPacket_Offer_ICAS3IVI_Entries_Array_Length = 16 * number_of_offered_services_by_ICAS3IVI;
    buffer[i++] = @ServiceDiscovery_SOMEIPPacket_Offer_ICAS3IVI_Entries_Array_Length>>24 & 0xFF;
    buffer[i++] = @ServiceDiscovery_SOMEIPPacket_Offer_ICAS3IVI_Entries_Array_Length>>16 & 0xFF;
    buffer[i++] = @ServiceDiscovery_SOMEIPPacket_Offer_ICAS3IVI_Entries_Array_Length>> 8 & 0xFF;
    buffer[i++] = @ServiceDiscovery_SOMEIPPacket_Offer_ICAS3IVI_Entries_Array_Length     & 0xFF;
    
    service_counter = 0;
    
    if (@ServiceDiscovery_Offer_Service_Distance == 1 && service_counter < number_of_offered_services_by_ICAS3IVI)
    {
      servicediscovery_offer_ICAS3IVI_entries_array_type[service_counter]                 = 1; // Offer
      servicediscovery_offer_ICAS3IVI_entries_array_index_1st_options[service_counter]    = 0;
      servicediscovery_offer_ICAS3IVI_entries_array_index_2nd_options[service_counter]    = 0;
      servicediscovery_offer_ICAS3IVI_entries_array_nr_of_opt_1[service_counter]          = @ServiceDiscovery_SOMEIPPacket_Offer_ICAS3IVI_Options_Array_On_Off;
      servicediscovery_offer_ICAS3IVI_entries_array_nr_of_opt_2[service_counter]          = 0;
      servicediscovery_offer_ICAS3IVI_entries_array_service_id[service_counter]           = 0x600A;
      servicediscovery_offer_ICAS3IVI_entries_array_instance_id[service_counter]          = 1;
      servicediscovery_offer_ICAS3IVI_entries_array_major_version[service_counter]        = 5;
      servicediscovery_offer_ICAS3IVI_entries_array_ttl[service_counter]                  = 5;
      servicediscovery_offer_ICAS3IVI_entries_array_minor_version[service_counter]        = 0;

      service_counter++;
    }
    
    if (number_of_offered_services_by_ICAS3IVI == 0)
    {
      servicediscovery_offer_ICAS3IVI_entries_array_type[service_counter]                 = 0;
      servicediscovery_offer_ICAS3IVI_entries_array_index_1st_options[service_counter]    = 0;
      servicediscovery_offer_ICAS3IVI_entries_array_index_2nd_options[service_counter]    = 0;
      servicediscovery_offer_ICAS3IVI_entries_array_nr_of_opt_1[service_counter]          = 0;
      servicediscovery_offer_ICAS3IVI_entries_array_nr_of_opt_2[service_counter]          = 0;
      servicediscovery_offer_ICAS3IVI_entries_array_service_id[service_counter]           = 0;
      servicediscovery_offer_ICAS3IVI_entries_array_instance_id[service_counter]          = 0;
      servicediscovery_offer_ICAS3IVI_entries_array_major_version[service_counter]        = 0;
      servicediscovery_offer_ICAS3IVI_entries_array_ttl[service_counter]                  = 0;
      servicediscovery_offer_ICAS3IVI_entries_array_minor_version[service_counter]        = 0;
    }
      
    for (j = 0; j < number_of_offered_services_by_ICAS3IVI; j++)
    {
      // SOME/IP Packet - Entries Array - Type [8 bit]
      buffer[i++] = servicediscovery_offer_ICAS3IVI_entries_array_type[j];
      
      // SOME/IP Packet - Entries Array - Index 1st options [8 bit]
      buffer[i++] = servicediscovery_offer_ICAS3IVI_entries_array_index_1st_options[j];
      
      // SOME/IP Packet - Entries Array - Index 2nd options [8 bit]
      buffer[i++] = servicediscovery_offer_ICAS3IVI_entries_array_index_2nd_options[j];
      
      // SOME/IP Packet - Entries Array - # of opt 1 [4 bit] / # of opt 2 [4 bit]
      buffer[i++] = (((servicediscovery_offer_ICAS3IVI_entries_array_nr_of_opt_1[j]*16)) + (servicediscovery_offer_ICAS3IVI_entries_array_nr_of_opt_2[j]));
      
      // SOME/IP Packet - Entries Array - Service ID [16 bit]
      buffer[i++] = servicediscovery_offer_ICAS3IVI_entries_array_service_id[j]>> 8 & 0xFF;
      buffer[i++] = servicediscovery_offer_ICAS3IVI_entries_array_service_id[j]     & 0xFF;

      // SOME/IP Packet - Entries Array - Instance ID [16 bit]
      buffer[i++] = servicediscovery_offer_ICAS3IVI_entries_array_instance_id[j]>> 8 & 0xFF;
      buffer[i++] = servicediscovery_offer_ICAS3IVI_entries_array_instance_id[j]     & 0xFF;
      
      // SOME/IP Packet - Entries Array - Major Version [8 bit]
      buffer[i++] = servicediscovery_offer_ICAS3IVI_entries_array_major_version[j];
      
      // SOME/IP Packet - Entries Array - TTL [24 bit]
      buffer[i++] = servicediscovery_offer_ICAS3IVI_entries_array_ttl[j]>>16 & 0xFF;
      buffer[i++] = servicediscovery_offer_ICAS3IVI_entries_array_ttl[j]>> 8 & 0xFF;
      buffer[i++] = servicediscovery_offer_ICAS3IVI_entries_array_ttl[j]     & 0xFF;
      
      // SOME/IP Packet - Entries Array - Minor Version [32 bit]
      buffer[i++] = servicediscovery_offer_ICAS3IVI_entries_array_minor_version[j]>>24 & 0xFF;
      buffer[i++] = servicediscovery_offer_ICAS3IVI_entries_array_minor_version[j]>>16 & 0xFF;
      buffer[i++] = servicediscovery_offer_ICAS3IVI_entries_array_minor_version[j]>> 8 & 0xFF;
      buffer[i++] = servicediscovery_offer_ICAS3IVI_entries_array_minor_version[j]     & 0xFF;
    }
    
    //SOME/IP Packet - Options Array - Length [32 bit]
    buffer[i++] = @ServiceDiscovery_SOMEIPPacket_Offer_ICAS3IVI_Options_Array_Length>>24 & 0xFF;
    buffer[i++] = @ServiceDiscovery_SOMEIPPacket_Offer_ICAS3IVI_Options_Array_Length>>16 & 0xFF;
    buffer[i++] = @ServiceDiscovery_SOMEIPPacket_Offer_ICAS3IVI_Options_Array_Length>> 8 & 0xFF;
    buffer[i++] = @ServiceDiscovery_SOMEIPPacket_Offer_ICAS3IVI_Options_Array_Length     & 0xFF;
    
    if (@ServiceDiscovery_SOMEIPPacket_Offer_ICAS3IVI_Options_Array_On_Off == 1)
    {
      //SOME/IP Packet - Options Array - Option1 Length [16 bit]
      buffer[i++] = @ServiceDiscovery_SOMEIPPacket_Offer_ICAS3IVI_Options_Array_Option1_Length>> 8 & 0xFF;
      buffer[i++] = @ServiceDiscovery_SOMEIPPacket_Offer_ICAS3IVI_Options_Array_Option1_Length     & 0xFF;
      
      //SOME/IP Packet - Options Array - Option1 Type [8 bit]
      buffer[i++] = @ServiceDiscovery_SOMEIPPacket_Offer_ICAS3IVI_Options_Array_Option1_Type & 0xFF;
      
      //SOME/IP Packet - Options Array - Reserved [8 bit]
      buffer[i++] = 0x00;
      
      //SOME/IP Packet - Options Array - Option1 IPv6 Address
      buffer[i++] = @ServiceDiscovery_SOMEIPPacket_Offer_ICAS3IVI_Options_Array_Option1_IPv6_01>>8 & 0xFF;
      buffer[i++] = @ServiceDiscovery_SOMEIPPacket_Offer_ICAS3IVI_Options_Array_Option1_IPv6_01    & 0xFF;
      buffer[i++] = @ServiceDiscovery_SOMEIPPacket_Offer_ICAS3IVI_Options_Array_Option1_IPv6_02>>8 & 0xFF;
      buffer[i++] = @ServiceDiscovery_SOMEIPPacket_Offer_ICAS3IVI_Options_Array_Option1_IPv6_02    & 0xFF;
      buffer[i++] = @ServiceDiscovery_SOMEIPPacket_Offer_ICAS3IVI_Options_Array_Option1_IPv6_03>>8 & 0xFF;
      buffer[i++] = @ServiceDiscovery_SOMEIPPacket_Offer_ICAS3IVI_Options_Array_Option1_IPv6_03    & 0xFF;
      buffer[i++] = @ServiceDiscovery_SOMEIPPacket_Offer_ICAS3IVI_Options_Array_Option1_IPv6_04>>8 & 0xFF;
      buffer[i++] = @ServiceDiscovery_SOMEIPPacket_Offer_ICAS3IVI_Options_Array_Option1_IPv6_04    & 0xFF;
      buffer[i++] = @ServiceDiscovery_SOMEIPPacket_Offer_ICAS3IVI_Options_Array_Option1_IPv6_05>>8 & 0xFF;
      buffer[i++] = @ServiceDiscovery_SOMEIPPacket_Offer_ICAS3IVI_Options_Array_Option1_IPv6_05    & 0xFF;
      buffer[i++] = @ServiceDiscovery_SOMEIPPacket_Offer_ICAS3IVI_Options_Array_Option1_IPv6_06>>8 & 0xFF;
      buffer[i++] = @ServiceDiscovery_SOMEIPPacket_Offer_ICAS3IVI_Options_Array_Option1_IPv6_06    & 0xFF;
      buffer[i++] = @ServiceDiscovery_SOMEIPPacket_Offer_ICAS3IVI_Options_Array_Option1_IPv6_07>>8 & 0xFF;
      buffer[i++] = @ServiceDiscovery_SOMEIPPacket_Offer_ICAS3IVI_Options_Array_Option1_IPv6_07    & 0xFF;
      buffer[i++] = @ServiceDiscovery_SOMEIPPacket_Offer_ICAS3IVI_Options_Array_Option1_IPv6_08>>8 & 0xFF;
      buffer[i++] = @ServiceDiscovery_SOMEIPPacket_Offer_ICAS3IVI_Options_Array_Option1_IPv6_08    & 0xFF;
      
      //SOME/IP Packet - Options Array - Reserved [8 bit]
      buffer[i++] = 0x00;
      
      //SOME/IP Packet - Options Array - Option1 L4-Proto [8 bit]
      buffer[i++] = @ServiceDiscovery_SOMEIPPacket_Offer_ICAS3IVI_Options_Array_Option1_L4_Proto;
      
      //SOME/IP Packet - Options Array - Option1 Port Number [16 bit]
      buffer[i++] = @ServiceDiscovery_SOMEIPPacket_Offer_ICAS3IVI_Options_Array_Option1_Port_Number>> 8 & 0xFF;
      buffer[i++] = @ServiceDiscovery_SOMEIPPacket_Offer_ICAS3IVI_Options_Array_Option1_Port_Number     & 0xFF;
    }
    
    ServiceDiscovery_SOMEIPPacket_Offer_ICAS3IVI_Entries_Array_update();

    // Rohdaten in UDP Paket schreiben
    EthPaket.udp.SetData( 0, buffer, i );

    // calculate UDP and IPv6 checksum and send Ethernet packet
    EthPaket.CompletePacket();
    output( EthPaket );
  }
}

on envVar ServiceDiscovery_SOMEIPPacket_Offer_ICAS3IVI_Entries_Array_Element_Next
{
  if (@this == 1 && @ServiceDiscovery_SOMEIPPacket_Offer_ICAS3IVI_Entries_Array_Element < number_of_offered_services_by_ICAS3IVI-1)
  {
    @ServiceDiscovery_SOMEIPPacket_Offer_ICAS3IVI_Entries_Array_Element = @ServiceDiscovery_SOMEIPPacket_Offer_ICAS3IVI_Entries_Array_Element + 1;
    ServiceDiscovery_SOMEIPPacket_Offer_ICAS3IVI_Entries_Array_update();
  }
}

on envVar ServiceDiscovery_SOMEIPPacket_Offer_ICAS3IVI_Entries_Array_Element_Previous
{
  if (@this == 1 && @ServiceDiscovery_SOMEIPPacket_Offer_ICAS3IVI_Entries_Array_Element > 0)
  {
    @ServiceDiscovery_SOMEIPPacket_Offer_ICAS3IVI_Entries_Array_Element = @ServiceDiscovery_SOMEIPPacket_Offer_ICAS3IVI_Entries_Array_Element - 1;
    ServiceDiscovery_SOMEIPPacket_Offer_ICAS3IVI_Entries_Array_update();
  }
}

ServiceDiscovery_SOMEIPPacket_Offer_ICAS3IVI_Entries_Array_update()
{
  @ServiceDiscovery_SOMEIPPacket_Offer_ICAS3IVI_Entries_Array_Type              = servicediscovery_offer_ICAS3IVI_entries_array_type[@ServiceDiscovery_SOMEIPPacket_Offer_ICAS3IVI_Entries_Array_Element];
  @ServiceDiscovery_SOMEIPPacket_Offer_ICAS3IVI_Entries_Array_Index_1st_options = servicediscovery_offer_ICAS3IVI_entries_array_index_1st_options[@ServiceDiscovery_SOMEIPPacket_Offer_ICAS3IVI_Entries_Array_Element];
  @ServiceDiscovery_SOMEIPPacket_Offer_ICAS3IVI_Entries_Array_Index_2nd_options = servicediscovery_offer_ICAS3IVI_entries_array_index_2nd_options[@ServiceDiscovery_SOMEIPPacket_Offer_ICAS3IVI_Entries_Array_Element];
  @ServiceDiscovery_SOMEIPPacket_Offer_ICAS3IVI_Entries_Array_Nr_of_opt_1       = servicediscovery_offer_ICAS3IVI_entries_array_nr_of_opt_1[@ServiceDiscovery_SOMEIPPacket_Offer_ICAS3IVI_Entries_Array_Element];
  @ServiceDiscovery_SOMEIPPacket_Offer_ICAS3IVI_Entries_Array_Nr_of_opt_2       = servicediscovery_offer_ICAS3IVI_entries_array_nr_of_opt_2[@ServiceDiscovery_SOMEIPPacket_Offer_ICAS3IVI_Entries_Array_Element];
  @ServiceDiscovery_SOMEIPPacket_Offer_ICAS3IVI_Entries_Array_Service_ID        = servicediscovery_offer_ICAS3IVI_entries_array_service_id[@ServiceDiscovery_SOMEIPPacket_Offer_ICAS3IVI_Entries_Array_Element];
  @ServiceDiscovery_SOMEIPPacket_Offer_ICAS3IVI_Entries_Array_Instance_ID       = servicediscovery_offer_ICAS3IVI_entries_array_instance_id[@ServiceDiscovery_SOMEIPPacket_Offer_ICAS3IVI_Entries_Array_Element];
  @ServiceDiscovery_SOMEIPPacket_Offer_ICAS3IVI_Entries_Array_Major_Version     = servicediscovery_offer_ICAS3IVI_entries_array_major_version[@ServiceDiscovery_SOMEIPPacket_Offer_ICAS3IVI_Entries_Array_Element];
  @ServiceDiscovery_SOMEIPPacket_Offer_ICAS3IVI_Entries_Array_TTL               = servicediscovery_offer_ICAS3IVI_entries_array_ttl[@ServiceDiscovery_SOMEIPPacket_Offer_ICAS3IVI_Entries_Array_Element];
  @ServiceDiscovery_SOMEIPPacket_Offer_ICAS3IVI_Entries_Array_Minor_Version     = servicediscovery_offer_ICAS3IVI_entries_array_minor_version[@ServiceDiscovery_SOMEIPPacket_Offer_ICAS3IVI_Entries_Array_Element];
}

on envVar ServiceDiscovery_SOMEIPPacket_Offer_ICAS3IVI_Entries_Array_Type
{
  servicediscovery_offer_ICAS3IVI_entries_array_type[@ServiceDiscovery_SOMEIPPacket_Offer_ICAS3IVI_Entries_Array_Element] = @this;
}
on envVar ServiceDiscovery_SOMEIPPacket_Offer_ICAS3IVI_Entries_Array_Index_1st_options
{
  servicediscovery_offer_ICAS3IVI_entries_array_index_1st_options[@ServiceDiscovery_SOMEIPPacket_Offer_ICAS3IVI_Entries_Array_Element] = @this;
}
on envVar ServiceDiscovery_SOMEIPPacket_Offer_ICAS3IVI_Entries_Array_Index_2nd_options
{
  servicediscovery_offer_ICAS3IVI_entries_array_index_2nd_options[@ServiceDiscovery_SOMEIPPacket_Offer_ICAS3IVI_Entries_Array_Element] = @this;
}
on envVar ServiceDiscovery_SOMEIPPacket_Offer_ICAS3IVI_Entries_Array_Nr_of_opt_1
{
  servicediscovery_offer_ICAS3IVI_entries_array_nr_of_opt_1[@ServiceDiscovery_SOMEIPPacket_Offer_ICAS3IVI_Entries_Array_Element] = @this;
}
on envVar ServiceDiscovery_SOMEIPPacket_Offer_ICAS3IVI_Entries_Array_Nr_of_opt_2
{
  servicediscovery_offer_ICAS3IVI_entries_array_nr_of_opt_2[@ServiceDiscovery_SOMEIPPacket_Offer_ICAS3IVI_Entries_Array_Element] = @this;
}
on envVar ServiceDiscovery_SOMEIPPacket_Offer_ICAS3IVI_Entries_Array_Service_ID
{
  servicediscovery_offer_ICAS3IVI_entries_array_service_id[@ServiceDiscovery_SOMEIPPacket_Offer_ICAS3IVI_Entries_Array_Element] = @this;
}
on envVar ServiceDiscovery_SOMEIPPacket_Offer_ICAS3IVI_Entries_Array_Instance_ID
{
  servicediscovery_offer_ICAS3IVI_entries_array_instance_id[@ServiceDiscovery_SOMEIPPacket_Offer_ICAS3IVI_Entries_Array_Element] = @this;
}
on envVar ServiceDiscovery_SOMEIPPacket_Offer_ICAS3IVI_Entries_Array_Major_Version
{
  servicediscovery_offer_ICAS3IVI_entries_array_major_version[@ServiceDiscovery_SOMEIPPacket_Offer_ICAS3IVI_Entries_Array_Element] = @this;
}
on envVar ServiceDiscovery_SOMEIPPacket_Offer_ICAS3IVI_Entries_Array_TTL
{
  servicediscovery_offer_ICAS3IVI_entries_array_ttl[@ServiceDiscovery_SOMEIPPacket_Offer_ICAS3IVI_Entries_Array_Element] = @this;
}
on envVar ServiceDiscovery_SOMEIPPacket_Offer_ICAS3IVI_Entries_Array_Minor_Version
{
  servicediscovery_offer_ICAS3IVI_entries_array_minor_version[@ServiceDiscovery_SOMEIPPacket_Offer_ICAS3IVI_Entries_Array_Element] = @this;
}

on envVar ServiceDiscovery_SOMEIPPacket_Offer_ICAS3IVI_Options_Array_On_Off
{
  if (@this == 0)
  {
    @ServiceDiscovery_SOMEIPPacket_Offer_ICAS3IVI_Options_Array_Length      = 0;
    @ServiceDiscovery_SOMEIPPacket_Offer_ICAS3IVI_Entries_Array_Nr_of_opt_1 = 0;
  }
  
  if (@this == 1)
  {
    @ServiceDiscovery_SOMEIPPacket_Offer_ICAS3IVI_Options_Array_Length      = 24;
    @ServiceDiscovery_SOMEIPPacket_Offer_ICAS3IVI_Entries_Array_Nr_of_opt_1 = 1;
  }
}




Send_ServiceDiscovery_SubscribeACK_ICAS1Gateway ()
{
  ethernetPacket EthPaket;
  
  // Ethernet Packet - MAC Source address
  getvalue (ServiceDiscovery_EthernetPacket_MAC_Source_ICAS1Gateway, buffer_MAC);
  //EthPaket.source.ParseAddress ( buffer_MAC );
  EthPaket.source = ethGetMacAddressAsNumber (buffer_MAC);
  
  // Ethernet Packet - MAC Destination address
  getvalue (ServiceDiscovery_EthernetPacket_MAC_Destination, buffer_MAC);
  //EthPaket.destination.ParseAddress ( buffer_MAC );
  EthPaket.destination = ethGetMacAddressAsNumber (buffer_MAC);
  
  // Ethernet Packet - VLAN
  EthPaket.SetVlan (@ServiceDiscovery_EthernetPacket_VLAN_TPID, @ServiceDiscovery_EthernetPacket_VLAN_TCI);
  
  // Ethernet Packet - Type
  //EthPaket.ipv6.type = @EthernetPacket_Type;
  if (@ServiceDiscovery_EthernetPacket_Type == 0x86DD) EthPaket.ipv6.Init();
  
  
  // IPv6 Packet - Version
  EthPaket.ipv6.version = @ServiceDiscovery_IPv6Packet_Version;

  // IPv6 Packet - Traffic Class
  EthPaket.ipv6.class = @ServiceDiscovery_IPv6Packet_Traffic_Class;
  
  // IPv6 Packet - Flow Label
  EthPaket.ipv6.flow = @ServiceDiscovery_IPv6Packet_Flow_Label;
  
  // IPv6 Packet - Payload_Length
  EthPaket.ipv6.length = @ServiceDiscovery_IPv6Packet_Payload_Length;
  
  // IPv6 Packet - Next Header
  EthPaket.ipv6.next = @ServiceDiscovery_IPv6Packet_Next_Header;
  if (@ServiceDiscovery_IPv6Packet_Next_Header == 6) EthPaket.tcp.Init();
  if (@ServiceDiscovery_IPv6Packet_Next_Header == 17) EthPaket.udp.Init();
  
  // IPv6 Packet - Hop Limit
  EthPaket.ipv6.hopLimit = @ServiceDiscovery_IPv6Packet_Hop_Limit;

  // IPv6 Packet - IPv6 Destination address    // TODO: char array zu byte array
  buffer_ipv6[0]  = @ServiceDiscovery_IPv6Packet_IP_Destination_Unicast_01>>8 & 0xFF;
  buffer_ipv6[1]  = @ServiceDiscovery_IPv6Packet_IP_Destination_Unicast_01    & 0xFF;
  buffer_ipv6[2]  = @ServiceDiscovery_IPv6Packet_IP_Destination_Unicast_02>>8 & 0xFF;
  buffer_ipv6[3]  = @ServiceDiscovery_IPv6Packet_IP_Destination_Unicast_02    & 0xFF;
  buffer_ipv6[4]  = @ServiceDiscovery_IPv6Packet_IP_Destination_Unicast_03>>8 & 0xFF;
  buffer_ipv6[5]  = @ServiceDiscovery_IPv6Packet_IP_Destination_Unicast_03    & 0xFF;
  buffer_ipv6[6]  = @ServiceDiscovery_IPv6Packet_IP_Destination_Unicast_04>>8 & 0xFF;
  buffer_ipv6[7]  = @ServiceDiscovery_IPv6Packet_IP_Destination_Unicast_04    & 0xFF;
  buffer_ipv6[8]  = @ServiceDiscovery_IPv6Packet_IP_Destination_Unicast_05>>8 & 0xFF;
  buffer_ipv6[9]  = @ServiceDiscovery_IPv6Packet_IP_Destination_Unicast_05    & 0xFF;
  buffer_ipv6[10] = @ServiceDiscovery_IPv6Packet_IP_Destination_Unicast_06>>8 & 0xFF;
  buffer_ipv6[11] = @ServiceDiscovery_IPv6Packet_IP_Destination_Unicast_06    & 0xFF;
  buffer_ipv6[12] = @ServiceDiscovery_IPv6Packet_IP_Destination_Unicast_07>>8 & 0xFF;
  buffer_ipv6[13] = @ServiceDiscovery_IPv6Packet_IP_Destination_Unicast_07    & 0xFF;
  buffer_ipv6[14] = @ServiceDiscovery_IPv6Packet_IP_Destination_Unicast_08>>8 & 0xFF;
  buffer_ipv6[15] = @ServiceDiscovery_IPv6Packet_IP_Destination_Unicast_08    & 0xFF;
  EthPaket.ipv6.destination.SetData ( 0, buffer_ipv6, elcount(buffer_ipv6) );

  // IPv6 Packet - IPv6 Source address    // TODO: char array zu byte array
  buffer_ipv6[0]  = @ServiceDiscovery_IPv6Packet_IP_Source_ICAS1Gateway_01>>8 & 0xFF;
  buffer_ipv6[1]  = @ServiceDiscovery_IPv6Packet_IP_Source_ICAS1Gateway_01    & 0xFF;
  buffer_ipv6[2]  = @ServiceDiscovery_IPv6Packet_IP_Source_ICAS1Gateway_02>>8 & 0xFF;
  buffer_ipv6[3]  = @ServiceDiscovery_IPv6Packet_IP_Source_ICAS1Gateway_02    & 0xFF;
  buffer_ipv6[4]  = @ServiceDiscovery_IPv6Packet_IP_Source_ICAS1Gateway_03>>8 & 0xFF;
  buffer_ipv6[5]  = @ServiceDiscovery_IPv6Packet_IP_Source_ICAS1Gateway_03    & 0xFF;
  buffer_ipv6[6]  = @ServiceDiscovery_IPv6Packet_IP_Source_ICAS1Gateway_04>>8 & 0xFF;
  buffer_ipv6[7]  = @ServiceDiscovery_IPv6Packet_IP_Source_ICAS1Gateway_04    & 0xFF;
  buffer_ipv6[8]  = @ServiceDiscovery_IPv6Packet_IP_Source_ICAS1Gateway_05>>8 & 0xFF;
  buffer_ipv6[9]  = @ServiceDiscovery_IPv6Packet_IP_Source_ICAS1Gateway_05    & 0xFF;
  buffer_ipv6[10] = @ServiceDiscovery_IPv6Packet_IP_Source_ICAS1Gateway_06>>8 & 0xFF;
  buffer_ipv6[11] = @ServiceDiscovery_IPv6Packet_IP_Source_ICAS1Gateway_06    & 0xFF;
  buffer_ipv6[12] = @ServiceDiscovery_IPv6Packet_IP_Source_ICAS1Gateway_07>>8 & 0xFF;
  buffer_ipv6[13] = @ServiceDiscovery_IPv6Packet_IP_Source_ICAS1Gateway_07    & 0xFF;
  buffer_ipv6[14] = @ServiceDiscovery_IPv6Packet_IP_Source_ICAS1Gateway_08>>8 & 0xFF;
  buffer_ipv6[15] = @ServiceDiscovery_IPv6Packet_IP_Source_ICAS1Gateway_08    & 0xFF;
  EthPaket.ipv6.source.SetData ( 0, buffer_ipv6, elcount(buffer_ipv6) );

  
  // UDP Packet - Source Port
  EthPaket.udp.source = @ServiceDiscovery_UDPPacket_Port_Source;
  
  // UDP Packet - Destination Port
  EthPaket.udp.destination = @ServiceDiscovery_UDPPacket_Port_Destination;
  
  // UDP Packet - Length
  EthPaket.udp.length = @ServiceDiscovery_UDPPacket_Length;
  
  
  // SOME/IP Packet aus Rohdaten zusammenbauen (buffer array)
  i=0;
  
  // SOME/IP Packet - Message ID, Service ID [16 bit]
  buffer[i++] = @ServiceDiscovery_SOMEIPPacket_SubACK_ICAS1Gateway_Message_ID_Service_ID>>8 & 0xFF;
  buffer[i++] = @ServiceDiscovery_SOMEIPPacket_SubACK_ICAS1Gateway_Message_ID_Service_ID    & 0xFF;
  
  // SOME/IP Packet - Message ID, Message ID [16 bit]
  buffer[i++] = @ServiceDiscovery_SOMEIPPacket_SubACK_ICAS1Gateway_Message_ID_Method_ID>>8 & 0xFF;
  buffer[i++] = @ServiceDiscovery_SOMEIPPacket_SubACK_ICAS1Gateway_Message_ID_Method_ID    & 0xFF;
  
  // SOME/IP Packet - Length [32 bit]
  @ServiceDiscovery_SOMEIPPacket_SubACK_ICAS1Gateway_Length = 16 + (16 * number_of_entries_array_elements) + 28;
  buffer[i++] = @ServiceDiscovery_SOMEIPPacket_SubACK_ICAS1Gateway_Length>>24 & 0xFF;
  buffer[i++] = @ServiceDiscovery_SOMEIPPacket_SubACK_ICAS1Gateway_Length>>16 & 0xFF;
  buffer[i++] = @ServiceDiscovery_SOMEIPPacket_SubACK_ICAS1Gateway_Length>> 8 & 0xFF;
  buffer[i++] = @ServiceDiscovery_SOMEIPPacket_SubACK_ICAS1Gateway_Length     & 0xFF;
  
  // SOME/IP Packet - Request ID, Client ID [16 bit]
  buffer[i++] = @ServiceDiscovery_SOMEIPPacket_SubACK_ICAS1Gateway_Request_ID_Client_ID>>8 & 0xFF;
  buffer[i++] = @ServiceDiscovery_SOMEIPPacket_SubACK_ICAS1Gateway_Request_ID_Client_ID    & 0xFF;
  
  // SOME/IP Packet - Request ID, Session ID) [16 bit]
  @ServiceDiscovery_SOMEIPPacket_Request_ID_Session_ID = @ServiceDiscovery_SOMEIPPacket_Request_ID_Session_ID + 1;
  if (@ServiceDiscovery_SOMEIPPacket_Request_ID_Session_ID == 0x10000) @ServiceDiscovery_SOMEIPPacket_Request_ID_Session_ID = 1;
  
  buffer[i++] = @ServiceDiscovery_SOMEIPPacket_Request_ID_Session_ID>>8 & 0xFF;
  buffer[i++] = @ServiceDiscovery_SOMEIPPacket_Request_ID_Session_ID    & 0xFF;
  
  // SOME/IP Packet - Protocol Version [8 bit]
  buffer[i++] = @ServiceDiscovery_SOMEIPPacket_SubACK_ICAS1Gateway_Protocol_Version;
  
  // SOME/IP Packet - Interface Version [8 bit]
  buffer[i++] = @ServiceDiscovery_SOMEIPPacket_SubACK_ICAS1Gateway_Interface_Version;

  // SOME/IP Packet - Message Type [8 bit]
  buffer[i++] = @ServiceDiscovery_SOMEIPPacket_SubACK_ICAS1Gateway_Message_Type;
    
  // SOME/IP Packet - Return Code [8 bit]
  buffer[i++] = @ServiceDiscovery_SOMEIPPacket_SubACK_ICAS1Gateway_Return_Code;
  
  // SOME/IP Packet - Flags [8 bit]
  buffer[i++] = @ServiceDiscovery_SOMEIPPacket_SubACK_ICAS1Gateway_Flags;
  
  // SOME/IP Packet - Reserved [24 bit]
  buffer[i++] = 0x00;
  buffer[i++] = 0x00;
  buffer[i++] = 0x00;


  // SOME/IP Packet - Entries Array - Length [32 bit]
  @ServiceDiscovery_SOMEIPPacket_SubACK_ICAS1Gateway_Entries_Array_Length = 16 * number_of_entries_array_elements;
  buffer[i++] = @ServiceDiscovery_SOMEIPPacket_SubACK_ICAS1Gateway_Entries_Array_Length>>24 & 0xFF;
  buffer[i++] = @ServiceDiscovery_SOMEIPPacket_SubACK_ICAS1Gateway_Entries_Array_Length>>16 & 0xFF;
  buffer[i++] = @ServiceDiscovery_SOMEIPPacket_SubACK_ICAS1Gateway_Entries_Array_Length>> 8 & 0xFF;
  buffer[i++] = @ServiceDiscovery_SOMEIPPacket_SubACK_ICAS1Gateway_Entries_Array_Length     & 0xFF;
  
  for (j=0; j < number_of_entries_array_elements; j++)
  {
    // SOME/IP Packet - Entries Array - Type [8 bit]
    buffer[i++] = servicediscovery_rx_entries_array_type[j]+1;
    
    // SOME/IP Packet - Entries Array - Index 1st options [8 bit]
    buffer[i++] = 0; //servicediscovery_rx_entries_array_index_1st_options[j];
    
    // SOME/IP Packet - Entries Array - Index 2nd options [8 bit]
    buffer[i++] = 0; //servicediscovery_rx_entries_array_index_2nd_options[j];
    
    // SOME/IP Packet - Entries Array - # of opt 1 [4 bit] / # of opt 2 [4 bit]
    buffer[i++] = 1*16;//(((servicediscovery_rx_entries_array_nr_of_opt_1[j]*16)) + (servicediscovery_rx_entries_array_nr_of_opt_2[j]));
    
    // SOME/IP Packet - Entries Array - Service ID [16 bit]
    buffer[i++] = servicediscovery_rx_entries_array_service_id[j]>> 8 & 0xFF;
    buffer[i++] = servicediscovery_rx_entries_array_service_id[j]     & 0xFF;

    // SOME/IP Packet - Entries Array - Instance ID [16 bit]
    buffer[i++] = servicediscovery_rx_entries_array_instance_id[j]>> 8 & 0xFF;
    buffer[i++] = servicediscovery_rx_entries_array_instance_id[j]     & 0xFF;
    
    // SOME/IP Packet - Entries Array - Major Version [8 bit]
    buffer[i++] = servicediscovery_rx_entries_array_major_version[j];
    
    // SOME/IP Packet - Entries Array - TTL [24 bit]
    buffer[i++] = servicediscovery_rx_entries_array_ttl[j]>>16 & 0xFF;
    buffer[i++] = servicediscovery_rx_entries_array_ttl[j]>> 8 & 0xFF;
    buffer[i++] = servicediscovery_rx_entries_array_ttl[j]     & 0xFF;
    
    // SOME/IP Packet - Entries Array - Reserved [12 bit] + Counter [4 bit]
    buffer[i++] = 0x00;
    buffer[i++] = servicediscovery_rx_entries_array_counter[j] & 0x0F;
    
    // SOME/IP Packet - Entries Array - Eventgroup ID
    buffer[i++] = servicediscovery_rx_entries_array_eventgroup_id[j]>> 8 & 0xFF;
    buffer[i++] = servicediscovery_rx_entries_array_eventgroup_id[j]     & 0xFF;

    
    // aktive Funktionen auswerten
    if (servicediscovery_rx_entries_array_service_id[j] == 0x6017) // Odometry
    {
      if (servicediscovery_rx_entries_array_eventgroup_id[j] == 0xC010) @Odometry_SubscribeStatus_speeds                              = 1;
      if (servicediscovery_rx_entries_array_eventgroup_id[j] == 0xC020) @Odometry_SubscribeStatus_velocities                          = 1;
      if (servicediscovery_rx_entries_array_eventgroup_id[j] == 0xC030) @Odometry_SubscribeStatus_additionalVehicleMotionInformations = 1;
      if (servicediscovery_rx_entries_array_eventgroup_id[j] == 0xC040) @Odometry_SubscribeStatus_wheelCorrections                    = 1;
      if (servicediscovery_rx_entries_array_eventgroup_id[j] == 0xC050) @Odometry_SubscribeStatus_accelerations                       = 1;
      if (servicediscovery_rx_entries_array_eventgroup_id[j] == 0xC060) @Odometry_SubscribeStatus_angularRates                        = 1;
    }
    
    if (servicediscovery_rx_entries_array_service_id[j] == 0x6068) // ChargingManagementCore
    {
      if (servicediscovery_rx_entries_array_eventgroup_id[j] == 0xC010) @ChargingManagementCore_SubscribeStatus_immediateChargingOptions   = 1;
      if (servicediscovery_rx_entries_array_eventgroup_id[j] == 0xC020) @ChargingManagementCore_SubscribeStatus_chargingProcessInformation = 1;
      if (servicediscovery_rx_entries_array_eventgroup_id[j] == 0xC030) @ChargingManagementCore_SubscribeStatus_chargingPlugs              = 1;
      if (servicediscovery_rx_entries_array_eventgroup_id[j] == 0xC040) @ChargingManagementCore_SubscribeStatus_immediateActions           = 1;
      if (servicediscovery_rx_entries_array_eventgroup_id[j] == 0xC050) @ChargingManagementCore_SubscribeStatus_notificationMarkers        = 1;
      if (servicediscovery_rx_entries_array_eventgroup_id[j] == 0xC060) @ChargingManagementCore_SubscribeStatus_notifications              = 1;
      if (servicediscovery_rx_entries_array_eventgroup_id[j] == 0xC070) @ChargingManagementCore_SubscribeStatus_pastErrorInformation       = 1;
      if (servicediscovery_rx_entries_array_eventgroup_id[j] == 0xC080) @ChargingManagementCore_SubscribeStatus_views                      = 1;
      if (servicediscovery_rx_entries_array_eventgroup_id[j] == 0xC090) @ChargingManagementCore_SubscribeStatus_oruUpdateApprovals         = 1;
      if (servicediscovery_rx_entries_array_eventgroup_id[j] == 0xC0A0) @ChargingManagementCore_SubscribeStatus_switchControls             = 1;
      if (servicediscovery_rx_entries_array_eventgroup_id[j] == 0xC0B0) @ChargingManagementCore_SubscribeStatus_valueControls              = 1;
      if (servicediscovery_rx_entries_array_eventgroup_id[j] == 0xC0C0) @ChargingManagementCore_SubscribeStatus_valueIndications           = 1;
      if (servicediscovery_rx_entries_array_eventgroup_id[j] == 0xC0D0) @ChargingManagementCore_SubscribeStatus_resetToFactoryData         = 1;
    }
  }
  
  
  //SOME/IP Packet - Options Array - Length [32 bit]
  buffer[i++] = @ServiceDiscovery_SOMEIPPacket_SubACK_ICAS1Gateway_Options_Array_Length>>24 & 0xFF;
  buffer[i++] = @ServiceDiscovery_SOMEIPPacket_SubACK_ICAS1Gateway_Options_Array_Length>>16 & 0xFF;
  buffer[i++] = @ServiceDiscovery_SOMEIPPacket_SubACK_ICAS1Gateway_Options_Array_Length>> 8 & 0xFF;
  buffer[i++] = @ServiceDiscovery_SOMEIPPacket_SubACK_ICAS1Gateway_Options_Array_Length     & 0xFF;

  //SOME/IP Packet - Options Array - Option1 Length [16 bit]
  buffer[i++] = @ServiceDiscovery_SOMEIPPacket_SubACK_ICAS1Gateway_Options_Array_Option1_Length>> 8 & 0xFF;
  buffer[i++] = @ServiceDiscovery_SOMEIPPacket_SubACK_ICAS1Gateway_Options_Array_Option1_Length     & 0xFF;
  
  //SOME/IP Packet - Options Array - Option1 Type [8 bit]
  buffer[i++] = @ServiceDiscovery_SOMEIPPacket_SubACK_ICAS1Gateway_Options_Array_Option1_Type & 0xFF;
  
  //SOME/IP Packet - Options Array - Reserved [8 bit]
  buffer[i++] = 0x00;
  
  //SOME/IP Packet - Options Array - Option1 IPv6 Address
  buffer[i++] = @ServiceDiscovery_SOMEIPPacket_SubACK_ICAS1Gateway_Options_Array_Option1_IPv6_01>>8 & 0xFF;
  buffer[i++] = @ServiceDiscovery_SOMEIPPacket_SubACK_ICAS1Gateway_Options_Array_Option1_IPv6_01    & 0xFF;
  buffer[i++] = @ServiceDiscovery_SOMEIPPacket_SubACK_ICAS1Gateway_Options_Array_Option1_IPv6_02>>8 & 0xFF;
  buffer[i++] = @ServiceDiscovery_SOMEIPPacket_SubACK_ICAS1Gateway_Options_Array_Option1_IPv6_02    & 0xFF;
  buffer[i++] = @ServiceDiscovery_SOMEIPPacket_SubACK_ICAS1Gateway_Options_Array_Option1_IPv6_03>>8 & 0xFF;
  buffer[i++] = @ServiceDiscovery_SOMEIPPacket_SubACK_ICAS1Gateway_Options_Array_Option1_IPv6_03    & 0xFF;
  buffer[i++] = @ServiceDiscovery_SOMEIPPacket_SubACK_ICAS1Gateway_Options_Array_Option1_IPv6_04>>8 & 0xFF;
  buffer[i++] = @ServiceDiscovery_SOMEIPPacket_SubACK_ICAS1Gateway_Options_Array_Option1_IPv6_04    & 0xFF;
  buffer[i++] = @ServiceDiscovery_SOMEIPPacket_SubACK_ICAS1Gateway_Options_Array_Option1_IPv6_05>>8 & 0xFF;
  buffer[i++] = @ServiceDiscovery_SOMEIPPacket_SubACK_ICAS1Gateway_Options_Array_Option1_IPv6_05    & 0xFF;
  buffer[i++] = @ServiceDiscovery_SOMEIPPacket_SubACK_ICAS1Gateway_Options_Array_Option1_IPv6_06>>8 & 0xFF;
  buffer[i++] = @ServiceDiscovery_SOMEIPPacket_SubACK_ICAS1Gateway_Options_Array_Option1_IPv6_06    & 0xFF;
  buffer[i++] = @ServiceDiscovery_SOMEIPPacket_SubACK_ICAS1Gateway_Options_Array_Option1_IPv6_07>>8 & 0xFF;
  buffer[i++] = @ServiceDiscovery_SOMEIPPacket_SubACK_ICAS1Gateway_Options_Array_Option1_IPv6_07    & 0xFF;
  buffer[i++] = @ServiceDiscovery_SOMEIPPacket_SubACK_ICAS1Gateway_Options_Array_Option1_IPv6_08>>8 & 0xFF;
  buffer[i++] = @ServiceDiscovery_SOMEIPPacket_SubACK_ICAS1Gateway_Options_Array_Option1_IPv6_08    & 0xFF;
  
  //SOME/IP Packet - Options Array - Reserved [8 bit]
  buffer[i++] = 0x00;
  
  //SOME/IP Packet - Options Array - Option1 L4-Proto [8 bit]
  buffer[i++] = @ServiceDiscovery_SOMEIPPacket_SubACK_ICAS1Gateway_Options_Array_Option1_L4_Proto;
  
  //SOME/IP Packet - Options Array - Option1 Port Number [16 bit]
  buffer[i++] = @ServiceDiscovery_SOMEIPPacket_SubACK_ICAS1Gateway_Options_Array_Option1_Port_Number>> 8 & 0xFF;
  buffer[i++] = @ServiceDiscovery_SOMEIPPacket_SubACK_ICAS1Gateway_Options_Array_Option1_Port_Number     & 0xFF;
  
  // Rohdaten in UDP Paket schreiben
  EthPaket.udp.SetData( 0, buffer, i );

  // calculate UDP and IPv6 checksum and send Ethernet packet
  EthPaket.CompletePacket();
  output( EthPaket );
}


Send_ServiceDiscovery_SubscribeACK_ICAS1Sys01 ()
{
  ethernetPacket EthPaket;
  
  // Ethernet Packet - MAC Source address
  getvalue (ServiceDiscovery_EthernetPacket_MAC_Source_ICAS1Sys01, buffer_MAC);
  //EthPaket.source.ParseAddress ( buffer_MAC );
  EthPaket.source = ethGetMacAddressAsNumber (buffer_MAC);
  
  // Ethernet Packet - MAC Destination address
  getvalue (ServiceDiscovery_EthernetPacket_MAC_Destination, buffer_MAC);
  //EthPaket.destination.ParseAddress ( buffer_MAC );
  EthPaket.destination = ethGetMacAddressAsNumber (buffer_MAC);
  
  // Ethernet Packet - VLAN
  EthPaket.SetVlan (@ServiceDiscovery_EthernetPacket_VLAN_TPID, @ServiceDiscovery_EthernetPacket_VLAN_TCI);
  
  // Ethernet Packet - Type
  //EthPaket.ipv6.type = @EthernetPacket_Type;
  if (@ServiceDiscovery_EthernetPacket_Type == 0x86DD) EthPaket.ipv6.Init();
  
  
  // IPv6 Packet - Version
  EthPaket.ipv6.version = @ServiceDiscovery_IPv6Packet_Version;

  // IPv6 Packet - Traffic Class
  EthPaket.ipv6.class = @ServiceDiscovery_IPv6Packet_Traffic_Class;
  
  // IPv6 Packet - Flow Label
  EthPaket.ipv6.flow = @ServiceDiscovery_IPv6Packet_Flow_Label;
  
  // IPv6 Packet - Payload_Length
  EthPaket.ipv6.length = @ServiceDiscovery_IPv6Packet_Payload_Length;
  
  // IPv6 Packet - Next Header
  EthPaket.ipv6.next = @ServiceDiscovery_IPv6Packet_Next_Header;
  if (@ServiceDiscovery_IPv6Packet_Next_Header == 6) EthPaket.tcp.Init();
  if (@ServiceDiscovery_IPv6Packet_Next_Header == 17) EthPaket.udp.Init();
  
  // IPv6 Packet - Hop Limit
  EthPaket.ipv6.hopLimit = @ServiceDiscovery_IPv6Packet_Hop_Limit;

  // IPv6 Packet - IPv6 Destination address    // TODO: char array zu byte array
  buffer_ipv6[0]  = @ServiceDiscovery_IPv6Packet_IP_Destination_Unicast_01>>8 & 0xFF;
  buffer_ipv6[1]  = @ServiceDiscovery_IPv6Packet_IP_Destination_Unicast_01    & 0xFF;
  buffer_ipv6[2]  = @ServiceDiscovery_IPv6Packet_IP_Destination_Unicast_02>>8 & 0xFF;
  buffer_ipv6[3]  = @ServiceDiscovery_IPv6Packet_IP_Destination_Unicast_02    & 0xFF;
  buffer_ipv6[4]  = @ServiceDiscovery_IPv6Packet_IP_Destination_Unicast_03>>8 & 0xFF;
  buffer_ipv6[5]  = @ServiceDiscovery_IPv6Packet_IP_Destination_Unicast_03    & 0xFF;
  buffer_ipv6[6]  = @ServiceDiscovery_IPv6Packet_IP_Destination_Unicast_04>>8 & 0xFF;
  buffer_ipv6[7]  = @ServiceDiscovery_IPv6Packet_IP_Destination_Unicast_04    & 0xFF;
  buffer_ipv6[8]  = @ServiceDiscovery_IPv6Packet_IP_Destination_Unicast_05>>8 & 0xFF;
  buffer_ipv6[9]  = @ServiceDiscovery_IPv6Packet_IP_Destination_Unicast_05    & 0xFF;
  buffer_ipv6[10] = @ServiceDiscovery_IPv6Packet_IP_Destination_Unicast_06>>8 & 0xFF;
  buffer_ipv6[11] = @ServiceDiscovery_IPv6Packet_IP_Destination_Unicast_06    & 0xFF;
  buffer_ipv6[12] = @ServiceDiscovery_IPv6Packet_IP_Destination_Unicast_07>>8 & 0xFF;
  buffer_ipv6[13] = @ServiceDiscovery_IPv6Packet_IP_Destination_Unicast_07    & 0xFF;
  buffer_ipv6[14] = @ServiceDiscovery_IPv6Packet_IP_Destination_Unicast_08>>8 & 0xFF;
  buffer_ipv6[15] = @ServiceDiscovery_IPv6Packet_IP_Destination_Unicast_08    & 0xFF;
  EthPaket.ipv6.destination.SetData ( 0, buffer_ipv6, elcount(buffer_ipv6) );

  // IPv6 Packet - IPv6 Source address    // TODO: char array zu byte array
  buffer_ipv6[0]  = @ServiceDiscovery_IPv6Packet_IP_Source_ICAS1Sys01_01>>8 & 0xFF;
  buffer_ipv6[1]  = @ServiceDiscovery_IPv6Packet_IP_Source_ICAS1Sys01_01    & 0xFF;
  buffer_ipv6[2]  = @ServiceDiscovery_IPv6Packet_IP_Source_ICAS1Sys01_02>>8 & 0xFF;
  buffer_ipv6[3]  = @ServiceDiscovery_IPv6Packet_IP_Source_ICAS1Sys01_02    & 0xFF;
  buffer_ipv6[4]  = @ServiceDiscovery_IPv6Packet_IP_Source_ICAS1Sys01_03>>8 & 0xFF;
  buffer_ipv6[5]  = @ServiceDiscovery_IPv6Packet_IP_Source_ICAS1Sys01_03    & 0xFF;
  buffer_ipv6[6]  = @ServiceDiscovery_IPv6Packet_IP_Source_ICAS1Sys01_04>>8 & 0xFF;
  buffer_ipv6[7]  = @ServiceDiscovery_IPv6Packet_IP_Source_ICAS1Sys01_04    & 0xFF;
  buffer_ipv6[8]  = @ServiceDiscovery_IPv6Packet_IP_Source_ICAS1Sys01_05>>8 & 0xFF;
  buffer_ipv6[9]  = @ServiceDiscovery_IPv6Packet_IP_Source_ICAS1Sys01_05    & 0xFF;
  buffer_ipv6[10] = @ServiceDiscovery_IPv6Packet_IP_Source_ICAS1Sys01_06>>8 & 0xFF;
  buffer_ipv6[11] = @ServiceDiscovery_IPv6Packet_IP_Source_ICAS1Sys01_06    & 0xFF;
  buffer_ipv6[12] = @ServiceDiscovery_IPv6Packet_IP_Source_ICAS1Sys01_07>>8 & 0xFF;
  buffer_ipv6[13] = @ServiceDiscovery_IPv6Packet_IP_Source_ICAS1Sys01_07    & 0xFF;
  buffer_ipv6[14] = @ServiceDiscovery_IPv6Packet_IP_Source_ICAS1Sys01_08>>8 & 0xFF;
  buffer_ipv6[15] = @ServiceDiscovery_IPv6Packet_IP_Source_ICAS1Sys01_08    & 0xFF;
  EthPaket.ipv6.source.SetData ( 0, buffer_ipv6, elcount(buffer_ipv6) );

  
  // UDP Packet - Source Port
  EthPaket.udp.source = @ServiceDiscovery_UDPPacket_Port_Source;
  
  // UDP Packet - Destination Port
  EthPaket.udp.destination = @ServiceDiscovery_UDPPacket_Port_Destination;
  
  // UDP Packet - Length
  EthPaket.udp.length = @ServiceDiscovery_UDPPacket_Length;
  
  
  // SOME/IP Packet aus Rohdaten zusammenbauen (buffer array)
  i=0;
  
  // SOME/IP Packet - Message ID, Service ID [16 bit]
  buffer[i++] = @ServiceDiscovery_SOMEIPPacket_SubACK_ICAS1Sys01_Message_ID_Service_ID>>8 & 0xFF;
  buffer[i++] = @ServiceDiscovery_SOMEIPPacket_SubACK_ICAS1Sys01_Message_ID_Service_ID    & 0xFF;
  
  // SOME/IP Packet - Message ID, Message ID [16 bit]
  buffer[i++] = @ServiceDiscovery_SOMEIPPacket_SubACK_ICAS1Sys01_Message_ID_Method_ID>>8 & 0xFF;
  buffer[i++] = @ServiceDiscovery_SOMEIPPacket_SubACK_ICAS1Sys01_Message_ID_Method_ID    & 0xFF;
  
  // SOME/IP Packet - Length [32 bit]
  @ServiceDiscovery_SOMEIPPacket_SubACK_ICAS1Sys01_Length = 16 + (16 * number_of_entries_array_elements) + 28;
  buffer[i++] = @ServiceDiscovery_SOMEIPPacket_SubACK_ICAS1Sys01_Length>>24 & 0xFF;
  buffer[i++] = @ServiceDiscovery_SOMEIPPacket_SubACK_ICAS1Sys01_Length>>16 & 0xFF;
  buffer[i++] = @ServiceDiscovery_SOMEIPPacket_SubACK_ICAS1Sys01_Length>> 8 & 0xFF;
  buffer[i++] = @ServiceDiscovery_SOMEIPPacket_SubACK_ICAS1Sys01_Length     & 0xFF;
  
  // SOME/IP Packet - Request ID, Client ID [16 bit]
  buffer[i++] = @ServiceDiscovery_SOMEIPPacket_SubACK_ICAS1Sys01_Request_ID_Client_ID>>8 & 0xFF;
  buffer[i++] = @ServiceDiscovery_SOMEIPPacket_SubACK_ICAS1Sys01_Request_ID_Client_ID    & 0xFF;
  
  // SOME/IP Packet - Request ID, Session ID) [16 bit]
  @ServiceDiscovery_SOMEIPPacket_Request_ID_Session_ID = @ServiceDiscovery_SOMEIPPacket_Request_ID_Session_ID + 1;
  if (@ServiceDiscovery_SOMEIPPacket_Request_ID_Session_ID == 0x10000) @ServiceDiscovery_SOMEIPPacket_Request_ID_Session_ID = 1;
  
  buffer[i++] = @ServiceDiscovery_SOMEIPPacket_Request_ID_Session_ID>>8 & 0xFF;
  buffer[i++] = @ServiceDiscovery_SOMEIPPacket_Request_ID_Session_ID    & 0xFF;
  
  // SOME/IP Packet - Protocol Version [8 bit]
  buffer[i++] = @ServiceDiscovery_SOMEIPPacket_SubACK_ICAS1Sys01_Protocol_Version;
  
  // SOME/IP Packet - Interface Version [8 bit]
  buffer[i++] = @ServiceDiscovery_SOMEIPPacket_SubACK_ICAS1Sys01_Interface_Version;

  // SOME/IP Packet - Message Type [8 bit]
  buffer[i++] = @ServiceDiscovery_SOMEIPPacket_SubACK_ICAS1Sys01_Message_Type;
    
  // SOME/IP Packet - Return Code [8 bit]
  buffer[i++] = @ServiceDiscovery_SOMEIPPacket_SubACK_ICAS1Sys01_Return_Code;
  
  // SOME/IP Packet - Flags [8 bit]
  buffer[i++] = @ServiceDiscovery_SOMEIPPacket_SubACK_ICAS1Sys01_Flags;
  
  // SOME/IP Packet - Reserved [24 bit]
  buffer[i++] = 0x00;
  buffer[i++] = 0x00;
  buffer[i++] = 0x00;


  // SOME/IP Packet - Entries Array - Length [32 bit]
  @ServiceDiscovery_SOMEIPPacket_SubACK_ICAS1Sys01_Entries_Array_Length = 16 * number_of_entries_array_elements;
  buffer[i++] = @ServiceDiscovery_SOMEIPPacket_SubACK_ICAS1Sys01_Entries_Array_Length>>24 & 0xFF;
  buffer[i++] = @ServiceDiscovery_SOMEIPPacket_SubACK_ICAS1Sys01_Entries_Array_Length>>16 & 0xFF;
  buffer[i++] = @ServiceDiscovery_SOMEIPPacket_SubACK_ICAS1Sys01_Entries_Array_Length>> 8 & 0xFF;
  buffer[i++] = @ServiceDiscovery_SOMEIPPacket_SubACK_ICAS1Sys01_Entries_Array_Length     & 0xFF;
  
  for (j=0; j < number_of_entries_array_elements; j++)
  {
    // SOME/IP Packet - Entries Array - Type [8 bit]
    buffer[i++] = servicediscovery_rx_entries_array_type[j]+1;
    
    // SOME/IP Packet - Entries Array - Index 1st options [8 bit]
    buffer[i++] = 0; //servicediscovery_rx_entries_array_index_1st_options[j];
    
    // SOME/IP Packet - Entries Array - Index 2nd options [8 bit]
    buffer[i++] = 0; //servicediscovery_rx_entries_array_index_2nd_options[j];
    
    // SOME/IP Packet - Entries Array - # of opt 1 [4 bit] / # of opt 2 [4 bit]
    buffer[i++] = 1*16;//(((servicediscovery_rx_entries_array_nr_of_opt_1[j]*16)) + (servicediscovery_rx_entries_array_nr_of_opt_2[j]));
    
    // SOME/IP Packet - Entries Array - Service ID [16 bit]
    buffer[i++] = servicediscovery_rx_entries_array_service_id[j]>> 8 & 0xFF;
    buffer[i++] = servicediscovery_rx_entries_array_service_id[j]     & 0xFF;

    // SOME/IP Packet - Entries Array - Instance ID [16 bit]
    buffer[i++] = servicediscovery_rx_entries_array_instance_id[j]>> 8 & 0xFF;
    buffer[i++] = servicediscovery_rx_entries_array_instance_id[j]     & 0xFF;
    
    // SOME/IP Packet - Entries Array - Major Version [8 bit]
    buffer[i++] = servicediscovery_rx_entries_array_major_version[j];
    
    // SOME/IP Packet - Entries Array - TTL [24 bit]
    buffer[i++] = servicediscovery_rx_entries_array_ttl[j]>>16 & 0xFF;
    buffer[i++] = servicediscovery_rx_entries_array_ttl[j]>> 8 & 0xFF;
    buffer[i++] = servicediscovery_rx_entries_array_ttl[j]     & 0xFF;
    
    // SOME/IP Packet - Entries Array - Reserved [12 bit] + Counter [4 bit]
    buffer[i++] = 0x00;
    buffer[i++] = servicediscovery_rx_entries_array_counter[j] & 0x0F;
    
    // SOME/IP Packet - Entries Array - Eventgroup ID
    buffer[i++] = servicediscovery_rx_entries_array_eventgroup_id[j]>> 8 & 0xFF;
    buffer[i++] = servicediscovery_rx_entries_array_eventgroup_id[j]     & 0xFF;
    
    // aktive Funktionen auswerten
    if (servicediscovery_rx_entries_array_service_id[j] == 0x6009) // Time
    {
      if (servicediscovery_rx_entries_array_eventgroup_id[j] == 0xC010) @Time_SubscribeStatus_timeSettings = 1;
      if (servicediscovery_rx_entries_array_eventgroup_id[j] == 0xC020) @Time_SubscribeStatus_times        = 1;
    }
    
    if (servicediscovery_rx_entries_array_service_id[j] == 0x6069) // ChargingManagementExtendedSync
    {
      if (servicediscovery_rx_entries_array_eventgroup_id[j] == 0xC010) @ChargingManagementExtendedSync_SubscribeStatus_estimatedTimesAndInfos = 1;
      if (servicediscovery_rx_entries_array_eventgroup_id[j] == 0xC020) @ChargingManagementExtendedSync_SubscribeStatus_activeChargingProfiles = 1;
      if (servicediscovery_rx_entries_array_eventgroup_id[j] == 0xC030) @ChargingManagementExtendedSync_SubscribeStatus_nextChargingTimers     = 1;
      if (servicediscovery_rx_entries_array_eventgroup_id[j] == 0xC040) @ChargingManagementExtendedSync_SubscribeStatus_preferredChargingTimes = 1;
    }
  }
  
  
  //SOME/IP Packet - Options Array - Length [32 bit]
  buffer[i++] = @ServiceDiscovery_SOMEIPPacket_SubACK_ICAS1Sys01_Options_Array_Length>>24 & 0xFF;
  buffer[i++] = @ServiceDiscovery_SOMEIPPacket_SubACK_ICAS1Sys01_Options_Array_Length>>16 & 0xFF;
  buffer[i++] = @ServiceDiscovery_SOMEIPPacket_SubACK_ICAS1Sys01_Options_Array_Length>> 8 & 0xFF;
  buffer[i++] = @ServiceDiscovery_SOMEIPPacket_SubACK_ICAS1Sys01_Options_Array_Length     & 0xFF;

  //SOME/IP Packet - Options Array - Option1 Length [16 bit]
  buffer[i++] = @ServiceDiscovery_SOMEIPPacket_SubACK_ICAS1Sys01_Options_Array_Option1_Length>> 8 & 0xFF;
  buffer[i++] = @ServiceDiscovery_SOMEIPPacket_SubACK_ICAS1Sys01_Options_Array_Option1_Length     & 0xFF;
  
  //SOME/IP Packet - Options Array - Option1 Type [8 bit]
  buffer[i++] = @ServiceDiscovery_SOMEIPPacket_SubACK_ICAS1Sys01_Options_Array_Option1_Type & 0xFF;
  
  //SOME/IP Packet - Options Array - Reserved [8 bit]
  buffer[i++] = 0x00;
  
  //SOME/IP Packet - Options Array - Option1 IPv6 Address
  buffer[i++] = @ServiceDiscovery_SOMEIPPacket_SubACK_ICAS1Sys01_Options_Array_Option1_IPv6_01>>8 & 0xFF;
  buffer[i++] = @ServiceDiscovery_SOMEIPPacket_SubACK_ICAS1Sys01_Options_Array_Option1_IPv6_01    & 0xFF;
  buffer[i++] = @ServiceDiscovery_SOMEIPPacket_SubACK_ICAS1Sys01_Options_Array_Option1_IPv6_02>>8 & 0xFF;
  buffer[i++] = @ServiceDiscovery_SOMEIPPacket_SubACK_ICAS1Sys01_Options_Array_Option1_IPv6_02    & 0xFF;
  buffer[i++] = @ServiceDiscovery_SOMEIPPacket_SubACK_ICAS1Sys01_Options_Array_Option1_IPv6_03>>8 & 0xFF;
  buffer[i++] = @ServiceDiscovery_SOMEIPPacket_SubACK_ICAS1Sys01_Options_Array_Option1_IPv6_03    & 0xFF;
  buffer[i++] = @ServiceDiscovery_SOMEIPPacket_SubACK_ICAS1Sys01_Options_Array_Option1_IPv6_04>>8 & 0xFF;
  buffer[i++] = @ServiceDiscovery_SOMEIPPacket_SubACK_ICAS1Sys01_Options_Array_Option1_IPv6_04    & 0xFF;
  buffer[i++] = @ServiceDiscovery_SOMEIPPacket_SubACK_ICAS1Sys01_Options_Array_Option1_IPv6_05>>8 & 0xFF;
  buffer[i++] = @ServiceDiscovery_SOMEIPPacket_SubACK_ICAS1Sys01_Options_Array_Option1_IPv6_05    & 0xFF;
  buffer[i++] = @ServiceDiscovery_SOMEIPPacket_SubACK_ICAS1Sys01_Options_Array_Option1_IPv6_06>>8 & 0xFF;
  buffer[i++] = @ServiceDiscovery_SOMEIPPacket_SubACK_ICAS1Sys01_Options_Array_Option1_IPv6_06    & 0xFF;
  buffer[i++] = @ServiceDiscovery_SOMEIPPacket_SubACK_ICAS1Sys01_Options_Array_Option1_IPv6_07>>8 & 0xFF;
  buffer[i++] = @ServiceDiscovery_SOMEIPPacket_SubACK_ICAS1Sys01_Options_Array_Option1_IPv6_07    & 0xFF;
  buffer[i++] = @ServiceDiscovery_SOMEIPPacket_SubACK_ICAS1Sys01_Options_Array_Option1_IPv6_08>>8 & 0xFF;
  buffer[i++] = @ServiceDiscovery_SOMEIPPacket_SubACK_ICAS1Sys01_Options_Array_Option1_IPv6_08    & 0xFF;
  
  //SOME/IP Packet - Options Array - Reserved [8 bit]
  buffer[i++] = 0x00;
  
  //SOME/IP Packet - Options Array - Option1 L4-Proto [8 bit]
  buffer[i++] = @ServiceDiscovery_SOMEIPPacket_SubACK_ICAS1Sys01_Options_Array_Option1_L4_Proto;
  
  //SOME/IP Packet - Options Array - Option1 Port Number [16 bit]
  buffer[i++] = @ServiceDiscovery_SOMEIPPacket_SubACK_ICAS1Sys01_Options_Array_Option1_Port_Number>> 8 & 0xFF;
  buffer[i++] = @ServiceDiscovery_SOMEIPPacket_SubACK_ICAS1Sys01_Options_Array_Option1_Port_Number     & 0xFF;
  
  // Rohdaten in UDP Paket schreiben
  EthPaket.udp.SetData( 0, buffer, i );

  // calculate UDP and IPv6 checksum and send Ethernet packet
  EthPaket.CompletePacket();
  output( EthPaket );
}



Send_ServiceDiscovery_SubscribeACK_ICAS3IVI ()
{
  ethernetPacket EthPaket;
  
  // Ethernet Packet - MAC Source address
  getvalue (ServiceDiscovery_EthernetPacket_MAC_Source_ICAS3IVI, buffer_MAC);
  //EthPaket.source.ParseAddress ( buffer_MAC );
  EthPaket.source = ethGetMacAddressAsNumber (buffer_MAC);
  
  // Ethernet Packet - MAC Destination address
  getvalue (ServiceDiscovery_EthernetPacket_MAC_Destination, buffer_MAC);
  //EthPaket.destination.ParseAddress ( buffer_MAC );
  EthPaket.destination = ethGetMacAddressAsNumber (buffer_MAC);
  
  // Ethernet Packet - VLAN
  EthPaket.SetVlan (@ServiceDiscovery_EthernetPacket_VLAN_TPID, @ServiceDiscovery_EthernetPacket_VLAN_TCI);
  
  // Ethernet Packet - Type
  //EthPaket.ipv6.type = @EthernetPacket_Type;
  if (@ServiceDiscovery_EthernetPacket_Type == 0x86DD) EthPaket.ipv6.Init();
  
  
  // IPv6 Packet - Version
  EthPaket.ipv6.version = @ServiceDiscovery_IPv6Packet_Version;

  // IPv6 Packet - Traffic Class
  EthPaket.ipv6.class = @ServiceDiscovery_IPv6Packet_Traffic_Class;
  
  // IPv6 Packet - Flow Label
  EthPaket.ipv6.flow = @ServiceDiscovery_IPv6Packet_Flow_Label;
  
  // IPv6 Packet - Payload_Length
  EthPaket.ipv6.length = @ServiceDiscovery_IPv6Packet_Payload_Length;
  
  // IPv6 Packet - Next Header
  EthPaket.ipv6.next = @ServiceDiscovery_IPv6Packet_Next_Header;
  if (@ServiceDiscovery_IPv6Packet_Next_Header == 6) EthPaket.tcp.Init();
  if (@ServiceDiscovery_IPv6Packet_Next_Header == 17) EthPaket.udp.Init();
  
  // IPv6 Packet - Hop Limit
  EthPaket.ipv6.hopLimit = @ServiceDiscovery_IPv6Packet_Hop_Limit;

  // IPv6 Packet - IPv6 Destination address    // TODO: char array zu byte array
  buffer_ipv6[0]  = @ServiceDiscovery_IPv6Packet_IP_Destination_Unicast_01>>8 & 0xFF;
  buffer_ipv6[1]  = @ServiceDiscovery_IPv6Packet_IP_Destination_Unicast_01    & 0xFF;
  buffer_ipv6[2]  = @ServiceDiscovery_IPv6Packet_IP_Destination_Unicast_02>>8 & 0xFF;
  buffer_ipv6[3]  = @ServiceDiscovery_IPv6Packet_IP_Destination_Unicast_02    & 0xFF;
  buffer_ipv6[4]  = @ServiceDiscovery_IPv6Packet_IP_Destination_Unicast_03>>8 & 0xFF;
  buffer_ipv6[5]  = @ServiceDiscovery_IPv6Packet_IP_Destination_Unicast_03    & 0xFF;
  buffer_ipv6[6]  = @ServiceDiscovery_IPv6Packet_IP_Destination_Unicast_04>>8 & 0xFF;
  buffer_ipv6[7]  = @ServiceDiscovery_IPv6Packet_IP_Destination_Unicast_04    & 0xFF;
  buffer_ipv6[8]  = @ServiceDiscovery_IPv6Packet_IP_Destination_Unicast_05>>8 & 0xFF;
  buffer_ipv6[9]  = @ServiceDiscovery_IPv6Packet_IP_Destination_Unicast_05    & 0xFF;
  buffer_ipv6[10] = @ServiceDiscovery_IPv6Packet_IP_Destination_Unicast_06>>8 & 0xFF;
  buffer_ipv6[11] = @ServiceDiscovery_IPv6Packet_IP_Destination_Unicast_06    & 0xFF;
  buffer_ipv6[12] = @ServiceDiscovery_IPv6Packet_IP_Destination_Unicast_07>>8 & 0xFF;
  buffer_ipv6[13] = @ServiceDiscovery_IPv6Packet_IP_Destination_Unicast_07    & 0xFF;
  buffer_ipv6[14] = @ServiceDiscovery_IPv6Packet_IP_Destination_Unicast_08>>8 & 0xFF;
  buffer_ipv6[15] = @ServiceDiscovery_IPv6Packet_IP_Destination_Unicast_08    & 0xFF;
  EthPaket.ipv6.destination.SetData ( 0, buffer_ipv6, elcount(buffer_ipv6) );

  // IPv6 Packet - IPv6 Source address    // TODO: char array zu byte array
  buffer_ipv6[0]  = @ServiceDiscovery_IPv6Packet_IP_Source_ICAS3IVI_01>>8 & 0xFF;
  buffer_ipv6[1]  = @ServiceDiscovery_IPv6Packet_IP_Source_ICAS3IVI_01    & 0xFF;
  buffer_ipv6[2]  = @ServiceDiscovery_IPv6Packet_IP_Source_ICAS3IVI_02>>8 & 0xFF;
  buffer_ipv6[3]  = @ServiceDiscovery_IPv6Packet_IP_Source_ICAS3IVI_02    & 0xFF;
  buffer_ipv6[4]  = @ServiceDiscovery_IPv6Packet_IP_Source_ICAS3IVI_03>>8 & 0xFF;
  buffer_ipv6[5]  = @ServiceDiscovery_IPv6Packet_IP_Source_ICAS3IVI_03    & 0xFF;
  buffer_ipv6[6]  = @ServiceDiscovery_IPv6Packet_IP_Source_ICAS3IVI_04>>8 & 0xFF;
  buffer_ipv6[7]  = @ServiceDiscovery_IPv6Packet_IP_Source_ICAS3IVI_04    & 0xFF;
  buffer_ipv6[8]  = @ServiceDiscovery_IPv6Packet_IP_Source_ICAS3IVI_05>>8 & 0xFF;
  buffer_ipv6[9]  = @ServiceDiscovery_IPv6Packet_IP_Source_ICAS3IVI_05    & 0xFF;
  buffer_ipv6[10] = @ServiceDiscovery_IPv6Packet_IP_Source_ICAS3IVI_06>>8 & 0xFF;
  buffer_ipv6[11] = @ServiceDiscovery_IPv6Packet_IP_Source_ICAS3IVI_06    & 0xFF;
  buffer_ipv6[12] = @ServiceDiscovery_IPv6Packet_IP_Source_ICAS3IVI_07>>8 & 0xFF;
  buffer_ipv6[13] = @ServiceDiscovery_IPv6Packet_IP_Source_ICAS3IVI_07    & 0xFF;
  buffer_ipv6[14] = @ServiceDiscovery_IPv6Packet_IP_Source_ICAS3IVI_08>>8 & 0xFF;
  buffer_ipv6[15] = @ServiceDiscovery_IPv6Packet_IP_Source_ICAS3IVI_08    & 0xFF;
  EthPaket.ipv6.source.SetData ( 0, buffer_ipv6, elcount(buffer_ipv6) );

  
  // UDP Packet - Source Port
  EthPaket.udp.source = @ServiceDiscovery_UDPPacket_Port_Source;
  
  // UDP Packet - Destination Port
  EthPaket.udp.destination = @ServiceDiscovery_UDPPacket_Port_Destination;
  
  // UDP Packet - Length
  EthPaket.udp.length = @ServiceDiscovery_UDPPacket_Length;
  
  
  // SOME/IP Packet aus Rohdaten zusammenbauen (buffer array)
  i=0;
  
  // SOME/IP Packet - Message ID, Service ID [16 bit]
  buffer[i++] = @ServiceDiscovery_SOMEIPPacket_SubACK_ICAS3IVI_Message_ID_Service_ID>>8 & 0xFF;
  buffer[i++] = @ServiceDiscovery_SOMEIPPacket_SubACK_ICAS3IVI_Message_ID_Service_ID    & 0xFF;
  
  // SOME/IP Packet - Message ID, Message ID [16 bit]
  buffer[i++] = @ServiceDiscovery_SOMEIPPacket_SubACK_ICAS3IVI_Message_ID_Method_ID>>8 & 0xFF;
  buffer[i++] = @ServiceDiscovery_SOMEIPPacket_SubACK_ICAS3IVI_Message_ID_Method_ID    & 0xFF;
  
  // SOME/IP Packet - Length [32 bit]
  @ServiceDiscovery_SOMEIPPacket_SubACK_ICAS3IVI_Length = 16 + (16 * number_of_entries_array_elements) + 28;
  buffer[i++] = @ServiceDiscovery_SOMEIPPacket_SubACK_ICAS3IVI_Length>>24 & 0xFF;
  buffer[i++] = @ServiceDiscovery_SOMEIPPacket_SubACK_ICAS3IVI_Length>>16 & 0xFF;
  buffer[i++] = @ServiceDiscovery_SOMEIPPacket_SubACK_ICAS3IVI_Length>> 8 & 0xFF;
  buffer[i++] = @ServiceDiscovery_SOMEIPPacket_SubACK_ICAS3IVI_Length     & 0xFF;
  
  // SOME/IP Packet - Request ID, Client ID [16 bit]
  buffer[i++] = @ServiceDiscovery_SOMEIPPacket_SubACK_ICAS3IVI_Request_ID_Client_ID>>8 & 0xFF;
  buffer[i++] = @ServiceDiscovery_SOMEIPPacket_SubACK_ICAS3IVI_Request_ID_Client_ID    & 0xFF;
  
  // SOME/IP Packet - Request ID, Session ID) [16 bit]
  @ServiceDiscovery_SOMEIPPacket_Request_ID_Session_ID = @ServiceDiscovery_SOMEIPPacket_Request_ID_Session_ID + 1;
  if (@ServiceDiscovery_SOMEIPPacket_Request_ID_Session_ID == 0x10000) @ServiceDiscovery_SOMEIPPacket_Request_ID_Session_ID = 1;
  
  buffer[i++] = @ServiceDiscovery_SOMEIPPacket_Request_ID_Session_ID>>8 & 0xFF;
  buffer[i++] = @ServiceDiscovery_SOMEIPPacket_Request_ID_Session_ID    & 0xFF;
  
  // SOME/IP Packet - Protocol Version [8 bit]
  buffer[i++] = @ServiceDiscovery_SOMEIPPacket_SubACK_ICAS3IVI_Protocol_Version;
  
  // SOME/IP Packet - Interface Version [8 bit]
  buffer[i++] = @ServiceDiscovery_SOMEIPPacket_SubACK_ICAS3IVI_Interface_Version;

  // SOME/IP Packet - Message Type [8 bit]
  buffer[i++] = @ServiceDiscovery_SOMEIPPacket_SubACK_ICAS3IVI_Message_Type;
    
  // SOME/IP Packet - Return Code [8 bit]
  buffer[i++] = @ServiceDiscovery_SOMEIPPacket_SubACK_ICAS3IVI_Return_Code;
  
  // SOME/IP Packet - Flags [8 bit]
  buffer[i++] = @ServiceDiscovery_SOMEIPPacket_SubACK_ICAS3IVI_Flags;
  
  // SOME/IP Packet - Reserved [24 bit]
  buffer[i++] = 0x00;
  buffer[i++] = 0x00;
  buffer[i++] = 0x00;


  // SOME/IP Packet - Entries Array - Length [32 bit]
  @ServiceDiscovery_SOMEIPPacket_SubACK_ICAS3IVI_Entries_Array_Length = 16 * number_of_entries_array_elements;
  buffer[i++] = @ServiceDiscovery_SOMEIPPacket_SubACK_ICAS3IVI_Entries_Array_Length>>24 & 0xFF;
  buffer[i++] = @ServiceDiscovery_SOMEIPPacket_SubACK_ICAS3IVI_Entries_Array_Length>>16 & 0xFF;
  buffer[i++] = @ServiceDiscovery_SOMEIPPacket_SubACK_ICAS3IVI_Entries_Array_Length>> 8 & 0xFF;
  buffer[i++] = @ServiceDiscovery_SOMEIPPacket_SubACK_ICAS3IVI_Entries_Array_Length     & 0xFF;
  
  for (j=0; j < number_of_entries_array_elements; j++)
  {
    // SOME/IP Packet - Entries Array - Type [8 bit]
    buffer[i++] = servicediscovery_rx_entries_array_type[j]+1;
    
    // SOME/IP Packet - Entries Array - Index 1st options [8 bit]
    buffer[i++] = 0; //servicediscovery_rx_entries_array_index_1st_options[j];
    
    // SOME/IP Packet - Entries Array - Index 2nd options [8 bit]
    buffer[i++] = 0; //servicediscovery_rx_entries_array_index_2nd_options[j];
    
    // SOME/IP Packet - Entries Array - # of opt 1 [4 bit] / # of opt 2 [4 bit]
    buffer[i++] = 1*16;//(((servicediscovery_rx_entries_array_nr_of_opt_1[j]*16)) + (servicediscovery_rx_entries_array_nr_of_opt_2[j]));
    
    // SOME/IP Packet - Entries Array - Service ID [16 bit]
    buffer[i++] = servicediscovery_rx_entries_array_service_id[j]>> 8 & 0xFF;
    buffer[i++] = servicediscovery_rx_entries_array_service_id[j]     & 0xFF;

    // SOME/IP Packet - Entries Array - Instance ID [16 bit]
    buffer[i++] = servicediscovery_rx_entries_array_instance_id[j]>> 8 & 0xFF;
    buffer[i++] = servicediscovery_rx_entries_array_instance_id[j]     & 0xFF;
    
    // SOME/IP Packet - Entries Array - Major Version [8 bit]
    buffer[i++] = servicediscovery_rx_entries_array_major_version[j];
    
    // SOME/IP Packet - Entries Array - TTL [24 bit]
    buffer[i++] = servicediscovery_rx_entries_array_ttl[j]>>16 & 0xFF;
    buffer[i++] = servicediscovery_rx_entries_array_ttl[j]>> 8 & 0xFF;
    buffer[i++] = servicediscovery_rx_entries_array_ttl[j]     & 0xFF;
    
    // SOME/IP Packet - Entries Array - Reserved [12 bit] + Counter [4 bit]
    buffer[i++] = 0x00;
    buffer[i++] = servicediscovery_rx_entries_array_counter[j] & 0x0F;
    
    // SOME/IP Packet - Entries Array - Eventgroup ID
    buffer[i++] = servicediscovery_rx_entries_array_eventgroup_id[j]>> 8 & 0xFF;
    buffer[i++] = servicediscovery_rx_entries_array_eventgroup_id[j]     & 0xFF;
    
    
    // aktive Funktionen auswerten
    if (servicediscovery_rx_entries_array_service_id[j] == 0x600A) // Distance
    {
      if (servicediscovery_rx_entries_array_eventgroup_id[j] == 0xC010) @Distance_SubscribeStatus_distances    = 1;
      if (servicediscovery_rx_entries_array_eventgroup_id[j] == 0xC020) @Distance_SubscribeStatus_notification = 1;
    }
  }
  
  
  //SOME/IP Packet - Options Array - Length [32 bit]
  buffer[i++] = @ServiceDiscovery_SOMEIPPacket_SubACK_ICAS3IVI_Options_Array_Length>>24 & 0xFF;
  buffer[i++] = @ServiceDiscovery_SOMEIPPacket_SubACK_ICAS3IVI_Options_Array_Length>>16 & 0xFF;
  buffer[i++] = @ServiceDiscovery_SOMEIPPacket_SubACK_ICAS3IVI_Options_Array_Length>> 8 & 0xFF;
  buffer[i++] = @ServiceDiscovery_SOMEIPPacket_SubACK_ICAS3IVI_Options_Array_Length     & 0xFF;

  //SOME/IP Packet - Options Array - Option1 Length [16 bit]
  buffer[i++] = @ServiceDiscovery_SOMEIPPacket_SubACK_ICAS3IVI_Options_Array_Option1_Length>> 8 & 0xFF;
  buffer[i++] = @ServiceDiscovery_SOMEIPPacket_SubACK_ICAS3IVI_Options_Array_Option1_Length     & 0xFF;
  
  //SOME/IP Packet - Options Array - Option1 Type [8 bit]
  buffer[i++] = @ServiceDiscovery_SOMEIPPacket_SubACK_ICAS3IVI_Options_Array_Option1_Type & 0xFF;
  
  //SOME/IP Packet - Options Array - Reserved [8 bit]
  buffer[i++] = 0x00;
  
  //SOME/IP Packet - Options Array - Option1 IPv6 Address
  buffer[i++] = @ServiceDiscovery_SOMEIPPacket_SubACK_ICAS3IVI_Options_Array_Option1_IPv6_01>>8 & 0xFF;
  buffer[i++] = @ServiceDiscovery_SOMEIPPacket_SubACK_ICAS3IVI_Options_Array_Option1_IPv6_01    & 0xFF;
  buffer[i++] = @ServiceDiscovery_SOMEIPPacket_SubACK_ICAS3IVI_Options_Array_Option1_IPv6_02>>8 & 0xFF;
  buffer[i++] = @ServiceDiscovery_SOMEIPPacket_SubACK_ICAS3IVI_Options_Array_Option1_IPv6_02    & 0xFF;
  buffer[i++] = @ServiceDiscovery_SOMEIPPacket_SubACK_ICAS3IVI_Options_Array_Option1_IPv6_03>>8 & 0xFF;
  buffer[i++] = @ServiceDiscovery_SOMEIPPacket_SubACK_ICAS3IVI_Options_Array_Option1_IPv6_03    & 0xFF;
  buffer[i++] = @ServiceDiscovery_SOMEIPPacket_SubACK_ICAS3IVI_Options_Array_Option1_IPv6_04>>8 & 0xFF;
  buffer[i++] = @ServiceDiscovery_SOMEIPPacket_SubACK_ICAS3IVI_Options_Array_Option1_IPv6_04    & 0xFF;
  buffer[i++] = @ServiceDiscovery_SOMEIPPacket_SubACK_ICAS3IVI_Options_Array_Option1_IPv6_05>>8 & 0xFF;
  buffer[i++] = @ServiceDiscovery_SOMEIPPacket_SubACK_ICAS3IVI_Options_Array_Option1_IPv6_05    & 0xFF;
  buffer[i++] = @ServiceDiscovery_SOMEIPPacket_SubACK_ICAS3IVI_Options_Array_Option1_IPv6_06>>8 & 0xFF;
  buffer[i++] = @ServiceDiscovery_SOMEIPPacket_SubACK_ICAS3IVI_Options_Array_Option1_IPv6_06    & 0xFF;
  buffer[i++] = @ServiceDiscovery_SOMEIPPacket_SubACK_ICAS3IVI_Options_Array_Option1_IPv6_07>>8 & 0xFF;
  buffer[i++] = @ServiceDiscovery_SOMEIPPacket_SubACK_ICAS3IVI_Options_Array_Option1_IPv6_07    & 0xFF;
  buffer[i++] = @ServiceDiscovery_SOMEIPPacket_SubACK_ICAS3IVI_Options_Array_Option1_IPv6_08>>8 & 0xFF;
  buffer[i++] = @ServiceDiscovery_SOMEIPPacket_SubACK_ICAS3IVI_Options_Array_Option1_IPv6_08    & 0xFF;
  
  //SOME/IP Packet - Options Array - Reserved [8 bit]
  buffer[i++] = 0x00;
  
  //SOME/IP Packet - Options Array - Option1 L4-Proto [8 bit]
  buffer[i++] = @ServiceDiscovery_SOMEIPPacket_SubACK_ICAS3IVI_Options_Array_Option1_L4_Proto;
  
  //SOME/IP Packet - Options Array - Option1 Port Number [16 bit]
  buffer[i++] = @ServiceDiscovery_SOMEIPPacket_SubACK_ICAS3IVI_Options_Array_Option1_Port_Number>> 8 & 0xFF;
  buffer[i++] = @ServiceDiscovery_SOMEIPPacket_SubACK_ICAS3IVI_Options_Array_Option1_Port_Number     & 0xFF;
  
  // Rohdaten in UDP Paket schreiben
  EthPaket.udp.SetData( 0, buffer, i );

  // calculate UDP and IPv6 checksum and send Ethernet packet
  EthPaket.CompletePacket();
  output( EthPaket );
}



on envVar Send_ServiceDiscovery_Find
{
  if (@this == 1) settimercyclic (tSend_ServiceDiscovery_Find_ICAS1Sys02, @Send_ServiceDiscovery_Find_Time);
  else            canceltimer    (tSend_ServiceDiscovery_Find_ICAS1Sys02);
}

on timer tSend_ServiceDiscovery_Find_ICAS1Sys02
{
  Send_ServiceDiscovery_Find_Service_ICAS1Sys02();
}


Send_ServiceDiscovery_Find_Service_ICAS1Sys02()
{
  ethernetPacket EthPaket;
  
  number_of_found_services_by_ICAS1Sys02 = @ServiceDiscovery_Find_Service_UnitMaster
                                         + @ServiceDiscovery_Find_Service_DisplaySpeed
                                         + @ServiceDiscovery_Find_Service_Temperature
                                         + @ServiceDiscovery_Find_Service_DrivingStatistics
                                         + @ServiceDiscovery_Find_Service_DiagnosticNotification;
    
  if (@Env_GlobalAppl == 1 && number_of_found_services_by_ICAS1Sys02 > 0)
  {
    if ((@ServiceDiscovery_SOMEIPPacket_Find_ICAS1Sys02_Entries_Array_Element > 0) && (@ServiceDiscovery_SOMEIPPacket_Find_ICAS1Sys02_Entries_Array_Element >= number_of_found_services_by_ICAS1Sys02))
      @ServiceDiscovery_SOMEIPPacket_Find_ICAS1Sys02_Entries_Array_Element = number_of_found_services_by_ICAS1Sys02-1;

    // Ethernet Packet - MAC Source address
    getvalue (ServiceDiscovery_EthernetPacket_MAC_Source_ICAS1Sys02, buffer_MAC);
    //EthPaket.source.ParseAddress ( buffer_MAC );
    EthPaket.source = ethGetMacAddressAsNumber (buffer_MAC);
    
    // Ethernet Packet - MAC Destination address
    getvalue (ServiceDiscovery_EthernetPacket_MAC_Destination, buffer_MAC);
    //EthPaket.destination.ParseAddress ( buffer_MAC );
    EthPaket.destination = ethGetMacAddressAsNumber (buffer_MAC);
    
    // Ethernet Packet - VLAN
    EthPaket.SetVlan (@ServiceDiscovery_EthernetPacket_VLAN_TPID, @ServiceDiscovery_EthernetPacket_VLAN_TCI);
    
    // Ethernet Packet - Type
    //EthPaket.ipv6.type = @EthernetPacket_Type;
    if (@ServiceDiscovery_EthernetPacket_Type == 0x86DD) EthPaket.ipv6.Init();
    
    
    // IPv6 Packet - Version
    EthPaket.ipv6.version = @ServiceDiscovery_IPv6Packet_Version;

    // IPv6 Packet - Traffic Class
    EthPaket.ipv6.class = @ServiceDiscovery_IPv6Packet_Traffic_Class;
    
    // IPv6 Packet - Flow Label
    EthPaket.ipv6.flow = @ServiceDiscovery_IPv6Packet_Flow_Label;
    
    // IPv6 Packet - Payload_Length
    EthPaket.ipv6.length = @ServiceDiscovery_IPv6Packet_Payload_Length;
    
    // IPv6 Packet - Next Header
    EthPaket.ipv6.next = @ServiceDiscovery_IPv6Packet_Next_Header;
    if (@ServiceDiscovery_IPv6Packet_Next_Header == 6) EthPaket.tcp.Init();
    if (@ServiceDiscovery_IPv6Packet_Next_Header == 17) EthPaket.udp.Init();
    
    // IPv6 Packet - Hop Limit
    EthPaket.ipv6.hopLimit = @ServiceDiscovery_IPv6Packet_Hop_Limit;

    // IPv6 Packet - IPv6 Destination address    // TODO: char array zu byte array
    buffer_ipv6[0]  = @ServiceDiscovery_IPv6Packet_IP_Destination_Multicast_01>>8 & 0xFF;
    buffer_ipv6[1]  = @ServiceDiscovery_IPv6Packet_IP_Destination_Multicast_01    & 0xFF;
    buffer_ipv6[2]  = @ServiceDiscovery_IPv6Packet_IP_Destination_Multicast_02>>8 & 0xFF;
    buffer_ipv6[3]  = @ServiceDiscovery_IPv6Packet_IP_Destination_Multicast_02    & 0xFF;
    buffer_ipv6[4]  = @ServiceDiscovery_IPv6Packet_IP_Destination_Multicast_03>>8 & 0xFF;
    buffer_ipv6[5]  = @ServiceDiscovery_IPv6Packet_IP_Destination_Multicast_03    & 0xFF;
    buffer_ipv6[6]  = @ServiceDiscovery_IPv6Packet_IP_Destination_Multicast_04>>8 & 0xFF;
    buffer_ipv6[7]  = @ServiceDiscovery_IPv6Packet_IP_Destination_Multicast_04    & 0xFF;
    buffer_ipv6[8]  = @ServiceDiscovery_IPv6Packet_IP_Destination_Multicast_05>>8 & 0xFF;
    buffer_ipv6[9]  = @ServiceDiscovery_IPv6Packet_IP_Destination_Multicast_05    & 0xFF;
    buffer_ipv6[10] = @ServiceDiscovery_IPv6Packet_IP_Destination_Multicast_06>>8 & 0xFF;
    buffer_ipv6[11] = @ServiceDiscovery_IPv6Packet_IP_Destination_Multicast_06    & 0xFF;
    buffer_ipv6[12] = @ServiceDiscovery_IPv6Packet_IP_Destination_Multicast_07>>8 & 0xFF;
    buffer_ipv6[13] = @ServiceDiscovery_IPv6Packet_IP_Destination_Multicast_07    & 0xFF;
    buffer_ipv6[14] = @ServiceDiscovery_IPv6Packet_IP_Destination_Multicast_08>>8 & 0xFF;
    buffer_ipv6[15] = @ServiceDiscovery_IPv6Packet_IP_Destination_Multicast_08    & 0xFF;
    EthPaket.ipv6.destination.SetData ( 0, buffer_ipv6, elcount(buffer_ipv6) );

    // IPv6 Packet - IPv6 Source address    // TODO: char array zu byte array
    buffer_ipv6[0]  = @ServiceDiscovery_IPv6Packet_IP_Source_ICAS1Sys02_01>>8 & 0xFF;
    buffer_ipv6[1]  = @ServiceDiscovery_IPv6Packet_IP_Source_ICAS1Sys02_01    & 0xFF;
    buffer_ipv6[2]  = @ServiceDiscovery_IPv6Packet_IP_Source_ICAS1Sys02_02>>8 & 0xFF;
    buffer_ipv6[3]  = @ServiceDiscovery_IPv6Packet_IP_Source_ICAS1Sys02_02    & 0xFF;
    buffer_ipv6[4]  = @ServiceDiscovery_IPv6Packet_IP_Source_ICAS1Sys02_03>>8 & 0xFF;
    buffer_ipv6[5]  = @ServiceDiscovery_IPv6Packet_IP_Source_ICAS1Sys02_03    & 0xFF;
    buffer_ipv6[6]  = @ServiceDiscovery_IPv6Packet_IP_Source_ICAS1Sys02_04>>8 & 0xFF;
    buffer_ipv6[7]  = @ServiceDiscovery_IPv6Packet_IP_Source_ICAS1Sys02_04    & 0xFF;
    buffer_ipv6[8]  = @ServiceDiscovery_IPv6Packet_IP_Source_ICAS1Sys02_05>>8 & 0xFF;
    buffer_ipv6[9]  = @ServiceDiscovery_IPv6Packet_IP_Source_ICAS1Sys02_05    & 0xFF;
    buffer_ipv6[10] = @ServiceDiscovery_IPv6Packet_IP_Source_ICAS1Sys02_06>>8 & 0xFF;
    buffer_ipv6[11] = @ServiceDiscovery_IPv6Packet_IP_Source_ICAS1Sys02_06    & 0xFF;
    buffer_ipv6[12] = @ServiceDiscovery_IPv6Packet_IP_Source_ICAS1Sys02_07>>8 & 0xFF;
    buffer_ipv6[13] = @ServiceDiscovery_IPv6Packet_IP_Source_ICAS1Sys02_07    & 0xFF;
    buffer_ipv6[14] = @ServiceDiscovery_IPv6Packet_IP_Source_ICAS1Sys02_08>>8 & 0xFF;
    buffer_ipv6[15] = @ServiceDiscovery_IPv6Packet_IP_Source_ICAS1Sys02_08    & 0xFF;
    EthPaket.ipv6.source.SetData ( 0, buffer_ipv6, elcount(buffer_ipv6) );

    
    // UDP Packet - Source Port
    EthPaket.udp.source = @ServiceDiscovery_UDPPacket_Port_Source;
    
    // UDP Packet - Destination Port
    EthPaket.udp.destination = @ServiceDiscovery_UDPPacket_Port_Destination;
    
    // UDP Packet - Length
    EthPaket.udp.length = @ServiceDiscovery_UDPPacket_Length;
    
    
    // SOME/IP Packet aus Rohdaten zusammenbauen (buffer array)
    i=0;
    
    // SOME/IP Packet - Message ID, Service ID [16 bit]
    buffer[i++] = @ServiceDiscovery_SOMEIPPacket_Find_ICAS1Sys02_Message_ID_Service_ID>>8 & 0xFF;
    buffer[i++] = @ServiceDiscovery_SOMEIPPacket_Find_ICAS1Sys02_Message_ID_Service_ID    & 0xFF;
    
    // SOME/IP Packet - Message ID, Message ID [16 bit]
    buffer[i++] = @ServiceDiscovery_SOMEIPPacket_Find_ICAS1Sys02_Message_ID_Method_ID>>8 & 0xFF;
    buffer[i++] = @ServiceDiscovery_SOMEIPPacket_Find_ICAS1Sys02_Message_ID_Method_ID    & 0xFF;
    
    // SOME/IP Packet - Length [32 bit]
    @ServiceDiscovery_SOMEIPPacket_Find_ICAS1Sys02_Length = 16 + (16 * number_of_found_services_by_ICAS1Sys02) + 4 + @ServiceDiscovery_SOMEIPPacket_Find_ICAS1Sys02_Options_Array_On_Off * 24;
    buffer[i++] = @ServiceDiscovery_SOMEIPPacket_Find_ICAS1Sys02_Length>>24 & 0xFF;
    buffer[i++] = @ServiceDiscovery_SOMEIPPacket_Find_ICAS1Sys02_Length>>16 & 0xFF;
    buffer[i++] = @ServiceDiscovery_SOMEIPPacket_Find_ICAS1Sys02_Length>> 8 & 0xFF;
    buffer[i++] = @ServiceDiscovery_SOMEIPPacket_Find_ICAS1Sys02_Length     & 0xFF;
    
    // SOME/IP Packet - Request ID, Client ID [16 bit]
    buffer[i++] = @ServiceDiscovery_SOMEIPPacket_Find_ICAS1Sys02_Request_ID_Client_ID>>8 & 0xFF;
    buffer[i++] = @ServiceDiscovery_SOMEIPPacket_Find_ICAS1Sys02_Request_ID_Client_ID    & 0xFF;
    
    // SOME/IP Packet - Request ID, Session ID) [16 bit]
    @ServiceDiscovery_SOMEIPPacket_Request_ID_Session_ID = @ServiceDiscovery_SOMEIPPacket_Request_ID_Session_ID + 1;
    if (@ServiceDiscovery_SOMEIPPacket_Request_ID_Session_ID == 0x10000) @ServiceDiscovery_SOMEIPPacket_Request_ID_Session_ID = 1;
    
    buffer[i++] = @ServiceDiscovery_SOMEIPPacket_Request_ID_Session_ID>>8 & 0xFF;
    buffer[i++] = @ServiceDiscovery_SOMEIPPacket_Request_ID_Session_ID    & 0xFF;
    
    // SOME/IP Packet - Protocol Version [8 bit]
    buffer[i++] = @ServiceDiscovery_SOMEIPPacket_Find_ICAS1Sys02_Protocol_Version;
    
    // SOME/IP Packet - Interface Version [8 bit]
    buffer[i++] = @ServiceDiscovery_SOMEIPPacket_Find_ICAS1Sys02_Interface_Version;

    // SOME/IP Packet - Message Type [8 bit]
    buffer[i++] = @ServiceDiscovery_SOMEIPPacket_Find_ICAS1Sys02_Message_Type;
      
    // SOME/IP Packet - Return Code [8 bit]
    buffer[i++] = @ServiceDiscovery_SOMEIPPacket_Find_ICAS1Sys02_Return_Code;
    
    // SOME/IP Packet - Flags [8 bit]
    buffer[i++] = @ServiceDiscovery_SOMEIPPacket_Find_ICAS1Sys02_Flags;
    
    // SOME/IP Packet - Reserved [24 bit]
    buffer[i++] = 0x00;
    buffer[i++] = 0x00;
    buffer[i++] = 0x00;
    
    
    // SOME/IP Packet - Entries Array
    
    // SOME/IP Packet - Entries Array - Length [32 bit]
    @ServiceDiscovery_SOMEIPPacket_Find_ICAS1Sys02_Entries_Array_Length = 16 * number_of_found_services_by_ICAS1Sys02;
    buffer[i++] = @ServiceDiscovery_SOMEIPPacket_Find_ICAS1Sys02_Entries_Array_Length>>24 & 0xFF;
    buffer[i++] = @ServiceDiscovery_SOMEIPPacket_Find_ICAS1Sys02_Entries_Array_Length>>16 & 0xFF;
    buffer[i++] = @ServiceDiscovery_SOMEIPPacket_Find_ICAS1Sys02_Entries_Array_Length>> 8 & 0xFF;
    buffer[i++] = @ServiceDiscovery_SOMEIPPacket_Find_ICAS1Sys02_Entries_Array_Length     & 0xFF;
    
    service_counter = 0;
    
    // Service UnitMaster
    if (@ServiceDiscovery_Find_Service_UnitMaster == 1 && service_counter < number_of_found_services_by_ICAS1Sys02)
    {
      servicediscovery_find_ICAS1Sys02_entries_array_type[service_counter]                 = 0; // Find
      servicediscovery_find_ICAS1Sys02_entries_array_index_1st_options[service_counter]    = 0;
      servicediscovery_find_ICAS1Sys02_entries_array_index_2nd_options[service_counter]    = 0;
      servicediscovery_find_ICAS1Sys02_entries_array_nr_of_opt_1[service_counter]          = @ServiceDiscovery_SOMEIPPacket_Find_ICAS1Sys02_Options_Array_On_Off;
      servicediscovery_find_ICAS1Sys02_entries_array_nr_of_opt_2[service_counter]          = 0;
      servicediscovery_find_ICAS1Sys02_entries_array_service_id[service_counter]           = 0x600E;
      servicediscovery_find_ICAS1Sys02_entries_array_instance_id[service_counter]          = 1;
      servicediscovery_find_ICAS1Sys02_entries_array_major_version[service_counter]        = 3;
      servicediscovery_find_ICAS1Sys02_entries_array_ttl[service_counter]                  = 5;
      servicediscovery_find_ICAS1Sys02_entries_array_minor_version[service_counter]        = 0xFFFFFFFF;

      service_counter++;
    }
    
    // Service DisplaySpeed
    if (@ServiceDiscovery_Find_Service_DisplaySpeed == 1 && service_counter < number_of_found_services_by_ICAS1Sys02)
    {
      servicediscovery_find_ICAS1Sys02_entries_array_type[service_counter]                 = 0; // Find
      servicediscovery_find_ICAS1Sys02_entries_array_index_1st_options[service_counter]    = 0;
      servicediscovery_find_ICAS1Sys02_entries_array_index_2nd_options[service_counter]    = 0;
      servicediscovery_find_ICAS1Sys02_entries_array_nr_of_opt_1[service_counter]          = @ServiceDiscovery_SOMEIPPacket_Find_ICAS1Sys02_Options_Array_On_Off;
      servicediscovery_find_ICAS1Sys02_entries_array_nr_of_opt_2[service_counter]          = 0;
      servicediscovery_find_ICAS1Sys02_entries_array_service_id[service_counter]           = 0x6021;
      servicediscovery_find_ICAS1Sys02_entries_array_instance_id[service_counter]          = 1;
      servicediscovery_find_ICAS1Sys02_entries_array_major_version[service_counter]        = 4;
      servicediscovery_find_ICAS1Sys02_entries_array_ttl[service_counter]                  = 5;
      servicediscovery_find_ICAS1Sys02_entries_array_minor_version[service_counter]        = 0xFFFFFFFF;

      service_counter++;
    }
    
    // Service Temperature
    if (@ServiceDiscovery_Find_Service_Temperature == 1 && service_counter < number_of_found_services_by_ICAS1Sys02)
    {
      servicediscovery_find_ICAS1Sys02_entries_array_type[service_counter]                 = 0; // Find
      servicediscovery_find_ICAS1Sys02_entries_array_index_1st_options[service_counter]    = 0;
      servicediscovery_find_ICAS1Sys02_entries_array_index_2nd_options[service_counter]    = 0;
      servicediscovery_find_ICAS1Sys02_entries_array_nr_of_opt_1[service_counter]          = @ServiceDiscovery_SOMEIPPacket_Find_ICAS1Sys02_Options_Array_On_Off;
      servicediscovery_find_ICAS1Sys02_entries_array_nr_of_opt_2[service_counter]          = 0;
      servicediscovery_find_ICAS1Sys02_entries_array_service_id[service_counter]           = 0x6034;
      servicediscovery_find_ICAS1Sys02_entries_array_instance_id[service_counter]          = 1;
      servicediscovery_find_ICAS1Sys02_entries_array_major_version[service_counter]        = 2;
      servicediscovery_find_ICAS1Sys02_entries_array_ttl[service_counter]                  = 5;
      servicediscovery_find_ICAS1Sys02_entries_array_minor_version[service_counter]        = 0xFFFFFFFF;

      service_counter++;
    }
    
    // Service DrivingStatistics
    if (@ServiceDiscovery_Find_Service_DrivingStatistics == 1 && service_counter < number_of_found_services_by_ICAS1Sys02)
    {
      servicediscovery_find_ICAS1Sys02_entries_array_type[service_counter]                 = 0; // Find
      servicediscovery_find_ICAS1Sys02_entries_array_index_1st_options[service_counter]    = 0;
      servicediscovery_find_ICAS1Sys02_entries_array_index_2nd_options[service_counter]    = 0;
      servicediscovery_find_ICAS1Sys02_entries_array_nr_of_opt_1[service_counter]          = @ServiceDiscovery_SOMEIPPacket_Find_ICAS1Sys02_Options_Array_On_Off;
      servicediscovery_find_ICAS1Sys02_entries_array_nr_of_opt_2[service_counter]          = 0;
      servicediscovery_find_ICAS1Sys02_entries_array_service_id[service_counter]           = 0x6035;
      servicediscovery_find_ICAS1Sys02_entries_array_instance_id[service_counter]          = 1;
      servicediscovery_find_ICAS1Sys02_entries_array_major_version[service_counter]        = 3;
      servicediscovery_find_ICAS1Sys02_entries_array_ttl[service_counter]                  = 5;
      servicediscovery_find_ICAS1Sys02_entries_array_minor_version[service_counter]        = 0xFFFFFFFF;

      service_counter++;
    }
    
    // Service DiagnosticNotification
    if (@ServiceDiscovery_Find_Service_DiagnosticNotification == 1 && service_counter < number_of_found_services_by_ICAS1Sys02)
    {
      servicediscovery_find_ICAS1Sys02_entries_array_type[service_counter]                 = 0; // Find
      servicediscovery_find_ICAS1Sys02_entries_array_index_1st_options[service_counter]    = 0;
      servicediscovery_find_ICAS1Sys02_entries_array_index_2nd_options[service_counter]    = 0;
      servicediscovery_find_ICAS1Sys02_entries_array_nr_of_opt_1[service_counter]          = @ServiceDiscovery_SOMEIPPacket_Find_ICAS1Sys02_Options_Array_On_Off;
      servicediscovery_find_ICAS1Sys02_entries_array_nr_of_opt_2[service_counter]          = 0;
      servicediscovery_find_ICAS1Sys02_entries_array_service_id[service_counter]           = 0x6046;
      servicediscovery_find_ICAS1Sys02_entries_array_instance_id[service_counter]          = 1;
      servicediscovery_find_ICAS1Sys02_entries_array_major_version[service_counter]        = 1;
      servicediscovery_find_ICAS1Sys02_entries_array_ttl[service_counter]                  = 5;
      servicediscovery_find_ICAS1Sys02_entries_array_minor_version[service_counter]        = 4294967295;//0xFFFFFFFF;

      service_counter++;
    }
    
    if (number_of_found_services_by_ICAS1Sys02 == 0)
    {
      servicediscovery_find_ICAS1Sys02_entries_array_type[service_counter]                 = 0;
      servicediscovery_find_ICAS1Sys02_entries_array_index_1st_options[service_counter]    = 0;
      servicediscovery_find_ICAS1Sys02_entries_array_index_2nd_options[service_counter]    = 0;
      servicediscovery_find_ICAS1Sys02_entries_array_nr_of_opt_1[service_counter]          = 0;
      servicediscovery_find_ICAS1Sys02_entries_array_nr_of_opt_2[service_counter]          = 0;
      servicediscovery_find_ICAS1Sys02_entries_array_service_id[service_counter]           = 0;
      servicediscovery_find_ICAS1Sys02_entries_array_instance_id[service_counter]          = 0;
      servicediscovery_find_ICAS1Sys02_entries_array_major_version[service_counter]        = 0;
      servicediscovery_find_ICAS1Sys02_entries_array_ttl[service_counter]                  = 0;
      servicediscovery_find_ICAS1Sys02_entries_array_minor_version[service_counter]        = 0;

      service_counter++;
    }
    
    for (j = 0; j < number_of_found_services_by_ICAS1Sys02; j++)
    {
      // SOME/IP Packet - Entries Array - Type [8 bit]
      buffer[i++] = servicediscovery_find_ICAS1Sys02_entries_array_type[j];
      
      // SOME/IP Packet - Entries Array - Index 1st options [8 bit]
      buffer[i++] = servicediscovery_find_ICAS1Sys02_entries_array_index_1st_options[j];
      
      // SOME/IP Packet - Entries Array - Index 2nd options [8 bit]
      buffer[i++] = servicediscovery_find_ICAS1Sys02_entries_array_index_2nd_options[j];
      
      // SOME/IP Packet - Entries Array - # of opt 1 [4 bit] / # of opt 2 [4 bit]
      buffer[i++] = (((servicediscovery_find_ICAS1Sys02_entries_array_nr_of_opt_1[j]*16)) + (servicediscovery_find_ICAS1Sys02_entries_array_nr_of_opt_2[j]));
      
      // SOME/IP Packet - Entries Array - Service ID [16 bit]
      buffer[i++] = servicediscovery_find_ICAS1Sys02_entries_array_service_id[j]>> 8 & 0xFF;
      buffer[i++] = servicediscovery_find_ICAS1Sys02_entries_array_service_id[j]     & 0xFF;

      // SOME/IP Packet - Entries Array - Instance ID [16 bit]
      buffer[i++] = servicediscovery_find_ICAS1Sys02_entries_array_instance_id[j]>> 8 & 0xFF;
      buffer[i++] = servicediscovery_find_ICAS1Sys02_entries_array_instance_id[j]     & 0xFF;
      
      // SOME/IP Packet - Entries Array - Major Version [8 bit]
      buffer[i++] = servicediscovery_find_ICAS1Sys02_entries_array_major_version[j];
      
      // SOME/IP Packet - Entries Array - TTL [24 bit]
      buffer[i++] = servicediscovery_find_ICAS1Sys02_entries_array_ttl[j]>>16 & 0xFF;
      buffer[i++] = servicediscovery_find_ICAS1Sys02_entries_array_ttl[j]>> 8 & 0xFF;
      buffer[i++] = servicediscovery_find_ICAS1Sys02_entries_array_ttl[j]     & 0xFF;
      
      // SOME/IP Packet - Entries Array - Minor Version [32 bit]
      buffer[i++] = servicediscovery_find_ICAS1Sys02_entries_array_minor_version[j]>>24 & 0xFF;
      buffer[i++] = servicediscovery_find_ICAS1Sys02_entries_array_minor_version[j]>>16 & 0xFF;
      buffer[i++] = servicediscovery_find_ICAS1Sys02_entries_array_minor_version[j]>> 8 & 0xFF;
      buffer[i++] = servicediscovery_find_ICAS1Sys02_entries_array_minor_version[j]     & 0xFF;
    }
    
    //SOME/IP Packet - Options Array - Length [32 bit]
    buffer[i++] = @ServiceDiscovery_SOMEIPPacket_Find_ICAS1Sys02_Options_Array_Length>>24 & 0xFF;
    buffer[i++] = @ServiceDiscovery_SOMEIPPacket_Find_ICAS1Sys02_Options_Array_Length>>16 & 0xFF;
    buffer[i++] = @ServiceDiscovery_SOMEIPPacket_Find_ICAS1Sys02_Options_Array_Length>> 8 & 0xFF;
    buffer[i++] = @ServiceDiscovery_SOMEIPPacket_Find_ICAS1Sys02_Options_Array_Length     & 0xFF;
    
    if (@ServiceDiscovery_SOMEIPPacket_Find_ICAS1Sys02_Options_Array_On_Off == 1)
    {
      //SOME/IP Packet - Options Array - Option1 Length [16 bit]
      buffer[i++] = @ServiceDiscovery_SOMEIPPacket_Find_ICAS1Sys02_Options_Array_Option1_Length>> 8 & 0xFF;
      buffer[i++] = @ServiceDiscovery_SOMEIPPacket_Find_ICAS1Sys02_Options_Array_Option1_Length     & 0xFF;
      
      //SOME/IP Packet - Options Array - Option1 Type [8 bit]
      buffer[i++] = @ServiceDiscovery_SOMEIPPacket_Find_ICAS1Sys02_Options_Array_Option1_Type & 0xFF;
      
      //SOME/IP Packet - Options Array - Reserved [8 bit]
      buffer[i++] = 0x00;
      
      //SOME/IP Packet - Options Array - Option1 IPv6 Address
      buffer[i++] = @ServiceDiscovery_SOMEIPPacket_Find_ICAS1Sys02_Options_Array_Option1_IPv6_01>>8 & 0xFF;
      buffer[i++] = @ServiceDiscovery_SOMEIPPacket_Find_ICAS1Sys02_Options_Array_Option1_IPv6_01    & 0xFF;
      buffer[i++] = @ServiceDiscovery_SOMEIPPacket_Find_ICAS1Sys02_Options_Array_Option1_IPv6_02>>8 & 0xFF;
      buffer[i++] = @ServiceDiscovery_SOMEIPPacket_Find_ICAS1Sys02_Options_Array_Option1_IPv6_02    & 0xFF;
      buffer[i++] = @ServiceDiscovery_SOMEIPPacket_Find_ICAS1Sys02_Options_Array_Option1_IPv6_03>>8 & 0xFF;
      buffer[i++] = @ServiceDiscovery_SOMEIPPacket_Find_ICAS1Sys02_Options_Array_Option1_IPv6_03    & 0xFF;
      buffer[i++] = @ServiceDiscovery_SOMEIPPacket_Find_ICAS1Sys02_Options_Array_Option1_IPv6_04>>8 & 0xFF;
      buffer[i++] = @ServiceDiscovery_SOMEIPPacket_Find_ICAS1Sys02_Options_Array_Option1_IPv6_04    & 0xFF;
      buffer[i++] = @ServiceDiscovery_SOMEIPPacket_Find_ICAS1Sys02_Options_Array_Option1_IPv6_05>>8 & 0xFF;
      buffer[i++] = @ServiceDiscovery_SOMEIPPacket_Find_ICAS1Sys02_Options_Array_Option1_IPv6_05    & 0xFF;
      buffer[i++] = @ServiceDiscovery_SOMEIPPacket_Find_ICAS1Sys02_Options_Array_Option1_IPv6_06>>8 & 0xFF;
      buffer[i++] = @ServiceDiscovery_SOMEIPPacket_Find_ICAS1Sys02_Options_Array_Option1_IPv6_06    & 0xFF;
      buffer[i++] = @ServiceDiscovery_SOMEIPPacket_Find_ICAS1Sys02_Options_Array_Option1_IPv6_07>>8 & 0xFF;
      buffer[i++] = @ServiceDiscovery_SOMEIPPacket_Find_ICAS1Sys02_Options_Array_Option1_IPv6_07    & 0xFF;
      buffer[i++] = @ServiceDiscovery_SOMEIPPacket_Find_ICAS1Sys02_Options_Array_Option1_IPv6_08>>8 & 0xFF;
      buffer[i++] = @ServiceDiscovery_SOMEIPPacket_Find_ICAS1Sys02_Options_Array_Option1_IPv6_08    & 0xFF;
      
      //SOME/IP Packet - Options Array - Reserved [8 bit]
      buffer[i++] = 0x00;
      
      //SOME/IP Packet - Options Array - Option1 L4-Proto [8 bit]
      buffer[i++] = @ServiceDiscovery_SOMEIPPacket_Find_ICAS1Sys02_Options_Array_Option1_L4_Proto;
      
      //SOME/IP Packet - Options Array - Option1 Port Number [16 bit]
      buffer[i++] = @ServiceDiscovery_SOMEIPPacket_Find_ICAS1Sys02_Options_Array_Option1_Port_Number>> 8 & 0xFF;
      buffer[i++] = @ServiceDiscovery_SOMEIPPacket_Find_ICAS1Sys02_Options_Array_Option1_Port_Number     & 0xFF;
    }

    ServiceDiscovery_SOMEIPPacket_Find_ICAS1Sys02_Entries_Array_update();
    
    // Rohdaten in UDP Paket schreiben
    EthPaket.udp.SetData( 0, buffer, i );

    // calculate UDP and IPv6 checksum and send Ethernet packet
    EthPaket.CompletePacket();
    output( EthPaket );
  }
}



on envVar ServiceDiscovery_SOMEIPPacket_Find_ICAS1Sys02_Entries_Array_Element_Next
{
  if (@this == 1 && @ServiceDiscovery_SOMEIPPacket_Find_ICAS1Sys02_Entries_Array_Element < number_of_found_services_by_ICAS1Sys02-1)
  {
    @ServiceDiscovery_SOMEIPPacket_Find_ICAS1Sys02_Entries_Array_Element = @ServiceDiscovery_SOMEIPPacket_Find_ICAS1Sys02_Entries_Array_Element + 1;
    ServiceDiscovery_SOMEIPPacket_Find_ICAS1Sys02_Entries_Array_update();
  }
}

on envVar ServiceDiscovery_SOMEIPPacket_Find_ICAS1Sys02_Entries_Array_Element_Previous
{
  if (@this == 1 && @ServiceDiscovery_SOMEIPPacket_Find_ICAS1Sys02_Entries_Array_Element > 0)
  {
    @ServiceDiscovery_SOMEIPPacket_Find_ICAS1Sys02_Entries_Array_Element = @ServiceDiscovery_SOMEIPPacket_Find_ICAS1Sys02_Entries_Array_Element - 1;
    ServiceDiscovery_SOMEIPPacket_Find_ICAS1Sys02_Entries_Array_update();
  }
}

ServiceDiscovery_SOMEIPPacket_Find_ICAS1Sys02_Entries_Array_update()
{
  @ServiceDiscovery_SOMEIPPacket_Find_ICAS1Sys02_Entries_Array_Type = servicediscovery_find_ICAS1Sys02_entries_array_type[@ServiceDiscovery_SOMEIPPacket_Find_ICAS1Sys02_Entries_Array_Element];
  @ServiceDiscovery_SOMEIPPacket_Find_ICAS1Sys02_Entries_Array_Index_1st_options = servicediscovery_find_ICAS1Sys02_entries_array_index_1st_options[@ServiceDiscovery_SOMEIPPacket_Find_ICAS1Sys02_Entries_Array_Element];
  @ServiceDiscovery_SOMEIPPacket_Find_ICAS1Sys02_Entries_Array_Index_2nd_options = servicediscovery_find_ICAS1Sys02_entries_array_index_2nd_options[@ServiceDiscovery_SOMEIPPacket_Find_ICAS1Sys02_Entries_Array_Element];
  @ServiceDiscovery_SOMEIPPacket_Find_ICAS1Sys02_Entries_Array_Nr_of_opt_1 = servicediscovery_find_ICAS1Sys02_entries_array_nr_of_opt_1[@ServiceDiscovery_SOMEIPPacket_Find_ICAS1Sys02_Entries_Array_Element];
  @ServiceDiscovery_SOMEIPPacket_Find_ICAS1Sys02_Entries_Array_Nr_of_opt_2 = servicediscovery_find_ICAS1Sys02_entries_array_nr_of_opt_2[@ServiceDiscovery_SOMEIPPacket_Find_ICAS1Sys02_Entries_Array_Element];
  @ServiceDiscovery_SOMEIPPacket_Find_ICAS1Sys02_Entries_Array_Service_ID = servicediscovery_find_ICAS1Sys02_entries_array_service_id[@ServiceDiscovery_SOMEIPPacket_Find_ICAS1Sys02_Entries_Array_Element];
  @ServiceDiscovery_SOMEIPPacket_Find_ICAS1Sys02_Entries_Array_Instance_ID = servicediscovery_find_ICAS1Sys02_entries_array_instance_id[@ServiceDiscovery_SOMEIPPacket_Find_ICAS1Sys02_Entries_Array_Element];
  @ServiceDiscovery_SOMEIPPacket_Find_ICAS1Sys02_Entries_Array_Major_Version = servicediscovery_find_ICAS1Sys02_entries_array_major_version[@ServiceDiscovery_SOMEIPPacket_Find_ICAS1Sys02_Entries_Array_Element];
  @ServiceDiscovery_SOMEIPPacket_Find_ICAS1Sys02_Entries_Array_TTL = servicediscovery_find_ICAS1Sys02_entries_array_ttl[@ServiceDiscovery_SOMEIPPacket_Find_ICAS1Sys02_Entries_Array_Element];
  @ServiceDiscovery_SOMEIPPacket_Find_ICAS1Sys02_Entries_Array_Minor_Version = servicediscovery_find_ICAS1Sys02_entries_array_minor_version[@ServiceDiscovery_SOMEIPPacket_Find_ICAS1Sys02_Entries_Array_Element];
}

on envVar ServiceDiscovery_SOMEIPPacket_Find_ICAS1Sys02_Entries_Array_Type
{
  servicediscovery_find_ICAS1Sys02_entries_array_type[@ServiceDiscovery_SOMEIPPacket_Find_ICAS1Sys02_Entries_Array_Element] = @this;
}
on envVar ServiceDiscovery_SOMEIPPacket_Find_ICAS1Sys02_Entries_Array_Index_1st_options
{
  servicediscovery_find_ICAS1Sys02_entries_array_index_1st_options[@ServiceDiscovery_SOMEIPPacket_Find_ICAS1Sys02_Entries_Array_Element] = @this;
}
on envVar ServiceDiscovery_SOMEIPPacket_Find_ICAS1Sys02_Entries_Array_Index_2nd_options
{
  servicediscovery_find_ICAS1Sys02_entries_array_index_2nd_options[@ServiceDiscovery_SOMEIPPacket_Find_ICAS1Sys02_Entries_Array_Element] = @this;
}
on envVar ServiceDiscovery_SOMEIPPacket_Find_ICAS1Sys02_Entries_Array_Nr_of_opt_1
{
  servicediscovery_find_ICAS1Sys02_entries_array_nr_of_opt_1[@ServiceDiscovery_SOMEIPPacket_Find_ICAS1Sys02_Entries_Array_Element] = @this;
}
on envVar ServiceDiscovery_SOMEIPPacket_Find_ICAS1Sys02_Entries_Array_Nr_of_opt_2
{
  servicediscovery_find_ICAS1Sys02_entries_array_nr_of_opt_2[@ServiceDiscovery_SOMEIPPacket_Find_ICAS1Sys02_Entries_Array_Element] = @this;
}
on envVar ServiceDiscovery_SOMEIPPacket_Find_ICAS1Sys02_Entries_Array_Service_ID
{
  servicediscovery_find_ICAS1Sys02_entries_array_service_id[@ServiceDiscovery_SOMEIPPacket_Find_ICAS1Sys02_Entries_Array_Element] = @this;
}
on envVar ServiceDiscovery_SOMEIPPacket_Find_ICAS1Sys02_Entries_Array_Instance_ID
{
  servicediscovery_find_ICAS1Sys02_entries_array_instance_id[@ServiceDiscovery_SOMEIPPacket_Find_ICAS1Sys02_Entries_Array_Element] = @this;
}
on envVar ServiceDiscovery_SOMEIPPacket_Find_ICAS1Sys02_Entries_Array_Major_Version
{
  servicediscovery_find_ICAS1Sys02_entries_array_major_version[@ServiceDiscovery_SOMEIPPacket_Find_ICAS1Sys02_Entries_Array_Element] = @this;
}
on envVar ServiceDiscovery_SOMEIPPacket_Find_ICAS1Sys02_Entries_Array_TTL
{
  servicediscovery_find_ICAS1Sys02_entries_array_ttl[@ServiceDiscovery_SOMEIPPacket_Find_ICAS1Sys02_Entries_Array_Element] = @this;
}
on envVar ServiceDiscovery_SOMEIPPacket_Find_ICAS1Sys02_Entries_Array_Minor_Version
{
  servicediscovery_find_ICAS1Sys02_entries_array_minor_version[@ServiceDiscovery_SOMEIPPacket_Find_ICAS1Sys02_Entries_Array_Element] = @this;
}


/*on timer tSend_ServiceDiscovery_Subscribe_ICAS1Sys02
{
  if ( ( (@UnitMaster_available == 1) && (@UnitMaster_Subscribe_units == 1) )
    
    || ( (@DisplaySpeed_available == 1) &&
       ( (@DisplaySpeed_Subscribe_speeds == 1) || (@DisplaySpeed_Subscribe_speedWarnings == 1) || (@DisplaySpeed_Subscribe_speedBlockings == 1) ) )
    
    || ( (@Temperature_available == 1) &&
       ( (@Temperature_Subscribe_temperatures == 1) || (@Temperature_Subscribe_temperatureWarnings == 1) ) )
    
    || ( (@DrivingStatistics_available == 1) &&
       ( (@DrivingStatistics_Subscribe_speeds == 1) || (@DrivingStatistics_Subscribe_distances == 1) || (@DrivingStatistics_Subscribe_durations == 1) ) )
    
    || ( (@DiagnosticNotification_available == 1) && (@DiagnosticNotification_Subscribe_notifications == 1) ) )
    
    {
      Send_ServiceDiscovery_Subscribe_ICAS1Sys02 ();
    }
}*/

on envVar ServiceDiscovery_SOMEIPPacket_Find_ICAS1Sys02_Options_Array_On_Off
{
  if (@this == 0)
  {
    @ServiceDiscovery_SOMEIPPacket_Find_ICAS1Sys02_Options_Array_Length = 0;
    @ServiceDiscovery_SOMEIPPacket_Find_ICAS1Sys02_Entries_Array_Nr_of_opt_1 = 0;
  }
  
  if (@this == 1)
  {
    @ServiceDiscovery_SOMEIPPacket_Find_ICAS1Sys02_Options_Array_Length = 24;
    @ServiceDiscovery_SOMEIPPacket_Find_ICAS1Sys02_Entries_Array_Nr_of_opt_1 = 1;
  }
}


Send_ServiceDiscovery_Subscribe_ICAS1Sys02 (word Service_ID, word Eventgroup_ID, byte Status)
{
  ethernetPacket EthPaket;
  
  // Ethernet Packet - MAC Source address
  getvalue (ServiceDiscovery_EthernetPacket_MAC_Source_ICAS1Sys02, buffer_MAC);
  
  //EthPaket.source.ParseAddress ( buffer_MAC );
  EthPaket.source = ethGetMacAddressAsNumber (buffer_MAC);
  
  // Ethernet Packet - MAC Destination address
  getvalue (ServiceDiscovery_EthernetPacket_MAC_Destination, buffer_MAC);
  //EthPaket.destination.ParseAddress ( buffer_MAC );
  EthPaket.destination = ethGetMacAddressAsNumber (buffer_MAC);
  
  // Ethernet Packet - VLAN
  EthPaket.SetVlan (@ServiceDiscovery_EthernetPacket_VLAN_TPID, @ServiceDiscovery_EthernetPacket_VLAN_TCI);
  
  // Ethernet Packet - Type
  //EthPaket.ipv6.type = @EthernetPacket_Type;
  if (@ServiceDiscovery_EthernetPacket_Type == 0x86DD) EthPaket.ipv6.Init();
  
  
  // IPv6 Packet - Version
  EthPaket.ipv6.version = @ServiceDiscovery_IPv6Packet_Version;

  // IPv6 Packet - Traffic Class
  EthPaket.ipv6.class = @ServiceDiscovery_IPv6Packet_Traffic_Class;
  
  // IPv6 Packet - Flow Label
  EthPaket.ipv6.flow = @ServiceDiscovery_IPv6Packet_Flow_Label;
  
  // IPv6 Packet - Payload_Length
  EthPaket.ipv6.length = @ServiceDiscovery_IPv6Packet_Payload_Length;
  
  // IPv6 Packet - Next Header
  EthPaket.ipv6.next = @ServiceDiscovery_IPv6Packet_Next_Header;
  if (@ServiceDiscovery_IPv6Packet_Next_Header == 6) EthPaket.tcp.Init();
  if (@ServiceDiscovery_IPv6Packet_Next_Header == 17) EthPaket.udp.Init();
  
  // IPv6 Packet - Hop Limit
  EthPaket.ipv6.hopLimit = @ServiceDiscovery_IPv6Packet_Hop_Limit;

  // IPv6 Packet - IPv6 Destination address    // TODO: char array zu byte array
  buffer_ipv6[0]  = @ServiceDiscovery_IPv6Packet_IP_Destination_Unicast_01>>8 & 0xFF;
  buffer_ipv6[1]  = @ServiceDiscovery_IPv6Packet_IP_Destination_Unicast_01    & 0xFF;
  buffer_ipv6[2]  = @ServiceDiscovery_IPv6Packet_IP_Destination_Unicast_02>>8 & 0xFF;
  buffer_ipv6[3]  = @ServiceDiscovery_IPv6Packet_IP_Destination_Unicast_02    & 0xFF;
  buffer_ipv6[4]  = @ServiceDiscovery_IPv6Packet_IP_Destination_Unicast_03>>8 & 0xFF;
  buffer_ipv6[5]  = @ServiceDiscovery_IPv6Packet_IP_Destination_Unicast_03    & 0xFF;
  buffer_ipv6[6]  = @ServiceDiscovery_IPv6Packet_IP_Destination_Unicast_04>>8 & 0xFF;
  buffer_ipv6[7]  = @ServiceDiscovery_IPv6Packet_IP_Destination_Unicast_04    & 0xFF;
  buffer_ipv6[8]  = @ServiceDiscovery_IPv6Packet_IP_Destination_Unicast_05>>8 & 0xFF;
  buffer_ipv6[9]  = @ServiceDiscovery_IPv6Packet_IP_Destination_Unicast_05    & 0xFF;
  buffer_ipv6[10] = @ServiceDiscovery_IPv6Packet_IP_Destination_Unicast_06>>8 & 0xFF;
  buffer_ipv6[11] = @ServiceDiscovery_IPv6Packet_IP_Destination_Unicast_06    & 0xFF;
  buffer_ipv6[12] = @ServiceDiscovery_IPv6Packet_IP_Destination_Unicast_07>>8 & 0xFF;
  buffer_ipv6[13] = @ServiceDiscovery_IPv6Packet_IP_Destination_Unicast_07    & 0xFF;
  buffer_ipv6[14] = @ServiceDiscovery_IPv6Packet_IP_Destination_Unicast_08>>8 & 0xFF;
  buffer_ipv6[15] = @ServiceDiscovery_IPv6Packet_IP_Destination_Unicast_08    & 0xFF;
  EthPaket.ipv6.destination.SetData ( 0, buffer_ipv6, elcount(buffer_ipv6) );

  // IPv6 Packet - IPv6 Source address    // TODO: char array zu byte array
  buffer_ipv6[0]  = @ServiceDiscovery_IPv6Packet_IP_Source_ICAS1Sys02_01>>8 & 0xFF;
  buffer_ipv6[1]  = @ServiceDiscovery_IPv6Packet_IP_Source_ICAS1Sys02_01    & 0xFF;
  buffer_ipv6[2]  = @ServiceDiscovery_IPv6Packet_IP_Source_ICAS1Sys02_02>>8 & 0xFF;
  buffer_ipv6[3]  = @ServiceDiscovery_IPv6Packet_IP_Source_ICAS1Sys02_02    & 0xFF;
  buffer_ipv6[4]  = @ServiceDiscovery_IPv6Packet_IP_Source_ICAS1Sys02_03>>8 & 0xFF;
  buffer_ipv6[5]  = @ServiceDiscovery_IPv6Packet_IP_Source_ICAS1Sys02_03    & 0xFF;
  buffer_ipv6[6]  = @ServiceDiscovery_IPv6Packet_IP_Source_ICAS1Sys02_04>>8 & 0xFF;
  buffer_ipv6[7]  = @ServiceDiscovery_IPv6Packet_IP_Source_ICAS1Sys02_04    & 0xFF;
  buffer_ipv6[8]  = @ServiceDiscovery_IPv6Packet_IP_Source_ICAS1Sys02_05>>8 & 0xFF;
  buffer_ipv6[9]  = @ServiceDiscovery_IPv6Packet_IP_Source_ICAS1Sys02_05    & 0xFF;
  buffer_ipv6[10] = @ServiceDiscovery_IPv6Packet_IP_Source_ICAS1Sys02_06>>8 & 0xFF;
  buffer_ipv6[11] = @ServiceDiscovery_IPv6Packet_IP_Source_ICAS1Sys02_06    & 0xFF;
  buffer_ipv6[12] = @ServiceDiscovery_IPv6Packet_IP_Source_ICAS1Sys02_07>>8 & 0xFF;
  buffer_ipv6[13] = @ServiceDiscovery_IPv6Packet_IP_Source_ICAS1Sys02_07    & 0xFF;
  buffer_ipv6[14] = @ServiceDiscovery_IPv6Packet_IP_Source_ICAS1Sys02_08>>8 & 0xFF;
  buffer_ipv6[15] = @ServiceDiscovery_IPv6Packet_IP_Source_ICAS1Sys02_08    & 0xFF;
  EthPaket.ipv6.source.SetData ( 0, buffer_ipv6, elcount(buffer_ipv6) );

  
  // UDP Packet - Source Port
  EthPaket.udp.source = @ServiceDiscovery_UDPPacket_Port_Source;
  
  // UDP Packet - Destination Port
  EthPaket.udp.destination = @ServiceDiscovery_UDPPacket_Port_Destination;
  
  // UDP Packet - Length
  EthPaket.udp.length = @ServiceDiscovery_UDPPacket_Length;
  
  
  // prüfen wie viele Subscribes gesendet werden sollen
  number_of_subscribed_services_by_ICAS1Sys02 = 1;
//                                                @UnitMaster_Subscribe_units
//                                              + @DisplaySpeed_Subscribe_speeds
//                                              + @DisplaySpeed_Subscribe_speedWarnings
//                                              + @DisplaySpeed_Subscribe_speedBlockings
//                                              + @Temperature_Subscribe_temperatures
//                                              + @Temperature_Subscribe_temperatureWarnings
//                                              + @DrivingStatistics_Subscribe_speeds
//                                              + @DrivingStatistics_Subscribe_distances
//                                              + @DrivingStatistics_Subscribe_durations
//                                              + @DiagnosticNotification_Subscribe_notifications;
  
  
  // SOME/IP Packet aus Rohdaten zusammenbauen (buffer array)
  i=0;
  
  // SOME/IP Packet - Message ID, Service ID [16 bit]
  buffer[i++] = @ServiceDiscovery_SOMEIPPacket_Sub_ICAS1Sys02_Message_ID_Service_ID>>8 & 0xFF;
  buffer[i++] = @ServiceDiscovery_SOMEIPPacket_Sub_ICAS1Sys02_Message_ID_Service_ID    & 0xFF;
  
  // SOME/IP Packet - Message ID, Message ID [16 bit]
  buffer[i++] = @ServiceDiscovery_SOMEIPPacket_Sub_ICAS1Sys02_Message_ID_Method_ID>>8 & 0xFF;
  buffer[i++] = @ServiceDiscovery_SOMEIPPacket_Sub_ICAS1Sys02_Message_ID_Method_ID    & 0xFF;
  
  // SOME/IP Packet - Length [32 bit]
  @ServiceDiscovery_SOMEIPPacket_Sub_ICAS1Sys02_Length = 16 + (16 * number_of_subscribed_services_by_ICAS1Sys02) + 4 + 24;
  buffer[i++] = @ServiceDiscovery_SOMEIPPacket_Sub_ICAS1Sys02_Length>>24 & 0xFF;
  buffer[i++] = @ServiceDiscovery_SOMEIPPacket_Sub_ICAS1Sys02_Length>>16 & 0xFF;
  buffer[i++] = @ServiceDiscovery_SOMEIPPacket_Sub_ICAS1Sys02_Length>> 8 & 0xFF;
  buffer[i++] = @ServiceDiscovery_SOMEIPPacket_Sub_ICAS1Sys02_Length     & 0xFF;
  
  // SOME/IP Packet - Request ID, Client ID [16 bit]
  buffer[i++] = @ServiceDiscovery_SOMEIPPacket_Sub_ICAS1Sys02_Request_ID_Client_ID>>8 & 0xFF;
  buffer[i++] = @ServiceDiscovery_SOMEIPPacket_Sub_ICAS1Sys02_Request_ID_Client_ID    & 0xFF;
  
  // SOME/IP Packet - Request ID, Session ID) [16 bit]
  @ServiceDiscovery_SOMEIPPacket_Request_ID_Session_ID = @ServiceDiscovery_SOMEIPPacket_Request_ID_Session_ID + 1;
  if (@ServiceDiscovery_SOMEIPPacket_Request_ID_Session_ID == 0x10000) @ServiceDiscovery_SOMEIPPacket_Request_ID_Session_ID = 1;
  
  buffer[i++] = @ServiceDiscovery_SOMEIPPacket_Request_ID_Session_ID>>8 & 0xFF;
  buffer[i++] = @ServiceDiscovery_SOMEIPPacket_Request_ID_Session_ID    & 0xFF;
  
  // SOME/IP Packet - Protocol Version [8 bit]
  buffer[i++] = @ServiceDiscovery_SOMEIPPacket_Sub_ICAS1Sys02_Protocol_Version;
  
  // SOME/IP Packet - Interface Version [8 bit]
  buffer[i++] = @ServiceDiscovery_SOMEIPPacket_Sub_ICAS1Sys02_Interface_Version;

  // SOME/IP Packet - Message Type [8 bit]
  buffer[i++] = @ServiceDiscovery_SOMEIPPacket_Sub_ICAS1Sys02_Message_Type;
    
  // SOME/IP Packet - Return Code [8 bit]
  buffer[i++] = @ServiceDiscovery_SOMEIPPacket_Sub_ICAS1Sys02_Return_Code;
  
  // SOME/IP Packet - Flags [8 bit]
  buffer[i++] = @ServiceDiscovery_SOMEIPPacket_Sub_ICAS1Sys02_Flags;
  
  // SOME/IP Packet - Reserved [24 bit]
  buffer[i++] = 0x00;
  buffer[i++] = 0x00;
  buffer[i++] = 0x00;
  
  // SOME/IP Packet - Entries Array - Length [32 bit]
  @ServiceDiscovery_SOMEIPPacket_Sub_ICAS1Sys02_Entries_Array_Length = 16 * number_of_subscribed_services_by_ICAS1Sys02;
  buffer[i++] = @ServiceDiscovery_SOMEIPPacket_Sub_ICAS1Sys02_Entries_Array_Length>>24 & 0xFF;
  buffer[i++] = @ServiceDiscovery_SOMEIPPacket_Sub_ICAS1Sys02_Entries_Array_Length>>16 & 0xFF;
  buffer[i++] = @ServiceDiscovery_SOMEIPPacket_Sub_ICAS1Sys02_Entries_Array_Length>> 8 & 0xFF;
  buffer[i++] = @ServiceDiscovery_SOMEIPPacket_Sub_ICAS1Sys02_Entries_Array_Length     & 0xFF;
  
  j=0;
  
  // UnitMaster_units
  if (Service_ID == 0x600E && Eventgroup_ID == 0xC010)
  {
    servicediscovery_sub_tx_entries_array_type[j]              = 6;
    servicediscovery_sub_tx_entries_array_index_1st_options[j] = 0;
    servicediscovery_sub_tx_entries_array_index_2nd_options[j] = 0;
    servicediscovery_sub_tx_entries_array_nr_of_opt_1[j]       = 1;
    servicediscovery_sub_tx_entries_array_nr_of_opt_2[j]       = 0;
    servicediscovery_sub_tx_entries_array_service_id[j]        = Service_ID;
    servicediscovery_sub_tx_entries_array_instance_id[j]       = 1;
    servicediscovery_sub_tx_entries_array_major_version[j]     = 3;
    servicediscovery_sub_tx_entries_array_ttl[j]               = 0xFFFFFF * Status;
    servicediscovery_sub_tx_entries_array_counter[j]           = 0;
    servicediscovery_sub_tx_entries_array_eventgroup_id[j]     = Eventgroup_ID;
    
    j++;
  }
  
  // DisplaySpeed_speeds
  if (Service_ID == 0x6021 && Eventgroup_ID == 0xC010)
  {
    servicediscovery_sub_tx_entries_array_type[j]              = 6;
    servicediscovery_sub_tx_entries_array_index_1st_options[j] = 0;
    servicediscovery_sub_tx_entries_array_index_2nd_options[j] = 0;
    servicediscovery_sub_tx_entries_array_nr_of_opt_1[j]       = 1;
    servicediscovery_sub_tx_entries_array_nr_of_opt_2[j]       = 0;
    servicediscovery_sub_tx_entries_array_service_id[j]        = Service_ID;
    servicediscovery_sub_tx_entries_array_instance_id[j]       = 1;
    servicediscovery_sub_tx_entries_array_major_version[j]     = 4;
    servicediscovery_sub_tx_entries_array_ttl[j]               = 0xFFFFFF * Status;
    servicediscovery_sub_tx_entries_array_counter[j]           = 0;
    servicediscovery_sub_tx_entries_array_eventgroup_id[j]     = Eventgroup_ID;
    
    j++;
  }
  
  // DisplaySpeed_speedWarnings
  if (Service_ID == 0x6021 && Eventgroup_ID == 0xC020)
  {
    servicediscovery_sub_tx_entries_array_type[j]              = 6;
    servicediscovery_sub_tx_entries_array_index_1st_options[j] = 0;
    servicediscovery_sub_tx_entries_array_index_2nd_options[j] = 0;
    servicediscovery_sub_tx_entries_array_nr_of_opt_1[j]       = 1;
    servicediscovery_sub_tx_entries_array_nr_of_opt_2[j]       = 0;
    servicediscovery_sub_tx_entries_array_service_id[j]        = Service_ID;
    servicediscovery_sub_tx_entries_array_instance_id[j]       = 1;
    servicediscovery_sub_tx_entries_array_major_version[j]     = 4;
    servicediscovery_sub_tx_entries_array_ttl[j]               = 0xFFFFFF * Status;
    servicediscovery_sub_tx_entries_array_counter[j]           = 0;
    servicediscovery_sub_tx_entries_array_eventgroup_id[j]     = Eventgroup_ID;
    
    j++;
  }
  
  // DisplaySpeed_speedBlockings
  if (Service_ID == 0x6021 && Eventgroup_ID == 0xC030)
  {
    servicediscovery_sub_tx_entries_array_type[j]              = 6;
    servicediscovery_sub_tx_entries_array_index_1st_options[j] = 0;
    servicediscovery_sub_tx_entries_array_index_2nd_options[j] = 0;
    servicediscovery_sub_tx_entries_array_nr_of_opt_1[j]       = 1;
    servicediscovery_sub_tx_entries_array_nr_of_opt_2[j]       = 0;
    servicediscovery_sub_tx_entries_array_service_id[j]        = Service_ID;
    servicediscovery_sub_tx_entries_array_instance_id[j]       = 1;
    servicediscovery_sub_tx_entries_array_major_version[j]     = 4;
    servicediscovery_sub_tx_entries_array_ttl[j]               = 0xFFFFFF * Status;
    servicediscovery_sub_tx_entries_array_counter[j]           = 0;
    servicediscovery_sub_tx_entries_array_eventgroup_id[j]     = Eventgroup_ID;
    
    j++;
  }
  
  // Temperature_temperatures
  if (Service_ID == 0x6034 && Eventgroup_ID == 0xC010)
  {
    servicediscovery_sub_tx_entries_array_type[j]              = 6;
    servicediscovery_sub_tx_entries_array_index_1st_options[j] = 0;
    servicediscovery_sub_tx_entries_array_index_2nd_options[j] = 0;
    servicediscovery_sub_tx_entries_array_nr_of_opt_1[j]       = 1;
    servicediscovery_sub_tx_entries_array_nr_of_opt_2[j]       = 0;
    servicediscovery_sub_tx_entries_array_service_id[j]        = Service_ID;
    servicediscovery_sub_tx_entries_array_instance_id[j]       = 1;
    servicediscovery_sub_tx_entries_array_major_version[j]     = 2;
    servicediscovery_sub_tx_entries_array_ttl[j]               = 0xFFFFFF * Status;
    servicediscovery_sub_tx_entries_array_counter[j]           = 0;
    servicediscovery_sub_tx_entries_array_eventgroup_id[j]     = Eventgroup_ID;
    
    j++;
  }
  
  // Temperature_temperatureWarnings
  if (Service_ID == 0x6034 && Eventgroup_ID == 0xC020)
  {
    servicediscovery_sub_tx_entries_array_type[j]              = 6;
    servicediscovery_sub_tx_entries_array_index_1st_options[j] = 0;
    servicediscovery_sub_tx_entries_array_index_2nd_options[j] = 0;
    servicediscovery_sub_tx_entries_array_nr_of_opt_1[j]       = 1;
    servicediscovery_sub_tx_entries_array_nr_of_opt_2[j]       = 0;
    servicediscovery_sub_tx_entries_array_service_id[j]        = Service_ID;
    servicediscovery_sub_tx_entries_array_instance_id[j]       = 1;
    servicediscovery_sub_tx_entries_array_major_version[j]     = 2;
    servicediscovery_sub_tx_entries_array_ttl[j]               = 0xFFFFFF * Status;
    servicediscovery_sub_tx_entries_array_counter[j]           = 0;
    servicediscovery_sub_tx_entries_array_eventgroup_id[j]     = Eventgroup_ID;
    
    j++;
  }
  
  // DrivingStatistics_speeds
  if (Service_ID == 0x6035 && Eventgroup_ID == 0xC010)
  {
    servicediscovery_sub_tx_entries_array_type[j]              = 6;
    servicediscovery_sub_tx_entries_array_index_1st_options[j] = 0;
    servicediscovery_sub_tx_entries_array_index_2nd_options[j] = 0;
    servicediscovery_sub_tx_entries_array_nr_of_opt_1[j]       = 1;
    servicediscovery_sub_tx_entries_array_nr_of_opt_2[j]       = 0;
    servicediscovery_sub_tx_entries_array_service_id[j]        = Service_ID;
    servicediscovery_sub_tx_entries_array_instance_id[j]       = 1;
    servicediscovery_sub_tx_entries_array_major_version[j]     = 3;
    servicediscovery_sub_tx_entries_array_ttl[j]               = 0xFFFFFF * Status;
    servicediscovery_sub_tx_entries_array_counter[j]           = 0;
    servicediscovery_sub_tx_entries_array_eventgroup_id[j]     = Eventgroup_ID;
    
    j++;
  }
  
  // DrivingStatistics_distances
  if (Service_ID == 0x6035 && Eventgroup_ID == 0xC020)
  {
    servicediscovery_sub_tx_entries_array_type[j]              = 6;
    servicediscovery_sub_tx_entries_array_index_1st_options[j] = 0;
    servicediscovery_sub_tx_entries_array_index_2nd_options[j] = 0;
    servicediscovery_sub_tx_entries_array_nr_of_opt_1[j]       = 1;
    servicediscovery_sub_tx_entries_array_nr_of_opt_2[j]       = 0;
    servicediscovery_sub_tx_entries_array_service_id[j]        = Service_ID;
    servicediscovery_sub_tx_entries_array_instance_id[j]       = 1;
    servicediscovery_sub_tx_entries_array_major_version[j]     = 3;
    servicediscovery_sub_tx_entries_array_ttl[j]               = 0xFFFFFF * Status;
    servicediscovery_sub_tx_entries_array_counter[j]           = 0;
    servicediscovery_sub_tx_entries_array_eventgroup_id[j]     = Eventgroup_ID;
    
    j++;
  }
  
  // DrivingStatistics_durations
  if (Service_ID == 0x6035 && Eventgroup_ID == 0xC030)
  {
    servicediscovery_sub_tx_entries_array_type[j]              = 6;
    servicediscovery_sub_tx_entries_array_index_1st_options[j] = 0;
    servicediscovery_sub_tx_entries_array_index_2nd_options[j] = 0;
    servicediscovery_sub_tx_entries_array_nr_of_opt_1[j]       = 1;
    servicediscovery_sub_tx_entries_array_nr_of_opt_2[j]       = 0;
    servicediscovery_sub_tx_entries_array_service_id[j]        = Service_ID;
    servicediscovery_sub_tx_entries_array_instance_id[j]       = 1;
    servicediscovery_sub_tx_entries_array_major_version[j]     = 3;
    servicediscovery_sub_tx_entries_array_ttl[j]               = 0xFFFFFF * Status;
    servicediscovery_sub_tx_entries_array_counter[j]           = 0;
    servicediscovery_sub_tx_entries_array_eventgroup_id[j]     = Eventgroup_ID;
    
    j++;
  }
  
  // DiagnosticNotification_notifications
  if (Service_ID == 0x6046 && Eventgroup_ID == 0xC010)
  {
    servicediscovery_sub_tx_entries_array_type[j]              = 6;
    servicediscovery_sub_tx_entries_array_index_1st_options[j] = 0;
    servicediscovery_sub_tx_entries_array_index_2nd_options[j] = 0;
    servicediscovery_sub_tx_entries_array_nr_of_opt_1[j]       = 1;
    servicediscovery_sub_tx_entries_array_nr_of_opt_2[j]       = 0;
    servicediscovery_sub_tx_entries_array_service_id[j]        = 0x6046;
    servicediscovery_sub_tx_entries_array_instance_id[j]       = 1;
    servicediscovery_sub_tx_entries_array_major_version[j]     = 1;
    servicediscovery_sub_tx_entries_array_ttl[j]               = 0xFFFFFF * Status;
    servicediscovery_sub_tx_entries_array_counter[j]           = 0;
    servicediscovery_sub_tx_entries_array_eventgroup_id[j]     = 0xC010;
    
    j++;
  }
  
  for (j=0; j < number_of_subscribed_services_by_ICAS1Sys02; j++)
  {
    // SOME/IP Packet - Entries Array - Type [8 bit]
    buffer[i++] = servicediscovery_sub_tx_entries_array_type[j];
    
    // SOME/IP Packet - Entries Array - Index 1st options [8 bit]
    buffer[i++] = servicediscovery_sub_tx_entries_array_index_1st_options[j];
    
    // SOME/IP Packet - Entries Array - Index 2nd options [8 bit]
    buffer[i++] = servicediscovery_sub_tx_entries_array_index_2nd_options[j];
    
    // SOME/IP Packet - Entries Array - # of opt 1 [4 bit] / # of opt 2 [4 bit]
    buffer[i++] = (((servicediscovery_sub_tx_entries_array_nr_of_opt_1[j]*16)) + (servicediscovery_sub_tx_entries_array_nr_of_opt_2[j]));
    
    // SOME/IP Packet - Entries Array - Service ID [16 bit]
    buffer[i++] = servicediscovery_sub_tx_entries_array_service_id[j]>> 8 & 0xFF;
    buffer[i++] = servicediscovery_sub_tx_entries_array_service_id[j]     & 0xFF;

    // SOME/IP Packet - Entries Array - Instance ID [16 bit]
    buffer[i++] = servicediscovery_sub_tx_entries_array_instance_id[j]>> 8 & 0xFF;
    buffer[i++] = servicediscovery_sub_tx_entries_array_instance_id[j]     & 0xFF;
    
    // SOME/IP Packet - Entries Array - Major Version [8 bit]
    buffer[i++] = servicediscovery_sub_tx_entries_array_major_version[j];
    
    // SOME/IP Packet - Entries Array - TTL [24 bit]
    buffer[i++] = servicediscovery_sub_tx_entries_array_ttl[j]>>16 & 0xFF;
    buffer[i++] = servicediscovery_sub_tx_entries_array_ttl[j]>> 8 & 0xFF;
    buffer[i++] = servicediscovery_sub_tx_entries_array_ttl[j]     & 0xFF;
    
    // SOME/IP Packet - Entries Array - Reserved [12 bit] + Counter [4 bit]
    buffer[i++] = 0x00;
    buffer[i++] = servicediscovery_sub_tx_entries_array_counter[j] & 0x0F;
    
    // SOME/IP Packet - Entries Array - Eventgroup ID
    buffer[i++] = servicediscovery_sub_tx_entries_array_eventgroup_id[j]>> 8 & 0xFF;
    buffer[i++] = servicediscovery_sub_tx_entries_array_eventgroup_id[j]     & 0xFF;  
  }
  
  
  //SOME/IP Packet - Options Array - Length [32 bit]
  buffer[i++] = @ServiceDiscovery_SOMEIPPacket_Sub_ICAS1Sys02_Options_Array_Length>>24 & 0xFF;
  buffer[i++] = @ServiceDiscovery_SOMEIPPacket_Sub_ICAS1Sys02_Options_Array_Length>>16 & 0xFF;
  buffer[i++] = @ServiceDiscovery_SOMEIPPacket_Sub_ICAS1Sys02_Options_Array_Length>> 8 & 0xFF;
  buffer[i++] = @ServiceDiscovery_SOMEIPPacket_Sub_ICAS1Sys02_Options_Array_Length     & 0xFF;

  //SOME/IP Packet - Options Array - Option1 Length [16 bit]
  buffer[i++] = @ServiceDiscovery_SOMEIPPacket_Sub_ICAS1Sys02_Options_Array_Option1_Length>> 8 & 0xFF;
  buffer[i++] = @ServiceDiscovery_SOMEIPPacket_Sub_ICAS1Sys02_Options_Array_Option1_Length     & 0xFF;
  
  //SOME/IP Packet - Options Array - Option1 Type [8 bit]
  buffer[i++] = @ServiceDiscovery_SOMEIPPacket_Sub_ICAS1Sys02_Options_Array_Option1_Type & 0xFF;
  
  //SOME/IP Packet - Options Array - Reserved [8 bit]
  buffer[i++] = 0x00;
  
  //SOME/IP Packet - Options Array - Option1 IPv6 Address
  buffer[i++] = @ServiceDiscovery_SOMEIPPacket_Sub_ICAS1Sys02_Options_Array_Option1_IPv6_01>>8 & 0xFF;
  buffer[i++] = @ServiceDiscovery_SOMEIPPacket_Sub_ICAS1Sys02_Options_Array_Option1_IPv6_01    & 0xFF;
  buffer[i++] = @ServiceDiscovery_SOMEIPPacket_Sub_ICAS1Sys02_Options_Array_Option1_IPv6_02>>8 & 0xFF;
  buffer[i++] = @ServiceDiscovery_SOMEIPPacket_Sub_ICAS1Sys02_Options_Array_Option1_IPv6_02    & 0xFF;
  buffer[i++] = @ServiceDiscovery_SOMEIPPacket_Sub_ICAS1Sys02_Options_Array_Option1_IPv6_03>>8 & 0xFF;
  buffer[i++] = @ServiceDiscovery_SOMEIPPacket_Sub_ICAS1Sys02_Options_Array_Option1_IPv6_03    & 0xFF;
  buffer[i++] = @ServiceDiscovery_SOMEIPPacket_Sub_ICAS1Sys02_Options_Array_Option1_IPv6_04>>8 & 0xFF;
  buffer[i++] = @ServiceDiscovery_SOMEIPPacket_Sub_ICAS1Sys02_Options_Array_Option1_IPv6_04    & 0xFF;
  buffer[i++] = @ServiceDiscovery_SOMEIPPacket_Sub_ICAS1Sys02_Options_Array_Option1_IPv6_05>>8 & 0xFF;
  buffer[i++] = @ServiceDiscovery_SOMEIPPacket_Sub_ICAS1Sys02_Options_Array_Option1_IPv6_05    & 0xFF;
  buffer[i++] = @ServiceDiscovery_SOMEIPPacket_Sub_ICAS1Sys02_Options_Array_Option1_IPv6_06>>8 & 0xFF;
  buffer[i++] = @ServiceDiscovery_SOMEIPPacket_Sub_ICAS1Sys02_Options_Array_Option1_IPv6_06    & 0xFF;
  buffer[i++] = @ServiceDiscovery_SOMEIPPacket_Sub_ICAS1Sys02_Options_Array_Option1_IPv6_07>>8 & 0xFF;
  buffer[i++] = @ServiceDiscovery_SOMEIPPacket_Sub_ICAS1Sys02_Options_Array_Option1_IPv6_07    & 0xFF;
  buffer[i++] = @ServiceDiscovery_SOMEIPPacket_Sub_ICAS1Sys02_Options_Array_Option1_IPv6_08>>8 & 0xFF;
  buffer[i++] = @ServiceDiscovery_SOMEIPPacket_Sub_ICAS1Sys02_Options_Array_Option1_IPv6_08    & 0xFF;
  
  //SOME/IP Packet - Options Array - Reserved [8 bit]
  buffer[i++] = 0x00;
  
  //SOME/IP Packet - Options Array - Option1 L4-Proto [8 bit]
  buffer[i++] = @ServiceDiscovery_SOMEIPPacket_Sub_ICAS1Sys02_Options_Array_Option1_L4_Proto;
  
  //SOME/IP Packet - Options Array - Option1 Port Number [16 bit]
  buffer[i++] = @ServiceDiscovery_SOMEIPPacket_Sub_ICAS1Sys02_Options_Array_Option1_Port_Number>> 8 & 0xFF;
  buffer[i++] = @ServiceDiscovery_SOMEIPPacket_Sub_ICAS1Sys02_Options_Array_Option1_Port_Number     & 0xFF;
  
  // Rohdaten in UDP Paket schreiben
  EthPaket.udp.SetData( 0, buffer, i );

  // calculate UDP and IPv6 checksum and send Ethernet packet
  EthPaket.CompletePacket();
  if (@Env_GlobalAppl == 1) output( EthPaket );  
}








//////////////////////////////////////////////////
////////////////// Service Time //////////////////
//////////////////////////////////////////////////

on envVar ServiceDiscovery_Offer_Service_Time
{
  Send_ServiceDiscovery_Offer_Service_ICAS1Sys01();
}

on envVar Time_Notification_timeSettings_Send
{
  if (@this == 1)
  {
    UDP_Segments_total = @Time_Notification_Length_timeSettings/1404 + 1;
    UDP_Segments_left  = UDP_Segments_total;
    
    if (UDP_Segments_total > 1) seg_id_flag = 1;
    else                        seg_id_flag = 0;
    
    Send_Service_Time_Notification (0xC010 & 0x0000FFFF);
  }
}
on envVar Time_Notification_timeSettings_Send_cyclic
{
  if (@this == 1)
    setTimercyclic (tTime_Notification_timeSettings_Send, @Time_Notification_timeSettings_Send_cyclic_cycletime);
  else
    cancelTimer (tTime_Notification_timeSettings_Send);
}
on envVar Time_Notification_timeSettings_Send_cyclic_cycletime
{
  if (@Time_Notification_timeSettings_Send_cyclic == 1)
  {
    cancelTimer (tTime_Notification_timeSettings_Send);
    setTimercyclic (tTime_Notification_timeSettings_Send, @this);
  }
}
on timer tTime_Notification_timeSettings_Send
{
  UDP_Segments_total = @Time_Notification_Length_timeSettings/1404 + 1;
  UDP_Segments_left  = UDP_Segments_total;
  
  if (UDP_Segments_total > 1) seg_id_flag = 1;
  else                        seg_id_flag = 0;
    
  if (@Env_GlobalAppl == 1) Send_Service_Time_Notification (0xC010 & 0x0000FFFF);
}

on envVar Time_Notification_times_Send
{
  if (@this == 1)
  {
    UDP_Segments_total = @Time_Notification_Length_times/1404 + 1;
    UDP_Segments_left  = UDP_Segments_total;
    
    if (UDP_Segments_total > 1) seg_id_flag = 1;
    else                        seg_id_flag = 0;
    
    Send_Service_Time_Notification (0xC020 & 0x0000FFFF);
  }
}
on envVar Time_Notification_times_Send_cyclic
{
  if (@this == 1)
    setTimercyclic (tTime_Notification_time_Send, @Time_Notification_times_Send_cyclic_cycletime);
  else
    cancelTimer (tTime_Notification_time_Send);
}
on envVar Time_Notification_times_Send_cyclic_cycletime
{
  if (@Time_Notification_times_Send_cyclic == 1)
  {
    cancelTimer (tTime_Notification_time_Send);
    setTimercyclic (tTime_Notification_time_Send, @this);
  }
}
on timer tTime_Notification_time_Send
{
  UDP_Segments_total = @Time_Notification_Length_times/1404 + 1;
  UDP_Segments_left  = UDP_Segments_total;
  
  if (UDP_Segments_total > 1) seg_id_flag = 1;
  else                        seg_id_flag = 0;
  
  if (@Env_GlobalAppl == 1) Send_Service_Time_Notification (0xC020 & 0x0000FFFF);
}


Send_Service_Time_Notification (word MethodID)
{
  ethernetPacket EthPaket;

  // Ethernet Packet - MAC Source address
  getvalue (ServiceDiscovery_EthernetPacket_MAC_Source_ICAS1Gateway, buffer_MAC);
  //EthPaket.source.ParseAddress ( buffer_MAC );
  EthPaket.source = ethGetMacAddressAsNumber (buffer_MAC);
  
  // Ethernet Packet - MAC Destination address
  getvalue (ServiceDiscovery_EthernetPacket_MAC_Destination, buffer_MAC);
  //EthPaket.destination.ParseAddress ( buffer_MAC );
  EthPaket.destination = ethGetMacAddressAsNumber (buffer_MAC);
  
  // Ethernet Packet - VLAN
  EthPaket.SetVlan (@ServiceDiscovery_EthernetPacket_VLAN_TPID, @ServiceDiscovery_EthernetPacket_VLAN_TCI);
  
  // Ethernet Packet - Type
  //EthPaket.ipv6.type = @EthernetPacket_Type;
  if (@ServiceDiscovery_EthernetPacket_Type == 0x86DD) EthPaket.ipv6.Init();
  
  
  // IPv6 Packet - Version
  EthPaket.ipv6.version = @ServiceDiscovery_IPv6Packet_Version;

  // IPv6 Packet - Traffic Class
  EthPaket.ipv6.class = @ServiceDiscovery_IPv6Packet_Traffic_Class;
  
  // IPv6 Packet - Flow Label
  EthPaket.ipv6.flow = @ServiceDiscovery_IPv6Packet_Flow_Label;
  
  // IPv6 Packet - Payload_Length
  EthPaket.ipv6.length = @ServiceDiscovery_IPv6Packet_Payload_Length;
  
  // IPv6 Packet - Next Header
  EthPaket.ipv6.next = @ServiceDiscovery_IPv6Packet_Next_Header;
  if (@ServiceDiscovery_IPv6Packet_Next_Header == 6) EthPaket.tcp.Init();
  if (@ServiceDiscovery_IPv6Packet_Next_Header == 17) EthPaket.udp.Init();
  
  // IPv6 Packet - Hop Limit
  EthPaket.ipv6.hopLimit = @ServiceDiscovery_IPv6Packet_Hop_Limit;

  // IPv6 Packet - IPv6 Destination address    // TODO: char array zu byte array
  buffer_ipv6[0]  = @ServiceDiscovery_IPv6Packet_IP_Destination_Unicast_01>>8 & 0xFF;
  buffer_ipv6[1]  = @ServiceDiscovery_IPv6Packet_IP_Destination_Unicast_01    & 0xFF;
  buffer_ipv6[2]  = @ServiceDiscovery_IPv6Packet_IP_Destination_Unicast_02>>8 & 0xFF;
  buffer_ipv6[3]  = @ServiceDiscovery_IPv6Packet_IP_Destination_Unicast_02    & 0xFF;
  buffer_ipv6[4]  = @ServiceDiscovery_IPv6Packet_IP_Destination_Unicast_03>>8 & 0xFF;
  buffer_ipv6[5]  = @ServiceDiscovery_IPv6Packet_IP_Destination_Unicast_03    & 0xFF;
  buffer_ipv6[6]  = @ServiceDiscovery_IPv6Packet_IP_Destination_Unicast_04>>8 & 0xFF;
  buffer_ipv6[7]  = @ServiceDiscovery_IPv6Packet_IP_Destination_Unicast_04    & 0xFF;
  buffer_ipv6[8]  = @ServiceDiscovery_IPv6Packet_IP_Destination_Unicast_05>>8 & 0xFF;
  buffer_ipv6[9]  = @ServiceDiscovery_IPv6Packet_IP_Destination_Unicast_05    & 0xFF;
  buffer_ipv6[10] = @ServiceDiscovery_IPv6Packet_IP_Destination_Unicast_06>>8 & 0xFF;
  buffer_ipv6[11] = @ServiceDiscovery_IPv6Packet_IP_Destination_Unicast_06    & 0xFF;
  buffer_ipv6[12] = @ServiceDiscovery_IPv6Packet_IP_Destination_Unicast_07>>8 & 0xFF;
  buffer_ipv6[13] = @ServiceDiscovery_IPv6Packet_IP_Destination_Unicast_07    & 0xFF;
  buffer_ipv6[14] = @ServiceDiscovery_IPv6Packet_IP_Destination_Unicast_08>>8 & 0xFF;
  buffer_ipv6[15] = @ServiceDiscovery_IPv6Packet_IP_Destination_Unicast_08    & 0xFF;
  EthPaket.ipv6.destination.SetData ( 0, buffer_ipv6, elcount(buffer_ipv6) );

  // IPv6 Packet - IPv6 Source address    // TODO: char array zu byte array
  buffer_ipv6[0]  = @ServiceDiscovery_IPv6Packet_IP_Source_ICAS1Gateway_01>>8 & 0xFF;
  buffer_ipv6[1]  = @ServiceDiscovery_IPv6Packet_IP_Source_ICAS1Gateway_01    & 0xFF;
  buffer_ipv6[2]  = @ServiceDiscovery_IPv6Packet_IP_Source_ICAS1Gateway_02>>8 & 0xFF;
  buffer_ipv6[3]  = @ServiceDiscovery_IPv6Packet_IP_Source_ICAS1Gateway_02    & 0xFF;
  buffer_ipv6[4]  = @ServiceDiscovery_IPv6Packet_IP_Source_ICAS1Gateway_03>>8 & 0xFF;
  buffer_ipv6[5]  = @ServiceDiscovery_IPv6Packet_IP_Source_ICAS1Gateway_03    & 0xFF;
  buffer_ipv6[6]  = @ServiceDiscovery_IPv6Packet_IP_Source_ICAS1Gateway_04>>8 & 0xFF;
  buffer_ipv6[7]  = @ServiceDiscovery_IPv6Packet_IP_Source_ICAS1Gateway_04    & 0xFF;
  buffer_ipv6[8]  = @ServiceDiscovery_IPv6Packet_IP_Source_ICAS1Gateway_05>>8 & 0xFF;
  buffer_ipv6[9]  = @ServiceDiscovery_IPv6Packet_IP_Source_ICAS1Gateway_05    & 0xFF;
  buffer_ipv6[10] = @ServiceDiscovery_IPv6Packet_IP_Source_ICAS1Gateway_06>>8 & 0xFF;
  buffer_ipv6[11] = @ServiceDiscovery_IPv6Packet_IP_Source_ICAS1Gateway_06    & 0xFF;
  buffer_ipv6[12] = @ServiceDiscovery_IPv6Packet_IP_Source_ICAS1Gateway_07>>8 & 0xFF;
  buffer_ipv6[13] = @ServiceDiscovery_IPv6Packet_IP_Source_ICAS1Gateway_07    & 0xFF;
  buffer_ipv6[14] = @ServiceDiscovery_IPv6Packet_IP_Source_ICAS1Gateway_08>>8 & 0xFF;
  buffer_ipv6[15] = @ServiceDiscovery_IPv6Packet_IP_Source_ICAS1Gateway_08    & 0xFF;
  EthPaket.ipv6.source.SetData ( 0, buffer_ipv6, elcount(buffer_ipv6) );

  
  // UDP Packet - Source Port
  EthPaket.udp.source = @Time_Notification_Port_Source;
  
  // UDP Packet - Destination Port
  EthPaket.udp.destination = @Time_Notification_Port_Destination;
  
  // UDP Packet - Length
  EthPaket.udp.length = @ServiceDiscovery_UDPPacket_Length;
  
  
  // SOME/IP Packet aus Rohdaten zusammenbauen (buffer array)
  i=0;
  
  // SOME/IP Packet - Message ID, Service ID [16 bit]
  buffer[i++] = @Time_Notification_Message_ID_Service_ID>>8 & 0xFF;
  buffer[i++] = @Time_Notification_Message_ID_Service_ID    & 0xFF;
  
  // SOME/IP Packet - Message ID, Message ID [16 bit]
  switch (MethodID)
  {
    case 0xC010: @Time_Notification_Message_ID_Method_ID = @Time_Notification_Message_ID_Method_ID_timeSettings; break;
    case 0xC020: @Time_Notification_Message_ID_Method_ID = @Time_Notification_Message_ID_Method_ID_times; break;
  }
  buffer[i++] = @Time_Notification_Message_ID_Method_ID>>8 & 0xFF;
  buffer[i++] = @Time_Notification_Message_ID_Method_ID    & 0xFF;
  
  // SOME/IP Packet - Length [32 bit]
  if (UDP_Segments_total == 1)
  {
    switch (MethodID)
    {
      case 0xC010: @Time_Notification_Length = @Time_Notification_Length_timeSettings; break;
      case 0xC020: @Time_Notification_Length = @Time_Notification_Length_times; break;
    }
  }
  else
  {
    if (UDP_Segments_left > 1)
    {
      switch (MethodID)
      {
        case 0xC010: @Time_Notification_Length = 1404; break;
        case 0xC020: @Time_Notification_Length = 1404; break;
      }
    }
    else
    {
      switch (MethodID)
      {
        case 0xC010: @Time_Notification_Length = Time_payload_length_timeSettings - 1404*(UDP_Segments_total-UDP_Segments_left) + 24; break;
        case 0xC020: @Time_Notification_Length = Time_payload_length_times        - 1404*(UDP_Segments_total-UDP_Segments_left) + 24; break;
      }
    }
  }
  buffer[i++] = @Time_Notification_Length>>24 & 0xFF;
  buffer[i++] = @Time_Notification_Length>>16 & 0xFF;
  buffer[i++] = @Time_Notification_Length>> 8 & 0xFF;
  buffer[i++] = @Time_Notification_Length     & 0xFF;
  
  // SOME/IP Packet - Request ID, Client ID [16 bit]
  buffer[i++] = @Time_Notification_Request_ID_Client_ID>>8 & 0xFF;
  buffer[i++] = @Time_Notification_Request_ID_Client_ID    & 0xFF;
  
  // SOME/IP Packet - Request ID, Session ID) [16 bit]
  if ((UDP_Segments_total == 1) || (seg_id_flag == 1))
  {
    @ServiceDiscovery_SOMEIPPacket_Notification_Request_ID_Session_ID = @ServiceDiscovery_SOMEIPPacket_Notification_Request_ID_Session_ID + 1;
    if (@ServiceDiscovery_SOMEIPPacket_Notification_Request_ID_Session_ID == 0x10000) @ServiceDiscovery_SOMEIPPacket_Notification_Request_ID_Session_ID = 1;
    seg_id_flag = 0;
  }
  
  buffer[i++] = @ServiceDiscovery_SOMEIPPacket_Notification_Request_ID_Session_ID>>8 & 0xFF;
  buffer[i++] = @ServiceDiscovery_SOMEIPPacket_Notification_Request_ID_Session_ID    & 0xFF;
  
  // SOME/IP Packet - Protocol Version [8 bit]
  buffer[i++] = @Time_Notification_Protocol_Version;
  
  // SOME/IP Packet - Interface Version [8 bit]
  buffer[i++] = @Time_Notification_Interface_Version;
  
  // SOME/IP Packet - Message Type [8 bit]
  buffer[i++] = @Time_Notification_Message_Type;
  
  // SOME/IP Packet - Return Code [8 bit]
  buffer[i++] = @Time_Notification_Return_Code;
  
  
  if (UDP_Segments_total > 1)
  {
    if (UDP_Segments_left >= 0)
    { 
      // Message Type neu setzen
      buffer[i-2] = @Time_Notification_Message_Type + 0x20;
      
      // Offset (16byte Schritte, 1392/16 = 87)
      @Time_Notification_Offset = 87 * (UDP_Segments_total - UDP_Segments_left);
      
      // More Segments Flag
      if (UDP_Segments_left > 1) @Time_Notification_More_Segments_Flag = 1;
      else                       @Time_Notification_More_Segments_Flag = 0;
      
      buffer[i++] =   @Time_Notification_Offset>>20 & 0xFF;
      buffer[i++] =   @Time_Notification_Offset>>12 & 0xFF;
      buffer[i++] =   @Time_Notification_Offset>>4  & 0xFF;
      buffer[i++] = ((@Time_Notification_Offset<<4) & 0xF0) + (@Time_Notification_More_Segments_Flag & 0x01);
    }
  }
  
  UDP_Segments_left--;
  
  ////// timeSettings notifier //////
  if (MethodID == 0xC010)
  {
    if (UDP_Segments_total == 1)
    {
      for (j=0; j<Time_payload_length_timeSettings; j++)
        buffer[i++] = Time_payload_buffer_timeSettings[j];
    }
    else
    {
      if (UDP_Segments_left >= 1)
      {
        for (j=(UDP_Segments_total-UDP_Segments_left-1)*1392; j<(UDP_Segments_total-UDP_Segments_left)*1392; j++)
          buffer[i++] = Time_payload_buffer_timeSettings[j];
      }
      else
      {
        for (j=(UDP_Segments_total-(UDP_Segments_left+1))*1392; j<Time_payload_length_timeSettings; j++)
          buffer[i++] = Time_payload_buffer_timeSettings[j];
      }
    }
  }
  
  ////// times notifier //////
  if (MethodID == 0xC020)
  {
    if (UDP_Segments_total == 1)
    {
      for (j=0; j<Time_payload_length_times; j++)
        buffer[i++] = Time_payload_buffer_times[j];
    }
    else
    {
      if (UDP_Segments_left >= 1)
      {
        for (j=(UDP_Segments_total-UDP_Segments_left-1)*1392; j<(UDP_Segments_total-UDP_Segments_left)*1392; j++)
          buffer[i++] = Time_payload_buffer_times[j];
      }
      else
      {
        for (j=(UDP_Segments_total-(UDP_Segments_left+1))*1392; j<Time_payload_length_times; j++)
          buffer[i++] = Time_payload_buffer_times[j];
      }
    }
  }
  
  // Rohdaten in UDP Paket schreiben
  EthPaket.udp.SetData( 0, buffer, i );

  // calculate UDP and IPv6 checksum and send Ethernet packet
  EthPaket.CompletePacket();
  output( EthPaket );
  
  // prüfen ob alle Segemente gesendet wurden, sonst senden erneut aufrufen
  Time_Segmentation_Method_ID = MethodID;
  if (UDP_Segments_left>0)
    settimer(Time_Segmentation_delay, 50);
}

on timer Time_Segmentation_delay
{
  Send_Service_Time_Notification (Time_Segmentation_Method_ID);
}






////////// timeSettings Notification //////////

on envVar Time_Notification_LengthIndicator_Struct_timeSettings
{
  Time_Notification_timeSettings();
}
on envVar Time_Notification_LengthIndicator_Element_timeSettings
{
  Time_Notification_timeSettings();
}
on envVar Time_Notification_timeSettings_id
{
  getvalue(this, buffer_uuid);
  for (k=0;k<16;k++)
    Time_array_timeSettings_id[@Time_Notification_timeSettings_Element][k] = buffer_uuid[k];
  Time_Notification_timeSettings();
}
on envVar Time_Notification_timeSettings_dstActive
{
  Time_array_timeSettings_dstActive[@Time_Notification_timeSettings_Element] = @this;
  Time_Notification_timeSettings();
}
on envVar Time_Notification_timeSettings_timeMode
{
  Time_array_timeSettings_timeMode[@Time_Notification_timeSettings_Element] = @this;
  Time_Notification_timeSettings();
}
on envVar Time_Notification_timeSettings_timeZoneOffset
{
  Time_array_timeSettings_timeZoneOffset[@Time_Notification_timeSettings_Element] = @this;
  Time_Notification_timeSettings();
}

on envVar Time_Notification_timeSettings_id_available
{
  Time_array_timeSettings_id_available[@Time_Notification_timeSettings_Element] = @this;
  Time_Notification_timeSettings(); 
}
on envVar Time_Notification_timeSettings_dstActive_available
{
  Time_array_timeSettings_dstActive_available[@Time_Notification_timeSettings_Element] = @this;
  Time_Notification_timeSettings(); 
}
on envVar Time_Notification_timeSettings_timeMode_available
{
  Time_array_timeSettings_timeMode_available[@Time_Notification_timeSettings_Element] = @this;
  Time_Notification_timeSettings(); 
}
on envVar Time_Notification_timeSettings_timeZoneOffset_available
{
  Time_array_timeSettings_timeZoneOffset_available[@Time_Notification_timeSettings_Element] = @this;
  Time_Notification_timeSettings(); 
}
on envVar Time_Notification_timeSettings_Payload
{
  Time_Notification_timeSettings_update();
}


Time_Notification_timeSettings()
{
  word payload_counter = 0;
  word start_pos       = 0;
  word element_length  = 0;
  
  // Length Indicator Struct - Platzhalter
  payload_counter = 0+4;
  start_pos = 0;
  
  for (j=0; j<@Time_Notification_timeSettings_Element_TotalNum; j++)
  {
    Time_array_timeSettings_available_functions[j] = Time_array_timeSettings_id_available[j]
                                                   + Time_array_timeSettings_dstActive_available[j]
                                                   + Time_array_timeSettings_timeMode_available[j]
                                                   + Time_array_timeSettings_timeZoneOffset_available[j];
    
    // Length Indicator Element - Platzhalter
    if (Time_array_timeSettings_available_functions[j] > 0)
    {
      start_pos = payload_counter;
      payload_counter = payload_counter + 4;
    }
    else 
      start_pos = payload_counter;
    
    
     // 0 id (uuid 16byte)
    if (Time_array_timeSettings_id_available[j] == 1)
    {
      tag_dataID = 0;
      Time_payload_buffer_timeSettings[payload_counter++] = 5 * 16 /* Wiretype = 5 =^ Array mit 1 Byte Länge */ + ((tag_dataID>>8) & 0x0F) /* DataID High Part */ ;
      Time_payload_buffer_timeSettings[payload_counter++] = tag_dataID & 0xFF /* DataID Low Part */ ;
      
      Time_payload_buffer_timeSettings[payload_counter++] = 16; // Array Length
      
      for (k=0; k<16; k++)
        Time_payload_buffer_timeSettings[payload_counter++] = Time_array_timeSettings_id[j][k] & 0xFF;
    }
    

    // 1 dstActive (boolean)
    if (Time_array_timeSettings_dstActive_available[j] == 1)
    {
      tag_dataID = 1;
      Time_payload_buffer_timeSettings[payload_counter++] = 0 * 16 /* Wiretype = 0 =^ 8 Bit */ + ((tag_dataID>>8) & 0x0F) /* DataID High Part */ ;
      Time_payload_buffer_timeSettings[payload_counter++] = tag_dataID & 0xFF /* DataID Low Part */ ;
      
      Time_payload_buffer_timeSettings[payload_counter++] = Time_array_timeSettings_dstActive[j] & 0xFF;
    }
    
    
    // 2 timeMode (enum32)
    if (Time_array_timeSettings_timeMode_available[j] == 1)
    {
      tag_dataID = 2;
      Time_payload_buffer_timeSettings[payload_counter++] = 2 * 16 /* Wiretype = 2 =^ 32 Bit */ + ((tag_dataID>>8) & 0x0F) /* DataID High Part */ ;
      Time_payload_buffer_timeSettings[payload_counter++] = tag_dataID & 0xFF /* DataID Low Part */ ;
      
      Time_payload_buffer_timeSettings[payload_counter++] = Time_array_timeSettings_timeMode[j]>>24 & 0xFF;
      Time_payload_buffer_timeSettings[payload_counter++] = Time_array_timeSettings_timeMode[j]>>16 & 0xFF;
      Time_payload_buffer_timeSettings[payload_counter++] = Time_array_timeSettings_timeMode[j]>> 8 & 0xFF;
      Time_payload_buffer_timeSettings[payload_counter++] = Time_array_timeSettings_timeMode[j]     & 0xFF;
    }
    
    
    // 3 timeZoneOffset (int32)
    if (Time_array_timeSettings_timeZoneOffset_available[j] == 1)
    {
      tag_dataID = 3;
      Time_payload_buffer_timeSettings[payload_counter++] = 2 * 16 /* Wiretype = 2 =^ 32 Bit */ + ((tag_dataID>>8) & 0x0F) /* DataID High Part */ ;
      Time_payload_buffer_timeSettings[payload_counter++] = tag_dataID & 0xFF /* DataID Low Part */ ;
      
      Time_payload_buffer_timeSettings[payload_counter++] = Time_array_timeSettings_timeZoneOffset[j]>>24 & 0xFF;
      Time_payload_buffer_timeSettings[payload_counter++] = Time_array_timeSettings_timeZoneOffset[j]>>16 & 0xFF;
      Time_payload_buffer_timeSettings[payload_counter++] = Time_array_timeSettings_timeZoneOffset[j]>> 8 & 0xFF;
      Time_payload_buffer_timeSettings[payload_counter++] = Time_array_timeSettings_timeZoneOffset[j]     & 0xFF;
    }
    
    //Element Length
    element_length = payload_counter-start_pos;
    if (element_length >0) Time_array_timeSettings_array_element_length[j] = element_length - 4;
    else                   Time_array_timeSettings_array_element_length[j] = element_length;
    
    Time_payload_buffer_timeSettings[start_pos++] = Time_array_timeSettings_array_element_length[j]>>24 & 0xFF;
    Time_payload_buffer_timeSettings[start_pos++] = Time_array_timeSettings_array_element_length[j]>>16 & 0xFF;
    Time_payload_buffer_timeSettings[start_pos++] = Time_array_timeSettings_array_element_length[j]>> 8 & 0xFF;
    Time_payload_buffer_timeSettings[start_pos++] = Time_array_timeSettings_array_element_length[j]     & 0xFF;
    
    if (Time_array_timeSettings_array_element_length[j] == 0) payload_counter = payload_counter+4;
  }
  
  // Struct Length
  Time_array_timeSettings_struct_element_length = 4*@Time_Notification_timeSettings_Element_TotalNum;

  for (k=0;k<@Time_Notification_timeSettings_Element_TotalNum;k++)
   Time_array_timeSettings_struct_element_length = Time_array_timeSettings_struct_element_length + Time_array_timeSettings_array_element_length[k];
  
  Time_payload_buffer_timeSettings[0] = Time_array_timeSettings_struct_element_length>>24 & 0xFF;
  Time_payload_buffer_timeSettings[1] = Time_array_timeSettings_struct_element_length>>16 & 0xFF;
  Time_payload_buffer_timeSettings[2] = Time_array_timeSettings_struct_element_length>> 8 & 0xFF;
  Time_payload_buffer_timeSettings[3] = Time_array_timeSettings_struct_element_length     & 0xFF;


  Time_payload_length_timeSettings = Time_array_timeSettings_struct_element_length+4;
  putvalue(Time_Notification_timeSettings_Payload, Time_payload_buffer_timeSettings, Time_payload_length_timeSettings);
}

on envVar Time_Notification_timeSettings_Element_TotalNum
{
  if (@this == 0) @this =  1;
  if (@this > 10) @this = 10;
  
  Time_Notification_timeSettings();
  Time_Notification_timeSettings_update();
}

on envVar Time_Notification_timeSettings_Element
{
  Time_Notification_timeSettings_update();
}

on envVar Time_Notification_timeSettings_Element_Next
{
  if (@this == 1 && @Time_Notification_timeSettings_Element < @Time_Notification_timeSettings_Element_TotalNum - 1)
  {
    @Time_Notification_timeSettings_Element = @Time_Notification_timeSettings_Element + 1;
    Time_Notification_timeSettings_update();
  }
}

on envVar Time_Notification_timeSettings_Element_Previous
{
  if (@this == 1 && @Time_Notification_timeSettings_Element > 0)
  {
    @Time_Notification_timeSettings_Element = @Time_Notification_timeSettings_Element - 1;
    Time_Notification_timeSettings_update();
  }
}

Time_Notification_timeSettings_update()
{
  @Time_Notification_LengthIndicator_Element_timeSettings = Time_array_timeSettings_array_element_length[@Time_Notification_timeSettings_Element];
  @Time_Notification_LengthIndicator_Struct_timeSettings  = Time_array_timeSettings_struct_element_length;
  @Time_Notification_Length_timeSettings                  = Time_payload_length_timeSettings+8;
  
  @Time_Notification_timeSettings_dstActive      = Time_array_timeSettings_dstActive[@Time_Notification_timeSettings_Element];
  @Time_Notification_timeSettings_timeMode       = Time_array_timeSettings_timeMode[@Time_Notification_timeSettings_Element];
  @Time_Notification_timeSettings_timeZoneOffset = Time_array_timeSettings_timeZoneOffset[@Time_Notification_timeSettings_Element];
  
  putValue (Time_Notification_timeSettings_id, Time_array_timeSettings_id[@Time_Notification_timeSettings_Element]);
  
  @Time_Notification_timeSettings_id_available             = Time_array_timeSettings_id_available[@Time_Notification_timeSettings_Element];
  @Time_Notification_timeSettings_dstActive_available      = Time_array_timeSettings_dstActive_available[@Time_Notification_timeSettings_Element];
  @Time_Notification_timeSettings_timeMode_available       = Time_array_timeSettings_timeMode_available[@Time_Notification_timeSettings_Element];
  @Time_Notification_timeSettings_timeZoneOffset_available = Time_array_timeSettings_timeZoneOffset_available[@Time_Notification_timeSettings_Element];
}






////////// times Notification //////////

on envVar Time_Notification_LengthIndicator_Struct_times
{
  Time_Notification_times();
}
on envVar Time_Notification_LengthIndicator_Element_times
{
  Time_Notification_times();
}
on envVar Time_Notification_times_type
{
  Time_array_times_type[@Time_Notification_times_Element] = @this;
  Time_Notification_times();
}
on envVar Time_Notification_times_date
{
  for (k=0; k<100; k++)
    Time_array_times_date[@Time_Notification_times_Element][k] = 0x00;
  
  getvalue (this, buffer_char);
  for (k=0; k<getvaluesize(this)-1; k++)
    Time_array_times_date[@Time_Notification_times_Element][k] = buffer_char[k];
    
  Time_Notification_times();
}
on envVar Time_Notification_times_pltOffset
{
  Time_array_times_pltOffset[@Time_Notification_times_Element] = @this;
  Time_Notification_times();
}
on envVar Time_Notification_times_time
{
  for (k=0; k<100; k++)
    Time_array_times_time[@Time_Notification_times_Element][k] = 0x00;
  
  getvalue (this, buffer_char);
  for (k=0; k<getvaluesize(Time_Notification_times_time)-1; k++)
    Time_array_times_time[@Time_Notification_times_Element][k] = buffer_char[k];
  
  Time_Notification_times();
}
on envVar Time_Notification_times_unix
{
  Time_array_times_unix[@Time_Notification_times_Element] = @this;
  Time_Notification_times();
}
on envVar Time_Notification_times_standby
{
  Time_array_times_standby[@Time_Notification_times_Element] = @this;
  Time_Notification_times();
}

on envVar Time_Notification_times_type_available
{
  Time_array_times_type_available[@Time_Notification_times_Element] = @this;
  Time_Notification_times(); 
}
on envVar Time_Notification_times_date_available
{
  Time_array_times_date_available[@Time_Notification_times_Element] = @this;
  Time_Notification_times(); 
}
on envVar Time_Notification_times_pltOffset_available
{
  Time_array_times_pltOffset_available[@Time_Notification_times_Element] = @this;
  Time_Notification_times(); 
}
on envVar Time_Notification_times_time_available
{
  Time_array_times_time_available[@Time_Notification_times_Element] = @this;
  Time_Notification_times(); 
}
on envVar Time_Notification_times_unix_available
{
  Time_array_times_unix_available[@Time_Notification_times_Element] = @this;
  Time_Notification_times(); 
}
on envVar Time_Notification_times_standby_available
{
  Time_array_times_standby_available[@Time_Notification_times_Element] = @this;
  Time_Notification_times(); 
}
on envVar Time_Notification_times_Payload
{
  Time_Notification_times_update();
}


Time_Notification_times()
{
  word payload_counter = 0;
  word start_pos       = 0;
  word element_length  = 0;
  
  // Length Indicator Struct - Platzhalter
  payload_counter = 0+4;
  start_pos = 0;
  
  for (j=0; j<@Time_Notification_times_Element_TotalNum; j++)
  {
    Time_array_times_available_functions[j] = Time_array_times_type_available[j]
                                            + Time_array_times_date_available[j]
                                            + Time_array_times_pltOffset_available[j]
                                            + Time_array_times_time_available[j]
                                            + Time_array_times_unix_available[j]
                                            + Time_array_times_standby_available[j];
    
    // Length Indicator Element - Platzhalter
    if (Time_array_times_available_functions[j] > 0)
    {
      start_pos = payload_counter;
      payload_counter = payload_counter + 4;
    }
    else 
      start_pos = payload_counter;
    
    // 0 type (enum32t)
    if (Time_array_times_type_available[j] == 1)
    {
      tag_dataID = 0;
      Time_payload_buffer_times[payload_counter++] = 2 * 16 /* Wiretype = 2 =^ 32 Bit */ + ((tag_dataID>>8) & 0x0F) /* DataID High Part */ ;
      Time_payload_buffer_times[payload_counter++] = tag_dataID & 0xFF /* DataID Low Part */ ;
      
      Time_payload_buffer_times[payload_counter++] = Time_array_times_type[j]>>24 & 0xFF;
      Time_payload_buffer_times[payload_counter++] = Time_array_times_type[j]>>16 & 0xFF;
      Time_payload_buffer_times[payload_counter++] = Time_array_times_type[j]>> 8 & 0xFF;
      Time_payload_buffer_times[payload_counter++] = Time_array_times_type[j]     & 0xFF;
    }
    
    
    // 1 date (string)
    if (Time_array_times_date_available[j] == 1)
    {
      tag_dataID = 1;
      Time_payload_buffer_times[payload_counter++] = 5 * 16 /* Wiretype = 5 =^ Array mit 1 Byte Länge */ + ((tag_dataID>>8) & 0x0F) /* DataID High Part */ ;
      Time_payload_buffer_times[payload_counter++] = tag_dataID & 0xFF /* DataID Low Part */ ;
      
      Time_payload_buffer_times[payload_counter++] = strlen(Time_array_times_date[j]);  
      
      if (strlen(Time_array_times_date[j]) >= 1)
      {
        for (k=0; k<strlen(Time_array_times_date[j]); k++)
          Time_payload_buffer_times[payload_counter++] = Time_array_times_date[j][k];
      }
    }
    
    
    // 2 pltOffset (uint64)
    if (Time_array_times_pltOffset_available[j] == 1)
    {
      tag_dataID = 2;
      Time_payload_buffer_times[payload_counter++] = 3 * 16 /* Wiretype = 3  =^ 64 Bit */ + ((tag_dataID>>8) & 0x0F) /* DataID High Part */ ;
      Time_payload_buffer_times[payload_counter++] = tag_dataID & 0xFF /* DataID Low Part */ ;
      
      temp_64bit_low  = Time_array_times_pltOffset[j]     & 0x00000000FFFFFFFF;
      temp_64bit_high = Time_array_times_pltOffset[j]>>32 & 0x00000000FFFFFFFF;
      
      Time_payload_buffer_times[payload_counter++] = temp_64bit_high>>24 & 0xFF;
      Time_payload_buffer_times[payload_counter++] = temp_64bit_high>>16 & 0xFF;
      Time_payload_buffer_times[payload_counter++] = temp_64bit_high>> 8 & 0xFF;
      Time_payload_buffer_times[payload_counter++] = temp_64bit_high     & 0xFF;
      Time_payload_buffer_times[payload_counter++] = temp_64bit_low>>24  & 0xFF;
      Time_payload_buffer_times[payload_counter++] = temp_64bit_low>>16  & 0xFF;
      Time_payload_buffer_times[payload_counter++] = temp_64bit_low>> 8  & 0xFF;
      Time_payload_buffer_times[payload_counter++] = temp_64bit_low      & 0xFF;
    }
    
    // 3 time (string)
    if (Time_array_times_time_available[j] == 1)
    {
      tag_dataID = 3;
      Time_payload_buffer_times[payload_counter++] = 5 * 16 /* Wiretype = 5 =^ Array mit 1 Byte Länge */ + ((tag_dataID>>8) & 0x0F) /* DataID High Part */ ;
      Time_payload_buffer_times[payload_counter++] = tag_dataID & 0xFF /* DataID Low Part */ ;
      
      Time_payload_buffer_times[payload_counter++] = strlen(Time_array_times_time[j]);
      
      if (strlen(Time_array_times_time[j]) >= 1)
      {
        for (k=0; k<strlen(Time_array_times_time[j]); k++)
          Time_payload_buffer_times[payload_counter++] = Time_array_times_time[j][k];
      }
    }
    
    
    // 4 unix (uint64)
    if (Time_array_times_unix_available[j] == 1)
    {
      tag_dataID = 4;
      Time_payload_buffer_times[payload_counter++] = 3 * 16 /* Wiretype = 3  =^ 64 Bit */ + ((tag_dataID>>8) & 0x0F) /* DataID High Part */ ;
      Time_payload_buffer_times[payload_counter++] = tag_dataID & 0xFF /* DataID Low Part */ ;
      
      temp_64bit_low  = Time_array_times_unix[j]     & 0x00000000FFFFFFFF;
      temp_64bit_high = Time_array_times_unix[j]>>32 & 0x00000000FFFFFFFF;
      
      Time_payload_buffer_times[payload_counter++] = temp_64bit_high>>24 & 0xFF;
      Time_payload_buffer_times[payload_counter++] = temp_64bit_high>>16 & 0xFF;
      Time_payload_buffer_times[payload_counter++] = temp_64bit_high>> 8 & 0xFF;
      Time_payload_buffer_times[payload_counter++] = temp_64bit_high     & 0xFF;
      Time_payload_buffer_times[payload_counter++] = temp_64bit_low>>24  & 0xFF;
      Time_payload_buffer_times[payload_counter++] = temp_64bit_low>>16  & 0xFF;
      Time_payload_buffer_times[payload_counter++] = temp_64bit_low>> 8  & 0xFF;
      Time_payload_buffer_times[payload_counter++] = temp_64bit_low      & 0xFF;
    }
    
    
    // 5 standby (enum32)
    if (Time_array_times_standby_available[j] == 1)
    {
      tag_dataID = 5;
      Time_payload_buffer_times[payload_counter++] = 2 * 16 /* Wiretype = 2 =^ 32 Bit */ + ((tag_dataID>>8) & 0x0F) /* DataID High Part */ ;
      Time_payload_buffer_times[payload_counter++] = tag_dataID & 0xFF /* DataID Low Part */ ;
      
      Time_payload_buffer_times[payload_counter++] = Time_array_times_standby[j]>>24 & 0xFF;
      Time_payload_buffer_times[payload_counter++] = Time_array_times_standby[j]>>16 & 0xFF;
      Time_payload_buffer_times[payload_counter++] = Time_array_times_standby[j]>> 8 & 0xFF;
      Time_payload_buffer_times[payload_counter++] = Time_array_times_standby[j]     & 0xFF;
    }
    
    //Element Length
    element_length = payload_counter-start_pos;
    if (element_length >0) Time_array_times_array_element_length[j] = element_length - 4;
    else                   Time_array_times_array_element_length[j] = element_length;
    
    Time_payload_buffer_times[start_pos++] = Time_array_times_array_element_length[j]>>24 & 0xFF;
    Time_payload_buffer_times[start_pos++] = Time_array_times_array_element_length[j]>>16 & 0xFF;
    Time_payload_buffer_times[start_pos++] = Time_array_times_array_element_length[j]>> 8 & 0xFF;
    Time_payload_buffer_times[start_pos++] = Time_array_times_array_element_length[j]     & 0xFF;
    
    if (Time_array_times_array_element_length[j] == 0) payload_counter = payload_counter+4;
  }
  
  // Struct Length
  Time_array_times_struct_element_length = 4*@Time_Notification_times_Element_TotalNum;

  for (k=0;k<@Time_Notification_times_Element_TotalNum;k++)
   Time_array_times_struct_element_length = Time_array_times_struct_element_length + Time_array_times_array_element_length[k];
  
  Time_payload_buffer_times[0] = Time_array_times_struct_element_length>>24 & 0xFF;
  Time_payload_buffer_times[1] = Time_array_times_struct_element_length>>16 & 0xFF;
  Time_payload_buffer_times[2] = Time_array_times_struct_element_length>> 8 & 0xFF;
  Time_payload_buffer_times[3] = Time_array_times_struct_element_length     & 0xFF;


  Time_payload_length_times = Time_array_times_struct_element_length+4;
  putvalue(Time_Notification_times_Payload, Time_payload_buffer_times, Time_payload_length_times);
}

on envVar Time_Notification_times_Element_TotalNum
{
  if (@this == 0) @this =  1;
  if (@this > 10) @this = 10;
  
  Time_Notification_times();
  Time_Notification_times_update();
}

on envVar Time_Notification_times_Element
{
  Time_Notification_times_update();
}

on envVar Time_Notification_times_Element_Next
{
  if (@this == 1 && @Time_Notification_times_Element < @Time_Notification_times_Element_TotalNum - 1)
  {
    @Time_Notification_times_Element = @Time_Notification_times_Element + 1;
    Time_Notification_times_update();
  }
}

on envVar Time_Notification_times_Element_Previous
{
  if (@this == 1 && @Time_Notification_times_Element > 0)
  {
    @Time_Notification_times_Element = @Time_Notification_times_Element - 1;
    Time_Notification_times_update();
  }
}

Time_Notification_times_update()
{
  @Time_Notification_LengthIndicator_Element_times = Time_array_times_array_element_length[@Time_Notification_times_Element];
  @Time_Notification_LengthIndicator_Struct_times  = Time_array_times_struct_element_length;
  @Time_Notification_Length_times                  = Time_payload_length_times+8;
  
  @Time_Notification_times_type      = Time_array_times_type[@Time_Notification_times_Element];
  @Time_Notification_times_pltOffset = Time_array_times_pltOffset[@Time_Notification_times_Element];
  @Time_Notification_times_unix      = Time_array_times_unix[@Time_Notification_times_Element];
  @Time_Notification_times_standby   = Time_array_times_standby[@Time_Notification_times_Element];
  
  putValue (Time_Notification_times_date, Time_array_times_date[@Time_Notification_times_Element]);
  putValue (Time_Notification_times_time, Time_array_times_time[@Time_Notification_times_Element]);
  
  @Time_Notification_times_type_available      = Time_array_times_type_available[@Time_Notification_times_Element];
  @Time_Notification_times_date_available      = Time_array_times_date_available[@Time_Notification_times_Element];
  @Time_Notification_times_pltOffset_available = Time_array_times_pltOffset_available[@Time_Notification_times_Element];
  @Time_Notification_times_time_available      = Time_array_times_time_available[@Time_Notification_times_Element];
  @Time_Notification_times_unix_available      = Time_array_times_unix_available[@Time_Notification_times_Element];
  @Time_Notification_times_standby_available   = Time_array_times_standby_available[@Time_Notification_times_Element];
}









//////////////////////////////////////////////////////
////////////////// Service Distance //////////////////
//////////////////////////////////////////////////////

on envVar ServiceDiscovery_Offer_Service_Distance
{
  Send_ServiceDiscovery_Offer_Service_ICAS3IVI();
}

on envVar Distance_Notification_distances_Send
{
  if (@this == 1)
  {
    UDP_Segments_total = @Distance_Notification_Length_distances/1404 + 1;
    UDP_Segments_left  = UDP_Segments_total;
    
    if (UDP_Segments_total > 1) seg_id_flag = 1;
    else                        seg_id_flag = 0;
    
    Send_Service_Distance_Notification (0xC010 & 0x0000FFFF);
  }
}
on envVar Distance_Notification_distances_Send_cyclic
{
  if (@this == 1)
    setTimercyclic (tDistance_Notification_distances_Send, @Distance_Notification_distances_Send_cyclic_cycletime);
  else
    cancelTimer (tDistance_Notification_distances_Send);
}
on envVar Distance_Notification_distances_Send_cyclic_cycletime
{
  if (@Distance_Notification_distances_Send_cyclic == 1)
  {
    cancelTimer (tDistance_Notification_distances_Send);
    setTimercyclic (tDistance_Notification_distances_Send, @this);
  }
}


on timer tDistance_Notification_distances_Send
{
  // Distance automatisch incrementieren
  @Distance_Notification_distances_currentValue = @Distance_Notification_distances_currentValue + @Distance_Notification_distances_currentValue_inc;
  
  
  UDP_Segments_total = @Distance_Notification_Length_distances/1404 + 1;
  UDP_Segments_left  = UDP_Segments_total;
  
  if (UDP_Segments_total > 1) seg_id_flag = 1;
  else                        seg_id_flag = 0;
    
  if (@Env_GlobalAppl == 1) Send_Service_Distance_Notification (0xC010 & 0x0000FFFF);
}

on envVar Distance_Notification_notifications_Send
{
  if (@this == 1)
  {
    UDP_Segments_total = @Distance_Notification_Length_notifications/1404 + 1;
    UDP_Segments_left  = UDP_Segments_total;
    
    if (UDP_Segments_total > 1) seg_id_flag = 1;
    else                        seg_id_flag = 0;
    
    Send_Service_Distance_Notification (0xC020 & 0x0000FFFF);
  }
}
on envVar Distance_Notification_notifications_Send_cyclic
{
  if (@this == 1)
    setTimercyclic (tDistance_Notification_notifications_Send, @Distance_Notification_notifications_Send_cyclic_cycletime);
  else
    cancelTimer (tDistance_Notification_notifications_Send);
}
on envVar Distance_Notification_notifications_Send_cyclic_cycletime
{
  if (@Distance_Notification_notifications_Send_cyclic == 1)
  {
    cancelTimer (tDistance_Notification_notifications_Send);
    setTimercyclic (tDistance_Notification_notifications_Send, @this);
  }
}
on timer tDistance_Notification_notifications_Send
{
  UDP_Segments_total = @Distance_Notification_Length_notifications/1404 + 1;
  UDP_Segments_left  = UDP_Segments_total;
  
  if (UDP_Segments_total > 1) seg_id_flag = 1;
  else                        seg_id_flag = 0;
    
  if (@Env_GlobalAppl == 1) Send_Service_Distance_Notification (0xC020 & 0x0000FFFF);
}


Send_Service_Distance_Notification (word MethodID)
{
  ethernetPacket EthPaket;

  // Ethernet Packet - MAC Source address
  getvalue (ServiceDiscovery_EthernetPacket_MAC_Source_ICAS1Gateway, buffer_MAC);
  //EthPaket.source.ParseAddress ( buffer_MAC );
  EthPaket.source = ethGetMacAddressAsNumber (buffer_MAC);
  
  // Ethernet Packet - MAC Destination address
  getvalue (ServiceDiscovery_EthernetPacket_MAC_Destination, buffer_MAC);
  //EthPaket.destination.ParseAddress ( buffer_MAC );
  EthPaket.destination = ethGetMacAddressAsNumber (buffer_MAC);
  
  // Ethernet Packet - VLAN
  EthPaket.SetVlan (@ServiceDiscovery_EthernetPacket_VLAN_TPID, @ServiceDiscovery_EthernetPacket_VLAN_TCI);
  
  // Ethernet Packet - Type
  //EthPaket.ipv6.type = @EthernetPacket_Type;
  if (@ServiceDiscovery_EthernetPacket_Type == 0x86DD) EthPaket.ipv6.Init();
  
  
  // IPv6 Packet - Version
  EthPaket.ipv6.version = @ServiceDiscovery_IPv6Packet_Version;

  // IPv6 Packet - Traffic Class
  EthPaket.ipv6.class = @ServiceDiscovery_IPv6Packet_Traffic_Class;
  
  // IPv6 Packet - Flow Label
  EthPaket.ipv6.flow = @ServiceDiscovery_IPv6Packet_Flow_Label;
  
  // IPv6 Packet - Payload_Length
  EthPaket.ipv6.length = @ServiceDiscovery_IPv6Packet_Payload_Length;
  
  // IPv6 Packet - Next Header
  EthPaket.ipv6.next = @ServiceDiscovery_IPv6Packet_Next_Header;
  if (@ServiceDiscovery_IPv6Packet_Next_Header == 6) EthPaket.tcp.Init();
  if (@ServiceDiscovery_IPv6Packet_Next_Header == 17) EthPaket.udp.Init();
  
  // IPv6 Packet - Hop Limit
  EthPaket.ipv6.hopLimit = @ServiceDiscovery_IPv6Packet_Hop_Limit;

  // IPv6 Packet - IPv6 Destination address    // TODO: char array zu byte array
  buffer_ipv6[0]  = @ServiceDiscovery_IPv6Packet_IP_Destination_Unicast_01>>8 & 0xFF;
  buffer_ipv6[1]  = @ServiceDiscovery_IPv6Packet_IP_Destination_Unicast_01    & 0xFF;
  buffer_ipv6[2]  = @ServiceDiscovery_IPv6Packet_IP_Destination_Unicast_02>>8 & 0xFF;
  buffer_ipv6[3]  = @ServiceDiscovery_IPv6Packet_IP_Destination_Unicast_02    & 0xFF;
  buffer_ipv6[4]  = @ServiceDiscovery_IPv6Packet_IP_Destination_Unicast_03>>8 & 0xFF;
  buffer_ipv6[5]  = @ServiceDiscovery_IPv6Packet_IP_Destination_Unicast_03    & 0xFF;
  buffer_ipv6[6]  = @ServiceDiscovery_IPv6Packet_IP_Destination_Unicast_04>>8 & 0xFF;
  buffer_ipv6[7]  = @ServiceDiscovery_IPv6Packet_IP_Destination_Unicast_04    & 0xFF;
  buffer_ipv6[8]  = @ServiceDiscovery_IPv6Packet_IP_Destination_Unicast_05>>8 & 0xFF;
  buffer_ipv6[9]  = @ServiceDiscovery_IPv6Packet_IP_Destination_Unicast_05    & 0xFF;
  buffer_ipv6[10] = @ServiceDiscovery_IPv6Packet_IP_Destination_Unicast_06>>8 & 0xFF;
  buffer_ipv6[11] = @ServiceDiscovery_IPv6Packet_IP_Destination_Unicast_06    & 0xFF;
  buffer_ipv6[12] = @ServiceDiscovery_IPv6Packet_IP_Destination_Unicast_07>>8 & 0xFF;
  buffer_ipv6[13] = @ServiceDiscovery_IPv6Packet_IP_Destination_Unicast_07    & 0xFF;
  buffer_ipv6[14] = @ServiceDiscovery_IPv6Packet_IP_Destination_Unicast_08>>8 & 0xFF;
  buffer_ipv6[15] = @ServiceDiscovery_IPv6Packet_IP_Destination_Unicast_08    & 0xFF;
  EthPaket.ipv6.destination.SetData ( 0, buffer_ipv6, elcount(buffer_ipv6) );

  // IPv6 Packet - IPv6 Source address    // TODO: char array zu byte array
  buffer_ipv6[0]  = @ServiceDiscovery_IPv6Packet_IP_Source_ICAS1Gateway_01>>8 & 0xFF;
  buffer_ipv6[1]  = @ServiceDiscovery_IPv6Packet_IP_Source_ICAS1Gateway_01    & 0xFF;
  buffer_ipv6[2]  = @ServiceDiscovery_IPv6Packet_IP_Source_ICAS1Gateway_02>>8 & 0xFF;
  buffer_ipv6[3]  = @ServiceDiscovery_IPv6Packet_IP_Source_ICAS1Gateway_02    & 0xFF;
  buffer_ipv6[4]  = @ServiceDiscovery_IPv6Packet_IP_Source_ICAS1Gateway_03>>8 & 0xFF;
  buffer_ipv6[5]  = @ServiceDiscovery_IPv6Packet_IP_Source_ICAS1Gateway_03    & 0xFF;
  buffer_ipv6[6]  = @ServiceDiscovery_IPv6Packet_IP_Source_ICAS1Gateway_04>>8 & 0xFF;
  buffer_ipv6[7]  = @ServiceDiscovery_IPv6Packet_IP_Source_ICAS1Gateway_04    & 0xFF;
  buffer_ipv6[8]  = @ServiceDiscovery_IPv6Packet_IP_Source_ICAS1Gateway_05>>8 & 0xFF;
  buffer_ipv6[9]  = @ServiceDiscovery_IPv6Packet_IP_Source_ICAS1Gateway_05    & 0xFF;
  buffer_ipv6[10] = @ServiceDiscovery_IPv6Packet_IP_Source_ICAS1Gateway_06>>8 & 0xFF;
  buffer_ipv6[11] = @ServiceDiscovery_IPv6Packet_IP_Source_ICAS1Gateway_06    & 0xFF;
  buffer_ipv6[12] = @ServiceDiscovery_IPv6Packet_IP_Source_ICAS1Gateway_07>>8 & 0xFF;
  buffer_ipv6[13] = @ServiceDiscovery_IPv6Packet_IP_Source_ICAS1Gateway_07    & 0xFF;
  buffer_ipv6[14] = @ServiceDiscovery_IPv6Packet_IP_Source_ICAS1Gateway_08>>8 & 0xFF;
  buffer_ipv6[15] = @ServiceDiscovery_IPv6Packet_IP_Source_ICAS1Gateway_08    & 0xFF;
  EthPaket.ipv6.source.SetData ( 0, buffer_ipv6, elcount(buffer_ipv6) );

  
  // UDP Packet - Source Port
  EthPaket.udp.source = @Distance_Notification_Port_Source;
  
  // UDP Packet - Destination Port
  EthPaket.udp.destination = @Distance_Notification_Port_Destination;
  
  // UDP Packet - Length
  EthPaket.udp.length = @ServiceDiscovery_UDPPacket_Length;
  
  
  // SOME/IP Packet aus Rohdaten zusammenbauen (buffer array)
  i=0;
  
  // SOME/IP Packet - Message ID, Service ID [16 bit]
  buffer[i++] = @Distance_Notification_Message_ID_Service_ID>>8 & 0xFF;
  buffer[i++] = @Distance_Notification_Message_ID_Service_ID    & 0xFF;
  
  // SOME/IP Packet - Message ID, Message ID [16 bit]
  switch (MethodID)
  {
    case 0xC010: @Distance_Notification_Message_ID_Method_ID = @Distance_Notification_Message_ID_Method_ID_distances; break;
    case 0xC020: @Distance_Notification_Message_ID_Method_ID = @Distance_Notification_Message_ID_Method_ID_notifications; break;
  }
  buffer[i++] = @Distance_Notification_Message_ID_Method_ID>>8 & 0xFF;
  buffer[i++] = @Distance_Notification_Message_ID_Method_ID    & 0xFF;
  
  // SOME/IP Packet - Length [32 bit]
  if (UDP_Segments_total == 1)
  {
    switch (MethodID)
    {
      case 0xC010: @Distance_Notification_Length = @Distance_Notification_Length_distances; break;
      case 0xC020: @Distance_Notification_Length = @Distance_Notification_Length_notifications; break;
    }
  }
  else
  {
    if (UDP_Segments_left > 1)
    {
      switch (MethodID)
      {
        case 0xC010: @Distance_Notification_Length = 1404; break;
        case 0xC020: @Distance_Notification_Length = 1404; break;
      }
    }
    else
    {
      switch (MethodID)
      {
        case 0xC010: @Distance_Notification_Length = Distance_payload_length_distances     - 1404*(UDP_Segments_total-UDP_Segments_left) + 24; break;
        case 0xC020: @Distance_Notification_Length = Distance_payload_length_notifications - 1404*(UDP_Segments_total-UDP_Segments_left) + 24; break;
      }
    }
  }
  buffer[i++] = @Distance_Notification_Length>>24 & 0xFF;
  buffer[i++] = @Distance_Notification_Length>>16 & 0xFF;
  buffer[i++] = @Distance_Notification_Length>> 8 & 0xFF;
  buffer[i++] = @Distance_Notification_Length     & 0xFF;
  
  // SOME/IP Packet - Request ID, Client ID [16 bit]
  buffer[i++] = @Distance_Notification_Request_ID_Client_ID>>8 & 0xFF;
  buffer[i++] = @Distance_Notification_Request_ID_Client_ID    & 0xFF;
  
  // SOME/IP Packet - Request ID, Session ID) [16 bit]
  if ((UDP_Segments_total == 1) || (seg_id_flag == 1))
  {
    @ServiceDiscovery_SOMEIPPacket_Notification_Request_ID_Session_ID = @ServiceDiscovery_SOMEIPPacket_Notification_Request_ID_Session_ID + 1;
    if (@ServiceDiscovery_SOMEIPPacket_Notification_Request_ID_Session_ID == 0x10000) @ServiceDiscovery_SOMEIPPacket_Notification_Request_ID_Session_ID = 1;
    seg_id_flag = 0;
  }
  
  buffer[i++] = @ServiceDiscovery_SOMEIPPacket_Notification_Request_ID_Session_ID>>8 & 0xFF;
  buffer[i++] = @ServiceDiscovery_SOMEIPPacket_Notification_Request_ID_Session_ID    & 0xFF;
  
  // SOME/IP Packet - Protocol Version [8 bit]
  buffer[i++] = @Distance_Notification_Protocol_Version;
  
  // SOME/IP Packet - Interface Version [8 bit]
  buffer[i++] = @Distance_Notification_Interface_Version;
  
  // SOME/IP Packet - Message Type [8 bit]
  buffer[i++] = @Distance_Notification_Message_Type;
  
  // SOME/IP Packet - Return Code [8 bit]
  buffer[i++] = @Distance_Notification_Return_Code;
  
  
  if (UDP_Segments_total > 1)
  {
    if (UDP_Segments_left >= 0)
    { 
      // Message Type neu setzen
      buffer[i-2] = @Distance_Notification_Message_Type + 0x20;
      
      // Offset (16byte Schritte, 1392/16 = 87)
      @Distance_Notification_Offset = 87 * (UDP_Segments_total - UDP_Segments_left);
      
      // More Segments Flag
      if (UDP_Segments_left > 1) @Distance_Notification_More_Segments_Flag = 1;
      else                       @Distance_Notification_More_Segments_Flag = 0;
      
      buffer[i++] =   @Distance_Notification_Offset>>20 & 0xFF;
      buffer[i++] =   @Distance_Notification_Offset>>12 & 0xFF;
      buffer[i++] =   @Distance_Notification_Offset>>4  & 0xFF;
      buffer[i++] = ((@Distance_Notification_Offset<<4) & 0xF0) + (@Distance_Notification_More_Segments_Flag & 0x01);
    }
  }
  
  UDP_Segments_left--;
  
  ////// distances notifier //////
  if (MethodID == 0xC010)
  {
    if (UDP_Segments_total == 1)
    {
      for (j=0; j<Distance_payload_length_distances; j++)
        buffer[i++] = Distance_payload_buffer_distances[j];
    }
    else
    {
      if (UDP_Segments_left >= 1)
      {
        for (j=(UDP_Segments_total-UDP_Segments_left-1)*1392; j<(UDP_Segments_total-UDP_Segments_left)*1392; j++)
          buffer[i++] = Distance_payload_buffer_distances[j];
      }
      else
      {
        for (j=(UDP_Segments_total-(UDP_Segments_left+1))*1392; j<Distance_payload_length_distances; j++)
          buffer[i++] = Distance_payload_buffer_distances[j];
      }
    }
  }
  
  ////// notifications notifier //////
  if (MethodID == 0xC020)
  {
    if (UDP_Segments_total == 1)
    {
      for (j=0; j<Distance_payload_length_notifications; j++)
        buffer[i++] = Distance_payload_buffer_notifications[j];
    }
    else
    {
      if (UDP_Segments_left >= 1)
      {
        for (j=(UDP_Segments_total-UDP_Segments_left-1)*1392; j<(UDP_Segments_total-UDP_Segments_left)*1392; j++)
          buffer[i++] = Distance_payload_buffer_notifications[j];
      }
      else
      {
        for (j=(UDP_Segments_total-(UDP_Segments_left+1))*1392; j<Distance_payload_length_notifications; j++)
          buffer[i++] = Distance_payload_buffer_notifications[j];
      }
    }
  }
  
  // Rohdaten in UDP Paket schreiben
  EthPaket.udp.SetData( 0, buffer, i );

  // calculate UDP and IPv6 checksum and send Ethernet packet
  EthPaket.CompletePacket();
  output( EthPaket );
  
  // prüfen ob alle Segemente gesendet wurden, sonst senden erneut aufrufen
  Distance_Segmentation_Method_ID = MethodID;
  if (UDP_Segments_left>0)
    setTimer(Distance_Segmentation_delay, 50);
}

on timer Distance_Segmentation_delay
{
  Send_Service_Distance_Notification (Distance_Segmentation_Method_ID);
}







////////// distances Notification //////////

on envVar Distance_Notification_LengthIndicator_Struct_distances
{
  Distance_Notification_distances();
}
on envVar Distance_Notification_LengthIndicator_Element_distances
{
  Distance_Notification_distances();
}
on envVar Distance_Notification_distances_distanceName
{
  Distance_array_distances_distanceName[@Distance_Notification_distances_Element] = @this;
  Distance_Notification_distances();
}
on envVar Distance_Notification_distances_currentValue
{
  Distance_array_distances_currentValue[@Distance_Notification_distances_Element] = @this;
  Distance_Notification_distances();
}
on envVar Distance_Notification_distances_restrictionReason
{
  Distance_array_distances_restrictionReason[@Distance_Notification_distances_Element] = @this;
  Distance_Notification_distances();
}
on envVar Distance_Notification_distances_unit
{
  Distance_array_distances_unit[@Distance_Notification_distances_Element] = @this;
  Distance_Notification_distances();
}

on envVar Distance_Notification_distances_distanceName_available
{
  Distance_array_distances_distanceName_available[@Distance_Notification_distances_Element] = @this;
  Distance_Notification_distances();
}
on envVar Distance_Notification_distances_currentValue_available
{
  Distance_array_distances_currentValue_available[@Distance_Notification_distances_Element] = @this;
  Distance_Notification_distances();
}
on envVar Distance_Notification_distances_restrictionReason_available
{
  Distance_array_distances_restrictionReason_available[@Distance_Notification_distances_Element] = @this;
  Distance_Notification_distances();
}
on envVar Distance_Notification_distances_unit_available
{
  Distance_array_distances_unit_available[@Distance_Notification_distances_Element] = @this;
  Distance_Notification_distances();
}
on envVar Distance_Notification_distances_Payload
{
  Distance_Notification_distances_update();
}


Distance_Notification_distances()
{
  word payload_counter = 0;
  word start_pos       = 0;
  word element_length  = 0;
  
  // Length Indicator Struct - Platzhalter
  payload_counter = 0+4;
  start_pos = 0;
  
  for (j=0; j<@Distance_Notification_distances_Element_TotalNum; j++)
  {
    Distance_array_distances_available_functions[j] = Distance_array_distances_distanceName_available[j]
                                                    + Distance_array_distances_currentValue_available[j]
                                                    + Distance_array_distances_restrictionReason_available[j]
                                                    + Distance_array_distances_unit_available[j];
    
    // Length Indicator Element - Platzhalter
    if (Distance_array_distances_available_functions[j] > 0)
    {
      start_pos = payload_counter;
      payload_counter = payload_counter + 4;
    }
    else 
      start_pos = payload_counter;
    
    
    // 0 distanceName (enum32)
    if (Distance_array_distances_distanceName_available[j] == 1)
    {
      tag_dataID = 0;
      Distance_payload_buffer_distances[payload_counter++] = 2 * 16 /* Wiretype = 2 =^ 32 Bit */ + ((tag_dataID>>8) & 0x0F) /* DataID High Part */ ;
      Distance_payload_buffer_distances[payload_counter++] = tag_dataID & 0xFF /* DataID Low Part */ ;
      
      Distance_payload_buffer_distances[payload_counter++] = Distance_array_distances_distanceName[j]>>24 & 0xFF;
      Distance_payload_buffer_distances[payload_counter++] = Distance_array_distances_distanceName[j]>>16 & 0xFF;
      Distance_payload_buffer_distances[payload_counter++] = Distance_array_distances_distanceName[j]>> 8 & 0xFF;
      Distance_payload_buffer_distances[payload_counter++] = Distance_array_distances_distanceName[j]     & 0xFF;
    }
    
    
    // 1 currentValue (uint64)
    if (Distance_array_distances_currentValue_available[j] == 1)
    {
      tag_dataID = 1;
      Distance_payload_buffer_distances[payload_counter++] = 3 * 16 /* Wiretype = 3  =^ 64 Bit */ + ((tag_dataID>>8) & 0x0F) /* DataID High Part */ ;
      Distance_payload_buffer_distances[payload_counter++] = tag_dataID & 0xFF /* DataID Low Part */ ;
      
      temp_64bit_low  = Distance_array_distances_currentValue[j]     & 0x00000000FFFFFFFF;
      temp_64bit_high = Distance_array_distances_currentValue[j]>>32 & 0x00000000FFFFFFFF;
      
      Distance_payload_buffer_distances[payload_counter++] = temp_64bit_high>>24 & 0xFF;
      Distance_payload_buffer_distances[payload_counter++] = temp_64bit_high>>16 & 0xFF;
      Distance_payload_buffer_distances[payload_counter++] = temp_64bit_high>> 8 & 0xFF;
      Distance_payload_buffer_distances[payload_counter++] = temp_64bit_high     & 0xFF;
      Distance_payload_buffer_distances[payload_counter++] = temp_64bit_low>>24  & 0xFF;
      Distance_payload_buffer_distances[payload_counter++] = temp_64bit_low>>16  & 0xFF;
      Distance_payload_buffer_distances[payload_counter++] = temp_64bit_low>> 8  & 0xFF;
      Distance_payload_buffer_distances[payload_counter++] = temp_64bit_low      & 0xFF;
    }
    
    
    // 2 restrictionReason (enum32)
    if (Distance_array_distances_restrictionReason_available[j] == 1)
    {
      tag_dataID = 2;
      Distance_payload_buffer_distances[payload_counter++] = 2 * 16 /* Wiretype = 2 =^ 32 Bit */ + ((tag_dataID>>8) & 0x0F) /* DataID High Part */ ;
      Distance_payload_buffer_distances[payload_counter++] = tag_dataID & 0xFF /* DataID Low Part */ ;
      
      Distance_payload_buffer_distances[payload_counter++] = Distance_array_distances_restrictionReason[j]>>24 & 0xFF;
      Distance_payload_buffer_distances[payload_counter++] = Distance_array_distances_restrictionReason[j]>>16 & 0xFF;
      Distance_payload_buffer_distances[payload_counter++] = Distance_array_distances_restrictionReason[j]>> 8 & 0xFF;
      Distance_payload_buffer_distances[payload_counter++] = Distance_array_distances_restrictionReason[j]     & 0xFF;
    }
    
    
    // 3 unit (enum32)
    if (Distance_array_distances_unit_available[j] == 1)
    {
      tag_dataID = 3;
      Distance_payload_buffer_distances[payload_counter++] = 2 * 16 /* Wiretype = 2 =^ 32 Bit */ + ((tag_dataID>>8) & 0x0F) /* DataID High Part */ ;
      Distance_payload_buffer_distances[payload_counter++] = tag_dataID & 0xFF /* DataID Low Part */ ;
      
      Distance_payload_buffer_distances[payload_counter++] = Distance_array_distances_unit[j]>>24 & 0xFF;
      Distance_payload_buffer_distances[payload_counter++] = Distance_array_distances_unit[j]>>16 & 0xFF;
      Distance_payload_buffer_distances[payload_counter++] = Distance_array_distances_unit[j]>> 8 & 0xFF;
      Distance_payload_buffer_distances[payload_counter++] = Distance_array_distances_unit[j]     & 0xFF;
    }
    
    //Element Length
    element_length = payload_counter-start_pos;
    if (element_length >0) Distance_array_distances_array_element_length[j] = element_length - 4;
    else                   Distance_array_distances_array_element_length[j] = element_length;
    
    Distance_payload_buffer_distances[start_pos++] = Distance_array_distances_array_element_length[j]>>24 & 0xFF;
    Distance_payload_buffer_distances[start_pos++] = Distance_array_distances_array_element_length[j]>>16 & 0xFF;
    Distance_payload_buffer_distances[start_pos++] = Distance_array_distances_array_element_length[j]>> 8 & 0xFF;
    Distance_payload_buffer_distances[start_pos++] = Distance_array_distances_array_element_length[j]     & 0xFF;
    
    if (Distance_array_distances_array_element_length[j] == 0) payload_counter = payload_counter+4;
  }
  
  // Struct Length
  Distance_array_distances_struct_element_length = 4*@Distance_Notification_distances_Element_TotalNum;

  for (k=0;k<@Distance_Notification_distances_Element_TotalNum;k++)
   Distance_array_distances_struct_element_length = Distance_array_distances_struct_element_length + Distance_array_distances_array_element_length[k];
  
  Distance_payload_buffer_distances[0] = Distance_array_distances_struct_element_length>>24 & 0xFF;
  Distance_payload_buffer_distances[1] = Distance_array_distances_struct_element_length>>16 & 0xFF;
  Distance_payload_buffer_distances[2] = Distance_array_distances_struct_element_length>> 8 & 0xFF;
  Distance_payload_buffer_distances[3] = Distance_array_distances_struct_element_length     & 0xFF;


  Distance_payload_length_distances = Distance_array_distances_struct_element_length+4;
  putvalue(Distance_Notification_distances_Payload, Distance_payload_buffer_distances, Distance_payload_length_distances);
}

on envVar Distance_Notification_distances_Element_TotalNum
{
  if (@this == 0) @this =  1;
  if (@this > 10) @this = 10;
  
  Distance_Notification_distances();
  Distance_Notification_distances_update();
}

on envVar Distance_Notification_distances_Element
{
  Distance_Notification_distances_update();
}

on envVar Distance_Notification_distances_Element_Next
{
  if (@this == 1 && @Distance_Notification_distances_Element < @Distance_Notification_distances_Element_TotalNum - 1)
  {
    @Distance_Notification_distances_Element = @Distance_Notification_distances_Element + 1;
    Distance_Notification_distances_update();
  }
}

on envVar Distance_Notification_distances_Element_Previous
{
  if (@this == 1 && @Distance_Notification_distances_Element > 0)
  {
    @Distance_Notification_distances_Element = @Distance_Notification_distances_Element - 1;
    Distance_Notification_distances_update();
  }
}

Distance_Notification_distances_update()
{
  @Distance_Notification_LengthIndicator_Element_distances = Distance_array_distances_array_element_length[@Distance_Notification_distances_Element];
  @Distance_Notification_LengthIndicator_Struct_distances  = Distance_array_distances_struct_element_length;
  @Distance_Notification_Length_distances                  = Distance_payload_length_distances+8;
  
  @Distance_Notification_distances_distanceName      = Distance_array_distances_distanceName[@Distance_Notification_distances_Element];
  @Distance_Notification_distances_currentValue      = Distance_array_distances_currentValue[@Distance_Notification_distances_Element];
  @Distance_Notification_distances_restrictionReason = Distance_array_distances_restrictionReason[@Distance_Notification_distances_Element];
  @Distance_Notification_distances_unit              = Distance_array_distances_unit[@Distance_Notification_distances_Element];
  
  @Distance_Notification_distances_distanceName_available      = Distance_array_distances_distanceName_available[@Distance_Notification_distances_Element];
  @Distance_Notification_distances_currentValue_available      = Distance_array_distances_currentValue_available[@Distance_Notification_distances_Element];
  @Distance_Notification_distances_restrictionReason_available = Distance_array_distances_restrictionReason_available[@Distance_Notification_distances_Element];
  @Distance_Notification_distances_unit_available              = Distance_array_distances_unit_available[@Distance_Notification_distances_Element];
}






////////// notifications Notification //////////

on envVar Distance_Notification_LengthIndicator_Struct_notifications
{
  Distance_Notification_notifications();
}
on envVar Distance_Notification_LengthIndicator_Element_notifications
{
  Distance_Notification_notifications();
}
on envVar Distance_Notification_notifications_type
{
  Distance_array_notifications_type[@Distance_Notification_notifications_Element] = @this;
  Distance_Notification_notifications();
}
on envVar Distance_Notification_notifications_value
{
  Distance_array_notifications_value[@Distance_Notification_notifications_Element] = @this;
  Distance_Notification_notifications();
}

on envVar Distance_Notification_notifications_type_available
{
  Distance_array_notifications_type_available[@Distance_Notification_notifications_Element] = @this;
  Distance_Notification_notifications();
}
on envVar Distance_Notification_notifications_value_available
{
  Distance_array_notifications_value_available[@Distance_Notification_notifications_Element] = @this;
  Distance_Notification_notifications();
}
on envVar Distance_Notification_notifications_Payload
{
  Distance_Notification_notifications_update();
}


Distance_Notification_notifications()
{
  word payload_counter = 0;
  word start_pos       = 0;
  word element_length  = 0;
  
  // Length Indicator Struct - Platzhalter
  payload_counter = 0+4;
  start_pos = 0;
  
  for (j=0; j<@Distance_Notification_notifications_Element_TotalNum; j++)
  {
    Distance_array_notifications_available_functions[j] = Distance_array_notifications_type_available[j]
                                                        + Distance_array_notifications_value_available[j];
    
    // Length Indicator Element - Platzhalter
    if (Distance_array_notifications_available_functions[j] > 0)
    {
      start_pos = payload_counter;
      payload_counter = payload_counter + 4;
    }
    else 
      start_pos = payload_counter;
    
    
    // 0 type (enum32)
    if (Distance_array_notifications_type_available[j] == 1)
    {
      tag_dataID = 0;
      Distance_payload_buffer_notifications[payload_counter++] = 2 * 16 /* Wiretype = 2 =^ 32 Bit */ + ((tag_dataID>>8) & 0x0F) /* DataID High Part */ ;
      Distance_payload_buffer_notifications[payload_counter++] = tag_dataID & 0xFF /* DataID Low Part */ ;
      
      Distance_payload_buffer_notifications[payload_counter++] = Distance_array_notifications_type[j]>>24 & 0xFF;
      Distance_payload_buffer_notifications[payload_counter++] = Distance_array_notifications_type[j]>>16 & 0xFF;
      Distance_payload_buffer_notifications[payload_counter++] = Distance_array_notifications_type[j]>> 8 & 0xFF;
      Distance_payload_buffer_notifications[payload_counter++] = Distance_array_notifications_type[j]     & 0xFF;
    }
    
    
    // 1 value (uint32)
    if (Distance_array_notifications_value_available[j] == 1)
    {
      tag_dataID = 1;
      Distance_payload_buffer_notifications[payload_counter++] = 2 * 16 /* Wiretype = 2 =^ 32 Bit */ + ((tag_dataID>>8) & 0x0F) /* DataID High Part */ ;
      Distance_payload_buffer_notifications[payload_counter++] = tag_dataID & 0xFF /* DataID Low Part */ ;
      
      Distance_payload_buffer_notifications[payload_counter++] = Distance_array_notifications_value[j]>>24 & 0xFF;
      Distance_payload_buffer_notifications[payload_counter++] = Distance_array_notifications_value[j]>>16 & 0xFF;
      Distance_payload_buffer_notifications[payload_counter++] = Distance_array_notifications_value[j]>> 8 & 0xFF;
      Distance_payload_buffer_notifications[payload_counter++] = Distance_array_notifications_value[j]     & 0xFF;
    }
    
    //Element Length
    element_length = payload_counter-start_pos;
    if (element_length >0) Distance_array_notifications_array_element_length[j] = element_length - 4;
    else                   Distance_array_notifications_array_element_length[j] = element_length;
    
    Distance_payload_buffer_notifications[start_pos++] = Distance_array_notifications_array_element_length[j]>>24 & 0xFF;
    Distance_payload_buffer_notifications[start_pos++] = Distance_array_notifications_array_element_length[j]>>16 & 0xFF;
    Distance_payload_buffer_notifications[start_pos++] = Distance_array_notifications_array_element_length[j]>> 8 & 0xFF;
    Distance_payload_buffer_notifications[start_pos++] = Distance_array_notifications_array_element_length[j]     & 0xFF;
    
    if (Distance_array_notifications_array_element_length[j] == 0) payload_counter = payload_counter+4;
  }
  
  // Struct Length
  Distance_array_notifications_struct_element_length = 4*@Distance_Notification_notifications_Element_TotalNum;

  for (k=0;k<@Distance_Notification_notifications_Element_TotalNum;k++)
   Distance_array_notifications_struct_element_length = Distance_array_notifications_struct_element_length + Distance_array_notifications_array_element_length[k];
  
  Distance_payload_buffer_notifications[0] = Distance_array_notifications_struct_element_length>>24 & 0xFF;
  Distance_payload_buffer_notifications[1] = Distance_array_notifications_struct_element_length>>16 & 0xFF;
  Distance_payload_buffer_notifications[2] = Distance_array_notifications_struct_element_length>> 8 & 0xFF;
  Distance_payload_buffer_notifications[3] = Distance_array_notifications_struct_element_length     & 0xFF;


  Distance_payload_length_notifications = Distance_array_notifications_struct_element_length+4;
  putvalue(Distance_Notification_notifications_Payload, Distance_payload_buffer_notifications, Distance_payload_length_notifications);
}


on envVar Distance_Notification_notifications_Element_TotalNum
{
  if (@this == 0) @this =  1;
  if (@this > 10) @this = 10;
  
  Distance_Notification_notifications();
  Distance_Notification_notifications_update();
}

on envVar Distance_Notification_notifications_Element
{
  Distance_Notification_notifications_update();
}

on envVar Distance_Notification_notifications_Element_Next
{
  if (@this == 1 && @Distance_Notification_notifications_Element < @Distance_Notification_notifications_Element_TotalNum - 1)
  {
    @Distance_Notification_notifications_Element = @Distance_Notification_notifications_Element + 1;
    Distance_Notification_notifications_update();
  }
}

on envVar Distance_Notification_notifications_Element_Previous
{
  if (@this == 1 && @Distance_Notification_notifications_Element > 0)
  {
    @Distance_Notification_notifications_Element = @Distance_Notification_notifications_Element - 1;
    Distance_Notification_notifications_update();
  }
}

Distance_Notification_notifications_update()
{
  @Distance_Notification_LengthIndicator_Element_notifications = Distance_array_notifications_array_element_length[@Distance_Notification_notifications_Element];
  @Distance_Notification_LengthIndicator_Struct_notifications  = Distance_array_notifications_struct_element_length;
  @Distance_Notification_Length_notifications                  = Distance_payload_length_notifications+8;
  
  @Distance_Notification_notifications_type  = Distance_array_notifications_type[@Distance_Notification_notifications_Element];
  @Distance_Notification_notifications_value = Distance_array_notifications_value[@Distance_Notification_notifications_Element];
  
  @Distance_Notification_notifications_type_available  = Distance_array_notifications_type_available[@Distance_Notification_notifications_Element];
  @Distance_Notification_notifications_value_available = Distance_array_notifications_value_available[@Distance_Notification_notifications_Element];
}










//////////////////////////////////////////////////////
////////////////// Service Odometry //////////////////
//////////////////////////////////////////////////////

on envVar ServiceDiscovery_Offer_Service_Odometry
{
  Send_ServiceDiscovery_Offer_Service_ICAS1Gateway();
}

on envVar Odometry_Notification_speeds_Send
{
  if (@this == 1)
  {
    UDP_Segments_total = @Odometry_Notification_Length_speeds/1404 + 1;
    UDP_Segments_left  = UDP_Segments_total;
    
    if (UDP_Segments_total > 1) seg_id_flag = 1;
    else                        seg_id_flag = 0;
    
    Send_Service_Odometry_Notification (0xC010 & 0x0000FFFF);
  }
}
on envVar Odometry_Notification_speeds_Send_cyclic
{
  if (@this == 1)
    setTimercyclic (tOdometry_Notification_speeds_Send, @Odometry_Notification_speeds_Send_cyclic_cycletime);
  else
    cancelTimer (tOdometry_Notification_speeds_Send);
}
on envVar Odometry_Notification_speeds_Send_cyclic_cycletime
{
  if (@Odometry_Notification_speeds_Send_cyclic == 1)
  {
    cancelTimer (tOdometry_Notification_speeds_Send);
    setTimercyclic (tOdometry_Notification_speeds_Send, @this);
  }
}
on timer tOdometry_Notification_speeds_Send
{
  UDP_Segments_total = @Odometry_Notification_Length_speeds/1404 + 1;
  UDP_Segments_left  = UDP_Segments_total;
  
  if (UDP_Segments_total > 1) seg_id_flag = 1;
  else                        seg_id_flag = 0;
    
  if (@Env_GlobalAppl == 1) Send_Service_Odometry_Notification (0xC010 & 0x0000FFFF);
}

on envVar Odometry_Notification_velocities_Send
{
  if (@this == 1)
  {
    UDP_Segments_total = @Odometry_Notification_Length_velocities/1404 + 1;
    UDP_Segments_left  = UDP_Segments_total;
    
    if (UDP_Segments_total > 1) seg_id_flag = 1;
    else                        seg_id_flag = 0;
    
    Send_Service_Odometry_Notification (0xC020 & 0x0000FFFF);
  }
}
on envVar Odometry_Notification_velocities_Send_cyclic
{
  if (@this == 1)
    setTimercyclic (tOdometry_Notification_velocities_Send, @Odometry_Notification_velocities_Send_cyclic_cycletime);
  else
    cancelTimer (tOdometry_Notification_velocities_Send);
}
on envVar Odometry_Notification_velocities_Send_cyclic_cycletime
{
  if (@Odometry_Notification_velocities_Send_cyclic == 1)
  {
    cancelTimer (tOdometry_Notification_velocities_Send);
    setTimercyclic (tOdometry_Notification_velocities_Send, @this);
  }
}
on timer tOdometry_Notification_velocities_Send
{
  UDP_Segments_total = @Odometry_Notification_Length_velocities/1404 + 1;
  UDP_Segments_left  = UDP_Segments_total;
  
  if (UDP_Segments_total > 1) seg_id_flag = 1;
  else                        seg_id_flag = 0;
    
  if (@Env_GlobalAppl == 1) Send_Service_Odometry_Notification (0xC020 & 0x0000FFFF);
}

on envVar Odometry_Notification_pose2D_Send
{
  if (@this == 1)
  {
    UDP_Segments_total = @Odometry_Notification_Length_pose2D/1404 + 1;
    UDP_Segments_left  = UDP_Segments_total;
    
    if (UDP_Segments_total > 1) seg_id_flag = 1;
    else                        seg_id_flag = 0;
    
    Send_Service_Odometry_Notification (0xC030 & 0x0000FFFF);
  }
}
on envVar Odometry_Notification_pose2D_Send_cyclic
{
  if (@this == 1)
    setTimercyclic (tOdometry_Notification_pose2D_Send, @Odometry_Notification_pose2D_Send_cyclic_cycletime);
  else
    cancelTimer (tOdometry_Notification_pose2D_Send);
}
on envVar Odometry_Notification_pose2D_Send_cyclic_cycletime
{
  if (@Odometry_Notification_pose2D_Send_cyclic == 1)
  {
    cancelTimer (tOdometry_Notification_pose2D_Send);
    setTimercyclic (tOdometry_Notification_pose2D_Send, @this);
  }
}
on timer tOdometry_Notification_pose2D_Send
{
  UDP_Segments_total = @Odometry_Notification_Length_pose2D/1404 + 1;
  UDP_Segments_left  = UDP_Segments_total;
  
  if (UDP_Segments_total > 1) seg_id_flag = 1;
  else                        seg_id_flag = 0;
    
  if (@Env_GlobalAppl == 1) Send_Service_Odometry_Notification (0xC030 & 0x0000FFFF);
}

on envVar Odometry_Notification_additionalVehicleMotionInformations_Send
{
  if (@this == 1)
  {
    UDP_Segments_total = @Odometry_Notification_Length_additionalVehicleMotionInformations/1404 + 1;
    UDP_Segments_left  = UDP_Segments_total;
    
    if (UDP_Segments_total > 1) seg_id_flag = 1;
    else                        seg_id_flag = 0;
    
    Send_Service_Odometry_Notification (0xC040 & 0x0000FFFF);
  }
}
on envVar Odometry_Notification_additionalVehicleMotionInformations_Send_cyclic
{
  if (@this == 1)
    setTimercyclic (tOdometry_Notification_additionalVehicleMotionInformations_Send, @Odometry_Notification_additionalVehicleMotionInformations_Send_cyclic_cycletime);
  else
    cancelTimer (tOdometry_Notification_additionalVehicleMotionInformations_Send);
}
on envVar Odometry_Notification_additionalVehicleMotionInformations_Send_cyclic_cycletime
{
  if (@Odometry_Notification_additionalVehicleMotionInformations_Send_cyclic == 1)
  {
    cancelTimer (tOdometry_Notification_additionalVehicleMotionInformations_Send);
    setTimercyclic (tOdometry_Notification_additionalVehicleMotionInformations_Send, @this);
  }
}
on timer tOdometry_Notification_additionalVehicleMotionInformations_Send
{
  UDP_Segments_total = @Odometry_Notification_Length_additionalVehicleMotionInformations/1404 + 1;
  UDP_Segments_left  = UDP_Segments_total;
  
  if (UDP_Segments_total > 1) seg_id_flag = 1;
  else                        seg_id_flag = 0;
    
  if (@Env_GlobalAppl == 1) Send_Service_Odometry_Notification (0xC040 & 0x0000FFFF);
}

on envVar Odometry_Notification_wheelCorrections_Send
{
  if (@this == 1)
  {
    UDP_Segments_total = @Odometry_Notification_Length_wheelCorrections/1404 + 1;
    UDP_Segments_left  = UDP_Segments_total;
    
    if (UDP_Segments_total > 1) seg_id_flag = 1;
    else                        seg_id_flag = 0;
    
    Send_Service_Odometry_Notification (0xC050 & 0x0000FFFF);
  }
}
on envVar Odometry_Notification_wheelCorrections_Send_cyclic
{
  if (@this == 1)
    setTimercyclic (tOdometry_Notification_wheelCorrections_Send, @Odometry_Notification_wheelCorrections_Send_cyclic_cycletime);
  else
    cancelTimer (tOdometry_Notification_wheelCorrections_Send);
}
on envVar Odometry_Notification_wheelCorrections_Send_cyclic_cycletime
{
  if (@Odometry_Notification_wheelCorrections_Send_cyclic == 1)
  {
    cancelTimer (tOdometry_Notification_wheelCorrections_Send);
    setTimercyclic (tOdometry_Notification_wheelCorrections_Send, @this);
  }
}
on timer tOdometry_Notification_wheelCorrections_Send
{
  UDP_Segments_total = @Odometry_Notification_Length_wheelCorrections/1404 + 1;
  UDP_Segments_left  = UDP_Segments_total;
  
  if (UDP_Segments_total > 1) seg_id_flag = 1;
  else                        seg_id_flag = 0;
    
  if (@Env_GlobalAppl == 1) Send_Service_Odometry_Notification (0xC050 & 0x0000FFFF);
}

on envVar Odometry_Notification_accelerations_Send
{
  if (@this == 1)
  {
    UDP_Segments_total = @Odometry_Notification_Length_accelerations/1404 + 1;
    UDP_Segments_left  = UDP_Segments_total;
    
    if (UDP_Segments_total > 1) seg_id_flag = 1;
    else                        seg_id_flag = 0;
    
    Send_Service_Odometry_Notification (0xC060 & 0x0000FFFF);
  }
}
on envVar Odometry_Notification_accelerations_Send_cyclic
{
  if (@this == 1)
    setTimercyclic (tOdometry_Notification_accelerations_Send, @Odometry_Notification_accelerations_Send_cyclic_cycletime);
  else
    cancelTimer (tOdometry_Notification_accelerations_Send);
}
on envVar Odometry_Notification_accelerations_Send_cyclic_cycletime
{
  if (@Odometry_Notification_accelerations_Send_cyclic == 1)
  {
    cancelTimer (tOdometry_Notification_accelerations_Send);
    setTimercyclic (tOdometry_Notification_accelerations_Send, @this);
  }
}
on timer tOdometry_Notification_accelerations_Send
{
  UDP_Segments_total = @Odometry_Notification_Length_accelerations/1404 + 1;
  UDP_Segments_left  = UDP_Segments_total;
  
  if (UDP_Segments_total > 1) seg_id_flag = 1;
  else                        seg_id_flag = 0;
    
  if (@Env_GlobalAppl == 1) Send_Service_Odometry_Notification (0xC060 & 0x0000FFFF);
}

on envVar Odometry_Notification_angularRates_Send
{
  if (@this == 1)
  {
    UDP_Segments_total = @Odometry_Notification_Length_angularRates/1404 + 1;
    UDP_Segments_left  = UDP_Segments_total;
    
    if (UDP_Segments_total > 1) seg_id_flag = 1;
    else                        seg_id_flag = 0;
    
    Send_Service_Odometry_Notification (0xC070 & 0x0000FFFF);
  }
}
on envVar Odometry_Notification_angularRates_Send_cyclic
{
  if (@this == 1)
    setTimercyclic (tOdometry_Notification_angularRates_Send, @Odometry_Notification_angularRates_Send_cyclic_cycletime);
  else
    cancelTimer (tOdometry_Notification_angularRates_Send);
}
on envVar Odometry_Notification_angularRates_Send_cyclic_cycletime
{
  if (@Odometry_Notification_angularRates_Send_cyclic == 1)
  {
    cancelTimer (tOdometry_Notification_angularRates_Send);
    setTimercyclic (tOdometry_Notification_angularRates_Send, @this);
  }
}
on timer tOdometry_Notification_angularRates_Send
{
  UDP_Segments_total = @Odometry_Notification_Length_angularRates/1404 + 1;
  UDP_Segments_left  = UDP_Segments_total;
  
  if (UDP_Segments_total > 1) seg_id_flag = 1;
  else                        seg_id_flag = 0;
    
  if (@Env_GlobalAppl == 1) Send_Service_Odometry_Notification (0xC070 & 0x0000FFFF);
}


Send_Service_Odometry_Notification (word MethodID)
{
  ethernetPacket EthPaket;

  // Ethernet Packet - MAC Source address
  getvalue (ServiceDiscovery_EthernetPacket_MAC_Source_ICAS1Gateway, buffer_MAC);
  //EthPaket.source.ParseAddress ( buffer_MAC );
  EthPaket.source = ethGetMacAddressAsNumber (buffer_MAC);
  
  // Ethernet Packet - MAC Destination address
  getvalue (ServiceDiscovery_EthernetPacket_MAC_Destination, buffer_MAC);
  //EthPaket.destination.ParseAddress ( buffer_MAC );
  EthPaket.destination = ethGetMacAddressAsNumber (buffer_MAC);
  
  // Ethernet Packet - VLAN
  EthPaket.SetVlan (@ServiceDiscovery_EthernetPacket_VLAN_TPID, @ServiceDiscovery_EthernetPacket_VLAN_TCI);
  
  // Ethernet Packet - Type
  //EthPaket.ipv6.type = @EthernetPacket_Type;
  if (@ServiceDiscovery_EthernetPacket_Type == 0x86DD) EthPaket.ipv6.Init();
  
  
  // IPv6 Packet - Version
  EthPaket.ipv6.version = @ServiceDiscovery_IPv6Packet_Version;

  // IPv6 Packet - Traffic Class
  EthPaket.ipv6.class = @ServiceDiscovery_IPv6Packet_Traffic_Class;
  
  // IPv6 Packet - Flow Label
  EthPaket.ipv6.flow = @ServiceDiscovery_IPv6Packet_Flow_Label;
  
  // IPv6 Packet - Payload_Length
  EthPaket.ipv6.length = @ServiceDiscovery_IPv6Packet_Payload_Length;
  
  // IPv6 Packet - Next Header
  EthPaket.ipv6.next = @ServiceDiscovery_IPv6Packet_Next_Header;
  if (@ServiceDiscovery_IPv6Packet_Next_Header == 6) EthPaket.tcp.Init();
  if (@ServiceDiscovery_IPv6Packet_Next_Header == 17) EthPaket.udp.Init();
  
  // IPv6 Packet - Hop Limit
  EthPaket.ipv6.hopLimit = @ServiceDiscovery_IPv6Packet_Hop_Limit;

  // IPv6 Packet - IPv6 Destination address    // TODO: char array zu byte array
  buffer_ipv6[0]  = @ServiceDiscovery_IPv6Packet_IP_Destination_Unicast_01>>8 & 0xFF;
  buffer_ipv6[1]  = @ServiceDiscovery_IPv6Packet_IP_Destination_Unicast_01    & 0xFF;
  buffer_ipv6[2]  = @ServiceDiscovery_IPv6Packet_IP_Destination_Unicast_02>>8 & 0xFF;
  buffer_ipv6[3]  = @ServiceDiscovery_IPv6Packet_IP_Destination_Unicast_02    & 0xFF;
  buffer_ipv6[4]  = @ServiceDiscovery_IPv6Packet_IP_Destination_Unicast_03>>8 & 0xFF;
  buffer_ipv6[5]  = @ServiceDiscovery_IPv6Packet_IP_Destination_Unicast_03    & 0xFF;
  buffer_ipv6[6]  = @ServiceDiscovery_IPv6Packet_IP_Destination_Unicast_04>>8 & 0xFF;
  buffer_ipv6[7]  = @ServiceDiscovery_IPv6Packet_IP_Destination_Unicast_04    & 0xFF;
  buffer_ipv6[8]  = @ServiceDiscovery_IPv6Packet_IP_Destination_Unicast_05>>8 & 0xFF;
  buffer_ipv6[9]  = @ServiceDiscovery_IPv6Packet_IP_Destination_Unicast_05    & 0xFF;
  buffer_ipv6[10] = @ServiceDiscovery_IPv6Packet_IP_Destination_Unicast_06>>8 & 0xFF;
  buffer_ipv6[11] = @ServiceDiscovery_IPv6Packet_IP_Destination_Unicast_06    & 0xFF;
  buffer_ipv6[12] = @ServiceDiscovery_IPv6Packet_IP_Destination_Unicast_07>>8 & 0xFF;
  buffer_ipv6[13] = @ServiceDiscovery_IPv6Packet_IP_Destination_Unicast_07    & 0xFF;
  buffer_ipv6[14] = @ServiceDiscovery_IPv6Packet_IP_Destination_Unicast_08>>8 & 0xFF;
  buffer_ipv6[15] = @ServiceDiscovery_IPv6Packet_IP_Destination_Unicast_08    & 0xFF;
  EthPaket.ipv6.destination.SetData ( 0, buffer_ipv6, elcount(buffer_ipv6) );

  // IPv6 Packet - IPv6 Source address    // TODO: char array zu byte array
  buffer_ipv6[0]  = @ServiceDiscovery_IPv6Packet_IP_Source_ICAS1Gateway_01>>8 & 0xFF;
  buffer_ipv6[1]  = @ServiceDiscovery_IPv6Packet_IP_Source_ICAS1Gateway_01    & 0xFF;
  buffer_ipv6[2]  = @ServiceDiscovery_IPv6Packet_IP_Source_ICAS1Gateway_02>>8 & 0xFF;
  buffer_ipv6[3]  = @ServiceDiscovery_IPv6Packet_IP_Source_ICAS1Gateway_02    & 0xFF;
  buffer_ipv6[4]  = @ServiceDiscovery_IPv6Packet_IP_Source_ICAS1Gateway_03>>8 & 0xFF;
  buffer_ipv6[5]  = @ServiceDiscovery_IPv6Packet_IP_Source_ICAS1Gateway_03    & 0xFF;
  buffer_ipv6[6]  = @ServiceDiscovery_IPv6Packet_IP_Source_ICAS1Gateway_04>>8 & 0xFF;
  buffer_ipv6[7]  = @ServiceDiscovery_IPv6Packet_IP_Source_ICAS1Gateway_04    & 0xFF;
  buffer_ipv6[8]  = @ServiceDiscovery_IPv6Packet_IP_Source_ICAS1Gateway_05>>8 & 0xFF;
  buffer_ipv6[9]  = @ServiceDiscovery_IPv6Packet_IP_Source_ICAS1Gateway_05    & 0xFF;
  buffer_ipv6[10] = @ServiceDiscovery_IPv6Packet_IP_Source_ICAS1Gateway_06>>8 & 0xFF;
  buffer_ipv6[11] = @ServiceDiscovery_IPv6Packet_IP_Source_ICAS1Gateway_06    & 0xFF;
  buffer_ipv6[12] = @ServiceDiscovery_IPv6Packet_IP_Source_ICAS1Gateway_07>>8 & 0xFF;
  buffer_ipv6[13] = @ServiceDiscovery_IPv6Packet_IP_Source_ICAS1Gateway_07    & 0xFF;
  buffer_ipv6[14] = @ServiceDiscovery_IPv6Packet_IP_Source_ICAS1Gateway_08>>8 & 0xFF;
  buffer_ipv6[15] = @ServiceDiscovery_IPv6Packet_IP_Source_ICAS1Gateway_08    & 0xFF;
  EthPaket.ipv6.source.SetData ( 0, buffer_ipv6, elcount(buffer_ipv6) );

  
  // UDP Packet - Source Port
  EthPaket.udp.source = @Odometry_Notification_Port_Source;
  
  // UDP Packet - Destination Port
  EthPaket.udp.destination = @Odometry_Notification_Port_Destination;
  
  // UDP Packet - Length
  EthPaket.udp.length = @ServiceDiscovery_UDPPacket_Length;
  
  
  // SOME/IP Packet aus Rohdaten zusammenbauen (buffer array)
  i=0;
  
  // SOME/IP Packet - Message ID, Service ID [16 bit]
  buffer[i++] = @Odometry_Notification_Message_ID_Service_ID>>8 & 0xFF;
  buffer[i++] = @Odometry_Notification_Message_ID_Service_ID    & 0xFF;
  
  // SOME/IP Packet - Message ID, Message ID [16 bit]
  switch (MethodID)
  {
    case 0xC010: @Odometry_Notification_Message_ID_Method_ID = @Odometry_Notification_Message_ID_Method_ID_speeds; break;
    case 0xC020: @Odometry_Notification_Message_ID_Method_ID = @Odometry_Notification_Message_ID_Method_ID_velocities; break;
    case 0xC030: @Odometry_Notification_Message_ID_Method_ID = @Odometry_Notification_Message_ID_Method_ID_pose2D; break;
    case 0xC040: @Odometry_Notification_Message_ID_Method_ID = @Odometry_Notification_Message_ID_Method_ID_additionalVehicleMotionInformations; break;
    case 0xC050: @Odometry_Notification_Message_ID_Method_ID = @Odometry_Notification_Message_ID_Method_ID_wheelCorrections; break;
    case 0xC060: @Odometry_Notification_Message_ID_Method_ID = @Odometry_Notification_Message_ID_Method_ID_accelerations; break;
    case 0xC070: @Odometry_Notification_Message_ID_Method_ID = @Odometry_Notification_Message_ID_Method_ID_angularRates; break;
  }
  buffer[i++] = @Odometry_Notification_Message_ID_Method_ID>>8 & 0xFF;
  buffer[i++] = @Odometry_Notification_Message_ID_Method_ID    & 0xFF;
  
  // SOME/IP Packet - Length [32 bit]
  if (UDP_Segments_total == 1)
  {
    switch (MethodID)
    {
      case 0xC010: @Odometry_Notification_Length = @Odometry_Notification_Length_speeds; break;
      case 0xC020: @Odometry_Notification_Length = @Odometry_Notification_Length_velocities; break;
      case 0xC030: @Odometry_Notification_Length = @Odometry_Notification_Length_pose2D; break;
      case 0xC040: @Odometry_Notification_Length = @Odometry_Notification_Length_additionalVehicleMotionInformations; break;
      case 0xC050: @Odometry_Notification_Length = @Odometry_Notification_Length_wheelCorrections; break;
      case 0xC060: @Odometry_Notification_Length = @Odometry_Notification_Length_accelerations; break;
      case 0xC070: @Odometry_Notification_Length = @Odometry_Notification_Length_angularRates; break;
    }
  }
  else
  {
    if (UDP_Segments_left > 1)
    {
      switch (MethodID)
      {
        case 0xC010: @Odometry_Notification_Length = 1404; break;
        case 0xC020: @Odometry_Notification_Length = 1404; break;
        case 0xC030: @Odometry_Notification_Length = 1404; break;
        case 0xC040: @Odometry_Notification_Length = 1404; break;
        case 0xC050: @Odometry_Notification_Length = 1404; break;
        case 0xC060: @Odometry_Notification_Length = 1404; break;
        case 0xC070: @Odometry_Notification_Length = 1404; break;
      }
    }
    else
    {
      switch (MethodID)
      {
        case 0xC010: @Odometry_Notification_Length = Odometry_payload_length_speeds                              - 1404*(UDP_Segments_total-UDP_Segments_left) + 24; break;
        case 0xC020: @Odometry_Notification_Length = Odometry_payload_length_velocities                          - 1404*(UDP_Segments_total-UDP_Segments_left) + 24; break;
        case 0xC030: @Odometry_Notification_Length = Odometry_payload_length_pose2D                              - 1404*(UDP_Segments_total-UDP_Segments_left) + 24; break;
        case 0xC040: @Odometry_Notification_Length = Odometry_payload_length_additionalVehicleMotionInformations - 1404*(UDP_Segments_total-UDP_Segments_left) + 24; break;
        case 0xC050: @Odometry_Notification_Length = Odometry_payload_length_wheelCorrections                    - 1404*(UDP_Segments_total-UDP_Segments_left) + 24; break;
        case 0xC060: @Odometry_Notification_Length = Odometry_payload_length_accelerations                       - 1404*(UDP_Segments_total-UDP_Segments_left) + 24; break;
        case 0xC070: @Odometry_Notification_Length = Odometry_payload_length_angularRates                        - 1404*(UDP_Segments_total-UDP_Segments_left) + 24; break;
      }
    }
  }
  buffer[i++] = @Odometry_Notification_Length>>24 & 0xFF;
  buffer[i++] = @Odometry_Notification_Length>>16 & 0xFF;
  buffer[i++] = @Odometry_Notification_Length>> 8 & 0xFF;
  buffer[i++] = @Odometry_Notification_Length     & 0xFF;
  
  // SOME/IP Packet - Request ID, Client ID [16 bit]
  buffer[i++] = @Odometry_Notification_Request_ID_Client_ID>>8 & 0xFF;
  buffer[i++] = @Odometry_Notification_Request_ID_Client_ID    & 0xFF;
  
  // SOME/IP Packet - Request ID, Session ID) [16 bit]
  if ((UDP_Segments_total == 1) || (seg_id_flag == 1))
  {
    @ServiceDiscovery_SOMEIPPacket_Notification_Request_ID_Session_ID = @ServiceDiscovery_SOMEIPPacket_Notification_Request_ID_Session_ID + 1;
    if (@ServiceDiscovery_SOMEIPPacket_Notification_Request_ID_Session_ID == 0x10000) @ServiceDiscovery_SOMEIPPacket_Notification_Request_ID_Session_ID = 1;
    seg_id_flag = 0;
  }
  
  buffer[i++] = @ServiceDiscovery_SOMEIPPacket_Notification_Request_ID_Session_ID>>8 & 0xFF;
  buffer[i++] = @ServiceDiscovery_SOMEIPPacket_Notification_Request_ID_Session_ID    & 0xFF;
  
  // SOME/IP Packet - Protocol Version [8 bit]
  buffer[i++] = @Odometry_Notification_Protocol_Version;
  
  // SOME/IP Packet - Interface Version [8 bit]
  buffer[i++] = @Odometry_Notification_Interface_Version;
  
  // SOME/IP Packet - Message Type [8 bit]
  buffer[i++] = @Odometry_Notification_Message_Type;
  
  // SOME/IP Packet - Return Code [8 bit]
  buffer[i++] = @Odometry_Notification_Return_Code;
  
  
  if (UDP_Segments_total > 1)
  {
    if (UDP_Segments_left >= 0)
    { 
      // Message Type neu setzen
      buffer[i-2] = @Odometry_Notification_Message_Type + 0x20;
      
      // Offset (16byte Schritte, 1392/16 = 87)
      @Odometry_Notification_Offset = 87 * (UDP_Segments_total - UDP_Segments_left);
      
      // More Segments Flag
      if (UDP_Segments_left > 1) @Odometry_Notification_More_Segments_Flag = 1;
      else                       @Odometry_Notification_More_Segments_Flag = 0;
      
      buffer[i++] =   @Odometry_Notification_Offset>>20 & 0xFF;
      buffer[i++] =   @Odometry_Notification_Offset>>12 & 0xFF;
      buffer[i++] =   @Odometry_Notification_Offset>>4  & 0xFF;
      buffer[i++] = ((@Odometry_Notification_Offset<<4) & 0xF0) + (@Odometry_Notification_More_Segments_Flag & 0x01);
    }
  }
  
  UDP_Segments_left--;
  
  ////// speeds notifier //////
  if (MethodID == 0xC010)
  {
    if (UDP_Segments_total == 1)
    {
      for (j=0; j<Odometry_payload_length_speeds; j++)
        buffer[i++] = Odometry_payload_buffer_speeds[j];
    }
    else
    {
      if (UDP_Segments_left >= 1)
      {
        for (j=(UDP_Segments_total-UDP_Segments_left-1)*1392; j<(UDP_Segments_total-UDP_Segments_left)*1392; j++)
          buffer[i++] = Odometry_payload_buffer_speeds[j];
      }
      else
      {
        for (j=(UDP_Segments_total-(UDP_Segments_left+1))*1392; j<Odometry_payload_length_speeds; j++)
          buffer[i++] = Odometry_payload_buffer_speeds[j];
      }
    }
  }
  
  ////// velocities notifier //////
  if (MethodID == 0xC020)
  {
    if (UDP_Segments_total == 1)
    {
      for (j=0; j<Odometry_payload_length_velocities; j++)
        buffer[i++] = Odometry_payload_buffer_velocities[j];
    }
    else
    {
      if (UDP_Segments_left >= 1)
      {
        for (j=(UDP_Segments_total-UDP_Segments_left-1)*1392; j<(UDP_Segments_total-UDP_Segments_left)*1392; j++)
          buffer[i++] = Odometry_payload_buffer_velocities[j];
      }
      else
      {
        for (j=(UDP_Segments_total-(UDP_Segments_left+1))*1392; j<Odometry_payload_length_velocities; j++)
          buffer[i++] = Odometry_payload_buffer_velocities[j];
      }
    }
  }
  
  ////// pose2D notifier //////
  if (MethodID == 0xC030)
  {
    if (UDP_Segments_total == 1)
    {
      for (j=0; j<Odometry_payload_length_pose2D; j++)
        buffer[i++] = Odometry_payload_buffer_pose2D[j];
    }
    else
    {
      if (UDP_Segments_left >= 1)
      {
        for (j=(UDP_Segments_total-UDP_Segments_left-1)*1392; j<(UDP_Segments_total-UDP_Segments_left)*1392; j++)
          buffer[i++] = Odometry_payload_buffer_pose2D[j];
      }
      else
      {
        for (j=(UDP_Segments_total-(UDP_Segments_left+1))*1392; j<Odometry_payload_length_pose2D; j++)
          buffer[i++] = Odometry_payload_buffer_pose2D[j];
      }
    }
  }
  
  ////// additionalVehicleMotionInformations notifier //////
  if (MethodID == 0xC040)
  {
    if (UDP_Segments_total == 1)
    {
      for (j=0; j<Odometry_payload_length_additionalVehicleMotionInformations; j++)
        buffer[i++] = Odometry_payload_buffer_additionalVehicleMotionInformations[j];
    }
    else
    {
      if (UDP_Segments_left >= 1)
      {
        for (j=(UDP_Segments_total-UDP_Segments_left-1)*1392; j<(UDP_Segments_total-UDP_Segments_left)*1392; j++)
          buffer[i++] = Odometry_payload_buffer_additionalVehicleMotionInformations[j];
      }
      else
      {
        for (j=(UDP_Segments_total-(UDP_Segments_left+1))*1392; j<Odometry_payload_length_additionalVehicleMotionInformations; j++)
          buffer[i++] = Odometry_payload_buffer_additionalVehicleMotionInformations[j];
      }
    }
  }
  
  ////// wheelCorrections notifier //////
  if (MethodID == 0xC050)
  {
    if (UDP_Segments_total == 1)
    {
      for (j=0; j<Odometry_payload_length_wheelCorrections; j++)
        buffer[i++] = Odometry_payload_buffer_wheelCorrections[j];
    }
    else
    {
      if (UDP_Segments_left >= 1)
      {
        for (j=(UDP_Segments_total-UDP_Segments_left-1)*1392; j<(UDP_Segments_total-UDP_Segments_left)*1392; j++)
          buffer[i++] = Odometry_payload_buffer_wheelCorrections[j];
      }
      else
      {
        for (j=(UDP_Segments_total-(UDP_Segments_left+1))*1392; j<Odometry_payload_length_wheelCorrections; j++)
          buffer[i++] = Odometry_payload_buffer_wheelCorrections[j];
      }
    }
  }
  
  ////// accelerations notifier //////
  if (MethodID == 0xC060)
  {
    if (UDP_Segments_total == 1)
    {
      for (j=0; j<Odometry_payload_length_accelerations; j++)
        buffer[i++] = Odometry_payload_buffer_accelerations[j];
    }
    else
    {
      if (UDP_Segments_left >= 1)
      {
        for (j=(UDP_Segments_total-UDP_Segments_left-1)*1392; j<(UDP_Segments_total-UDP_Segments_left)*1392; j++)
          buffer[i++] = Odometry_payload_buffer_accelerations[j];
      }
      else
      {
        for (j=(UDP_Segments_total-(UDP_Segments_left+1))*1392; j<Odometry_payload_length_accelerations; j++)
          buffer[i++] = Odometry_payload_buffer_accelerations[j];
      }
    }
  }
  
  ////// angularRates notifier //////
  if (MethodID == 0xC070)
  {
    if (UDP_Segments_total == 1)
    {
      for (j=0; j<Odometry_payload_length_angularRates; j++)
        buffer[i++] = Odometry_payload_buffer_angularRates[j];
    }
    else
    {
      if (UDP_Segments_left >= 1)
      {
        for (j=(UDP_Segments_total-UDP_Segments_left-1)*1392; j<(UDP_Segments_total-UDP_Segments_left)*1392; j++)
          buffer[i++] = Odometry_payload_buffer_angularRates[j];
      }
      else
      {
        for (j=(UDP_Segments_total-(UDP_Segments_left+1))*1392; j<Odometry_payload_length_angularRates; j++)
          buffer[i++] = Odometry_payload_buffer_angularRates[j];
      }
    }
  }
  
  
  // Rohdaten in UDP Paket schreiben
  EthPaket.udp.SetData( 0, buffer, i );

  // calculate UDP and IPv6 checksum and send Ethernet packet
  EthPaket.CompletePacket();
  output( EthPaket );
  
  // prüfen ob alle Segemente gesendet wurden, sonst senden erneut aufrufen
  Odometry_Segmentation_Method_ID = MethodID;
  if (UDP_Segments_left>0)
    settimer(Odometry_Segmentation_delay, 50);
}

on timer Odometry_Segmentation_delay
{
  Send_Service_Odometry_Notification (Odometry_Segmentation_Method_ID);
}






////////// speeds Notification //////////

on envVar Odometry_Notification_LengthIndicator_Struct_speeds
{
  Odometry_Notification_speeds();
}
on envVar Odometry_Notification_LengthIndicator_Element_speeds
{
  Odometry_Notification_speeds();
}
on envVar Odometry_Notification_speeds_type
{
  Odometry_array_speeds_type[@Odometry_Notification_speeds_Element] = @this;
  Odometry_Notification_speeds();
}
on envVar Odometry_Notification_speeds_value
{
  Odometry_array_speeds_value[@Odometry_Notification_speeds_Element] = @this;
  Odometry_Notification_speeds();
}
on envVar Odometry_Notification_speeds_confidence
{
  Odometry_array_speeds_confidence[@Odometry_Notification_speeds_Element] = @this;
  Odometry_Notification_speeds();
}
on envVar Odometry_Notification_speeds_timestamp
{
  Odometry_array_speeds_timestamp[@Odometry_Notification_speeds_Element] = @this;
  Odometry_Notification_speeds();
}
on envVar Odometry_Notification_speeds_type_available
{
  Odometry_array_speeds_type_available[@Odometry_Notification_speeds_Element] = @this;
  Odometry_Notification_speeds();
}
on envVar Odometry_Notification_speeds_value_available
{
  Odometry_array_speeds_value_available[@Odometry_Notification_speeds_Element] = @this;
  Odometry_Notification_speeds();
}
on envVar Odometry_Notification_speeds_confidence_available
{
  Odometry_array_speeds_confidence_available[@Odometry_Notification_speeds_Element] = @this;
  Odometry_Notification_speeds();
}
on envVar Odometry_Notification_speeds_timestamp_available
{
  Odometry_array_speeds_timestamp_available[@Odometry_Notification_speeds_Element] = @this;
  Odometry_Notification_speeds();
}
on envVar Odometry_Notification_speeds_Payload
{
  Odometry_Notification_speeds_update();
}


Odometry_Notification_speeds()
{
  word payload_counter = 0;
  word start_pos       = 0;
  word element_length  = 0;
  
  // Length Indicator Struct - Platzhalter
  payload_counter = 0+4;
  start_pos = 0;
  
  for (j=0; j<@Odometry_Notification_speeds_Element_TotalNum; j++)
  {
    Odometry_array_speeds_available_functions[j] = Odometry_array_speeds_type_available[j]
                                                 + Odometry_array_speeds_value_available[j]
                                                 + Odometry_array_speeds_confidence_available[j]
                                                 + Odometry_array_speeds_timestamp_available[j];
    
    // Length Indicator Element - Platzhalter
    if (Odometry_array_speeds_available_functions[j] > 0)
    {
      start_pos = payload_counter;
      payload_counter = payload_counter + 4;
    }
    else 
      start_pos = payload_counter;
    
    
    // 0 type (enum32)
    if (Odometry_array_speeds_type_available[j] == 1)
    {
      tag_dataID = 0;
      Odometry_payload_buffer_speeds[payload_counter++] = 2 * 16 /* Wiretype = 2  =^ 32 Bit */ + ((tag_dataID>>8) & 0x0F) /* DataID High Part */ ;
      Odometry_payload_buffer_speeds[payload_counter++] = tag_dataID & 0xFF /* DataID Low Part */ ;
      
      Odometry_payload_buffer_speeds[payload_counter++] = Odometry_array_speeds_type[j]>>24 & 0xFF;
      Odometry_payload_buffer_speeds[payload_counter++] = Odometry_array_speeds_type[j]>>16 & 0xFF;
      Odometry_payload_buffer_speeds[payload_counter++] = Odometry_array_speeds_type[j]>> 8 & 0xFF;
      Odometry_payload_buffer_speeds[payload_counter++] = Odometry_array_speeds_type[j]     & 0xFF;
    }
    
    
    // 1 value (float32)
    if (Odometry_array_speeds_value_available[j] == 1)
    {
      tag_dataID = 1;
      Odometry_payload_buffer_speeds[payload_counter++] = 2 * 16 /* Wiretype = 2  =^ 32 Bit */ + ((tag_dataID>>8) & 0x0F) /* DataID High Part */ ;
      Odometry_payload_buffer_speeds[payload_counter++] = tag_dataID & 0xFF /* DataID Low Part */ ;
      
      temp_converttodword = interpretAsDword (Odometry_array_speeds_value[j]);
      Odometry_payload_buffer_speeds[payload_counter++] = temp_converttodword>>24 & 0xFF;
      Odometry_payload_buffer_speeds[payload_counter++] = temp_converttodword>>16 & 0xFF;
      Odometry_payload_buffer_speeds[payload_counter++] = temp_converttodword>> 8 & 0xFF;
      Odometry_payload_buffer_speeds[payload_counter++] = temp_converttodword     & 0xFF;
    }
    
    
    // 2 confidence (enum32)
    if (Odometry_array_speeds_confidence_available[j] == 1)
    {
      tag_dataID = 2;
      Odometry_payload_buffer_speeds[payload_counter++] = 2 * 16 /* Wiretype = 2  =^ 32 Bit */ + ((tag_dataID>>8) & 0x0F) /* DataID High Part */ ;
      Odometry_payload_buffer_speeds[payload_counter++] = tag_dataID & 0xFF /* DataID Low Part */ ;
      
      Odometry_payload_buffer_speeds[payload_counter++] = Odometry_array_speeds_confidence[j]>>24 & 0xFF;
      Odometry_payload_buffer_speeds[payload_counter++] = Odometry_array_speeds_confidence[j]>>16 & 0xFF;
      Odometry_payload_buffer_speeds[payload_counter++] = Odometry_array_speeds_confidence[j]>> 8 & 0xFF;
      Odometry_payload_buffer_speeds[payload_counter++] = Odometry_array_speeds_confidence[j]     & 0xFF;
    }
    
    
    // 3 timestamp (uint64)
    if (Odometry_array_speeds_timestamp_available[j] == 1)
    {
      tag_dataID = 3;
      Odometry_payload_buffer_speeds[payload_counter++] = 3 * 16 /* Wiretype = 3  =^ 64 Bit */ + ((tag_dataID>>8) & 0x0F) /* DataID High Part */ ;
      Odometry_payload_buffer_speeds[payload_counter++] = tag_dataID & 0xFF /* DataID Low Part */ ;
      
      temp_64bit_low  = Odometry_array_speeds_timestamp[j]     & 0x00000000FFFFFFFF;
      temp_64bit_high = Odometry_array_speeds_timestamp[j]>>32 & 0x00000000FFFFFFFF;
      
      Odometry_payload_buffer_speeds[payload_counter++] = temp_64bit_high>>24 & 0xFF;
      Odometry_payload_buffer_speeds[payload_counter++] = temp_64bit_high>>16 & 0xFF;
      Odometry_payload_buffer_speeds[payload_counter++] = temp_64bit_high>> 8 & 0xFF;
      Odometry_payload_buffer_speeds[payload_counter++] = temp_64bit_high     & 0xFF;
      Odometry_payload_buffer_speeds[payload_counter++] = temp_64bit_low>>24  & 0xFF;
      Odometry_payload_buffer_speeds[payload_counter++] = temp_64bit_low>>16  & 0xFF;
      Odometry_payload_buffer_speeds[payload_counter++] = temp_64bit_low>> 8  & 0xFF;
      Odometry_payload_buffer_speeds[payload_counter++] = temp_64bit_low      & 0xFF;
    }
    
    //Element Length
    element_length = payload_counter-start_pos;
    if (element_length >0) Odometry_array_speeds_array_element_length[j] = element_length - 4;
    else                   Odometry_array_speeds_array_element_length[j] = element_length;
    
    Odometry_payload_buffer_speeds[start_pos++] = Odometry_array_speeds_array_element_length[j]>>24 & 0xFF;
    Odometry_payload_buffer_speeds[start_pos++] = Odometry_array_speeds_array_element_length[j]>>16 & 0xFF;
    Odometry_payload_buffer_speeds[start_pos++] = Odometry_array_speeds_array_element_length[j]>> 8 & 0xFF;
    Odometry_payload_buffer_speeds[start_pos++] = Odometry_array_speeds_array_element_length[j]     & 0xFF;
    
    if (Odometry_array_speeds_array_element_length[j] == 0) payload_counter = payload_counter+4;
  }
  
  // Struct Length
  Odometry_array_speeds_struct_element_length = 4*@Odometry_Notification_speeds_Element_TotalNum;

  for (k=0;k<@Odometry_Notification_speeds_Element_TotalNum;k++)
   Odometry_array_speeds_struct_element_length = Odometry_array_speeds_struct_element_length + Odometry_array_speeds_array_element_length[k];
  
  Odometry_payload_buffer_speeds[0] = Odometry_array_speeds_struct_element_length>>24 & 0xFF;
  Odometry_payload_buffer_speeds[1] = Odometry_array_speeds_struct_element_length>>16 & 0xFF;
  Odometry_payload_buffer_speeds[2] = Odometry_array_speeds_struct_element_length>> 8 & 0xFF;
  Odometry_payload_buffer_speeds[3] = Odometry_array_speeds_struct_element_length     & 0xFF;


  Odometry_payload_length_speeds = Odometry_array_speeds_struct_element_length+4;
  putvalue(Odometry_Notification_speeds_Payload, Odometry_payload_buffer_speeds, Odometry_payload_length_speeds);
}

on envVar Odometry_Notification_speeds_Element_TotalNum
{
  if (@this == 0) @this =  1;
  if (@this > 10) @this = 10;
  
  Odometry_Notification_speeds();
  Odometry_Notification_speeds_update();
}

on envVar Odometry_Notification_speeds_Element
{
  Odometry_Notification_speeds_update();
}

on envVar Odometry_Notification_speeds_Element_Next
{
  if (@this == 1 && @Odometry_Notification_speeds_Element < @Odometry_Notification_speeds_Element_TotalNum - 1)
  {
    @Odometry_Notification_speeds_Element = @Odometry_Notification_speeds_Element + 1;
    Odometry_Notification_speeds_update();
  }
}

on envVar Odometry_Notification_speeds_Element_Previous
{
  if (@this == 1 && @Odometry_Notification_speeds_Element > 0)
  {
    @Odometry_Notification_speeds_Element = @Odometry_Notification_speeds_Element - 1;
    Odometry_Notification_speeds_update();
  }
}

Odometry_Notification_speeds_update()
{
  @Odometry_Notification_LengthIndicator_Element_speeds = Odometry_array_speeds_array_element_length[@Odometry_Notification_speeds_Element];
  @Odometry_Notification_LengthIndicator_Struct_speeds  = Odometry_array_speeds_struct_element_length;
  @Odometry_Notification_Length_speeds                  = Odometry_payload_length_speeds+8;
  
  @Odometry_Notification_speeds_type       = Odometry_array_speeds_type[@Odometry_Notification_speeds_Element];
  @Odometry_Notification_speeds_value      = Odometry_array_speeds_value[@Odometry_Notification_speeds_Element];
  @Odometry_Notification_speeds_confidence = Odometry_array_speeds_confidence[@Odometry_Notification_speeds_Element];
  @Odometry_Notification_speeds_timestamp  = Odometry_array_speeds_timestamp[@Odometry_Notification_speeds_Element];
  
  @Odometry_Notification_speeds_type_available       = Odometry_array_speeds_type_available[@Odometry_Notification_speeds_Element];
  @Odometry_Notification_speeds_value_available      = Odometry_array_speeds_value_available[@Odometry_Notification_speeds_Element];
  @Odometry_Notification_speeds_confidence_available = Odometry_array_speeds_confidence_available[@Odometry_Notification_speeds_Element];
  @Odometry_Notification_speeds_timestamp_available  = Odometry_array_speeds_timestamp_available[@Odometry_Notification_speeds_Element];
}






////////// velocities Notification //////////

on envVar Odometry_Notification_LengthIndicator_Struct_velocities
{
  Odometry_Notification_velocities();
}
on envVar Odometry_Notification_LengthIndicator_Element_velocities
{
  Odometry_Notification_velocities();
}
on envVar Odometry_Notification_velocities_type
{
  Odometry_array_velocities_type[@Odometry_Notification_velocities_Element] = @this;
  Odometry_Notification_velocities();
}
on envVar Odometry_Notification_velocities_timestamp
{
  Odometry_array_velocities_timestamp[@Odometry_Notification_velocities_Element] = @this;
  Odometry_Notification_velocities();
}
on envVar Odometry_Notification_velocities_value
{
  Odometry_array_velocities_value[@Odometry_Notification_velocities_Element] = @this;
  Odometry_Notification_velocities();
}
on envVar Odometry_Notification_velocities_variance
{
  Odometry_array_velocities_variance[@Odometry_Notification_velocities_Element] = @this;
  Odometry_Notification_velocities();
}
on envVar Odometry_Notification_velocities_confidence
{
  Odometry_array_velocities_confidence[@Odometry_Notification_velocities_Element] = @this;
  Odometry_Notification_velocities();
}
on envVar Odometry_Notification_velocities_type_available
{
  Odometry_array_velocities_type_available[@Odometry_Notification_velocities_Element] = @this;
  Odometry_Notification_velocities();
}
on envVar Odometry_Notification_velocities_timestamp_available
{
  Odometry_array_velocities_timestamp_available[@Odometry_Notification_velocities_Element] = @this;
  Odometry_Notification_velocities();
}
on envVar Odometry_Notification_velocities_value_available
{
  Odometry_array_velocities_value_available[@Odometry_Notification_velocities_Element] = @this;
  Odometry_Notification_velocities();
}
on envVar Odometry_Notification_velocities_variance_available
{
  Odometry_array_velocities_variance_available[@Odometry_Notification_velocities_Element] = @this;
  Odometry_Notification_velocities();
}
on envVar Odometry_Notification_velocities_confidence_available
{
  Odometry_array_velocities_confidence_available[@Odometry_Notification_velocities_Element] = @this;
  Odometry_Notification_velocities();
}
on envVar Odometry_Notification_velocities_Payload
{
  Odometry_Notification_velocities_update();
}


Odometry_Notification_velocities()
{
  word payload_counter = 0;
  word start_pos       = 0;
  word element_length  = 0;
  
  // Length Indicator Struct - Platzhalter
  payload_counter = 0+4;
  start_pos = 0;
  
  for (j=0; j<@Odometry_Notification_velocities_Element_TotalNum; j++)
  {
    Odometry_array_velocities_available_functions[j] = Odometry_array_velocities_type_available[j]
                                                     + Odometry_array_velocities_timestamp_available[j]
                                                     + Odometry_array_velocities_value_available[j]
                                                     + Odometry_array_velocities_variance_available[j]
                                                     + Odometry_array_velocities_confidence_available[j];
    
    // Length Indicator Element - Platzhalter
    if (Odometry_array_velocities_available_functions[j] > 0)
    {
      start_pos = payload_counter;
      payload_counter = payload_counter + 4;
    }
    else 
      start_pos = payload_counter;
    
    
    // 0 type (enum32)
    if (Odometry_array_velocities_type_available[j] == 1)
    {
      tag_dataID = 0;
      Odometry_payload_buffer_velocities[payload_counter++] = 2 * 16 /* Wiretype = 2  =^ 32 Bit */ + ((tag_dataID>>8) & 0x0F) /* DataID High Part */ ;
      Odometry_payload_buffer_velocities[payload_counter++] = tag_dataID & 0xFF /* DataID Low Part */ ;
      
      Odometry_payload_buffer_velocities[payload_counter++] = Odometry_array_velocities_type[j]>>24 & 0xFF;
      Odometry_payload_buffer_velocities[payload_counter++] = Odometry_array_velocities_type[j]>>16 & 0xFF;
      Odometry_payload_buffer_velocities[payload_counter++] = Odometry_array_velocities_type[j]>> 8 & 0xFF;
      Odometry_payload_buffer_velocities[payload_counter++] = Odometry_array_velocities_type[j]     & 0xFF;
    }
    
    
    // 1 timestamp (uint64)
    if (Odometry_array_velocities_timestamp_available[j] == 1)
    {
      tag_dataID = 1;
      Odometry_payload_buffer_velocities[payload_counter++] = 3 * 16 /* Wiretype = 3  =^ 64 Bit */ + ((tag_dataID>>8) & 0x0F) /* DataID High Part */ ;
      Odometry_payload_buffer_velocities[payload_counter++] = tag_dataID & 0xFF /* DataID Low Part */ ;
      
      temp_64bit_low  = Odometry_array_velocities_timestamp[j]     & 0x00000000FFFFFFFF;
      temp_64bit_high = Odometry_array_velocities_timestamp[j]>>32 & 0x00000000FFFFFFFF;
      
      Odometry_payload_buffer_velocities[payload_counter++] = temp_64bit_high>>24 & 0xFF;
      Odometry_payload_buffer_velocities[payload_counter++] = temp_64bit_high>>16 & 0xFF;
      Odometry_payload_buffer_velocities[payload_counter++] = temp_64bit_high>> 8 & 0xFF;
      Odometry_payload_buffer_velocities[payload_counter++] = temp_64bit_high     & 0xFF;
      Odometry_payload_buffer_velocities[payload_counter++] = temp_64bit_low>>24  & 0xFF;
      Odometry_payload_buffer_velocities[payload_counter++] = temp_64bit_low>>16  & 0xFF;
      Odometry_payload_buffer_velocities[payload_counter++] = temp_64bit_low>> 8  & 0xFF;
      Odometry_payload_buffer_velocities[payload_counter++] = temp_64bit_low      & 0xFF;
    }
        
    
    // 2 value (float32)
    if (Odometry_array_velocities_value_available[j] == 1)
    {
      tag_dataID = 2;
      Odometry_payload_buffer_velocities[payload_counter++] = 2 * 16 /* Wiretype = 2  =^ 32 Bit */ + ((tag_dataID>>8) & 0x0F) /* DataID High Part */ ;
      Odometry_payload_buffer_velocities[payload_counter++] = tag_dataID & 0xFF /* DataID Low Part */ ;
      
      temp_converttodword = interpretAsDword (Odometry_array_velocities_value[j]);
      Odometry_payload_buffer_velocities[payload_counter++] = temp_converttodword>>24 & 0xFF;
      Odometry_payload_buffer_velocities[payload_counter++] = temp_converttodword>>16 & 0xFF;
      Odometry_payload_buffer_velocities[payload_counter++] = temp_converttodword>> 8 & 0xFF;
      Odometry_payload_buffer_velocities[payload_counter++] = temp_converttodword     & 0xFF;
    }
    
    
    // 3 variance (float32)
    if (Odometry_array_velocities_variance_available[j] == 1)
    {
      tag_dataID = 3;
      Odometry_payload_buffer_velocities[payload_counter++] = 2 * 16 /* Wiretype = 2  =^ 32 Bit */ + ((tag_dataID>>8) & 0x0F) /* DataID High Part */ ;
      Odometry_payload_buffer_velocities[payload_counter++] = tag_dataID & 0xFF /* DataID Low Part */ ;
      
      temp_converttodword = interpretAsDword (Odometry_array_velocities_variance[j]);
      Odometry_payload_buffer_velocities[payload_counter++] = temp_converttodword>>24 & 0xFF;
      Odometry_payload_buffer_velocities[payload_counter++] = temp_converttodword>>16 & 0xFF;
      Odometry_payload_buffer_velocities[payload_counter++] = temp_converttodword>> 8 & 0xFF;
      Odometry_payload_buffer_velocities[payload_counter++] = temp_converttodword     & 0xFF;
    }
    
    
    // 4 confidence (enum32)
    if (Odometry_array_velocities_confidence_available[j] == 1)
    {
      tag_dataID = 4;
      Odometry_payload_buffer_velocities[payload_counter++] = 2 * 16 /* Wiretype = 2  =^ 32 Bit */ + ((tag_dataID>>8) & 0x0F) /* DataID High Part */ ;
      Odometry_payload_buffer_velocities[payload_counter++] = tag_dataID & 0xFF /* DataID Low Part */ ;
      
      Odometry_payload_buffer_velocities[payload_counter++] = Odometry_array_velocities_confidence[j]>>24 & 0xFF;
      Odometry_payload_buffer_velocities[payload_counter++] = Odometry_array_velocities_confidence[j]>>16 & 0xFF;
      Odometry_payload_buffer_velocities[payload_counter++] = Odometry_array_velocities_confidence[j]>> 8 & 0xFF;
      Odometry_payload_buffer_velocities[payload_counter++] = Odometry_array_velocities_confidence[j]     & 0xFF;
    }
    
    //Element Length
    element_length = payload_counter-start_pos;
    if (element_length >0) Odometry_array_velocities_array_element_length[j] = element_length - 4;
    else                   Odometry_array_velocities_array_element_length[j] = element_length;
    
    Odometry_payload_buffer_velocities[start_pos++] = Odometry_array_velocities_array_element_length[j]>>24 & 0xFF;
    Odometry_payload_buffer_velocities[start_pos++] = Odometry_array_velocities_array_element_length[j]>>16 & 0xFF;
    Odometry_payload_buffer_velocities[start_pos++] = Odometry_array_velocities_array_element_length[j]>> 8 & 0xFF;
    Odometry_payload_buffer_velocities[start_pos++] = Odometry_array_velocities_array_element_length[j]     & 0xFF;
    
    if (Odometry_array_velocities_array_element_length[j] == 0) payload_counter = payload_counter+4;
  }
  
  // Struct Length
  Odometry_array_velocities_struct_element_length = 4*@Odometry_Notification_velocities_Element_TotalNum;

  for (k=0;k<@Odometry_Notification_velocities_Element_TotalNum;k++)
   Odometry_array_velocities_struct_element_length = Odometry_array_velocities_struct_element_length + Odometry_array_velocities_array_element_length[k];
  
  Odometry_payload_buffer_velocities[0] = Odometry_array_velocities_struct_element_length>>24 & 0xFF;
  Odometry_payload_buffer_velocities[1] = Odometry_array_velocities_struct_element_length>>16 & 0xFF;
  Odometry_payload_buffer_velocities[2] = Odometry_array_velocities_struct_element_length>> 8 & 0xFF;
  Odometry_payload_buffer_velocities[3] = Odometry_array_velocities_struct_element_length     & 0xFF;


  Odometry_payload_length_velocities = Odometry_array_velocities_struct_element_length+4;
  putvalue(Odometry_Notification_velocities_Payload, Odometry_payload_buffer_velocities, Odometry_payload_length_velocities);
}

on envVar Odometry_Notification_velocities_Element_TotalNum
{
  if (@this == 0) @this =  1;
  if (@this > 10) @this = 10;
  
  Odometry_Notification_velocities();
  Odometry_Notification_velocities_update();
}

on envVar Odometry_Notification_velocities_Element
{
  Odometry_Notification_velocities_update();
}

on envVar Odometry_Notification_velocities_Element_Next
{
  if (@this == 1 && @Odometry_Notification_velocities_Element < @Odometry_Notification_velocities_Element_TotalNum - 1)
  {
    @Odometry_Notification_velocities_Element = @Odometry_Notification_velocities_Element + 1;
    Odometry_Notification_velocities_update();
  }
}

on envVar Odometry_Notification_velocities_Element_Previous
{
  if (@this == 1 && @Odometry_Notification_velocities_Element > 0)
  {
    @Odometry_Notification_velocities_Element = @Odometry_Notification_velocities_Element - 1;
    Odometry_Notification_velocities_update();
  }
}
Odometry_Notification_velocities_update()
{
  @Odometry_Notification_LengthIndicator_Element_velocities = Odometry_array_velocities_array_element_length[@Odometry_Notification_velocities_Element];
  @Odometry_Notification_LengthIndicator_Struct_velocities  = Odometry_array_velocities_struct_element_length;
  @Odometry_Notification_Length_velocities                  = Odometry_payload_length_velocities+8;
  
  @Odometry_Notification_velocities_type       = Odometry_array_velocities_type[@Odometry_Notification_velocities_Element];
  @Odometry_Notification_velocities_timestamp  = Odometry_array_velocities_timestamp[@Odometry_Notification_velocities_Element];
  @Odometry_Notification_velocities_value      = Odometry_array_velocities_value[@Odometry_Notification_velocities_Element];
  @Odometry_Notification_velocities_variance   = Odometry_array_velocities_variance[@Odometry_Notification_velocities_Element];
  @Odometry_Notification_velocities_confidence = Odometry_array_velocities_confidence[@Odometry_Notification_velocities_Element];
  
  @Odometry_Notification_velocities_type_available       = Odometry_array_velocities_type_available[@Odometry_Notification_velocities_Element];
  @Odometry_Notification_velocities_timestamp_available  = Odometry_array_velocities_timestamp_available[@Odometry_Notification_velocities_Element];
  @Odometry_Notification_velocities_value_available      = Odometry_array_velocities_value_available[@Odometry_Notification_velocities_Element];
  @Odometry_Notification_velocities_variance_available   = Odometry_array_velocities_variance_available[@Odometry_Notification_velocities_Element];
  @Odometry_Notification_velocities_confidence_available = Odometry_array_velocities_confidence_available[@Odometry_Notification_velocities_Element];
}






////////// pose2D Notification //////////

on envVar Odometry_Notification_LengthIndicator_Struct_pose2D
{
  Odometry_Notification_pose2D();
}
on envVar Odometry_Notification_LengthIndicator_Element_pose2D
{
  Odometry_Notification_pose2D();
}
on envVar Odometry_Notification_pose2D_timestamp
{
  Odometry_array_pose2D_timestamp[@Odometry_Notification_pose2D_Element] = @this;
  Odometry_Notification_pose2D();
}
on envVar Odometry_Notification_pose2D_positionX
{
  Odometry_array_pose2D_positionX[@Odometry_Notification_pose2D_Element] = @this;
  Odometry_Notification_pose2D();
}
on envVar Odometry_Notification_pose2D_positionY
{
  Odometry_array_pose2D_positionY[@Odometry_Notification_pose2D_Element] = @this;
  Odometry_Notification_pose2D();
}
on envVar Odometry_Notification_pose2D_yawAngle
{
  Odometry_array_pose2D_yawAngle[@Odometry_Notification_pose2D_Element] = @this;
  Odometry_Notification_pose2D();
}
on envVar Odometry_Notification_pose2D_positionXVariance
{
  Odometry_array_pose2D_positionXVariance[@Odometry_Notification_pose2D_Element] = @this;
  Odometry_Notification_pose2D();
}
on envVar Odometry_Notification_pose2D_positionYVariance
{
  Odometry_array_pose2D_positionYVariance[@Odometry_Notification_pose2D_Element] = @this;
  Odometry_Notification_pose2D();
}
on envVar Odometry_Notification_pose2D_yawAngleVariance
{
  Odometry_array_pose2D_yawAngleVariance[@Odometry_Notification_pose2D_Element] = @this;
  Odometry_Notification_pose2D();
}
on envVar Odometry_Notification_pose2D_pose2dConfidence
{
  Odometry_array_pose2D_pose2dConfidence[@Odometry_Notification_pose2D_Element] = @this;
  Odometry_Notification_pose2D();
}
on envVar Odometry_Notification_pose2D_timestamp_available
{
  Odometry_array_pose2D_timestamp_available[@Odometry_Notification_pose2D_Element] = @this;
  Odometry_Notification_pose2D();
}
on envVar Odometry_Notification_pose2D_positionX_available
{
  Odometry_array_pose2D_positionX_available[@Odometry_Notification_pose2D_Element] = @this;
  Odometry_Notification_pose2D();
}
on envVar Odometry_Notification_pose2D_positionY_available
{
  Odometry_array_pose2D_positionY_available[@Odometry_Notification_pose2D_Element] = @this;
  Odometry_Notification_pose2D();
}
on envVar Odometry_Notification_pose2D_yawAngle_available
{
  Odometry_array_pose2D_yawAngle_available[@Odometry_Notification_pose2D_Element] = @this;
  Odometry_Notification_pose2D();
}
on envVar Odometry_Notification_pose2D_positionXVariance_available
{
  Odometry_array_pose2D_positionXVariance_available[@Odometry_Notification_pose2D_Element] = @this;
  Odometry_Notification_pose2D();
}
on envVar Odometry_Notification_pose2D_positionYVariance_available
{
  Odometry_array_pose2D_positionYVariance_available[@Odometry_Notification_pose2D_Element] = @this;
  Odometry_Notification_pose2D();
}
on envVar Odometry_Notification_pose2D_yawAngleVariance_available
{
  Odometry_array_pose2D_yawAngleVariance_available[@Odometry_Notification_pose2D_Element] = @this;
  Odometry_Notification_pose2D();
}
on envVar Odometry_Notification_pose2D_pose2dConfidence_available
{
  Odometry_array_pose2D_pose2dConfidence_available[@Odometry_Notification_pose2D_Element] = @this;
  Odometry_Notification_pose2D();
}
on envVar Odometry_Notification_pose2D_Payload
{
  Odometry_Notification_pose2D_update();
}


Odometry_Notification_pose2D()
{
  word payload_counter = 0;
  word start_pos       = 0;
  word element_length  = 0;
  
  // Length Indicator Struct - Platzhalter
  payload_counter = 0+4;
  start_pos = 0;
  
  for (j=0; j<@Odometry_Notification_pose2D_Element_TotalNum; j++)
  {
    Odometry_array_pose2D_available_functions[j] = Odometry_array_pose2D_timestamp_available[j]
                                                 + Odometry_array_pose2D_positionX_available[j]
                                                 + Odometry_array_pose2D_positionY_available[j]
                                                 + Odometry_array_pose2D_yawAngle_available[j]
                                                 + Odometry_array_pose2D_positionXVariance_available[j]
                                                 + Odometry_array_pose2D_positionYVariance_available[j]
                                                 + Odometry_array_pose2D_yawAngleVariance_available[j]
                                                 + Odometry_array_pose2D_pose2dConfidence_available[j];
    
    // Length Indicator Element - Platzhalter
    if (Odometry_array_pose2D_available_functions[j] > 0)
    {
      start_pos = payload_counter;
      payload_counter = payload_counter + 4;
    }
    else 
      start_pos = payload_counter;
    
    
    // 0 timestamp (uint64)
    if (Odometry_array_pose2D_timestamp_available[j] == 1)
    {
      tag_dataID = 0;
      Odometry_payload_buffer_pose2D[payload_counter++] = 3 * 16 /* Wiretype = 3  =^ 64 Bit */ + ((tag_dataID>>8) & 0x0F) /* DataID High Part */ ;
      Odometry_payload_buffer_pose2D[payload_counter++] = tag_dataID & 0xFF /* DataID Low Part */ ;
      
      temp_64bit_low  = Odometry_array_pose2D_timestamp[j]     & 0x00000000FFFFFFFF;
      temp_64bit_high = Odometry_array_pose2D_timestamp[j]>>32 & 0x00000000FFFFFFFF;
      
      Odometry_payload_buffer_pose2D[payload_counter++] = temp_64bit_high>>24 & 0xFF;
      Odometry_payload_buffer_pose2D[payload_counter++] = temp_64bit_high>>16 & 0xFF;
      Odometry_payload_buffer_pose2D[payload_counter++] = temp_64bit_high>> 8 & 0xFF;
      Odometry_payload_buffer_pose2D[payload_counter++] = temp_64bit_high     & 0xFF;
      Odometry_payload_buffer_pose2D[payload_counter++] = temp_64bit_low>>24  & 0xFF;
      Odometry_payload_buffer_pose2D[payload_counter++] = temp_64bit_low>>16  & 0xFF;
      Odometry_payload_buffer_pose2D[payload_counter++] = temp_64bit_low>> 8  & 0xFF;
      Odometry_payload_buffer_pose2D[payload_counter++] = temp_64bit_low      & 0xFF;
    }
    
    
    // 1 positionX (double64)
    if (Odometry_array_pose2D_positionX_available[j] == 1)
    {
      tag_dataID = 1;
      Odometry_payload_buffer_pose2D[payload_counter++] = 3 * 16 /* Wiretype = 3  =^ 64 Bit */ + ((tag_dataID>>8) & 0x0F) /* DataID High Part */ ;
      Odometry_payload_buffer_pose2D[payload_counter++] = tag_dataID & 0xFF /* DataID Low Part */ ;
      
      temp_converttoqword = interpretAsQword (Odometry_array_pose2D_positionX[j]);
      temp_64bit_low  = temp_converttoqword     & 0x00000000FFFFFFFF;
      temp_64bit_high = temp_converttoqword>>32 & 0x00000000FFFFFFFF;
      
      Odometry_payload_buffer_pose2D[payload_counter++] = temp_64bit_high>>24 & 0xFF;
      Odometry_payload_buffer_pose2D[payload_counter++] = temp_64bit_high>>16 & 0xFF;
      Odometry_payload_buffer_pose2D[payload_counter++] = temp_64bit_high>> 8 & 0xFF;
      Odometry_payload_buffer_pose2D[payload_counter++] = temp_64bit_high     & 0xFF;
      Odometry_payload_buffer_pose2D[payload_counter++] = temp_64bit_low>>24  & 0xFF;
      Odometry_payload_buffer_pose2D[payload_counter++] = temp_64bit_low>>16  & 0xFF;
      Odometry_payload_buffer_pose2D[payload_counter++] = temp_64bit_low>> 8  & 0xFF;
      Odometry_payload_buffer_pose2D[payload_counter++] = temp_64bit_low      & 0xFF;
    }
    
    
    // 2 positionY (double64)
    if (Odometry_array_pose2D_positionY_available[j] == 1)
    {
      tag_dataID = 2;
      Odometry_payload_buffer_pose2D[payload_counter++] = 3 * 16 /* Wiretype = 3  =^ 64 Bit */ + ((tag_dataID>>8) & 0x0F) /* DataID High Part */ ;
      Odometry_payload_buffer_pose2D[payload_counter++] = tag_dataID & 0xFF /* DataID Low Part */ ;
      
      temp_converttoqword = interpretAsQword (Odometry_array_pose2D_positionY[j]);
      temp_64bit_low  = temp_converttoqword     & 0x00000000FFFFFFFF;
      temp_64bit_high = temp_converttoqword>>32 & 0x00000000FFFFFFFF;
      Odometry_payload_buffer_pose2D[payload_counter++] = temp_64bit_high>>24 & 0xFF;
      Odometry_payload_buffer_pose2D[payload_counter++] = temp_64bit_high>>16 & 0xFF;
      Odometry_payload_buffer_pose2D[payload_counter++] = temp_64bit_high>> 8 & 0xFF;
      Odometry_payload_buffer_pose2D[payload_counter++] = temp_64bit_high     & 0xFF;
      Odometry_payload_buffer_pose2D[payload_counter++] = temp_64bit_low>>24  & 0xFF;
      Odometry_payload_buffer_pose2D[payload_counter++] = temp_64bit_low>>16  & 0xFF;
      Odometry_payload_buffer_pose2D[payload_counter++] = temp_64bit_low>> 8  & 0xFF;
      Odometry_payload_buffer_pose2D[payload_counter++] = temp_64bit_low      & 0xFF;
    }
    
    
    // 3 yawAngle (float32)
    if (Odometry_array_pose2D_yawAngle_available[j] == 1)
    {
      tag_dataID = 3;
      Odometry_payload_buffer_pose2D[payload_counter++] = 2 * 16 /* Wiretype = 2  =^ 32 Bit */ + ((tag_dataID>>8) & 0x0F) /* DataID High Part */ ;
      Odometry_payload_buffer_pose2D[payload_counter++] = tag_dataID & 0xFF /* DataID Low Part */ ;
      
      temp_converttodword = interpretAsDword (Odometry_array_pose2D_yawAngle[j]);
      Odometry_payload_buffer_pose2D[payload_counter++] = temp_converttodword>>24 & 0xFF;
      Odometry_payload_buffer_pose2D[payload_counter++] = temp_converttodword>>16 & 0xFF;
      Odometry_payload_buffer_pose2D[payload_counter++] = temp_converttodword>> 8 & 0xFF;
      Odometry_payload_buffer_pose2D[payload_counter++] = temp_converttodword     & 0xFF;
    }
    
    
    // 4 positionXVariance (float32)
    if (Odometry_array_pose2D_positionXVariance_available[j] == 1)
    {
      tag_dataID = 4;
      Odometry_payload_buffer_pose2D[payload_counter++] = 2 * 16 /* Wiretype = 2  =^ 32 Bit */ + ((tag_dataID>>8) & 0x0F) /* DataID High Part */ ;
      Odometry_payload_buffer_pose2D[payload_counter++] = tag_dataID & 0xFF /* DataID Low Part */ ;
      
      temp_converttodword = interpretAsDword (Odometry_array_pose2D_positionXVariance[j]);
      Odometry_payload_buffer_pose2D[payload_counter++] = temp_converttodword>>24 & 0xFF;
      Odometry_payload_buffer_pose2D[payload_counter++] = temp_converttodword>>16 & 0xFF;
      Odometry_payload_buffer_pose2D[payload_counter++] = temp_converttodword>> 8 & 0xFF;
      Odometry_payload_buffer_pose2D[payload_counter++] = temp_converttodword     & 0xFF;
    }
    
    
    // 5 positionYVariance (float32)
    if (Odometry_array_pose2D_positionYVariance_available[j] == 1)
    {
      tag_dataID = 5;
      Odometry_payload_buffer_pose2D[payload_counter++] = 2 * 16 /* Wiretype = 2  =^ 32 Bit */ + ((tag_dataID>>8) & 0x0F) /* DataID High Part */ ;
      Odometry_payload_buffer_pose2D[payload_counter++] = tag_dataID & 0xFF /* DataID Low Part */ ;
      
      temp_converttodword = interpretAsDword (Odometry_array_pose2D_positionYVariance[j]);
      Odometry_payload_buffer_pose2D[payload_counter++] = temp_converttodword>>24 & 0xFF;
      Odometry_payload_buffer_pose2D[payload_counter++] = temp_converttodword>>16 & 0xFF;
      Odometry_payload_buffer_pose2D[payload_counter++] = temp_converttodword>> 8 & 0xFF;
      Odometry_payload_buffer_pose2D[payload_counter++] = temp_converttodword     & 0xFF;
    }
    
    
    // 6 yawAngleVariance (float32)
    if (Odometry_array_pose2D_yawAngleVariance_available[j] == 1)
    {
      tag_dataID = 6;
      Odometry_payload_buffer_pose2D[payload_counter++] = 2 * 16 /* Wiretype = 2  =^ 32 Bit */ + ((tag_dataID>>8) & 0x0F) /* DataID High Part */ ;
      Odometry_payload_buffer_pose2D[payload_counter++] = tag_dataID & 0xFF /* DataID Low Part */ ;
      
      temp_converttodword = interpretAsDword (Odometry_array_pose2D_yawAngleVariance[j]);
      Odometry_payload_buffer_pose2D[payload_counter++] = temp_converttodword>>24 & 0xFF;
      Odometry_payload_buffer_pose2D[payload_counter++] = temp_converttodword>>16 & 0xFF;
      Odometry_payload_buffer_pose2D[payload_counter++] = temp_converttodword>> 8 & 0xFF;
      Odometry_payload_buffer_pose2D[payload_counter++] = temp_converttodword     & 0xFF;
    }
    
    
    // 7 pose2dConfidence (enum32)
    if (Odometry_array_pose2D_pose2dConfidence_available[j] == 1)
    {
      tag_dataID = 7;
      Odometry_payload_buffer_pose2D[payload_counter++] = 2 * 16 /* Wiretype = 2  =^ 32 Bit */ + ((tag_dataID>>8) & 0x0F) /* DataID High Part */ ;
      Odometry_payload_buffer_pose2D[payload_counter++] = tag_dataID & 0xFF /* DataID Low Part */ ;
      
      Odometry_payload_buffer_pose2D[payload_counter++] = Odometry_array_pose2D_pose2dConfidence[j]>>24 & 0xFF;
      Odometry_payload_buffer_pose2D[payload_counter++] = Odometry_array_pose2D_pose2dConfidence[j]>>16 & 0xFF;
      Odometry_payload_buffer_pose2D[payload_counter++] = Odometry_array_pose2D_pose2dConfidence[j]>> 8 & 0xFF;
      Odometry_payload_buffer_pose2D[payload_counter++] = Odometry_array_pose2D_pose2dConfidence[j]     & 0xFF;
    }
    
    //Element Length
    element_length = payload_counter-start_pos;
    if (element_length >0) Odometry_array_pose2D_array_element_length[j] = element_length - 4;
    else                   Odometry_array_pose2D_array_element_length[j] = element_length;
    
    Odometry_payload_buffer_pose2D[start_pos++] = Odometry_array_pose2D_array_element_length[j]>>24 & 0xFF;
    Odometry_payload_buffer_pose2D[start_pos++] = Odometry_array_pose2D_array_element_length[j]>>16 & 0xFF;
    Odometry_payload_buffer_pose2D[start_pos++] = Odometry_array_pose2D_array_element_length[j]>> 8 & 0xFF;
    Odometry_payload_buffer_pose2D[start_pos++] = Odometry_array_pose2D_array_element_length[j]     & 0xFF;
    
    if (Odometry_array_pose2D_array_element_length[j] == 0) payload_counter = payload_counter+4;
  }
  
  // Struct Length
  Odometry_array_pose2D_struct_element_length = 4*@Odometry_Notification_pose2D_Element_TotalNum;

  for (k=0;k<@Odometry_Notification_pose2D_Element_TotalNum;k++)
   Odometry_array_pose2D_struct_element_length = Odometry_array_pose2D_struct_element_length + Odometry_array_pose2D_array_element_length[k];
  
  Odometry_payload_buffer_pose2D[0] = Odometry_array_pose2D_struct_element_length>>24 & 0xFF;
  Odometry_payload_buffer_pose2D[1] = Odometry_array_pose2D_struct_element_length>>16 & 0xFF;
  Odometry_payload_buffer_pose2D[2] = Odometry_array_pose2D_struct_element_length>> 8 & 0xFF;
  Odometry_payload_buffer_pose2D[3] = Odometry_array_pose2D_struct_element_length     & 0xFF;


  Odometry_payload_length_pose2D = Odometry_array_pose2D_struct_element_length+4;
  putvalue(Odometry_Notification_pose2D_Payload, Odometry_payload_buffer_pose2D, Odometry_payload_length_pose2D);
}

on envVar Odometry_Notification_pose2D_Element_TotalNum
{
  if (@this == 0) @this =  1;
  if (@this > 10) @this = 10;
  
  Odometry_Notification_pose2D();
  Odometry_Notification_pose2D_update();
}

on envVar Odometry_Notification_pose2D_Element
{
  Odometry_Notification_pose2D_update();
}

on envVar Odometry_Notification_pose2D_Element_Next
{
  if (@this == 1 && @Odometry_Notification_pose2D_Element < @Odometry_Notification_pose2D_Element_TotalNum - 1)
  {
    @Odometry_Notification_pose2D_Element = @Odometry_Notification_pose2D_Element + 1;
    Odometry_Notification_pose2D_update();
  }
}

on envVar Odometry_Notification_pose2D_Element_Previous
{
  if (@this == 1 && @Odometry_Notification_pose2D_Element > 0)
  {
    @Odometry_Notification_pose2D_Element = @Odometry_Notification_pose2D_Element - 1;
    Odometry_Notification_pose2D_update();
  }
}

Odometry_Notification_pose2D_update()
{
  @Odometry_Notification_LengthIndicator_Element_pose2D = Odometry_array_pose2D_array_element_length[@Odometry_Notification_pose2D_Element];
  @Odometry_Notification_LengthIndicator_Struct_pose2D  = Odometry_array_pose2D_struct_element_length;
  @Odometry_Notification_Length_pose2D                  = Odometry_payload_length_pose2D+8;
  
  @Odometry_Notification_pose2D_timestamp         = Odometry_array_pose2D_timestamp[@Odometry_Notification_pose2D_Element];
  @Odometry_Notification_pose2D_positionX         = Odometry_array_pose2D_positionX[@Odometry_Notification_pose2D_Element];
  @Odometry_Notification_pose2D_positionY         = Odometry_array_pose2D_positionY[@Odometry_Notification_pose2D_Element];
  @Odometry_Notification_pose2D_yawAngle          = Odometry_array_pose2D_yawAngle[@Odometry_Notification_pose2D_Element];
  @Odometry_Notification_pose2D_positionXVariance = Odometry_array_pose2D_positionXVariance[@Odometry_Notification_pose2D_Element];
  @Odometry_Notification_pose2D_positionYVariance = Odometry_array_pose2D_positionYVariance[@Odometry_Notification_pose2D_Element];
  @Odometry_Notification_pose2D_yawAngleVariance  = Odometry_array_pose2D_yawAngleVariance[@Odometry_Notification_pose2D_Element];
  @Odometry_Notification_pose2D_pose2dConfidence  = Odometry_array_pose2D_pose2dConfidence[@Odometry_Notification_pose2D_Element];
  
  @Odometry_Notification_pose2D_timestamp_available         = Odometry_array_pose2D_timestamp_available[@Odometry_Notification_pose2D_Element];
  @Odometry_Notification_pose2D_positionX_available         = Odometry_array_pose2D_positionX_available[@Odometry_Notification_pose2D_Element];
  @Odometry_Notification_pose2D_positionY_available         = Odometry_array_pose2D_positionY_available[@Odometry_Notification_pose2D_Element];
  @Odometry_Notification_pose2D_yawAngle_available          = Odometry_array_pose2D_yawAngle_available[@Odometry_Notification_pose2D_Element];
  @Odometry_Notification_pose2D_positionXVariance_available = Odometry_array_pose2D_positionXVariance_available[@Odometry_Notification_pose2D_Element];
  @Odometry_Notification_pose2D_positionYVariance_available = Odometry_array_pose2D_positionYVariance_available[@Odometry_Notification_pose2D_Element];
  @Odometry_Notification_pose2D_yawAngleVariance_available  = Odometry_array_pose2D_yawAngleVariance_available[@Odometry_Notification_pose2D_Element];
  @Odometry_Notification_pose2D_pose2dConfidence_available  = Odometry_array_pose2D_pose2dConfidence_available[@Odometry_Notification_pose2D_Element];
}








////////// additionalVehicleMotionInformations Notification //////////

on envVar Odometry_Notification_LengthIndicator_Struct_additionalVehicleMotionInformations
{
  Odometry_Notification_additionalVehicleMotionInformations();
}
on envVar Odometry_Notification_LengthIndicator_Element_additionalVehicleMotionInformations
{
  Odometry_Notification_additionalVehicleMotionInformations();
}
on envVar Odometry_Notification_additionalVehicleMotionInformations_timestamp
{
  Odometry_array_additionalVehicleMotionInformations_timestamp[@Odometry_Notification_additionalVehicleMotionInformations_Element] = @this;
  Odometry_Notification_additionalVehicleMotionInformations();
}
on envVar Odometry_Notification_additionalVehicleMotionInformations_drivingDirectionProbabilityRange
{
  Odometry_array_additionalVehicleMotionInformations_drivingDirectionProbabilityRange[@Odometry_Notification_additionalVehicleMotionInformations_Element] = @this;
  Odometry_Notification_additionalVehicleMotionInformations();
}
on envVar Odometry_Notification_additionalVehicleMotionInformations_drivingDirectionProbabilityRangeConfidence
{
  Odometry_array_additionalVehicleMotionInformations_drivingDirectionProbabilityRangeConfidence[@Odometry_Notification_additionalVehicleMotionInformations_Element] = @this;
  Odometry_Notification_additionalVehicleMotionInformations();
}
on envVar Odometry_Notification_additionalVehicleMotionInformations_standStillProbabilityRange
{
  Odometry_array_additionalVehicleMotionInformations_standStillProbabilityRange[@Odometry_Notification_additionalVehicleMotionInformations_Element] = @this;
  Odometry_Notification_additionalVehicleMotionInformations();
}
on envVar Odometry_Notification_additionalVehicleMotionInformations_standStillProbabilityRangeConfidence
{
  Odometry_array_additionalVehicleMotionInformations_standStillProbabilityRangeConfidence[@Odometry_Notification_additionalVehicleMotionInformations_Element] = @this;
  Odometry_Notification_additionalVehicleMotionInformations();
}
on envVar Odometry_Notification_additionalVehicleMotionInformations_timestamp_available
{
  Odometry_array_additionalVehicleMotionInformations_timestamp_available[@Odometry_Notification_additionalVehicleMotionInformations_Element] = @this;
  Odometry_Notification_additionalVehicleMotionInformations();
}
on envVar Odometry_Notification_additionalVehicleMotionInformations_drivingDirectionProbabilityRange_available
{
  Odometry_array_additionalVehicleMotionInformations_drivingDirectionProbabilityRange_available[@Odometry_Notification_additionalVehicleMotionInformations_Element] = @this;
  Odometry_Notification_additionalVehicleMotionInformations();
}
on envVar Odometry_Notification_additionalVehicleMotionInformations_drivingDirectionProbabilityRangeConfidence_available
{
  Odometry_array_additionalVehicleMotionInformations_drivingDirectionProbabilityRangeConfidence_available[@Odometry_Notification_additionalVehicleMotionInformations_Element] = @this;
  Odometry_Notification_additionalVehicleMotionInformations();
}
on envVar Odometry_Notification_additionalVehicleMotionInformations_standStillProbabilityRange_available
{
  Odometry_array_additionalVehicleMotionInformations_standStillProbabilityRange_available[@Odometry_Notification_additionalVehicleMotionInformations_Element] = @this;
  Odometry_Notification_additionalVehicleMotionInformations();
}
on envVar Odometry_Notification_additionalVehicleMotionInformations_standStillProbabilityRangeConfidence_available
{
  Odometry_array_additionalVehicleMotionInformations_standStillProbabilityRangeConfidence_available[@Odometry_Notification_additionalVehicleMotionInformations_Element] = @this;
  Odometry_Notification_additionalVehicleMotionInformations();
}
on envVar Odometry_Notification_additionalVehicleMotionInformations_Payload
{
  Odometry_Notification_additionalVehicleMotionInformations_update();
}


Odometry_Notification_additionalVehicleMotionInformations()
{
  word payload_counter = 0;
  word start_pos       = 0;
  word element_length  = 0;
  
  // Length Indicator Struct - Platzhalter
  payload_counter = 0+4;
  start_pos = 0;
  
  for (j=0; j<@Odometry_Notification_additionalVehicleMotionInformations_Element_TotalNum; j++)
  {
    Odometry_array_additionalVehicleMotionInformations_available_functions[j] = Odometry_array_additionalVehicleMotionInformations_timestamp_available[j]
                                                                              + Odometry_array_additionalVehicleMotionInformations_drivingDirectionProbabilityRange_available[j]
                                                                              + Odometry_array_additionalVehicleMotionInformations_drivingDirectionProbabilityRangeConfidence_available[j]
                                                                              + Odometry_array_additionalVehicleMotionInformations_standStillProbabilityRange_available[j]
                                                                              + Odometry_array_additionalVehicleMotionInformations_standStillProbabilityRangeConfidence_available[j];
    
    // Length Indicator Element - Platzhalter
    if (Odometry_array_additionalVehicleMotionInformations_available_functions[j] > 0)
    {
      start_pos = payload_counter;
      payload_counter = payload_counter + 4;
    }
    else 
      start_pos = payload_counter;
    
    
    // 0 timestamp (uint64)
    if (Odometry_array_additionalVehicleMotionInformations_timestamp_available[j] == 1)
    {
      tag_dataID = 0;
      Odometry_payload_buffer_additionalVehicleMotionInformations[payload_counter++] = 3 * 16 /* Wiretype = 3  =^ 64 Bit */ + ((tag_dataID>>8) & 0x0F) /* DataID High Part */ ;
      Odometry_payload_buffer_additionalVehicleMotionInformations[payload_counter++] = tag_dataID & 0xFF /* DataID Low Part */ ;
      
      temp_64bit_low  = Odometry_array_additionalVehicleMotionInformations_timestamp[j]     & 0x00000000FFFFFFFF;
      temp_64bit_high = Odometry_array_additionalVehicleMotionInformations_timestamp[j]>>32 & 0x00000000FFFFFFFF;
      
      Odometry_payload_buffer_additionalVehicleMotionInformations[payload_counter++] = temp_64bit_high>>24 & 0xFF;
      Odometry_payload_buffer_additionalVehicleMotionInformations[payload_counter++] = temp_64bit_high>>16 & 0xFF;
      Odometry_payload_buffer_additionalVehicleMotionInformations[payload_counter++] = temp_64bit_high>> 8 & 0xFF;
      Odometry_payload_buffer_additionalVehicleMotionInformations[payload_counter++] = temp_64bit_high     & 0xFF;
      Odometry_payload_buffer_additionalVehicleMotionInformations[payload_counter++] = temp_64bit_low>>24  & 0xFF;
      Odometry_payload_buffer_additionalVehicleMotionInformations[payload_counter++] = temp_64bit_low>>16  & 0xFF;
      Odometry_payload_buffer_additionalVehicleMotionInformations[payload_counter++] = temp_64bit_low>> 8  & 0xFF;
      Odometry_payload_buffer_additionalVehicleMotionInformations[payload_counter++] = temp_64bit_low      & 0xFF;
    }
    
    
    // 1 drivingDirectionProbabilityRange (float32)
    if (Odometry_array_additionalVehicleMotionInformations_drivingDirectionProbabilityRange_available[j] == 1)
    {
      tag_dataID = 1;
      Odometry_payload_buffer_additionalVehicleMotionInformations[payload_counter++] = 2 * 16 /* Wiretype = 2  =^ 32 Bit */ + ((tag_dataID>>8) & 0x0F) /* DataID High Part */ ;
      Odometry_payload_buffer_additionalVehicleMotionInformations[payload_counter++] = tag_dataID & 0xFF /* DataID Low Part */ ;
      
      temp_converttodword = interpretAsDword (Odometry_array_additionalVehicleMotionInformations_drivingDirectionProbabilityRange[j]);
      Odometry_payload_buffer_additionalVehicleMotionInformations[payload_counter++] = temp_converttodword>>24 & 0xFF;
      Odometry_payload_buffer_additionalVehicleMotionInformations[payload_counter++] = temp_converttodword>>16 & 0xFF;
      Odometry_payload_buffer_additionalVehicleMotionInformations[payload_counter++] = temp_converttodword>> 8 & 0xFF;
      Odometry_payload_buffer_additionalVehicleMotionInformations[payload_counter++] = temp_converttodword     & 0xFF;
    }
    
    
    // 2 drivingDirectionProbabilityRangeConfidence (enum32)
    if (Odometry_array_additionalVehicleMotionInformations_drivingDirectionProbabilityRangeConfidence_available[j] == 1)
    {
      tag_dataID = 2;
      Odometry_payload_buffer_additionalVehicleMotionInformations[payload_counter++] = 2 * 16 /* Wiretype = 2  =^ 32 Bit */ + ((tag_dataID>>8) & 0x0F) /* DataID High Part */ ;
      Odometry_payload_buffer_additionalVehicleMotionInformations[payload_counter++] = tag_dataID & 0xFF /* DataID Low Part */ ;
      
      Odometry_payload_buffer_additionalVehicleMotionInformations[payload_counter++] = Odometry_array_additionalVehicleMotionInformations_drivingDirectionProbabilityRangeConfidence[j]>>24 & 0xFF;
      Odometry_payload_buffer_additionalVehicleMotionInformations[payload_counter++] = Odometry_array_additionalVehicleMotionInformations_drivingDirectionProbabilityRangeConfidence[j]>>16 & 0xFF;
      Odometry_payload_buffer_additionalVehicleMotionInformations[payload_counter++] = Odometry_array_additionalVehicleMotionInformations_drivingDirectionProbabilityRangeConfidence[j]>> 8 & 0xFF;
      Odometry_payload_buffer_additionalVehicleMotionInformations[payload_counter++] = Odometry_array_additionalVehicleMotionInformations_drivingDirectionProbabilityRangeConfidence[j]     & 0xFF;
    }
    
    
    // 3 standStillProbabilityRange (float32)
    if (Odometry_array_additionalVehicleMotionInformations_standStillProbabilityRange_available[j] == 1)
    {
      tag_dataID = 3;
      Odometry_payload_buffer_additionalVehicleMotionInformations[payload_counter++] = 2 * 16 /* Wiretype = 2  =^ 32 Bit */ + ((tag_dataID>>8) & 0x0F) /* DataID High Part */ ;
      Odometry_payload_buffer_additionalVehicleMotionInformations[payload_counter++] = tag_dataID & 0xFF /* DataID Low Part */ ;
      
      temp_converttodword = interpretAsDword (Odometry_array_additionalVehicleMotionInformations_standStillProbabilityRange[j]);
      Odometry_payload_buffer_additionalVehicleMotionInformations[payload_counter++] = temp_converttodword>>24 & 0xFF;
      Odometry_payload_buffer_additionalVehicleMotionInformations[payload_counter++] = temp_converttodword>>16 & 0xFF;
      Odometry_payload_buffer_additionalVehicleMotionInformations[payload_counter++] = temp_converttodword>> 8 & 0xFF;
      Odometry_payload_buffer_additionalVehicleMotionInformations[payload_counter++] = temp_converttodword     & 0xFF;
    }
    
    
    // 4 standStillProbabilityRangeConfidence (enum32)
    if (Odometry_array_additionalVehicleMotionInformations_standStillProbabilityRangeConfidence_available[j] == 1)
    {
      tag_dataID = 4;
      Odometry_payload_buffer_additionalVehicleMotionInformations[payload_counter++] = 2 * 16 /* Wiretype = 2  =^ 32 Bit */ + ((tag_dataID>>8) & 0x0F) /* DataID High Part */ ;
      Odometry_payload_buffer_additionalVehicleMotionInformations[payload_counter++] = tag_dataID & 0xFF /* DataID Low Part */ ;
      
      Odometry_payload_buffer_additionalVehicleMotionInformations[payload_counter++] = Odometry_array_additionalVehicleMotionInformations_standStillProbabilityRangeConfidence[j]>>24 & 0xFF;
      Odometry_payload_buffer_additionalVehicleMotionInformations[payload_counter++] = Odometry_array_additionalVehicleMotionInformations_standStillProbabilityRangeConfidence[j]>>16 & 0xFF;
      Odometry_payload_buffer_additionalVehicleMotionInformations[payload_counter++] = Odometry_array_additionalVehicleMotionInformations_standStillProbabilityRangeConfidence[j]>> 8 & 0xFF;
      Odometry_payload_buffer_additionalVehicleMotionInformations[payload_counter++] = Odometry_array_additionalVehicleMotionInformations_standStillProbabilityRangeConfidence[j]     & 0xFF;
    }
    
    //Element Length
    element_length = payload_counter-start_pos;
    if (element_length >0) Odometry_array_additionalVehicleMotionInformations_array_element_length[j] = element_length - 4;
    else                   Odometry_array_additionalVehicleMotionInformations_array_element_length[j] = element_length;
    
    Odometry_payload_buffer_additionalVehicleMotionInformations[start_pos++] = Odometry_array_additionalVehicleMotionInformations_array_element_length[j]>>24 & 0xFF;
    Odometry_payload_buffer_additionalVehicleMotionInformations[start_pos++] = Odometry_array_additionalVehicleMotionInformations_array_element_length[j]>>16 & 0xFF;
    Odometry_payload_buffer_additionalVehicleMotionInformations[start_pos++] = Odometry_array_additionalVehicleMotionInformations_array_element_length[j]>> 8 & 0xFF;
    Odometry_payload_buffer_additionalVehicleMotionInformations[start_pos++] = Odometry_array_additionalVehicleMotionInformations_array_element_length[j]     & 0xFF;
    
    if (Odometry_array_additionalVehicleMotionInformations_array_element_length[j] == 0) payload_counter = payload_counter+4;
  }
  
  // Struct Length
  Odometry_array_additionalVehicleMotionInformations_struct_element_length = 4*@Odometry_Notification_additionalVehicleMotionInformations_Element_TotalNum;

  for (k=0;k<@Odometry_Notification_additionalVehicleMotionInformations_Element_TotalNum;k++)
   Odometry_array_additionalVehicleMotionInformations_struct_element_length = Odometry_array_additionalVehicleMotionInformations_struct_element_length + Odometry_array_additionalVehicleMotionInformations_array_element_length[k];
  
  Odometry_payload_buffer_additionalVehicleMotionInformations[0] = Odometry_array_additionalVehicleMotionInformations_struct_element_length>>24 & 0xFF;
  Odometry_payload_buffer_additionalVehicleMotionInformations[1] = Odometry_array_additionalVehicleMotionInformations_struct_element_length>>16 & 0xFF;
  Odometry_payload_buffer_additionalVehicleMotionInformations[2] = Odometry_array_additionalVehicleMotionInformations_struct_element_length>> 8 & 0xFF;
  Odometry_payload_buffer_additionalVehicleMotionInformations[3] = Odometry_array_additionalVehicleMotionInformations_struct_element_length     & 0xFF;


  Odometry_payload_length_additionalVehicleMotionInformations = Odometry_array_additionalVehicleMotionInformations_struct_element_length+4;
  putvalue(Odometry_Notification_additionalVehicleMotionInformations_Payload, Odometry_payload_buffer_additionalVehicleMotionInformations, Odometry_payload_length_additionalVehicleMotionInformations);
}

on envVar Odometry_Notification_additionalVehicleMotionInformations_Element_TotalNum
{
  if (@this == 0) @this =  1;
  if (@this > 10) @this = 10;
  
  Odometry_Notification_additionalVehicleMotionInformations();
  Odometry_Notification_additionalVehicleMotionInformations_update();
}

on envVar Odometry_Notification_additionalVehicleMotionInformations_Element
{
  Odometry_Notification_additionalVehicleMotionInformations_update();
}

on envVar Odometry_Notification_additionalVehicleMotionInformations_Element_Next
{
  if (@this == 1 && @Odometry_Notification_additionalVehicleMotionInformations_Element < @Odometry_Notification_additionalVehicleMotionInformations_Element_TotalNum - 1)
  {
    @Odometry_Notification_additionalVehicleMotionInformations_Element = @Odometry_Notification_additionalVehicleMotionInformations_Element + 1;
    Odometry_Notification_additionalVehicleMotionInformations_update();
  }
}

on envVar Odometry_Notification_additionalVehicleMotionInformations_Element_Previous
{
  if (@this == 1 && @Odometry_Notification_additionalVehicleMotionInformations_Element > 0)
  {
    @Odometry_Notification_additionalVehicleMotionInformations_Element = @Odometry_Notification_additionalVehicleMotionInformations_Element - 1;
    Odometry_Notification_additionalVehicleMotionInformations_update();
  }
}

Odometry_Notification_additionalVehicleMotionInformations_update()
{
  @Odometry_Notification_LengthIndicator_Element_additionalVehicleMotionInformations = Odometry_array_additionalVehicleMotionInformations_array_element_length[@Odometry_Notification_additionalVehicleMotionInformations_Element];
  @Odometry_Notification_LengthIndicator_Struct_additionalVehicleMotionInformations  = Odometry_array_additionalVehicleMotionInformations_struct_element_length;
  @Odometry_Notification_Length_additionalVehicleMotionInformations                  = Odometry_payload_length_additionalVehicleMotionInformations+8;
  
  @Odometry_Notification_additionalVehicleMotionInformations_timestamp                                  = Odometry_array_additionalVehicleMotionInformations_timestamp[@Odometry_Notification_additionalVehicleMotionInformations_Element];
  @Odometry_Notification_additionalVehicleMotionInformations_drivingDirectionProbabilityRange           = Odometry_array_additionalVehicleMotionInformations_drivingDirectionProbabilityRange[@Odometry_Notification_additionalVehicleMotionInformations_Element];
  @Odometry_Notification_additionalVehicleMotionInformations_drivingDirectionProbabilityRangeConfidence = Odometry_array_additionalVehicleMotionInformations_drivingDirectionProbabilityRangeConfidence[@Odometry_Notification_additionalVehicleMotionInformations_Element];
  @Odometry_Notification_additionalVehicleMotionInformations_standStillProbabilityRange                 = Odometry_array_additionalVehicleMotionInformations_standStillProbabilityRange[@Odometry_Notification_additionalVehicleMotionInformations_Element];
  @Odometry_Notification_additionalVehicleMotionInformations_standStillProbabilityRangeConfidence       = Odometry_array_additionalVehicleMotionInformations_standStillProbabilityRangeConfidence[@Odometry_Notification_additionalVehicleMotionInformations_Element];
  
  @Odometry_Notification_additionalVehicleMotionInformations_timestamp_available                                  = Odometry_array_additionalVehicleMotionInformations_timestamp_available[@Odometry_Notification_additionalVehicleMotionInformations_Element];
  @Odometry_Notification_additionalVehicleMotionInformations_drivingDirectionProbabilityRange_available           = Odometry_array_additionalVehicleMotionInformations_drivingDirectionProbabilityRange_available[@Odometry_Notification_additionalVehicleMotionInformations_Element];
  @Odometry_Notification_additionalVehicleMotionInformations_drivingDirectionProbabilityRangeConfidence_available = Odometry_array_additionalVehicleMotionInformations_drivingDirectionProbabilityRangeConfidence_available[@Odometry_Notification_additionalVehicleMotionInformations_Element];
  @Odometry_Notification_additionalVehicleMotionInformations_standStillProbabilityRange_available                 = Odometry_array_additionalVehicleMotionInformations_standStillProbabilityRange_available[@Odometry_Notification_additionalVehicleMotionInformations_Element];
  @Odometry_Notification_additionalVehicleMotionInformations_standStillProbabilityRangeConfidence_available       = Odometry_array_additionalVehicleMotionInformations_standStillProbabilityRangeConfidence_available[@Odometry_Notification_additionalVehicleMotionInformations_Element];
}








////////// wheelCorrections Notification //////////

on envVar Odometry_Notification_LengthIndicator_Struct_wheelCorrections
{
  Odometry_Notification_wheelCorrections();
}
on envVar Odometry_Notification_LengthIndicator_Element_wheelCorrections
{
  Odometry_Notification_wheelCorrections();
}
on envVar Odometry_Notification_wheelCorrections_timestamp
{
  Odometry_array_wheelCorrections_timestamp[@Odometry_Notification_wheelCorrections_Element] = @this;
  Odometry_Notification_wheelCorrections();
}
on envVar Odometry_Notification_wheelCorrections_wheelCorrectionFactorFrontLeft
{
  Odometry_array_wheelCorrections_wheelCorrectionFactorFrontLeft[@Odometry_Notification_wheelCorrections_Element] = @this;
  Odometry_Notification_wheelCorrections();
}
on envVar Odometry_Notification_wheelCorrections_wheelCorrectionFactorFrontRight
{
  Odometry_array_wheelCorrections_wheelCorrectionFactorFrontRight[@Odometry_Notification_wheelCorrections_Element] = @this;
  Odometry_Notification_wheelCorrections();
}
on envVar Odometry_Notification_wheelCorrections_wheelCorrectionFactorRearLeft
{
  Odometry_array_wheelCorrections_wheelCorrectionFactorRearLeft[@Odometry_Notification_wheelCorrections_Element] = @this;
  Odometry_Notification_wheelCorrections();
}
on envVar Odometry_Notification_wheelCorrections_wheelCorrectionFactorRearRight
{
  Odometry_array_wheelCorrections_wheelCorrectionFactorRearRight[@Odometry_Notification_wheelCorrections_Element] = @this;
  Odometry_Notification_wheelCorrections();
}
on envVar Odometry_Notification_wheelCorrections_wheelCorrectionFactorEstimatorStatus
{
  Odometry_array_wheelCorrections_wheelCorrectionFactorEstimatorStatus[@Odometry_Notification_wheelCorrections_Element] = @this;
  Odometry_Notification_wheelCorrections();
}
on envVar Odometry_Notification_wheelCorrections_wheelCorrectionFactorEstimatorStatusConfidence
{
  Odometry_array_wheelCorrections_wheelCorrectionFactorEstimatorStatusConfidence[@Odometry_Notification_wheelCorrections_Element] = @this;
  Odometry_Notification_wheelCorrections();
}
on envVar Odometry_Notification_wheelCorrections_wheelCorrectionFactorFrontLeftConfidence
{
  Odometry_array_wheelCorrections_wheelCorrectionFactorFrontLeftConfidence[@Odometry_Notification_wheelCorrections_Element] = @this;
  Odometry_Notification_wheelCorrections();
}
on envVar Odometry_Notification_wheelCorrections_wheelCorrectionFactorFrontRightConfidence
{
  Odometry_array_wheelCorrections_wheelCorrectionFactorFrontRightConfidence[@Odometry_Notification_wheelCorrections_Element] = @this;
  Odometry_Notification_wheelCorrections();
}
on envVar Odometry_Notification_wheelCorrections_wheelCorrectionFactoRearLeftConfidence
{
  Odometry_array_wheelCorrections_wheelCorrectionFactoRearLeftConfidence[@Odometry_Notification_wheelCorrections_Element] = @this;
  Odometry_Notification_wheelCorrections();
}
on envVar Odometry_Notification_wheelCorrections_wheelCorrectionFactoRearRightConfidence
{
  Odometry_array_wheelCorrections_wheelCorrectionFactoRearRightConfidence[@Odometry_Notification_wheelCorrections_Element] = @this;
  Odometry_Notification_wheelCorrections();
}
on envVar Odometry_Notification_wheelCorrections_wheelCircumferenceStatic
{
  Odometry_array_wheelCorrections_wheelCircumferenceStatic[@Odometry_Notification_wheelCorrections_Element] = @this;
  Odometry_Notification_wheelCorrections();
}
on envVar Odometry_Notification_wheelCorrections_wheelCircumferenceStaticConfidence
{
  Odometry_array_wheelCorrections_wheelCircumferenceStaticConfidence[@Odometry_Notification_wheelCorrections_Element] = @this;
  Odometry_Notification_wheelCorrections();
}
on envVar Odometry_Notification_wheelCorrections_timestamp_available
{
  Odometry_array_wheelCorrections_timestamp_available[@Odometry_Notification_wheelCorrections_Element] = @this;
  Odometry_Notification_wheelCorrections();
}
on envVar Odometry_Notification_wheelCorrections_wheelCorrectionFactorFrontLeft_available
{
  Odometry_array_wheelCorrections_wheelCorrectionFactorFrontLeft_available[@Odometry_Notification_wheelCorrections_Element] = @this;
  Odometry_Notification_wheelCorrections();
}
on envVar Odometry_Notification_wheelCorrections_wheelCorrectionFactorFrontRight_available
{
  Odometry_array_wheelCorrections_wheelCorrectionFactorFrontRight_available[@Odometry_Notification_wheelCorrections_Element] = @this;
  Odometry_Notification_wheelCorrections();
}
on envVar Odometry_Notification_wheelCorrections_wheelCorrectionFactorRearLeft_available
{
  Odometry_array_wheelCorrections_wheelCorrectionFactorRearLeft_available[@Odometry_Notification_wheelCorrections_Element] = @this;
  Odometry_Notification_wheelCorrections();
}
on envVar Odometry_Notification_wheelCorrections_wheelCorrectionFactorRearRight_available
{
  Odometry_array_wheelCorrections_wheelCorrectionFactorRearRight_available[@Odometry_Notification_wheelCorrections_Element] = @this;
  Odometry_Notification_wheelCorrections();
}
on envVar Odometry_Notification_wheelCorrections_wheelCorrectionFactorEstimatorStatus_available
{
  Odometry_array_wheelCorrections_wheelCorrectionFactorEstimatorStatus_available[@Odometry_Notification_wheelCorrections_Element] = @this;
  Odometry_Notification_wheelCorrections();
}
on envVar Odometry_Notification_wheelCorrections_wheelCorrectionFactorEstimatorStatusConfidence_available
{
  Odometry_array_wheelCorrections_wheelCorrectionFactorEstimatorStatusConfidence_available[@Odometry_Notification_wheelCorrections_Element] = @this;
  Odometry_Notification_wheelCorrections();
}
on envVar Odometry_Notification_wheelCorrections_wheelCorrectionFactorFrontLeftConfidence_available
{
  Odometry_array_wheelCorrections_wheelCorrectionFactorFrontLeftConfidence_available[@Odometry_Notification_wheelCorrections_Element] = @this;
  Odometry_Notification_wheelCorrections();
}
on envVar Odometry_Notification_wheelCorrections_wheelCorrectionFactorFrontRightConfidence_available
{
  Odometry_array_wheelCorrections_wheelCorrectionFactorFrontRightConfidence_available[@Odometry_Notification_wheelCorrections_Element] = @this;
  Odometry_Notification_wheelCorrections();
}
on envVar Odometry_Notification_wheelCorrections_wheelCorrectionFactoRearLeftConfidence_available
{
  Odometry_array_wheelCorrections_wheelCorrectionFactoRearLeftConfidence_available[@Odometry_Notification_wheelCorrections_Element] = @this;
  Odometry_Notification_wheelCorrections();
}
on envVar Odometry_Notification_wheelCorrections_wheelCorrectionFactoRearRightConfidence_available
{
  Odometry_array_wheelCorrections_wheelCorrectionFactoRearRightConfidence_available[@Odometry_Notification_wheelCorrections_Element] = @this;
  Odometry_Notification_wheelCorrections();
}
on envVar Odometry_Notification_wheelCorrections_wheelCircumferenceStatic_available
{
  Odometry_array_wheelCorrections_wheelCircumferenceStatic_available[@Odometry_Notification_wheelCorrections_Element] = @this;
  Odometry_Notification_wheelCorrections();
}
on envVar Odometry_Notification_wheelCorrections_wheelCircumferenceStaticConfidence_available
{
  Odometry_array_wheelCorrections_wheelCircumferenceStaticConfidence_available[@Odometry_Notification_wheelCorrections_Element] = @this;
  Odometry_Notification_wheelCorrections();
}
on envVar Odometry_Notification_wheelCorrections_Payload
{
  Odometry_Notification_wheelCorrections_update();
}


Odometry_Notification_wheelCorrections()
{
  word payload_counter = 0;
  word start_pos       = 0;
  word element_length  = 0;
  
  // Length Indicator Struct - Platzhalter
  payload_counter = 0+4;
  start_pos = 0;
  
  for (j=0; j<@Odometry_Notification_wheelCorrections_Element_TotalNum; j++)
  {
    Odometry_array_wheelCorrections_available_functions[j] = Odometry_array_wheelCorrections_timestamp_available[j]
                                                           + Odometry_array_wheelCorrections_wheelCorrectionFactorFrontLeft_available[j]
                                                           + Odometry_array_wheelCorrections_wheelCorrectionFactorFrontRight_available[j]
                                                           + Odometry_array_wheelCorrections_wheelCorrectionFactorRearLeft_available[j]
                                                           + Odometry_array_wheelCorrections_wheelCorrectionFactorRearRight_available[j]
                                                           + Odometry_array_wheelCorrections_wheelCorrectionFactorEstimatorStatus_available[j]
                                                           + Odometry_array_wheelCorrections_wheelCorrectionFactorEstimatorStatusConfidence_available[j]
                                                           + Odometry_array_wheelCorrections_wheelCorrectionFactorFrontLeftConfidence_available[j]
                                                           + Odometry_array_wheelCorrections_wheelCorrectionFactorFrontRightConfidence_available[j]
                                                           + Odometry_array_wheelCorrections_wheelCorrectionFactoRearLeftConfidence_available[j]
                                                           + Odometry_array_wheelCorrections_wheelCorrectionFactoRearRightConfidence_available[j]
                                                           + Odometry_array_wheelCorrections_wheelCircumferenceStatic_available[j]
                                                           + Odometry_array_wheelCorrections_wheelCircumferenceStaticConfidence_available[j];
    
    // Length Indicator Element - Platzhalter
    if (Odometry_array_wheelCorrections_available_functions[j] > 0)
    {
      start_pos = payload_counter;
      payload_counter = payload_counter + 4;
    }
    else 
      start_pos = payload_counter;
    
    
    // 0 timestamp (uint64)
    if (Odometry_array_wheelCorrections_timestamp_available[j] == 1)
    {
      tag_dataID = 0;
      Odometry_payload_buffer_wheelCorrections[payload_counter++] = 3 * 16 /* Wiretype = 3  =^ 64 Bit */ + ((tag_dataID>>8) & 0x0F) /* DataID High Part */ ;
      Odometry_payload_buffer_wheelCorrections[payload_counter++] = tag_dataID & 0xFF /* DataID Low Part */ ;
      
      temp_64bit_low  = Odometry_array_wheelCorrections_timestamp[j]     & 0x00000000FFFFFFFF;
      temp_64bit_high = Odometry_array_wheelCorrections_timestamp[j]>>32 & 0x00000000FFFFFFFF;
      
      Odometry_payload_buffer_wheelCorrections[payload_counter++] = temp_64bit_high>>24 & 0xFF;
      Odometry_payload_buffer_wheelCorrections[payload_counter++] = temp_64bit_high>>16 & 0xFF;
      Odometry_payload_buffer_wheelCorrections[payload_counter++] = temp_64bit_high>> 8 & 0xFF;
      Odometry_payload_buffer_wheelCorrections[payload_counter++] = temp_64bit_high     & 0xFF;
      Odometry_payload_buffer_wheelCorrections[payload_counter++] = temp_64bit_low>>24  & 0xFF;
      Odometry_payload_buffer_wheelCorrections[payload_counter++] = temp_64bit_low>>16  & 0xFF;
      Odometry_payload_buffer_wheelCorrections[payload_counter++] = temp_64bit_low>> 8  & 0xFF;
      Odometry_payload_buffer_wheelCorrections[payload_counter++] = temp_64bit_low      & 0xFF;
    }
    
    
    // 1 wheelCorrectionFactorFrontLeft (float32)
    if (Odometry_array_wheelCorrections_wheelCorrectionFactorFrontLeft_available[j] == 1)
    {
      tag_dataID = 1;
      Odometry_payload_buffer_wheelCorrections[payload_counter++] = 2 * 16 /* Wiretype = 2  =^ 32 Bit */ + ((tag_dataID>>8) & 0x0F) /* DataID High Part */ ;
      Odometry_payload_buffer_wheelCorrections[payload_counter++] = tag_dataID & 0xFF /* DataID Low Part */ ;
      
      temp_converttodword = interpretAsDword (Odometry_array_wheelCorrections_wheelCorrectionFactorFrontLeft[j]);
      Odometry_payload_buffer_wheelCorrections[payload_counter++] = temp_converttodword>>24 & 0xFF;
      Odometry_payload_buffer_wheelCorrections[payload_counter++] = temp_converttodword>>16 & 0xFF;
      Odometry_payload_buffer_wheelCorrections[payload_counter++] = temp_converttodword>> 8 & 0xFF;
      Odometry_payload_buffer_wheelCorrections[payload_counter++] = temp_converttodword     & 0xFF;
    }
    
    
    // 2 wheelCorrectionFactorFrontRight (float32)
    if (Odometry_array_wheelCorrections_wheelCorrectionFactorFrontRight_available[j] == 1)
    {
      tag_dataID = 2;
      Odometry_payload_buffer_wheelCorrections[payload_counter++] = 2 * 16 /* Wiretype = 2  =^ 32 Bit */ + ((tag_dataID>>8) & 0x0F) /* DataID High Part */ ;
      Odometry_payload_buffer_wheelCorrections[payload_counter++] = tag_dataID & 0xFF /* DataID Low Part */ ;
      
      temp_converttodword = interpretAsDword (Odometry_array_wheelCorrections_wheelCorrectionFactorFrontRight[j]);
      Odometry_payload_buffer_wheelCorrections[payload_counter++] = temp_converttodword>>24 & 0xFF;
      Odometry_payload_buffer_wheelCorrections[payload_counter++] = temp_converttodword>>16 & 0xFF;
      Odometry_payload_buffer_wheelCorrections[payload_counter++] = temp_converttodword>> 8 & 0xFF;
      Odometry_payload_buffer_wheelCorrections[payload_counter++] = temp_converttodword     & 0xFF;
    }
    
    
    // 3 wheelCorrectionFactorRearLeft (float32)
    if (Odometry_array_wheelCorrections_wheelCorrectionFactorRearLeft_available[j] == 1)
    {
      tag_dataID = 3;
      Odometry_payload_buffer_wheelCorrections[payload_counter++] = 2 * 16 /* Wiretype = 2  =^ 32 Bit */ + ((tag_dataID>>8) & 0x0F) /* DataID High Part */ ;
      Odometry_payload_buffer_wheelCorrections[payload_counter++] = tag_dataID & 0xFF /* DataID Low Part */ ;
      
      temp_converttodword = interpretAsDword (Odometry_array_wheelCorrections_wheelCorrectionFactorRearLeft[j]);
      Odometry_payload_buffer_wheelCorrections[payload_counter++] = temp_converttodword>>24 & 0xFF;
      Odometry_payload_buffer_wheelCorrections[payload_counter++] = temp_converttodword>>16 & 0xFF;
      Odometry_payload_buffer_wheelCorrections[payload_counter++] = temp_converttodword>> 8 & 0xFF;
      Odometry_payload_buffer_wheelCorrections[payload_counter++] = temp_converttodword     & 0xFF;
    }
    
    
    // 4 wheelCorrectionFactorRearRight (float32)
    if (Odometry_array_wheelCorrections_wheelCorrectionFactorRearRight_available[j] == 1)
    {
      tag_dataID = 4;
      Odometry_payload_buffer_wheelCorrections[payload_counter++] = 2 * 16 /* Wiretype = 2  =^ 32 Bit */ + ((tag_dataID>>8) & 0x0F) /* DataID High Part */ ;
      Odometry_payload_buffer_wheelCorrections[payload_counter++] = tag_dataID & 0xFF /* DataID Low Part */ ;
      
      temp_converttodword = interpretAsDword (Odometry_array_wheelCorrections_wheelCorrectionFactorRearRight[j]);
      Odometry_payload_buffer_wheelCorrections[payload_counter++] = temp_converttodword>>24 & 0xFF;
      Odometry_payload_buffer_wheelCorrections[payload_counter++] = temp_converttodword>>16 & 0xFF;
      Odometry_payload_buffer_wheelCorrections[payload_counter++] = temp_converttodword>> 8 & 0xFF;
      Odometry_payload_buffer_wheelCorrections[payload_counter++] = temp_converttodword     & 0xFF;
    }
    
    
    // 5 wheelCorrectionFactorEstimatorStatus (uint8)
    if (Odometry_array_wheelCorrections_wheelCorrectionFactorEstimatorStatus_available[j] == 1)
    {
      tag_dataID = 5;
      Odometry_payload_buffer_wheelCorrections[payload_counter++] = 0 * 16 /* Wiretype = 0  =^ 8 Bit */ + ((tag_dataID>>8) & 0x0F) /* DataID High Part */ ;
      Odometry_payload_buffer_wheelCorrections[payload_counter++] = tag_dataID & 0xFF /* DataID Low Part */ ;
      
      Odometry_payload_buffer_wheelCorrections[payload_counter++] = Odometry_array_wheelCorrections_wheelCorrectionFactorEstimatorStatus[j] & 0xFF;
    }
    
    
    // 6 wheelCorrectionFactorEstimatorStatusConfidence (enum32)
    if (Odometry_array_wheelCorrections_wheelCorrectionFactorEstimatorStatusConfidence_available[j] == 1)
    {
      tag_dataID = 6;
      Odometry_payload_buffer_wheelCorrections[payload_counter++] = 2 * 16 /* Wiretype = 2  =^ 32 Bit */ + ((tag_dataID>>8) & 0x0F) /* DataID High Part */ ;
      Odometry_payload_buffer_wheelCorrections[payload_counter++] = tag_dataID & 0xFF /* DataID Low Part */ ;
      
      Odometry_payload_buffer_wheelCorrections[payload_counter++] = Odometry_array_wheelCorrections_wheelCorrectionFactorEstimatorStatusConfidence[j]>>24 & 0xFF;
      Odometry_payload_buffer_wheelCorrections[payload_counter++] = Odometry_array_wheelCorrections_wheelCorrectionFactorEstimatorStatusConfidence[j]>>16 & 0xFF;
      Odometry_payload_buffer_wheelCorrections[payload_counter++] = Odometry_array_wheelCorrections_wheelCorrectionFactorEstimatorStatusConfidence[j]>> 8 & 0xFF;
      Odometry_payload_buffer_wheelCorrections[payload_counter++] = Odometry_array_wheelCorrections_wheelCorrectionFactorEstimatorStatusConfidence[j]     & 0xFF;
    }
    
    
    // 7 wheelCorrectionFactorFrontLeftConfidence (enum32)
    if (Odometry_array_wheelCorrections_wheelCorrectionFactorFrontLeftConfidence_available[j] == 1)
    {
      tag_dataID = 7;
      Odometry_payload_buffer_wheelCorrections[payload_counter++] = 2 * 16 /* Wiretype = 2  =^ 32 Bit */ + ((tag_dataID>>8) & 0x0F) /* DataID High Part */ ;
      Odometry_payload_buffer_wheelCorrections[payload_counter++] = tag_dataID & 0xFF /* DataID Low Part */ ;
      
      Odometry_payload_buffer_wheelCorrections[payload_counter++] = Odometry_array_wheelCorrections_wheelCorrectionFactorFrontLeftConfidence[j]>>24 & 0xFF;
      Odometry_payload_buffer_wheelCorrections[payload_counter++] = Odometry_array_wheelCorrections_wheelCorrectionFactorFrontLeftConfidence[j]>>16 & 0xFF;
      Odometry_payload_buffer_wheelCorrections[payload_counter++] = Odometry_array_wheelCorrections_wheelCorrectionFactorFrontLeftConfidence[j]>> 8 & 0xFF;
      Odometry_payload_buffer_wheelCorrections[payload_counter++] = Odometry_array_wheelCorrections_wheelCorrectionFactorFrontLeftConfidence[j]     & 0xFF;
    }
    
    
    // 8 wheelCorrectionFactorFrontRightConfidence (enum32)
    if (Odometry_array_wheelCorrections_wheelCorrectionFactorFrontRightConfidence_available[j] == 1)
    {
      tag_dataID = 8;
      Odometry_payload_buffer_wheelCorrections[payload_counter++] = 2 * 16 /* Wiretype = 2  =^ 32 Bit */ + ((tag_dataID>>8) & 0x0F) /* DataID High Part */ ;
      Odometry_payload_buffer_wheelCorrections[payload_counter++] = tag_dataID & 0xFF /* DataID Low Part */ ;
      
      Odometry_payload_buffer_wheelCorrections[payload_counter++] = Odometry_array_wheelCorrections_wheelCorrectionFactorFrontRightConfidence[j]>>24 & 0xFF;
      Odometry_payload_buffer_wheelCorrections[payload_counter++] = Odometry_array_wheelCorrections_wheelCorrectionFactorFrontRightConfidence[j]>>16 & 0xFF;
      Odometry_payload_buffer_wheelCorrections[payload_counter++] = Odometry_array_wheelCorrections_wheelCorrectionFactorFrontRightConfidence[j]>> 8 & 0xFF;
      Odometry_payload_buffer_wheelCorrections[payload_counter++] = Odometry_array_wheelCorrections_wheelCorrectionFactorFrontRightConfidence[j]     & 0xFF;
    }
    
    
    // 9 wheelCorrectionFactoRearLeftConfidence (enum32)
    if (Odometry_array_wheelCorrections_wheelCorrectionFactoRearLeftConfidence_available[j] == 1)
    {
      tag_dataID = 9;
      Odometry_payload_buffer_wheelCorrections[payload_counter++] = 2 * 16 /* Wiretype = 2  =^ 32 Bit */ + ((tag_dataID>>8) & 0x0F) /* DataID High Part */ ;
      Odometry_payload_buffer_wheelCorrections[payload_counter++] = tag_dataID & 0xFF /* DataID Low Part */ ;
      
      Odometry_payload_buffer_wheelCorrections[payload_counter++] = Odometry_array_wheelCorrections_wheelCorrectionFactoRearLeftConfidence[j]>>24 & 0xFF;
      Odometry_payload_buffer_wheelCorrections[payload_counter++] = Odometry_array_wheelCorrections_wheelCorrectionFactoRearLeftConfidence[j]>>16 & 0xFF;
      Odometry_payload_buffer_wheelCorrections[payload_counter++] = Odometry_array_wheelCorrections_wheelCorrectionFactoRearLeftConfidence[j]>> 8 & 0xFF;
      Odometry_payload_buffer_wheelCorrections[payload_counter++] = Odometry_array_wheelCorrections_wheelCorrectionFactoRearLeftConfidence[j]     & 0xFF;
    }
    
    
    // 10 wheelCorrectionFactoRearRightConfidence (enum32)
    if (Odometry_array_wheelCorrections_wheelCorrectionFactoRearRightConfidence_available[j] == 1)
    {
      tag_dataID = 10;
      Odometry_payload_buffer_wheelCorrections[payload_counter++] = 2 * 16 /* Wiretype = 2  =^ 32 Bit */ + ((tag_dataID>>8) & 0x0F) /* DataID High Part */ ;
      Odometry_payload_buffer_wheelCorrections[payload_counter++] = tag_dataID & 0xFF /* DataID Low Part */ ;
      
      Odometry_payload_buffer_wheelCorrections[payload_counter++] = Odometry_array_wheelCorrections_wheelCorrectionFactoRearRightConfidence[j]>>24 & 0xFF;
      Odometry_payload_buffer_wheelCorrections[payload_counter++] = Odometry_array_wheelCorrections_wheelCorrectionFactoRearRightConfidence[j]>>16 & 0xFF;
      Odometry_payload_buffer_wheelCorrections[payload_counter++] = Odometry_array_wheelCorrections_wheelCorrectionFactoRearRightConfidence[j]>> 8 & 0xFF;
      Odometry_payload_buffer_wheelCorrections[payload_counter++] = Odometry_array_wheelCorrections_wheelCorrectionFactoRearRightConfidence[j]     & 0xFF;
    }
    
    
    // 11 wheelCircumferenceStatic (uint16)
    if (Odometry_array_wheelCorrections_wheelCircumferenceStatic_available[j] == 1)
    {
      tag_dataID = 11;
      Odometry_payload_buffer_wheelCorrections[payload_counter++] = 1 * 16 /* Wiretype = 1  =^ 16 Bit */ + ((tag_dataID>>8) & 0x0F) /* DataID High Part */ ;
      Odometry_payload_buffer_wheelCorrections[payload_counter++] = tag_dataID & 0xFF /* DataID Low Part */ ;
      
      Odometry_payload_buffer_wheelCorrections[payload_counter++] = Odometry_array_wheelCorrections_wheelCircumferenceStatic[j]>> 8 & 0xFF;
      Odometry_payload_buffer_wheelCorrections[payload_counter++] = Odometry_array_wheelCorrections_wheelCircumferenceStatic[j]     & 0xFF;
    }
    
    
    // 12 wheelCircumferenceStaticConfidence (enum32)
    if (Odometry_array_wheelCorrections_wheelCircumferenceStaticConfidence_available[j] == 1)
    {
      tag_dataID = 12;
      Odometry_payload_buffer_wheelCorrections[payload_counter++] = 2 * 16 /* Wiretype = 2  =^ 32 Bit */ + ((tag_dataID>>8) & 0x0F) /* DataID High Part */ ;
      Odometry_payload_buffer_wheelCorrections[payload_counter++] = tag_dataID & 0xFF /* DataID Low Part */ ;
      
      Odometry_payload_buffer_wheelCorrections[payload_counter++] = Odometry_array_wheelCorrections_wheelCircumferenceStaticConfidence[j]>>24 & 0xFF;
      Odometry_payload_buffer_wheelCorrections[payload_counter++] = Odometry_array_wheelCorrections_wheelCircumferenceStaticConfidence[j]>>16 & 0xFF;
      Odometry_payload_buffer_wheelCorrections[payload_counter++] = Odometry_array_wheelCorrections_wheelCircumferenceStaticConfidence[j]>> 8 & 0xFF;
      Odometry_payload_buffer_wheelCorrections[payload_counter++] = Odometry_array_wheelCorrections_wheelCircumferenceStaticConfidence[j]     & 0xFF;
    }
    
    
    //Element Length
    element_length = payload_counter-start_pos;
    if (element_length >0) Odometry_array_wheelCorrections_array_element_length[j] = element_length - 4;
    else                   Odometry_array_wheelCorrections_array_element_length[j] = element_length;
    
    Odometry_payload_buffer_wheelCorrections[start_pos++] = Odometry_array_wheelCorrections_array_element_length[j]>>24 & 0xFF;
    Odometry_payload_buffer_wheelCorrections[start_pos++] = Odometry_array_wheelCorrections_array_element_length[j]>>16 & 0xFF;
    Odometry_payload_buffer_wheelCorrections[start_pos++] = Odometry_array_wheelCorrections_array_element_length[j]>> 8 & 0xFF;
    Odometry_payload_buffer_wheelCorrections[start_pos++] = Odometry_array_wheelCorrections_array_element_length[j]     & 0xFF;
    
    if (Odometry_array_wheelCorrections_array_element_length[j] == 0) payload_counter = payload_counter+4;
  }
  
  // Struct Length
  Odometry_array_wheelCorrections_struct_element_length = 4*@Odometry_Notification_wheelCorrections_Element_TotalNum;

  for (k=0;k<@Odometry_Notification_wheelCorrections_Element_TotalNum;k++)
   Odometry_array_wheelCorrections_struct_element_length = Odometry_array_wheelCorrections_struct_element_length + Odometry_array_wheelCorrections_array_element_length[k];
  
  Odometry_payload_buffer_wheelCorrections[0] = Odometry_array_wheelCorrections_struct_element_length>>24 & 0xFF;
  Odometry_payload_buffer_wheelCorrections[1] = Odometry_array_wheelCorrections_struct_element_length>>16 & 0xFF;
  Odometry_payload_buffer_wheelCorrections[2] = Odometry_array_wheelCorrections_struct_element_length>> 8 & 0xFF;
  Odometry_payload_buffer_wheelCorrections[3] = Odometry_array_wheelCorrections_struct_element_length     & 0xFF;


  Odometry_payload_length_wheelCorrections = Odometry_array_wheelCorrections_struct_element_length+4;
  putvalue(Odometry_Notification_wheelCorrections_Payload, Odometry_payload_buffer_wheelCorrections, Odometry_payload_length_wheelCorrections);
}

on envVar Odometry_Notification_wheelCorrections_Element_TotalNum
{
  if (@this == 0) @this =  1;
  if (@this > 10) @this = 10;
  
  Odometry_Notification_wheelCorrections();
  Odometry_Notification_wheelCorrections_update();
}

on envVar Odometry_Notification_wheelCorrections_Element
{
  Odometry_Notification_wheelCorrections_update();
}

on envVar Odometry_Notification_wheelCorrections_Element_Next
{
  if (@this == 1 && @Odometry_Notification_wheelCorrections_Element < @Odometry_Notification_wheelCorrections_Element_TotalNum - 1)
  {
    @Odometry_Notification_wheelCorrections_Element = @Odometry_Notification_wheelCorrections_Element + 1;
    Odometry_Notification_wheelCorrections_update();
  }
}

on envVar Odometry_Notification_wheelCorrections_Element_Previous
{
  if (@this == 1 && @Odometry_Notification_wheelCorrections_Element > 0)
  {
    @Odometry_Notification_wheelCorrections_Element = @Odometry_Notification_wheelCorrections_Element - 1;
    Odometry_Notification_wheelCorrections_update();
  }
}

Odometry_Notification_wheelCorrections_update()
{
  @Odometry_Notification_LengthIndicator_Element_wheelCorrections = Odometry_array_wheelCorrections_array_element_length[@Odometry_Notification_wheelCorrections_Element];
  @Odometry_Notification_LengthIndicator_Struct_wheelCorrections  = Odometry_array_wheelCorrections_struct_element_length;
  @Odometry_Notification_Length_wheelCorrections                  = Odometry_payload_length_wheelCorrections+8;
  
  @Odometry_Notification_wheelCorrections_timestamp                                      = Odometry_array_wheelCorrections_timestamp[@Odometry_Notification_wheelCorrections_Element];
  @Odometry_Notification_wheelCorrections_wheelCorrectionFactorFrontLeft                 = Odometry_array_wheelCorrections_wheelCorrectionFactorFrontLeft[@Odometry_Notification_wheelCorrections_Element];
  @Odometry_Notification_wheelCorrections_wheelCorrectionFactorFrontRight                = Odometry_array_wheelCorrections_wheelCorrectionFactorFrontRight[@Odometry_Notification_wheelCorrections_Element];
  @Odometry_Notification_wheelCorrections_wheelCorrectionFactorRearLeft                  = Odometry_array_wheelCorrections_wheelCorrectionFactorRearLeft[@Odometry_Notification_wheelCorrections_Element];
  @Odometry_Notification_wheelCorrections_wheelCorrectionFactorRearRight                 = Odometry_array_wheelCorrections_wheelCorrectionFactorRearRight[@Odometry_Notification_wheelCorrections_Element];
  @Odometry_Notification_wheelCorrections_wheelCorrectionFactorEstimatorStatus           = Odometry_array_wheelCorrections_wheelCorrectionFactorEstimatorStatus[@Odometry_Notification_wheelCorrections_Element];
  @Odometry_Notification_wheelCorrections_wheelCorrectionFactorEstimatorStatusConfidence = Odometry_array_wheelCorrections_wheelCorrectionFactorEstimatorStatusConfidence[@Odometry_Notification_wheelCorrections_Element];
  @Odometry_Notification_wheelCorrections_wheelCorrectionFactorFrontLeftConfidence       = Odometry_array_wheelCorrections_wheelCorrectionFactorFrontLeftConfidence[@Odometry_Notification_wheelCorrections_Element];
  @Odometry_Notification_wheelCorrections_wheelCorrectionFactorFrontRightConfidence      = Odometry_array_wheelCorrections_wheelCorrectionFactorFrontRightConfidence[@Odometry_Notification_wheelCorrections_Element];
  @Odometry_Notification_wheelCorrections_wheelCorrectionFactoRearLeftConfidence         = Odometry_array_wheelCorrections_wheelCorrectionFactoRearLeftConfidence[@Odometry_Notification_wheelCorrections_Element];
  @Odometry_Notification_wheelCorrections_wheelCorrectionFactoRearRightConfidence        = Odometry_array_wheelCorrections_wheelCorrectionFactoRearRightConfidence[@Odometry_Notification_wheelCorrections_Element];
  @Odometry_Notification_wheelCorrections_wheelCircumferenceStatic                       = Odometry_array_wheelCorrections_wheelCircumferenceStatic[@Odometry_Notification_wheelCorrections_Element];
  @Odometry_Notification_wheelCorrections_wheelCircumferenceStaticConfidence             = Odometry_array_wheelCorrections_wheelCircumferenceStaticConfidence[@Odometry_Notification_wheelCorrections_Element];
  
  @Odometry_Notification_wheelCorrections_timestamp_available                                      = Odometry_array_wheelCorrections_timestamp_available[@Odometry_Notification_wheelCorrections_Element];
  @Odometry_Notification_wheelCorrections_wheelCorrectionFactorFrontLeft_available                 = Odometry_array_wheelCorrections_wheelCorrectionFactorFrontLeft_available[@Odometry_Notification_wheelCorrections_Element];
  @Odometry_Notification_wheelCorrections_wheelCorrectionFactorFrontRight_available                = Odometry_array_wheelCorrections_wheelCorrectionFactorFrontRight_available[@Odometry_Notification_wheelCorrections_Element];
  @Odometry_Notification_wheelCorrections_wheelCorrectionFactorRearLeft_available                  = Odometry_array_wheelCorrections_wheelCorrectionFactorRearLeft_available[@Odometry_Notification_wheelCorrections_Element];
  @Odometry_Notification_wheelCorrections_wheelCorrectionFactorRearRight_available                 = Odometry_array_wheelCorrections_wheelCorrectionFactorRearRight_available[@Odometry_Notification_wheelCorrections_Element];
  @Odometry_Notification_wheelCorrections_wheelCorrectionFactorEstimatorStatus_available           = Odometry_array_wheelCorrections_wheelCorrectionFactorEstimatorStatus_available[@Odometry_Notification_wheelCorrections_Element];
  @Odometry_Notification_wheelCorrections_wheelCorrectionFactorEstimatorStatusConfidence_available = Odometry_array_wheelCorrections_wheelCorrectionFactorEstimatorStatusConfidence_available[@Odometry_Notification_wheelCorrections_Element];
  @Odometry_Notification_wheelCorrections_wheelCorrectionFactorFrontLeftConfidence_available       = Odometry_array_wheelCorrections_wheelCorrectionFactorFrontLeftConfidence_available[@Odometry_Notification_wheelCorrections_Element];
  @Odometry_Notification_wheelCorrections_wheelCorrectionFactorFrontRightConfidence_available      = Odometry_array_wheelCorrections_wheelCorrectionFactorFrontRightConfidence_available[@Odometry_Notification_wheelCorrections_Element];
  @Odometry_Notification_wheelCorrections_wheelCorrectionFactoRearLeftConfidence_available         = Odometry_array_wheelCorrections_wheelCorrectionFactoRearLeftConfidence_available[@Odometry_Notification_wheelCorrections_Element];
  @Odometry_Notification_wheelCorrections_wheelCorrectionFactoRearRightConfidence_available        = Odometry_array_wheelCorrections_wheelCorrectionFactoRearRightConfidence_available[@Odometry_Notification_wheelCorrections_Element];
  @Odometry_Notification_wheelCorrections_wheelCircumferenceStatic_available                       = Odometry_array_wheelCorrections_wheelCircumferenceStatic_available[@Odometry_Notification_wheelCorrections_Element];
  @Odometry_Notification_wheelCorrections_wheelCircumferenceStaticConfidence_available             = Odometry_array_wheelCorrections_wheelCircumferenceStaticConfidence_available[@Odometry_Notification_wheelCorrections_Element];
}







////////// accelerations Notification //////////

on envVar Odometry_Notification_LengthIndicator_Struct_accelerations
{
  Odometry_Notification_accelerations();
}
on envVar Odometry_Notification_LengthIndicator_Element_accelerations
{
  Odometry_Notification_accelerations();
}
on envVar Odometry_Notification_accelerations_type
{
  Odometry_array_accelerations_type[@Odometry_Notification_accelerations_Element] = @this;
  Odometry_Notification_accelerations();
}
on envVar Odometry_Notification_accelerations_timestamp
{
  Odometry_array_accelerations_timestamp[@Odometry_Notification_accelerations_Element] = @this;
  Odometry_Notification_accelerations();
}
on envVar Odometry_Notification_accelerations_acceleration
{
  Odometry_array_accelerations_acceleration[@Odometry_Notification_accelerations_Element] = @this;
  Odometry_Notification_accelerations();
}
on envVar Odometry_Notification_accelerations_variance
{
  Odometry_array_accelerations_variance[@Odometry_Notification_accelerations_Element] = @this;
  Odometry_Notification_accelerations();
}
on envVar Odometry_Notification_accelerations_confidence
{
  Odometry_array_accelerations_confidence[@Odometry_Notification_accelerations_Element] = @this;
  Odometry_Notification_accelerations();
}
on envVar Odometry_Notification_accelerations_type_available
{
  Odometry_array_accelerations_type_available[@Odometry_Notification_accelerations_Element] = @this;
  Odometry_Notification_accelerations();
}
on envVar Odometry_Notification_accelerations_timestamp_available
{
  Odometry_array_accelerations_timestamp_available[@Odometry_Notification_accelerations_Element] = @this;
  Odometry_Notification_accelerations();
}
on envVar Odometry_Notification_accelerations_acceleration_available
{
  Odometry_array_accelerations_acceleration_available[@Odometry_Notification_accelerations_Element] = @this;
  Odometry_Notification_accelerations();
}
on envVar Odometry_Notification_accelerations_variance_available
{
  Odometry_array_accelerations_variance_available[@Odometry_Notification_accelerations_Element] = @this;
  Odometry_Notification_accelerations();
}
on envVar Odometry_Notification_accelerations_confidence_available
{
  Odometry_array_accelerations_confidence_available[@Odometry_Notification_accelerations_Element] = @this;
  Odometry_Notification_accelerations();
}
on envVar Odometry_Notification_accelerations_Payload
{
  Odometry_Notification_accelerations_update();
}


Odometry_Notification_accelerations()
{
  word payload_counter = 0;
  word start_pos       = 0;
  word element_length  = 0;
  
  // Length Indicator Struct - Platzhalter
  payload_counter = 0+4;
  start_pos = 0;
  
  for (j=0; j<@Odometry_Notification_accelerations_Element_TotalNum; j++)
  {
    Odometry_array_accelerations_available_functions[j] = Odometry_array_accelerations_type_available[j]
                                                        + Odometry_array_accelerations_timestamp_available[j]
                                                        + Odometry_array_accelerations_acceleration_available[j]
                                                        + Odometry_array_accelerations_variance_available[j]
                                                        + Odometry_array_accelerations_confidence_available[j];
    
    // Length Indicator Element - Platzhalter
    if (Odometry_array_accelerations_available_functions[j] > 0)
    {
      start_pos = payload_counter;
      payload_counter = payload_counter + 4;
    }
    else 
      start_pos = payload_counter;
    
    // 0 type (enum32)
    if (Odometry_array_accelerations_type_available[j] == 1)
    {
      tag_dataID = 0;
      Odometry_payload_buffer_accelerations[payload_counter++] = 2 * 16 /* Wiretype = 2  =^ 32 Bit */ + ((tag_dataID>>8) & 0x0F) /* DataID High Part */ ;
      Odometry_payload_buffer_accelerations[payload_counter++] = tag_dataID & 0xFF /* DataID Low Part */ ;
      
      Odometry_payload_buffer_accelerations[payload_counter++] = Odometry_array_accelerations_type[j]>>24 & 0xFF;
      Odometry_payload_buffer_accelerations[payload_counter++] = Odometry_array_accelerations_type[j]>>16 & 0xFF;
      Odometry_payload_buffer_accelerations[payload_counter++] = Odometry_array_accelerations_type[j]>> 8 & 0xFF;
      Odometry_payload_buffer_accelerations[payload_counter++] = Odometry_array_accelerations_type[j]     & 0xFF;
    }
    
    
    // 1 timestamp (uint64)
    if (Odometry_array_accelerations_timestamp_available[j] == 1)
    {
      tag_dataID = 1;
      Odometry_payload_buffer_accelerations[payload_counter++] = 3 * 16 /* Wiretype = 3  =^ 64 Bit */ + ((tag_dataID>>8) & 0x0F) /* DataID High Part */ ;
      Odometry_payload_buffer_accelerations[payload_counter++] = tag_dataID & 0xFF /* DataID Low Part */ ;
      
      temp_64bit_low  = Odometry_array_accelerations_timestamp[j]     & 0x00000000FFFFFFFF;
      temp_64bit_high = Odometry_array_accelerations_timestamp[j]>>32 & 0x00000000FFFFFFFF;
      
      Odometry_payload_buffer_accelerations[payload_counter++] = temp_64bit_high>>24 & 0xFF;
      Odometry_payload_buffer_accelerations[payload_counter++] = temp_64bit_high>>16 & 0xFF;
      Odometry_payload_buffer_accelerations[payload_counter++] = temp_64bit_high>> 8 & 0xFF;
      Odometry_payload_buffer_accelerations[payload_counter++] = temp_64bit_high     & 0xFF;
      Odometry_payload_buffer_accelerations[payload_counter++] = temp_64bit_low>>24  & 0xFF;
      Odometry_payload_buffer_accelerations[payload_counter++] = temp_64bit_low>>16  & 0xFF;
      Odometry_payload_buffer_accelerations[payload_counter++] = temp_64bit_low>> 8  & 0xFF;
      Odometry_payload_buffer_accelerations[payload_counter++] = temp_64bit_low      & 0xFF;
    }
    
    
    // 2 acceleration (float32)
    if (Odometry_array_accelerations_acceleration_available[j] == 1)
    {
      tag_dataID = 2;
      Odometry_payload_buffer_accelerations[payload_counter++] = 2 * 16 /* Wiretype = 2  =^ 32 Bit */ + ((tag_dataID>>8) & 0x0F) /* DataID High Part */ ;
      Odometry_payload_buffer_accelerations[payload_counter++] = tag_dataID & 0xFF /* DataID Low Part */ ;
      
      temp_converttodword = interpretAsDword (Odometry_array_accelerations_acceleration[j]);
      Odometry_payload_buffer_accelerations[payload_counter++] = temp_converttodword>>24 & 0xFF;
      Odometry_payload_buffer_accelerations[payload_counter++] = temp_converttodword>>16 & 0xFF;
      Odometry_payload_buffer_accelerations[payload_counter++] = temp_converttodword>> 8 & 0xFF;
      Odometry_payload_buffer_accelerations[payload_counter++] = temp_converttodword     & 0xFF;
    }
    
    
    // 3 variance (float32)
    if (Odometry_array_accelerations_variance_available[j] == 1)
    {
      tag_dataID = 3;
      Odometry_payload_buffer_accelerations[payload_counter++] = 2 * 16 /* Wiretype = 2  =^ 32 Bit */ + ((tag_dataID>>8) & 0x0F) /* DataID High Part */ ;
      Odometry_payload_buffer_accelerations[payload_counter++] = tag_dataID & 0xFF /* DataID Low Part */ ;
      
      temp_converttodword = interpretAsDword (Odometry_array_accelerations_variance[j]);
      Odometry_payload_buffer_accelerations[payload_counter++] = temp_converttodword>>24 & 0xFF;
      Odometry_payload_buffer_accelerations[payload_counter++] = temp_converttodword>>16 & 0xFF;
      Odometry_payload_buffer_accelerations[payload_counter++] = temp_converttodword>> 8 & 0xFF;
      Odometry_payload_buffer_accelerations[payload_counter++] = temp_converttodword     & 0xFF;
    }
    
    
    // 4 confidence (enum32)
    if (Odometry_array_accelerations_confidence_available[j] == 1)
    {
      tag_dataID = 4;
      Odometry_payload_buffer_accelerations[payload_counter++] = 2 * 16 /* Wiretype = 2  =^ 32 Bit */ + ((tag_dataID>>8) & 0x0F) /* DataID High Part */ ;
      Odometry_payload_buffer_accelerations[payload_counter++] = tag_dataID & 0xFF /* DataID Low Part */ ;
      
      Odometry_payload_buffer_accelerations[payload_counter++] = Odometry_array_accelerations_confidence[j]>>24 & 0xFF;
      Odometry_payload_buffer_accelerations[payload_counter++] = Odometry_array_accelerations_confidence[j]>>16 & 0xFF;
      Odometry_payload_buffer_accelerations[payload_counter++] = Odometry_array_accelerations_confidence[j]>> 8 & 0xFF;
      Odometry_payload_buffer_accelerations[payload_counter++] = Odometry_array_accelerations_confidence[j]     & 0xFF;
    }
    
    //Element Length
    element_length = payload_counter-start_pos;
    if (element_length >0) Odometry_array_accelerations_array_element_length[j] = element_length - 4;
    else                   Odometry_array_accelerations_array_element_length[j] = element_length;
    
    Odometry_payload_buffer_accelerations[start_pos++] = Odometry_array_accelerations_array_element_length[j]>>24 & 0xFF;
    Odometry_payload_buffer_accelerations[start_pos++] = Odometry_array_accelerations_array_element_length[j]>>16 & 0xFF;
    Odometry_payload_buffer_accelerations[start_pos++] = Odometry_array_accelerations_array_element_length[j]>> 8 & 0xFF;
    Odometry_payload_buffer_accelerations[start_pos++] = Odometry_array_accelerations_array_element_length[j]     & 0xFF;
    
    if (Odometry_array_accelerations_array_element_length[j] == 0) payload_counter = payload_counter+4;
  }
  
  // Struct Length
  Odometry_array_accelerations_struct_element_length = 4*@Odometry_Notification_accelerations_Element_TotalNum;

  for (k=0;k<@Odometry_Notification_accelerations_Element_TotalNum;k++)
   Odometry_array_accelerations_struct_element_length = Odometry_array_accelerations_struct_element_length + Odometry_array_accelerations_array_element_length[k];
  
  Odometry_payload_buffer_accelerations[0] = Odometry_array_accelerations_struct_element_length>>24 & 0xFF;
  Odometry_payload_buffer_accelerations[1] = Odometry_array_accelerations_struct_element_length>>16 & 0xFF;
  Odometry_payload_buffer_accelerations[2] = Odometry_array_accelerations_struct_element_length>> 8 & 0xFF;
  Odometry_payload_buffer_accelerations[3] = Odometry_array_accelerations_struct_element_length     & 0xFF;


  Odometry_payload_length_accelerations = Odometry_array_accelerations_struct_element_length+4;
  putvalue(Odometry_Notification_accelerations_Payload, Odometry_payload_buffer_accelerations, Odometry_payload_length_accelerations);
}

on envVar Odometry_Notification_accelerations_Element_TotalNum
{
  if (@this == 0) @this =  1;
  if (@this > 10) @this = 10;
  
  Odometry_Notification_accelerations();
  Odometry_Notification_accelerations_update();
}

on envVar Odometry_Notification_accelerations_Element
{
  Odometry_Notification_accelerations_update();
}

on envVar Odometry_Notification_accelerations_Element_Next
{
  if (@this == 1 && @Odometry_Notification_accelerations_Element < @Odometry_Notification_accelerations_Element_TotalNum - 1)
  {
    @Odometry_Notification_accelerations_Element = @Odometry_Notification_accelerations_Element + 1;
    Odometry_Notification_accelerations_update();
  }
}

on envVar Odometry_Notification_accelerations_Element_Previous
{
  if (@this == 1 && @Odometry_Notification_accelerations_Element > 0)
  {
    @Odometry_Notification_accelerations_Element = @Odometry_Notification_accelerations_Element - 1;
    Odometry_Notification_accelerations_update();
  }
}

Odometry_Notification_accelerations_update()
{
  @Odometry_Notification_LengthIndicator_Element_accelerations = Odometry_array_accelerations_array_element_length[@Odometry_Notification_accelerations_Element];
  @Odometry_Notification_LengthIndicator_Struct_accelerations  = Odometry_array_accelerations_struct_element_length;
  @Odometry_Notification_Length_accelerations                  = Odometry_payload_length_accelerations+8;
  
  @Odometry_Notification_accelerations_type         = Odometry_array_accelerations_type[@Odometry_Notification_accelerations_Element];
  @Odometry_Notification_accelerations_timestamp    = Odometry_array_accelerations_timestamp[@Odometry_Notification_accelerations_Element];
  @Odometry_Notification_accelerations_acceleration = Odometry_array_accelerations_acceleration[@Odometry_Notification_accelerations_Element];
  @Odometry_Notification_accelerations_variance     = Odometry_array_accelerations_variance[@Odometry_Notification_accelerations_Element];
  @Odometry_Notification_accelerations_confidence   = Odometry_array_accelerations_confidence[@Odometry_Notification_accelerations_Element];
  
  @Odometry_Notification_accelerations_type_available         = Odometry_array_accelerations_type_available[@Odometry_Notification_accelerations_Element];
  @Odometry_Notification_accelerations_timestamp_available    = Odometry_array_accelerations_timestamp_available[@Odometry_Notification_accelerations_Element];
  @Odometry_Notification_accelerations_acceleration_available = Odometry_array_accelerations_acceleration_available[@Odometry_Notification_accelerations_Element];
  @Odometry_Notification_accelerations_variance_available     = Odometry_array_accelerations_variance_available[@Odometry_Notification_accelerations_Element];
  @Odometry_Notification_accelerations_confidence_available   = Odometry_array_accelerations_confidence_available[@Odometry_Notification_accelerations_Element];
}






////////// angularRates Notification //////////

on envVar Odometry_Notification_LengthIndicator_Struct_angularRates
{
  Odometry_Notification_angularRates();
}
on envVar Odometry_Notification_LengthIndicator_Element_angularRates
{
  Odometry_Notification_angularRates();
}
on envVar Odometry_Notification_angularRates_type
{
  Odometry_array_angularRates_type[@Odometry_Notification_angularRates_Element] = @this;
  Odometry_Notification_angularRates();
}
on envVar Odometry_Notification_angularRates_timestamp
{
  Odometry_array_angularRates_timestamp[@Odometry_Notification_angularRates_Element] = @this;
  Odometry_Notification_angularRates();
}
on envVar Odometry_Notification_angularRates_angularrate
{
  Odometry_array_angularRates_angularrate[@Odometry_Notification_angularRates_Element] = @this;
  Odometry_Notification_angularRates();
}
on envVar Odometry_Notification_angularRates_variance
{
  Odometry_array_angularRates_variance[@Odometry_Notification_angularRates_Element] = @this;
  Odometry_Notification_angularRates();
}
on envVar Odometry_Notification_angularRates_confidence
{
  Odometry_array_angularRates_confidence[@Odometry_Notification_angularRates_Element] = @this;
  Odometry_Notification_angularRates();
}
on envVar Odometry_Notification_angularRates_type_available
{
  Odometry_array_angularRates_type_available[@Odometry_Notification_angularRates_Element] = @this;
  Odometry_Notification_angularRates();
}
on envVar Odometry_Notification_angularRates_timestamp_available
{
  Odometry_array_angularRates_timestamp_available[@Odometry_Notification_angularRates_Element] = @this;
  Odometry_Notification_angularRates();
}
on envVar Odometry_Notification_angularRates_angularrate_available
{
  Odometry_array_angularRates_angularrate_available[@Odometry_Notification_angularRates_Element] = @this;
  Odometry_Notification_angularRates();
}
on envVar Odometry_Notification_angularRates_variance_available
{
  Odometry_array_angularRates_variance_available[@Odometry_Notification_angularRates_Element] = @this;
  Odometry_Notification_angularRates();
}
on envVar Odometry_Notification_angularRates_confidence_available
{
  Odometry_array_angularRates_confidence_available[@Odometry_Notification_angularRates_Element] = @this;
  Odometry_Notification_angularRates();
}
on envVar Odometry_Notification_angularRates_Payload
{
  Odometry_Notification_angularRates_update();
}


Odometry_Notification_angularRates()
{
  word payload_counter = 0;
  word start_pos       = 0;
  word element_length  = 0;
  
  // Length Indicator Struct - Platzhalter
  payload_counter = 0+4;
  start_pos = 0;
  
  for (j=0; j<@Odometry_Notification_angularRates_Element_TotalNum; j++)
  {
    Odometry_array_angularRates_available_functions[j] = Odometry_array_angularRates_type_available[j]
                                                       + Odometry_array_angularRates_timestamp_available[j]
                                                       + Odometry_array_angularRates_angularrate_available[j]
                                                       + Odometry_array_angularRates_variance_available[j]
                                                       + Odometry_array_angularRates_confidence_available[j];
    
    // Length Indicator Element - Platzhalter
    if (Odometry_array_angularRates_available_functions[j] > 0)
    {
      start_pos = payload_counter;
      payload_counter = payload_counter + 4;
    }
    else 
      start_pos = payload_counter;
    
    
    // 0 type (enum32)
    if (Odometry_array_angularRates_type_available[j] == 1)
    {
      tag_dataID = 0;
      Odometry_payload_buffer_angularRates[payload_counter++] = 2 * 16 /* Wiretype = 2  =^ 32 Bit */ + ((tag_dataID>>8) & 0x0F) /* DataID High Part */ ;
      Odometry_payload_buffer_angularRates[payload_counter++] = tag_dataID & 0xFF /* DataID Low Part */ ;
      
      Odometry_payload_buffer_angularRates[payload_counter++] = Odometry_array_angularRates_type[j]>>24 & 0xFF;
      Odometry_payload_buffer_angularRates[payload_counter++] = Odometry_array_angularRates_type[j]>>16 & 0xFF;
      Odometry_payload_buffer_angularRates[payload_counter++] = Odometry_array_angularRates_type[j]>> 8 & 0xFF;
      Odometry_payload_buffer_angularRates[payload_counter++] = Odometry_array_angularRates_type[j]     & 0xFF;
    }
    
                                                                                                 
    // 1 timestamp (uint64)
    if (Odometry_array_angularRates_timestamp_available[j] == 1)
    {
      tag_dataID = 1;                                                                              
      Odometry_payload_buffer_angularRates[payload_counter++] = 3 * 16 /* Wiretype = 3  =^ 64 Bit */ + ((tag_dataID>>8) & 0x0F) /* DataID High Part */ ;
      Odometry_payload_buffer_angularRates[payload_counter++] = tag_dataID & 0xFF /* DataID Low Part */ ;
      
      temp_64bit_low  = Odometry_array_angularRates_timestamp[j]     & 0x00000000FFFFFFFF;
      temp_64bit_high = Odometry_array_angularRates_timestamp[j]>>32 & 0x00000000FFFFFFFF;
      
      Odometry_payload_buffer_angularRates[payload_counter++] = temp_64bit_high>>24 & 0xFF;
      Odometry_payload_buffer_angularRates[payload_counter++] = temp_64bit_high>>16 & 0xFF;
      Odometry_payload_buffer_angularRates[payload_counter++] = temp_64bit_high>> 8 & 0xFF;
      Odometry_payload_buffer_angularRates[payload_counter++] = temp_64bit_high     & 0xFF;
      Odometry_payload_buffer_angularRates[payload_counter++] = temp_64bit_low>>24  & 0xFF;
      Odometry_payload_buffer_angularRates[payload_counter++] = temp_64bit_low>>16  & 0xFF;
      Odometry_payload_buffer_angularRates[payload_counter++] = temp_64bit_low>> 8  & 0xFF;
      Odometry_payload_buffer_angularRates[payload_counter++] = temp_64bit_low      & 0xFF;
    }
    
    
    // 2 angularrate (float32)
    if (Odometry_array_angularRates_angularrate_available[j] == 1)
    {
      tag_dataID = 2;
      Odometry_payload_buffer_angularRates[payload_counter++] = 2 * 16 /* Wiretype = 2  =^ 32 Bit */ + ((tag_dataID>>8) & 0x0F) /* DataID High Part */ ;
      Odometry_payload_buffer_angularRates[payload_counter++] = tag_dataID & 0xFF /* DataID Low Part */ ;
      
      temp_converttodword = interpretAsDword (Odometry_array_angularRates_angularrate[j]);
      Odometry_payload_buffer_angularRates[payload_counter++] = temp_converttodword>>24 & 0xFF;
      Odometry_payload_buffer_angularRates[payload_counter++] = temp_converttodword>>16 & 0xFF;
      Odometry_payload_buffer_angularRates[payload_counter++] = temp_converttodword>> 8 & 0xFF;
      Odometry_payload_buffer_angularRates[payload_counter++] = temp_converttodword     & 0xFF;
    }
    
    
    // 3 variance (float32)
    if (Odometry_array_angularRates_variance_available[j] == 1)
    {
      tag_dataID = 3;
      Odometry_payload_buffer_angularRates[payload_counter++] = 2 * 16 /* Wiretype = 2  =^ 32 Bit */ + ((tag_dataID>>8) & 0x0F) /* DataID High Part */ ;
      Odometry_payload_buffer_angularRates[payload_counter++] = tag_dataID & 0xFF /* DataID Low Part */ ;
      
      temp_converttodword = interpretAsDword (Odometry_array_angularRates_variance[j]);
      Odometry_payload_buffer_angularRates[payload_counter++] = temp_converttodword>>24 & 0xFF;
      Odometry_payload_buffer_angularRates[payload_counter++] = temp_converttodword>>16 & 0xFF;
      Odometry_payload_buffer_angularRates[payload_counter++] = temp_converttodword>> 8 & 0xFF;
      Odometry_payload_buffer_angularRates[payload_counter++] = temp_converttodword     & 0xFF;
    }
    
    
    // 4 confidence (enum32)
    if (Odometry_array_angularRates_confidence_available[j] == 1)
    {
      tag_dataID = 4;
      Odometry_payload_buffer_angularRates[payload_counter++] = 2 * 16 /* Wiretype = 2  =^ 32 Bit */ + ((tag_dataID>>8) & 0x0F) /* DataID High Part */ ;
      Odometry_payload_buffer_angularRates[payload_counter++] = tag_dataID & 0xFF /* DataID Low Part */ ;
      
      Odometry_payload_buffer_angularRates[payload_counter++] = Odometry_array_angularRates_confidence[j]>>24 & 0xFF;
      Odometry_payload_buffer_angularRates[payload_counter++] = Odometry_array_angularRates_confidence[j]>>16 & 0xFF;
      Odometry_payload_buffer_angularRates[payload_counter++] = Odometry_array_angularRates_confidence[j]>> 8 & 0xFF;
      Odometry_payload_buffer_angularRates[payload_counter++] = Odometry_array_angularRates_confidence[j]     & 0xFF;
    }
    
    
    //Element Length
    element_length = payload_counter-start_pos;
    if (element_length >0) Odometry_array_angularRates_array_element_length[j] = element_length - 4;
    else                   Odometry_array_angularRates_array_element_length[j] = element_length;
    
    Odometry_payload_buffer_angularRates[start_pos++] = Odometry_array_angularRates_array_element_length[j]>>24 & 0xFF;
    Odometry_payload_buffer_angularRates[start_pos++] = Odometry_array_angularRates_array_element_length[j]>>16 & 0xFF;
    Odometry_payload_buffer_angularRates[start_pos++] = Odometry_array_angularRates_array_element_length[j]>> 8 & 0xFF;
    Odometry_payload_buffer_angularRates[start_pos++] = Odometry_array_angularRates_array_element_length[j]     & 0xFF;
    
    if (Odometry_array_angularRates_array_element_length[j] == 0) payload_counter = payload_counter+4;
  }
  
  // Struct Length
  Odometry_array_angularRates_struct_element_length = 4*@Odometry_Notification_angularRates_Element_TotalNum;

  for (k=0;k<@Odometry_Notification_angularRates_Element_TotalNum;k++)
   Odometry_array_angularRates_struct_element_length = Odometry_array_angularRates_struct_element_length + Odometry_array_angularRates_array_element_length[k];
  
  Odometry_payload_buffer_angularRates[0] = Odometry_array_angularRates_struct_element_length>>24 & 0xFF;
  Odometry_payload_buffer_angularRates[1] = Odometry_array_angularRates_struct_element_length>>16 & 0xFF;
  Odometry_payload_buffer_angularRates[2] = Odometry_array_angularRates_struct_element_length>> 8 & 0xFF;
  Odometry_payload_buffer_angularRates[3] = Odometry_array_angularRates_struct_element_length     & 0xFF;


  Odometry_payload_length_angularRates = Odometry_array_angularRates_struct_element_length+4;
  putvalue(Odometry_Notification_angularRates_Payload, Odometry_payload_buffer_angularRates, Odometry_payload_length_angularRates);
}

on envVar Odometry_Notification_angularRates_Element_TotalNum
{
  if (@this == 0) @this =  1;
  if (@this > 10) @this = 10;
  
  Odometry_Notification_angularRates();
  Odometry_Notification_angularRates_update();
}

on envVar Odometry_Notification_angularRates_Element
{
  Odometry_Notification_angularRates_update();
}

on envVar Odometry_Notification_angularRates_Element_Next
{
  if (@this == 1 && @Odometry_Notification_angularRates_Element < @Odometry_Notification_angularRates_Element_TotalNum - 1)
  {
    @Odometry_Notification_angularRates_Element = @Odometry_Notification_angularRates_Element + 1;
    Odometry_Notification_angularRates_update();
  }
}

on envVar Odometry_Notification_angularRates_Element_Previous
{
  if (@this == 1 && @Odometry_Notification_angularRates_Element > 0)
  {
    @Odometry_Notification_angularRates_Element = @Odometry_Notification_angularRates_Element - 1;
    Odometry_Notification_angularRates_update();
  }
}

Odometry_Notification_angularRates_update()
{
  @Odometry_Notification_LengthIndicator_Element_angularRates = Odometry_array_angularRates_array_element_length[@Odometry_Notification_angularRates_Element];
  @Odometry_Notification_LengthIndicator_Struct_angularRates  = Odometry_array_angularRates_struct_element_length;
  @Odometry_Notification_Length_angularRates                  = Odometry_payload_length_angularRates+8;
  
  @Odometry_Notification_angularRates_type        = Odometry_array_angularRates_type[@Odometry_Notification_angularRates_Element];
  @Odometry_Notification_angularRates_timestamp   = Odometry_array_angularRates_timestamp[@Odometry_Notification_angularRates_Element];
  @Odometry_Notification_angularRates_angularrate = Odometry_array_angularRates_angularrate[@Odometry_Notification_angularRates_Element];
  @Odometry_Notification_angularRates_variance    = Odometry_array_angularRates_variance[@Odometry_Notification_angularRates_Element];
  @Odometry_Notification_angularRates_confidence  = Odometry_array_angularRates_confidence[@Odometry_Notification_angularRates_Element];
  
  @Odometry_Notification_angularRates_type_available        = Odometry_array_angularRates_type_available[@Odometry_Notification_angularRates_Element];
  @Odometry_Notification_angularRates_timestamp_available   = Odometry_array_angularRates_timestamp_available[@Odometry_Notification_angularRates_Element];
  @Odometry_Notification_angularRates_angularrate_available = Odometry_array_angularRates_angularrate_available[@Odometry_Notification_angularRates_Element];
  @Odometry_Notification_angularRates_variance_available    = Odometry_array_angularRates_variance_available[@Odometry_Notification_angularRates_Element];
  @Odometry_Notification_angularRates_confidence_available  = Odometry_array_angularRates_confidence_available[@Odometry_Notification_angularRates_Element];
}







////////////////////////////////////////////////////////////////////
////////////////// Service ChargingManagementCore //////////////////
////////////////////////////////////////////////////////////////////

on envVar ServiceDiscovery_Offer_Service_ChargingManagementCore
{
  Send_ServiceDiscovery_Offer_Service_ICAS1Gateway();
}

on envVar ChargingManagementCore_Notification_immediateChargingOptions_Send
{
  if (@this == 1)
  {
    UDP_Segments_total = @ChargingManagementCore_Notification_Length_immediateChargingOptions/1404 + 1;
    UDP_Segments_left  = UDP_Segments_total;
    
    if (UDP_Segments_total > 1) seg_id_flag = 1;
    else                        seg_id_flag = 0;
    
    Send_Service_ChargingManagementCore_Notification (0xC010 & 0x0000FFFF);
  }
}
on envVar ChargingManagementCore_Notification_immediateChargingOptions_Send_cyclic
{
  if (@this == 1)
    setTimercyclic (tChargingManagementCore_Notification_immediateChargingOptions_Send, @ChargingManagementCore_Notification_immediateChargingOptions_Send_cyclic_cycletime);
  else
    cancelTimer (tChargingManagementCore_Notification_immediateChargingOptions_Send);
}
on envVar ChargingManagementCore_Notification_immediateChargingOptions_Send_cyclic_cycletime
{
  if (@ChargingManagementCore_Notification_immediateChargingOptions_Send_cyclic == 1)
  {
    cancelTimer (tChargingManagementCore_Notification_immediateChargingOptions_Send);
    setTimercyclic (tChargingManagementCore_Notification_immediateChargingOptions_Send, @this);
  }
}
on timer tChargingManagementCore_Notification_immediateChargingOptions_Send
{
  UDP_Segments_total = @ChargingManagementCore_Notification_Length_immediateChargingOptions/1404 + 1;
  UDP_Segments_left  = UDP_Segments_total;
  
  if (UDP_Segments_total > 1) seg_id_flag = 1;
  else                        seg_id_flag = 0;
    
  if (@Env_GlobalAppl == 1) Send_Service_ChargingManagementCore_Notification (0xC010 & 0x0000FFFF);
}

on envVar ChargingManagementCore_Notification_chargingProcessInformation_Send
{
  if (@this == 1)
  {
    UDP_Segments_total = @ChargingManagementCore_Notification_Length_chargingProcessInformation/1404 + 1;
    UDP_Segments_left  = UDP_Segments_total;
    
    if (UDP_Segments_total > 1) seg_id_flag = 1;
    else                        seg_id_flag = 0;
    
    Send_Service_ChargingManagementCore_Notification (0xC020 & 0x0000FFFF);
  }
}
on envVar ChargingManagementCore_Notification_chargingProcessInformation_Send_cyclic
{
  if (@this == 1)
    setTimercyclic (tChargingManagementCore_Notification_chargingProcessInformation_Send, @ChargingManagementCore_Notification_chargingProcessInformation_Send_cyclic_cycletime);
  else
    cancelTimer (tChargingManagementCore_Notification_chargingProcessInformation_Send);
}
on envVar ChargingManagementCore_Notification_chargingProcessInformation_Send_cyclic_cycletime
{
  if (@ChargingManagementCore_Notification_chargingProcessInformation_Send_cyclic == 1)
  {
    cancelTimer (tChargingManagementCore_Notification_chargingProcessInformation_Send);
    setTimercyclic (tChargingManagementCore_Notification_chargingProcessInformation_Send, @this);
  }
}
on timer tChargingManagementCore_Notification_chargingProcessInformation_Send
{
  UDP_Segments_total = @ChargingManagementCore_Notification_Length_chargingProcessInformation/1404 + 1;
  UDP_Segments_left  = UDP_Segments_total;
  
  if (UDP_Segments_total > 1) seg_id_flag = 1;
  else                        seg_id_flag = 0;
    
  if (@Env_GlobalAppl == 1) Send_Service_ChargingManagementCore_Notification (0xC020 & 0x0000FFFF);
}

on envVar ChargingManagementCore_Notification_chargingPlugs_Send
{
  if (@this == 1)
  {
    UDP_Segments_total = @ChargingManagementCore_Notification_Length_chargingPlugs/1404 + 1;
    UDP_Segments_left  = UDP_Segments_total;
    
    if (UDP_Segments_total > 1) seg_id_flag = 1;
    else                        seg_id_flag = 0;
    
    Send_Service_ChargingManagementCore_Notification (0xC030 & 0x0000FFFF);
  }
}
on envVar ChargingManagementCore_Notification_chargingPlugs_Send_cyclic
{
  if (@this == 1)
    setTimercyclic (tChargingManagementCore_Notification_chargingPlugs_Send, @ChargingManagementCore_Notification_chargingPlugs_Send_cyclic_cycletime);
  else
    cancelTimer (tChargingManagementCore_Notification_chargingPlugs_Send);
}
on envVar ChargingManagementCore_Notification_chargingPlugs_Send_cyclic_cycletime
{
  if (@ChargingManagementCore_Notification_chargingPlugs_Send_cyclic == 1)
  {
    cancelTimer (tChargingManagementCore_Notification_chargingPlugs_Send);
    setTimercyclic (tChargingManagementCore_Notification_chargingPlugs_Send, @this);
  }
}
on timer tChargingManagementCore_Notification_chargingPlugs_Send
{
  UDP_Segments_total = @ChargingManagementCore_Notification_Length_chargingPlugs/1404 + 1;
  UDP_Segments_left  = UDP_Segments_total;
  
  if (UDP_Segments_total > 1) seg_id_flag = 1;
  else                        seg_id_flag = 0;
    
  if (@Env_GlobalAppl == 1) Send_Service_ChargingManagementCore_Notification (0xC030 & 0x0000FFFF);
}

on envVar ChargingManagementCore_Notification_immediateActions_Send
{
  if (@this == 1)
  {
    UDP_Segments_total = @ChargingManagementCore_Notification_Length_immediateActions/1404 + 1;
    UDP_Segments_left  = UDP_Segments_total;
    
    if (UDP_Segments_total > 1) seg_id_flag = 1;
    else                        seg_id_flag = 0;
    
    Send_Service_ChargingManagementCore_Notification (0xC040 & 0x0000FFFF);
  }
}
on envVar ChargingManagementCore_Notification_immediateActions_Send_cyclic
{
  if (@this == 1)
    setTimercyclic (tChargingManagementCore_Notification_immediateActions_Send, @ChargingManagementCore_Notification_immediateActions_Send_cyclic_cycletime);
  else
    cancelTimer (tChargingManagementCore_Notification_immediateActions_Send);
}
on envVar ChargingManagementCore_Notification_immediateActions_Send_cyclic_cycletime
{
  if (@ChargingManagementCore_Notification_immediateActions_Send_cyclic == 1)
  {
    cancelTimer (tChargingManagementCore_Notification_immediateActions_Send);
    setTimercyclic (tChargingManagementCore_Notification_immediateActions_Send, @this);
  }
}
on timer tChargingManagementCore_Notification_immediateActions_Send
{
  UDP_Segments_total = @ChargingManagementCore_Notification_Length_immediateActions/1404 + 1;
  UDP_Segments_left  = UDP_Segments_total;
  
  if (UDP_Segments_total > 1) seg_id_flag = 1;
  else                        seg_id_flag = 0;
    
  if (@Env_GlobalAppl == 1) Send_Service_ChargingManagementCore_Notification (0xC040 & 0x0000FFFF);
}

on envVar ChargingManagementCore_Notification_notificationMarkers_Send
{
  if (@this == 1)
  {
    UDP_Segments_total = @ChargingManagementCore_Notification_Length_notificationMarkers/1404 + 1;
    UDP_Segments_left  = UDP_Segments_total;
    
    if (UDP_Segments_total > 1) seg_id_flag = 1;
    else                        seg_id_flag = 0;
    
    Send_Service_ChargingManagementCore_Notification (0xC050 & 0x0000FFFF);
  }
}
on envVar ChargingManagementCore_Notification_notificationMarkers_Send_cyclic
{
  if (@this == 1)
    setTimercyclic (tChargingManagementCore_Notification_notificationMarkers_Send, @ChargingManagementCore_Notification_notificationMarkers_Send_cyclic_cycletime);
  else
    cancelTimer (tChargingManagementCore_Notification_notificationMarkers_Send);
}
on envVar ChargingManagementCore_Notification_notificationMarkers_Send_cyclic_cycletime
{
  if (@ChargingManagementCore_Notification_notificationMarkers_Send_cyclic == 1)
  {
    cancelTimer (tChargingManagementCore_Notification_notificationMarkers_Send);
    setTimercyclic (tChargingManagementCore_Notification_notificationMarkers_Send, @this);
  }
}
on timer tChargingManagementCore_Notification_notificationMarkers_Send
{
  UDP_Segments_total = @ChargingManagementCore_Notification_Length_notificationMarkers/1404 + 1;
  UDP_Segments_left  = UDP_Segments_total;
  
  if (UDP_Segments_total > 1) seg_id_flag = 1;
  else                        seg_id_flag = 0;
    
  if (@Env_GlobalAppl == 1) Send_Service_ChargingManagementCore_Notification (0xC050 & 0x0000FFFF);
}

on envVar ChargingManagementCore_Notification_notifications_Send
{
  if (@this == 1)
  {
    UDP_Segments_total = @ChargingManagementCore_Notification_Length_notifications/1404 + 1;
    UDP_Segments_left  = UDP_Segments_total;
    
    if (UDP_Segments_total > 1) seg_id_flag = 1;
    else                        seg_id_flag = 0;
    
    Send_Service_ChargingManagementCore_Notification (0xC060 & 0x0000FFFF);
  }
}
on envVar ChargingManagementCore_Notification_notifications_Send_cyclic
{
  if (@this == 1)
    setTimercyclic (tChargingManagementCore_Notification_notifications_Send, @ChargingManagementCore_Notification_notifications_Send_cyclic_cycletime);
  else
    cancelTimer (tChargingManagementCore_Notification_notifications_Send);
}
on envVar ChargingManagementCore_Notification_notifications_Send_cyclic_cycletime
{
  if (@ChargingManagementCore_Notification_notifications_Send_cyclic == 1)
  {
    cancelTimer (tChargingManagementCore_Notification_notifications_Send);
    setTimercyclic (tChargingManagementCore_Notification_notifications_Send, @this);
  }
}
on timer tChargingManagementCore_Notification_notifications_Send
{
  UDP_Segments_total = @ChargingManagementCore_Notification_Length_notifications/1404 + 1;
  UDP_Segments_left  = UDP_Segments_total;
  
  if (UDP_Segments_total > 1) seg_id_flag = 1;
  else                        seg_id_flag = 0;
    
  if (@Env_GlobalAppl == 1) Send_Service_ChargingManagementCore_Notification (0xC060 & 0x0000FFFF);
}

on envVar ChargingManagementCore_Notification_pastErrorInformation_Send
{
  if (@this == 1)
  {
    UDP_Segments_total = @ChargingManagementCore_Notification_Length_pastErrorInformation/1404 + 1;
    UDP_Segments_left  = UDP_Segments_total;
    
    if (UDP_Segments_total > 1) seg_id_flag = 1;
    else                        seg_id_flag = 0;
    
    Send_Service_ChargingManagementCore_Notification (0xC070 & 0x0000FFFF);
  }
}
on envVar ChargingManagementCore_Notification_pastErrorInformation_Send_cyclic
{
  if (@this == 1)
    setTimercyclic (tChargingManagementCore_Notification_pastErrorInformation_Send, @ChargingManagementCore_Notification_pastErrorInformation_Send_cyclic_cycletime);
  else
    cancelTimer (tChargingManagementCore_Notification_pastErrorInformation_Send);
}
on envVar ChargingManagementCore_Notification_pastErrorInformation_Send_cyclic_cycletime
{
  if (@ChargingManagementCore_Notification_pastErrorInformation_Send_cyclic == 1)
  {
    cancelTimer (tChargingManagementCore_Notification_pastErrorInformation_Send);
    setTimercyclic (tChargingManagementCore_Notification_pastErrorInformation_Send, @this);
  }
}
on timer tChargingManagementCore_Notification_pastErrorInformation_Send
{
  UDP_Segments_total = @ChargingManagementCore_Notification_Length_pastErrorInformation/1404 + 1;
  UDP_Segments_left  = UDP_Segments_total;
  
  if (UDP_Segments_total > 1) seg_id_flag = 1;
  else                        seg_id_flag = 0;
    
  if (@Env_GlobalAppl == 1) Send_Service_ChargingManagementCore_Notification (0xC070 & 0x0000FFFF);
}

on envVar ChargingManagementCore_Notification_views_Send
{
  if (@this == 1)
  {
    UDP_Segments_total = @ChargingManagementCore_Notification_Length_views/1404 + 1;
    UDP_Segments_left  = UDP_Segments_total;
    
    if (UDP_Segments_total > 1) seg_id_flag = 1;
    else                        seg_id_flag = 0;
    
    Send_Service_ChargingManagementCore_Notification (0xC080 & 0x0000FFFF);
  }
}
on envVar ChargingManagementCore_Notification_views_Send_cyclic
{
  if (@this == 1)
    setTimercyclic (tChargingManagementCore_Notification_views_Send, @ChargingManagementCore_Notification_views_Send_cyclic_cycletime);
  else
    cancelTimer (tChargingManagementCore_Notification_views_Send);
}
on envVar ChargingManagementCore_Notification_views_Send_cyclic_cycletime
{
  if (@ChargingManagementCore_Notification_views_Send_cyclic == 1)
  {
    cancelTimer (tChargingManagementCore_Notification_views_Send);
    setTimercyclic (tChargingManagementCore_Notification_views_Send, @this);
  }
}
on timer tChargingManagementCore_Notification_views_Send
{
  UDP_Segments_total = @ChargingManagementCore_Notification_Length_views/1404 + 1;
  UDP_Segments_left  = UDP_Segments_total;
  
  if (UDP_Segments_total > 1) seg_id_flag = 1;
  else                        seg_id_flag = 0;
    
  if (@Env_GlobalAppl == 1) Send_Service_ChargingManagementCore_Notification (0xC080 & 0x0000FFFF);
}

on envVar ChargingManagementCore_Notification_oruUpdateApprovals_Send
{
  if (@this == 1)
  {
    UDP_Segments_total = @ChargingManagementCore_Notification_Length_oruUpdateApprovals/1404 + 1;
    UDP_Segments_left  = UDP_Segments_total;
    
    if (UDP_Segments_total > 1) seg_id_flag = 1;
    else                        seg_id_flag = 0;
    
    Send_Service_ChargingManagementCore_Notification (0xC090 & 0x0000FFFF);
  }
}
on envVar ChargingManagementCore_Notification_oruUpdateApprovals_Send_cyclic
{
  if (@this == 1)
    setTimercyclic (tChargingManagementCore_Notification_oruUpdateApprovals_Send, @ChargingManagementCore_Notification_oruUpdateApprovals_Send_cyclic_cycletime);
  else
    cancelTimer (tChargingManagementCore_Notification_oruUpdateApprovals_Send);
}
on envVar ChargingManagementCore_Notification_oruUpdateApprovals_Send_cyclic_cycletime
{
  if (@ChargingManagementCore_Notification_oruUpdateApprovals_Send_cyclic == 1)
  {
    cancelTimer (tChargingManagementCore_Notification_oruUpdateApprovals_Send);
    setTimercyclic (tChargingManagementCore_Notification_oruUpdateApprovals_Send, @this);
  }
}
on timer tChargingManagementCore_Notification_oruUpdateApprovals_Send
{
  UDP_Segments_total = @ChargingManagementCore_Notification_Length_oruUpdateApprovals/1404 + 1;
  UDP_Segments_left  = UDP_Segments_total;
  
  if (UDP_Segments_total > 1) seg_id_flag = 1;
  else                        seg_id_flag = 0;
    
  if (@Env_GlobalAppl == 1) Send_Service_ChargingManagementCore_Notification (0xC090 & 0x0000FFFF);
}

on envVar ChargingManagementCore_Notification_switchControls_Send
{
  if (@this == 1)
  {
    UDP_Segments_total = @ChargingManagementCore_Notification_Length_switchControls/1404 + 1;
    UDP_Segments_left  = UDP_Segments_total;
    
    if (UDP_Segments_total > 1) seg_id_flag = 1;
    else                        seg_id_flag = 0;
    
    Send_Service_ChargingManagementCore_Notification (0xC0A0 & 0x0000FFFF);
  }
}
on envVar ChargingManagementCore_Notification_switchControls_Send_cyclic
{
  if (@this == 1)
    setTimercyclic (tChargingManagementCore_Notification_switchControls_Send, @ChargingManagementCore_Notification_switchControls_Send_cyclic_cycletime);
  else
    cancelTimer (tChargingManagementCore_Notification_switchControls_Send);
}
on envVar ChargingManagementCore_Notification_switchControls_Send_cyclic_cycletime
{
  if (@ChargingManagementCore_Notification_switchControls_Send_cyclic == 1)
  {
    cancelTimer (tChargingManagementCore_Notification_switchControls_Send);
    setTimercyclic (tChargingManagementCore_Notification_switchControls_Send, @this);
  }
}
on timer tChargingManagementCore_Notification_switchControls_Send
{
  UDP_Segments_total = @ChargingManagementCore_Notification_Length_switchControls/1404 + 1;
  UDP_Segments_left  = UDP_Segments_total;
  
  if (UDP_Segments_total > 1) seg_id_flag = 1;
  else                        seg_id_flag = 0;
    
  if (@Env_GlobalAppl == 1) Send_Service_ChargingManagementCore_Notification (0xC0A0 & 0x0000FFFF);
}

on envVar ChargingManagementCore_Notification_valueControls_Send
{
  if (@this == 1)
  {
    UDP_Segments_total = @ChargingManagementCore_Notification_Length_valueControls/1404 + 1;
    UDP_Segments_left  = UDP_Segments_total;
    
    if (UDP_Segments_total > 1) seg_id_flag = 1;
    else                        seg_id_flag = 0;
    
    Send_Service_ChargingManagementCore_Notification (0xC0B0 & 0x0000FFFF);
  }
}
on envVar ChargingManagementCore_Notification_valueControls_Send_cyclic
{
  if (@this == 1)
    setTimercyclic (tChargingManagementCore_Notification_valueControls_Send, @ChargingManagementCore_Notification_valueControls_Send_cyclic_cycletime);
  else
    cancelTimer (tChargingManagementCore_Notification_valueControls_Send);
}
on envVar ChargingManagementCore_Notification_valueControls_Send_cyclic_cycletime
{
  if (@ChargingManagementCore_Notification_valueControls_Send_cyclic == 1)
  {
    cancelTimer (tChargingManagementCore_Notification_valueControls_Send);
    setTimercyclic (tChargingManagementCore_Notification_valueControls_Send, @this);
  }
}
on timer tChargingManagementCore_Notification_valueControls_Send
{
  UDP_Segments_total = @ChargingManagementCore_Notification_Length_valueControls/1404 + 1;
  UDP_Segments_left  = UDP_Segments_total;
  
  if (UDP_Segments_total > 1) seg_id_flag = 1;
  else                        seg_id_flag = 0;
    
  if (@Env_GlobalAppl == 1) Send_Service_ChargingManagementCore_Notification (0xC0B0 & 0x0000FFFF);
}

on envVar ChargingManagementCore_Notification_valueIndications_Send
{
  if (@this == 1)
  {
    UDP_Segments_total = @ChargingManagementCore_Notification_Length_valueIndications/1404 + 1;
    UDP_Segments_left  = UDP_Segments_total;
    
    if (UDP_Segments_total > 1) seg_id_flag = 1;
    else                        seg_id_flag = 0;
    
    Send_Service_ChargingManagementCore_Notification (0xC0C0 & 0x0000FFFF);
  }
}
on envVar ChargingManagementCore_Notification_valueIndications_Send_cyclic
{
  if (@this == 1)
    setTimercyclic (tChargingManagementCore_Notification_valueIndications_Send, @ChargingManagementCore_Notification_valueIndications_Send_cyclic_cycletime);
  else
    cancelTimer (tChargingManagementCore_Notification_valueIndications_Send);
}
on envVar ChargingManagementCore_Notification_valueIndications_Send_cyclic_cycletime
{
  if (@ChargingManagementCore_Notification_valueIndications_Send_cyclic == 1)
  {
    cancelTimer (tChargingManagementCore_Notification_valueIndications_Send);
    setTimercyclic (tChargingManagementCore_Notification_valueIndications_Send, @this);
  }
}
on timer tChargingManagementCore_Notification_valueIndications_Send
{
  UDP_Segments_total = @ChargingManagementCore_Notification_Length_valueIndications/1404 + 1;
  UDP_Segments_left  = UDP_Segments_total;
  
  if (UDP_Segments_total > 1) seg_id_flag = 1;
  else                        seg_id_flag = 0;
    
  if (@Env_GlobalAppl == 1) Send_Service_ChargingManagementCore_Notification (0xC0C0 & 0x0000FFFF);
}

on envVar ChargingManagementCore_Notification_resetToFactoryData_Send
{
  if (@this == 1)
  {
    UDP_Segments_total = @ChargingManagementCore_Notification_Length_resetToFactoryData/1404 + 1;
    UDP_Segments_left  = UDP_Segments_total;
    
    if (UDP_Segments_total > 1) seg_id_flag = 1;
    else                        seg_id_flag = 0;
    
    Send_Service_ChargingManagementCore_Notification (0xC0D0 & 0x0000FFFF);
  }
}
on envVar ChargingManagementCore_Notification_resetToFactoryData_Send_cyclic
{
  if (@this == 1)
    setTimercyclic (tChargingManagementCore_Notification_resetToFactoryData_Send, @ChargingManagementCore_Notification_resetToFactoryData_Send_cyclic_cycletime);
  else
    cancelTimer (tChargingManagementCore_Notification_resetToFactoryData_Send);
}
on envVar ChargingManagementCore_Notification_resetToFactoryData_Send_cyclic_cycletime
{
  if (@ChargingManagementCore_Notification_resetToFactoryData_Send_cyclic == 1)
  {
    cancelTimer (tChargingManagementCore_Notification_resetToFactoryData_Send);
    setTimercyclic (tChargingManagementCore_Notification_resetToFactoryData_Send, @this);
  }
}
on timer tChargingManagementCore_Notification_resetToFactoryData_Send
{
  UDP_Segments_total = @ChargingManagementCore_Notification_Length_resetToFactoryData/1404 + 1;
  UDP_Segments_left  = UDP_Segments_total;
  
  if (UDP_Segments_total > 1) seg_id_flag = 1;
  else                        seg_id_flag = 0;
    
  if (@Env_GlobalAppl == 1) Send_Service_ChargingManagementCore_Notification (0xC0D0 & 0x0000FFFF);
}


Send_Service_ChargingManagementCore_Notification (word MethodID)
{
  ethernetPacket EthPaket;

  // Ethernet Packet - MAC Source address
  getvalue (ServiceDiscovery_EthernetPacket_MAC_Source_ICAS1Gateway, buffer_MAC);
  //EthPaket.source.ParseAddress ( buffer_MAC );
  EthPaket.source = ethGetMacAddressAsNumber (buffer_MAC);
  
  // Ethernet Packet - MAC Destination address
  getvalue (ServiceDiscovery_EthernetPacket_MAC_Destination, buffer_MAC);
  //EthPaket.destination.ParseAddress ( buffer_MAC );
  EthPaket.destination = ethGetMacAddressAsNumber (buffer_MAC);
  
  // Ethernet Packet - VLAN
  EthPaket.SetVlan (@ServiceDiscovery_EthernetPacket_VLAN_TPID, @ServiceDiscovery_EthernetPacket_VLAN_TCI);
  
  // Ethernet Packet - Type
  //EthPaket.ipv6.type = @EthernetPacket_Type;
  if (@ServiceDiscovery_EthernetPacket_Type == 0x86DD) EthPaket.ipv6.Init();
  
  
  // IPv6 Packet - Version
  EthPaket.ipv6.version = @ServiceDiscovery_IPv6Packet_Version;

  // IPv6 Packet - Traffic Class
  EthPaket.ipv6.class = @ServiceDiscovery_IPv6Packet_Traffic_Class;
  
  // IPv6 Packet - Flow Label
  EthPaket.ipv6.flow = @ServiceDiscovery_IPv6Packet_Flow_Label;
  
  // IPv6 Packet - Payload_Length
  EthPaket.ipv6.length = @ServiceDiscovery_IPv6Packet_Payload_Length;
  
  // IPv6 Packet - Next Header
  EthPaket.ipv6.next = @ServiceDiscovery_IPv6Packet_Next_Header;
  if (@ServiceDiscovery_IPv6Packet_Next_Header == 6) EthPaket.tcp.Init();
  if (@ServiceDiscovery_IPv6Packet_Next_Header == 17) EthPaket.udp.Init();
  
  // IPv6 Packet - Hop Limit
  EthPaket.ipv6.hopLimit = @ServiceDiscovery_IPv6Packet_Hop_Limit;

  // IPv6 Packet - IPv6 Destination address    // TODO: char array zu byte array
  buffer_ipv6[0]  = @ServiceDiscovery_IPv6Packet_IP_Destination_Unicast_01>>8 & 0xFF;
  buffer_ipv6[1]  = @ServiceDiscovery_IPv6Packet_IP_Destination_Unicast_01    & 0xFF;
  buffer_ipv6[2]  = @ServiceDiscovery_IPv6Packet_IP_Destination_Unicast_02>>8 & 0xFF;
  buffer_ipv6[3]  = @ServiceDiscovery_IPv6Packet_IP_Destination_Unicast_02    & 0xFF;
  buffer_ipv6[4]  = @ServiceDiscovery_IPv6Packet_IP_Destination_Unicast_03>>8 & 0xFF;
  buffer_ipv6[5]  = @ServiceDiscovery_IPv6Packet_IP_Destination_Unicast_03    & 0xFF;
  buffer_ipv6[6]  = @ServiceDiscovery_IPv6Packet_IP_Destination_Unicast_04>>8 & 0xFF;
  buffer_ipv6[7]  = @ServiceDiscovery_IPv6Packet_IP_Destination_Unicast_04    & 0xFF;
  buffer_ipv6[8]  = @ServiceDiscovery_IPv6Packet_IP_Destination_Unicast_05>>8 & 0xFF;
  buffer_ipv6[9]  = @ServiceDiscovery_IPv6Packet_IP_Destination_Unicast_05    & 0xFF;
  buffer_ipv6[10] = @ServiceDiscovery_IPv6Packet_IP_Destination_Unicast_06>>8 & 0xFF;
  buffer_ipv6[11] = @ServiceDiscovery_IPv6Packet_IP_Destination_Unicast_06    & 0xFF;
  buffer_ipv6[12] = @ServiceDiscovery_IPv6Packet_IP_Destination_Unicast_07>>8 & 0xFF;
  buffer_ipv6[13] = @ServiceDiscovery_IPv6Packet_IP_Destination_Unicast_07    & 0xFF;
  buffer_ipv6[14] = @ServiceDiscovery_IPv6Packet_IP_Destination_Unicast_08>>8 & 0xFF;
  buffer_ipv6[15] = @ServiceDiscovery_IPv6Packet_IP_Destination_Unicast_08    & 0xFF;
  EthPaket.ipv6.destination.SetData ( 0, buffer_ipv6, elcount(buffer_ipv6) );

  // IPv6 Packet - IPv6 Source address    // TODO: char array zu byte array
  buffer_ipv6[0]  = @ServiceDiscovery_IPv6Packet_IP_Source_ICAS1Gateway_01>>8 & 0xFF;
  buffer_ipv6[1]  = @ServiceDiscovery_IPv6Packet_IP_Source_ICAS1Gateway_01    & 0xFF;
  buffer_ipv6[2]  = @ServiceDiscovery_IPv6Packet_IP_Source_ICAS1Gateway_02>>8 & 0xFF;
  buffer_ipv6[3]  = @ServiceDiscovery_IPv6Packet_IP_Source_ICAS1Gateway_02    & 0xFF;
  buffer_ipv6[4]  = @ServiceDiscovery_IPv6Packet_IP_Source_ICAS1Gateway_03>>8 & 0xFF;
  buffer_ipv6[5]  = @ServiceDiscovery_IPv6Packet_IP_Source_ICAS1Gateway_03    & 0xFF;
  buffer_ipv6[6]  = @ServiceDiscovery_IPv6Packet_IP_Source_ICAS1Gateway_04>>8 & 0xFF;
  buffer_ipv6[7]  = @ServiceDiscovery_IPv6Packet_IP_Source_ICAS1Gateway_04    & 0xFF;
  buffer_ipv6[8]  = @ServiceDiscovery_IPv6Packet_IP_Source_ICAS1Gateway_05>>8 & 0xFF;
  buffer_ipv6[9]  = @ServiceDiscovery_IPv6Packet_IP_Source_ICAS1Gateway_05    & 0xFF;
  buffer_ipv6[10] = @ServiceDiscovery_IPv6Packet_IP_Source_ICAS1Gateway_06>>8 & 0xFF;
  buffer_ipv6[11] = @ServiceDiscovery_IPv6Packet_IP_Source_ICAS1Gateway_06    & 0xFF;
  buffer_ipv6[12] = @ServiceDiscovery_IPv6Packet_IP_Source_ICAS1Gateway_07>>8 & 0xFF;
  buffer_ipv6[13] = @ServiceDiscovery_IPv6Packet_IP_Source_ICAS1Gateway_07    & 0xFF;
  buffer_ipv6[14] = @ServiceDiscovery_IPv6Packet_IP_Source_ICAS1Gateway_08>>8 & 0xFF;
  buffer_ipv6[15] = @ServiceDiscovery_IPv6Packet_IP_Source_ICAS1Gateway_08    & 0xFF;
  EthPaket.ipv6.source.SetData ( 0, buffer_ipv6, elcount(buffer_ipv6) );

  
  // UDP Packet - Source Port
  EthPaket.udp.source = @ChargingManagementCore_Notification_Port_Source;
  
  // UDP Packet - Destination Port
  EthPaket.udp.destination = @ChargingManagementCore_Notification_Port_Destination;
  
  // UDP Packet - Length
  EthPaket.udp.length = @ServiceDiscovery_UDPPacket_Length;
  
  
  // SOME/IP Packet aus Rohdaten zusammenbauen (buffer array)
  i=0;
  
  // SOME/IP Packet - Message ID, Service ID [16 bit]
  buffer[i++] = @ChargingManagementCore_Notification_Message_ID_Service_ID>>8 & 0xFF;
  buffer[i++] = @ChargingManagementCore_Notification_Message_ID_Service_ID    & 0xFF;
  
  // SOME/IP Packet - Message ID, Message ID [16 bit]
  switch (MethodID)
  {
    case 0xC010: @ChargingManagementCore_Notification_Message_ID_Method_ID = @ChargingManagementCore_Notification_Message_ID_Method_ID_immediateChargingOptions; break;
    case 0xC020: @ChargingManagementCore_Notification_Message_ID_Method_ID = @ChargingManagementCore_Notification_Message_ID_Method_ID_chargingProcessInformation; break;
    case 0xC030: @ChargingManagementCore_Notification_Message_ID_Method_ID = @ChargingManagementCore_Notification_Message_ID_Method_ID_chargingPlugs; break;
    case 0xC040: @ChargingManagementCore_Notification_Message_ID_Method_ID = @ChargingManagementCore_Notification_Message_ID_Method_ID_immediateActions; break;
    case 0xC050: @ChargingManagementCore_Notification_Message_ID_Method_ID = @ChargingManagementCore_Notification_Message_ID_Method_ID_notificationMarkers; break;
    case 0xC060: @ChargingManagementCore_Notification_Message_ID_Method_ID = @ChargingManagementCore_Notification_Message_ID_Method_ID_notifications; break;
    case 0xC070: @ChargingManagementCore_Notification_Message_ID_Method_ID = @ChargingManagementCore_Notification_Message_ID_Method_ID_pastErrorInformation; break;
    case 0xC080: @ChargingManagementCore_Notification_Message_ID_Method_ID = @ChargingManagementCore_Notification_Message_ID_Method_ID_views; break;
    case 0xC090: @ChargingManagementCore_Notification_Message_ID_Method_ID = @ChargingManagementCore_Notification_Message_ID_Method_ID_oruUpdateApprovals; break;
    case 0xC0A0: @ChargingManagementCore_Notification_Message_ID_Method_ID = @ChargingManagementCore_Notification_Message_ID_Method_ID_switchControls; break;
    case 0xC0B0: @ChargingManagementCore_Notification_Message_ID_Method_ID = @ChargingManagementCore_Notification_Message_ID_Method_ID_valueControls; break;
    case 0xC0C0: @ChargingManagementCore_Notification_Message_ID_Method_ID = @ChargingManagementCore_Notification_Message_ID_Method_ID_valueIndications; break;
    case 0xC0D0: @ChargingManagementCore_Notification_Message_ID_Method_ID = @ChargingManagementCore_Notification_Message_ID_Method_ID_resetToFactoryData; break;
  }
  buffer[i++] = @ChargingManagementCore_Notification_Message_ID_Method_ID>>8 & 0xFF;
  buffer[i++] = @ChargingManagementCore_Notification_Message_ID_Method_ID    & 0xFF;
  
  // SOME/IP Packet - Length [32 bit]
  if (UDP_Segments_total == 1)
  {
    switch (MethodID)
    {
      case 0xC010: @ChargingManagementCore_Notification_Length = @ChargingManagementCore_Notification_Length_immediateChargingOptions; break;
      case 0xC020: @ChargingManagementCore_Notification_Length = @ChargingManagementCore_Notification_Length_chargingProcessInformation; break;
      case 0xC030: @ChargingManagementCore_Notification_Length = @ChargingManagementCore_Notification_Length_chargingPlugs; break;
      case 0xC040: @ChargingManagementCore_Notification_Length = @ChargingManagementCore_Notification_Length_immediateActions; break;
      case 0xC050: @ChargingManagementCore_Notification_Length = @ChargingManagementCore_Notification_Length_notificationMarkers; break;
      case 0xC060: @ChargingManagementCore_Notification_Length = @ChargingManagementCore_Notification_Length_notifications; break;
      case 0xC070: @ChargingManagementCore_Notification_Length = @ChargingManagementCore_Notification_Length_pastErrorInformation; break;
      case 0xC080: @ChargingManagementCore_Notification_Length = @ChargingManagementCore_Notification_Length_views; break;
      case 0xC090: @ChargingManagementCore_Notification_Length = @ChargingManagementCore_Notification_Length_oruUpdateApprovals; break;
      case 0xC0A0: @ChargingManagementCore_Notification_Length = @ChargingManagementCore_Notification_Length_switchControls; break;
      case 0xC0B0: @ChargingManagementCore_Notification_Length = @ChargingManagementCore_Notification_Length_valueControls; break;
      case 0xC0C0: @ChargingManagementCore_Notification_Length = @ChargingManagementCore_Notification_Length_valueIndications; break;
      case 0xC0D0: @ChargingManagementCore_Notification_Length = @ChargingManagementCore_Notification_Length_resetToFactoryData; break;
    }
  }
  else
  {
    if (UDP_Segments_left > 1)
    {
      switch (MethodID)
      {
        case 0xC010: @ChargingManagementCore_Notification_Length = 1404; break;
        case 0xC020: @ChargingManagementCore_Notification_Length = 1404; break;
        case 0xC030: @ChargingManagementCore_Notification_Length = 1404; break;
        case 0xC040: @ChargingManagementCore_Notification_Length = 1404; break;
        case 0xC050: @ChargingManagementCore_Notification_Length = 1404; break;
        case 0xC060: @ChargingManagementCore_Notification_Length = 1404; break;
        case 0xC070: @ChargingManagementCore_Notification_Length = 1404; break;
        case 0xC080: @ChargingManagementCore_Notification_Length = 1404; break;
        case 0xC090: @ChargingManagementCore_Notification_Length = 1404; break;
        case 0xC0A0: @ChargingManagementCore_Notification_Length = 1404; break;
        case 0xC0B0: @ChargingManagementCore_Notification_Length = 1404; break;
        case 0xC0C0: @ChargingManagementCore_Notification_Length = 1404; break;
        case 0xC0D0: @ChargingManagementCore_Notification_Length = 1404; break;
      }
    }
    else
    {
      switch (MethodID)
      {
        case 0xC010: @ChargingManagementCore_Notification_Length = ChargingManagementCore_payload_length_immediateChargingOptions   - 1404*(UDP_Segments_total-UDP_Segments_left) + 24; break;
        case 0xC020: @ChargingManagementCore_Notification_Length = ChargingManagementCore_payload_length_chargingProcessInformation - 1404*(UDP_Segments_total-UDP_Segments_left) + 24; break;
        case 0xC030: @ChargingManagementCore_Notification_Length = ChargingManagementCore_payload_length_chargingPlugs              - 1404*(UDP_Segments_total-UDP_Segments_left) + 24; break;
        case 0xC040: @ChargingManagementCore_Notification_Length = ChargingManagementCore_payload_length_immediateActions           - 1404*(UDP_Segments_total-UDP_Segments_left) + 24; break;
        case 0xC050: @ChargingManagementCore_Notification_Length = ChargingManagementCore_payload_length_notificationMarkers        - 1404*(UDP_Segments_total-UDP_Segments_left) + 24; break;
        case 0xC060: @ChargingManagementCore_Notification_Length = ChargingManagementCore_payload_length_notifications              - 1404*(UDP_Segments_total-UDP_Segments_left) + 24; break;
        case 0xC070: @ChargingManagementCore_Notification_Length = ChargingManagementCore_payload_length_pastErrorInformation       - 1404*(UDP_Segments_total-UDP_Segments_left) + 24; break;
        case 0xC080: @ChargingManagementCore_Notification_Length = ChargingManagementCore_payload_length_views                      - 1404*(UDP_Segments_total-UDP_Segments_left) + 24; break;
        case 0xC090: @ChargingManagementCore_Notification_Length = ChargingManagementCore_payload_length_oruUpdateApprovals         - 1404*(UDP_Segments_total-UDP_Segments_left) + 24; break;
        case 0xC0A0: @ChargingManagementCore_Notification_Length = ChargingManagementCore_payload_length_switchControls             - 1404*(UDP_Segments_total-UDP_Segments_left) + 24; break;
        case 0xC0B0: @ChargingManagementCore_Notification_Length = ChargingManagementCore_payload_length_valueControls              - 1404*(UDP_Segments_total-UDP_Segments_left) + 24; break;
        case 0xC0C0: @ChargingManagementCore_Notification_Length = ChargingManagementCore_payload_length_valueIndications           - 1404*(UDP_Segments_total-UDP_Segments_left) + 24; break;
        case 0xC0D0: @ChargingManagementCore_Notification_Length = ChargingManagementCore_payload_length_resetToFactoryData         - 1404*(UDP_Segments_total-UDP_Segments_left) + 24; break;
      }
    }
  }
  buffer[i++] = @ChargingManagementCore_Notification_Length>>24 & 0xFF;
  buffer[i++] = @ChargingManagementCore_Notification_Length>>16 & 0xFF;
  buffer[i++] = @ChargingManagementCore_Notification_Length>> 8 & 0xFF;
  buffer[i++] = @ChargingManagementCore_Notification_Length     & 0xFF;
  
  // SOME/IP Packet - Request ID, Client ID [16 bit]
  buffer[i++] = @ChargingManagementCore_Notification_Request_ID_Client_ID>>8 & 0xFF;
  buffer[i++] = @ChargingManagementCore_Notification_Request_ID_Client_ID    & 0xFF;
  
  // SOME/IP Packet - Request ID, Session ID) [16 bit]
  if ((UDP_Segments_total == 1) || (seg_id_flag == 1))
  {
    @ServiceDiscovery_SOMEIPPacket_Notification_Request_ID_Session_ID = @ServiceDiscovery_SOMEIPPacket_Notification_Request_ID_Session_ID + 1;
    if (@ServiceDiscovery_SOMEIPPacket_Notification_Request_ID_Session_ID == 0x10000) @ServiceDiscovery_SOMEIPPacket_Notification_Request_ID_Session_ID = 1;
    seg_id_flag = 0;
  }
  
  buffer[i++] = @ServiceDiscovery_SOMEIPPacket_Notification_Request_ID_Session_ID>>8 & 0xFF;
  buffer[i++] = @ServiceDiscovery_SOMEIPPacket_Notification_Request_ID_Session_ID    & 0xFF;
  
  // SOME/IP Packet - Protocol Version [8 bit]
  buffer[i++] = @ChargingManagementCore_Notification_Protocol_Version;
  
  // SOME/IP Packet - Interface Version [8 bit]
  buffer[i++] = @ChargingManagementCore_Notification_Interface_Version;
  
  // SOME/IP Packet - Message Type [8 bit]
  buffer[i++] = @ChargingManagementCore_Notification_Message_Type;
  
  // SOME/IP Packet - Return Code [8 bit]
  buffer[i++] = @ChargingManagementCore_Notification_Return_Code;
  
  
  if (UDP_Segments_total > 1)
  {
    if (UDP_Segments_left >= 0)
    { 
      // Message Type neu setzen
      buffer[i-2] = @ChargingManagementCore_Notification_Message_Type + 0x20;
      
      // Offset (16byte Schritte, 1392/16 = 87)
      @ChargingManagementCore_Notification_Offset = 87 * (UDP_Segments_total - UDP_Segments_left);
      
      // More Segments Flag
      if (UDP_Segments_left > 1) @ChargingManagementCore_Notification_More_Segments_Flag = 1;
      else                       @ChargingManagementCore_Notification_More_Segments_Flag = 0;
      
      buffer[i++] =   @ChargingManagementCore_Notification_Offset>>20 & 0xFF;
      buffer[i++] =   @ChargingManagementCore_Notification_Offset>>12 & 0xFF;
      buffer[i++] =   @ChargingManagementCore_Notification_Offset>>4  & 0xFF;
      buffer[i++] = ((@ChargingManagementCore_Notification_Offset<<4) & 0xF0) + (@ChargingManagementCore_Notification_More_Segments_Flag & 0x01);
    }
  }
  
  UDP_Segments_left--;
  
  ////// immediateChargingOptions notifier //////
  if (MethodID == 0xC010)
  {
    if (UDP_Segments_total == 1)
    {
      for (j=0; j<ChargingManagementCore_payload_length_immediateChargingOptions; j++)
        buffer[i++] = ChargingManagementCore_payload_buffer_immediateChargingOptions[j];
    }
    else
    {
      if (UDP_Segments_left >= 1)
      {
        for (j=(UDP_Segments_total-UDP_Segments_left-1)*1392; j<(UDP_Segments_total-UDP_Segments_left)*1392; j++)
          buffer[i++] = ChargingManagementCore_payload_buffer_immediateChargingOptions[j];
      }
      else
      {
        for (j=(UDP_Segments_total-(UDP_Segments_left+1))*1392; j<ChargingManagementCore_payload_length_immediateChargingOptions; j++)
          buffer[i++] = ChargingManagementCore_payload_buffer_immediateChargingOptions[j];
      }
    }
  }
  
  ////// chargingProcessInformation notifier //////
  if (MethodID == 0xC020)
  {
    if (UDP_Segments_total == 1)
    {
      for (j=0; j<ChargingManagementCore_payload_length_chargingProcessInformation; j++)
        buffer[i++] = ChargingManagementCore_payload_buffer_chargingProcessInformation[j];
    }
    else
    {
      if (UDP_Segments_left >= 1)
      {
        for (j=(UDP_Segments_total-UDP_Segments_left-1)*1392; j<(UDP_Segments_total-UDP_Segments_left)*1392; j++)
          buffer[i++] = ChargingManagementCore_payload_buffer_chargingProcessInformation[j];
      }
      else
      {
        for (j=(UDP_Segments_total-(UDP_Segments_left+1))*1392; j<ChargingManagementCore_payload_length_chargingProcessInformation; j++)
          buffer[i++] = ChargingManagementCore_payload_buffer_chargingProcessInformation[j];
      }
    }
  }
  
  ////// chargingPlugs notifier //////
  if (MethodID == 0xC030)
  {
    if (UDP_Segments_total == 1)
    {
      for (j=0; j<ChargingManagementCore_payload_length_chargingPlugs; j++)
        buffer[i++] = ChargingManagementCore_payload_buffer_chargingPlugs[j];
    }
    else
    {
      if (UDP_Segments_left >= 1)
      {
        for (j=(UDP_Segments_total-UDP_Segments_left-1)*1392; j<(UDP_Segments_total-UDP_Segments_left)*1392; j++)
          buffer[i++] = ChargingManagementCore_payload_buffer_chargingPlugs[j];
      }
      else
      {
        for (j=(UDP_Segments_total-(UDP_Segments_left+1))*1392; j<ChargingManagementCore_payload_length_chargingPlugs; j++)
          buffer[i++] = ChargingManagementCore_payload_buffer_chargingPlugs[j];
      }
    }
  }
  
  ////// immediateActions notifier //////
  if (MethodID == 0xC040)
  {
    if (UDP_Segments_total == 1)
    {
      for (j=0; j<ChargingManagementCore_payload_length_immediateActions; j++)
        buffer[i++] = ChargingManagementCore_payload_buffer_immediateActions[j];
    }
    else
    {
      if (UDP_Segments_left >= 1)
      {
        for (j=(UDP_Segments_total-UDP_Segments_left-1)*1392; j<(UDP_Segments_total-UDP_Segments_left)*1392; j++)
          buffer[i++] = ChargingManagementCore_payload_buffer_immediateActions[j];
      }
      else
      {
        for (j=(UDP_Segments_total-(UDP_Segments_left+1))*1392; j<ChargingManagementCore_payload_length_immediateActions; j++)
          buffer[i++] = ChargingManagementCore_payload_buffer_immediateActions[j];
      }
    }
  }
  
  ////// notificationMarkers notifier //////
  if (MethodID == 0xC050)
  {
    if (UDP_Segments_total == 1)
    {
      for (j=0; j<ChargingManagementCore_payload_length_notificationMarkers; j++)
        buffer[i++] = ChargingManagementCore_payload_buffer_notificationMarkers[j];
    }
    else
    {
      if (UDP_Segments_left >= 1)
      {
        for (j=(UDP_Segments_total-UDP_Segments_left-1)*1392; j<(UDP_Segments_total-UDP_Segments_left)*1392; j++)
          buffer[i++] = ChargingManagementCore_payload_buffer_notificationMarkers[j];
      }
      else
      {
        for (j=(UDP_Segments_total-(UDP_Segments_left+1))*1392; j<ChargingManagementCore_payload_length_notificationMarkers; j++)
          buffer[i++] = ChargingManagementCore_payload_buffer_notificationMarkers[j];
      }
    }
  }
  
  ////// notifications notifier //////
  if (MethodID == 0xC060)
  {
    if (UDP_Segments_total == 1)
    {
      for (j=0; j<ChargingManagementCore_payload_length_notifications; j++)
        buffer[i++] = ChargingManagementCore_payload_buffer_notifications[j];
    }
    else
    {
      if (UDP_Segments_left >= 1)
      {
        for (j=(UDP_Segments_total-UDP_Segments_left-1)*1392; j<(UDP_Segments_total-UDP_Segments_left)*1392; j++)
          buffer[i++] = ChargingManagementCore_payload_buffer_notifications[j];
      }
      else
      {
        for (j=(UDP_Segments_total-(UDP_Segments_left+1))*1392; j<ChargingManagementCore_payload_length_notifications; j++)
          buffer[i++] = ChargingManagementCore_payload_buffer_notifications[j];
      }
    }
  }
  
  ////// pastErrorInformation notifier //////
  if (MethodID == 0xC070)
  {
    if (UDP_Segments_total == 1)
    {
      for (j=0; j<ChargingManagementCore_payload_length_pastErrorInformation; j++)
        buffer[i++] = ChargingManagementCore_payload_buffer_pastErrorInformation[j];
    }
    else
    {
      if (UDP_Segments_left >= 1)
      {
        for (j=(UDP_Segments_total-UDP_Segments_left-1)*1392; j<(UDP_Segments_total-UDP_Segments_left)*1392; j++)
          buffer[i++] = ChargingManagementCore_payload_buffer_pastErrorInformation[j];
      }
      else
      {
        for (j=(UDP_Segments_total-(UDP_Segments_left+1))*1392; j<ChargingManagementCore_payload_length_pastErrorInformation; j++)
          buffer[i++] = ChargingManagementCore_payload_buffer_pastErrorInformation[j];
      }
    }
  }
  
  ////// views notifier //////
  if (MethodID == 0xC080)
  {
    if (UDP_Segments_total == 1)
    {
      for (j=0; j<ChargingManagementCore_payload_length_views; j++)
        buffer[i++] = ChargingManagementCore_payload_buffer_views[j];
    }
    else
    {
      if (UDP_Segments_left >= 1)
      {
        for (j=(UDP_Segments_total-UDP_Segments_left-1)*1392; j<(UDP_Segments_total-UDP_Segments_left)*1392; j++)
          buffer[i++] = ChargingManagementCore_payload_buffer_views[j];
      }
      else
      {
        for (j=(UDP_Segments_total-(UDP_Segments_left+1))*1392; j<ChargingManagementCore_payload_length_views; j++)
          buffer[i++] = ChargingManagementCore_payload_buffer_views[j];
      }
    }
  }
  
  ////// oruUpdateApprovals notifier //////
  if (MethodID == 0xC090)
  {
    if (UDP_Segments_total == 1)
    {
      for (j=0; j<ChargingManagementCore_payload_length_oruUpdateApprovals; j++)
        buffer[i++] = ChargingManagementCore_payload_buffer_oruUpdateApprovals[j];
    }
    else
    {
      if (UDP_Segments_left >= 1)
      {
        for (j=(UDP_Segments_total-UDP_Segments_left-1)*1392; j<(UDP_Segments_total-UDP_Segments_left)*1392; j++)
          buffer[i++] = ChargingManagementCore_payload_buffer_oruUpdateApprovals[j];
      }
      else
      {
        for (j=(UDP_Segments_total-(UDP_Segments_left+1))*1392; j<ChargingManagementCore_payload_length_oruUpdateApprovals; j++)
          buffer[i++] = ChargingManagementCore_payload_buffer_oruUpdateApprovals[j];
      }
    }
  }
  
  ////// switchControls notifier //////
  if (MethodID == 0xC0A0)
  {
    if (UDP_Segments_total == 1)
    {
      for (j=0; j<ChargingManagementCore_payload_length_switchControls; j++)
        buffer[i++] = ChargingManagementCore_payload_buffer_switchControls[j];
    }
    else
    {
      if (UDP_Segments_left >= 1)
      {
        for (j=(UDP_Segments_total-UDP_Segments_left-1)*1392; j<(UDP_Segments_total-UDP_Segments_left)*1392; j++)
          buffer[i++] = ChargingManagementCore_payload_buffer_switchControls[j];
      }
      else
      {
        for (j=(UDP_Segments_total-(UDP_Segments_left+1))*1392; j<ChargingManagementCore_payload_length_switchControls; j++)
          buffer[i++] = ChargingManagementCore_payload_buffer_switchControls[j];
      }
    }
  }
  
  ////// valueControls notifier //////
  if (MethodID == 0xC0B0)
  {
    if (UDP_Segments_total == 1)
    {
      for (j=0; j<ChargingManagementCore_payload_length_valueControls; j++)
        buffer[i++] = ChargingManagementCore_payload_buffer_valueControls[j];
    }
    else
    {
      if (UDP_Segments_left >= 1)
      {
        for (j=(UDP_Segments_total-UDP_Segments_left-1)*1392; j<(UDP_Segments_total-UDP_Segments_left)*1392; j++)
          buffer[i++] = ChargingManagementCore_payload_buffer_valueControls[j];
      }
      else
      {
        for (j=(UDP_Segments_total-(UDP_Segments_left+1))*1392; j<ChargingManagementCore_payload_length_valueControls; j++)
          buffer[i++] = ChargingManagementCore_payload_buffer_valueControls[j];
      }
    }
  }
  
  ////// valueIndications notifier //////
  if (MethodID == 0xC0C0)
  {
    if (UDP_Segments_total == 1)
    {
      for (j=0; j<ChargingManagementCore_payload_length_valueIndications; j++)
        buffer[i++] = ChargingManagementCore_payload_buffer_valueIndications[j];
    }
    else
    {
      if (UDP_Segments_left >= 1)
      {
        for (j=(UDP_Segments_total-UDP_Segments_left-1)*1392; j<(UDP_Segments_total-UDP_Segments_left)*1392; j++)
          buffer[i++] = ChargingManagementCore_payload_buffer_valueIndications[j];
      }
      else
      {
        for (j=(UDP_Segments_total-(UDP_Segments_left+1))*1392; j<ChargingManagementCore_payload_length_valueIndications; j++)
          buffer[i++] = ChargingManagementCore_payload_buffer_valueIndications[j];
      }
    }
  }
  
  ////// resetToFactoryData notifier //////
  if (MethodID == 0xC0D0)
  {
    if (UDP_Segments_total == 1)
    {
      for (j=0; j<ChargingManagementCore_payload_length_resetToFactoryData; j++)
        buffer[i++] = ChargingManagementCore_payload_buffer_resetToFactoryData[j];
    }
    else
    {
      if (UDP_Segments_left >= 1)
      {
        for (j=(UDP_Segments_total-UDP_Segments_left-1)*1392; j<(UDP_Segments_total-UDP_Segments_left)*1392; j++)
          buffer[i++] = ChargingManagementCore_payload_buffer_resetToFactoryData[j];
      }
      else
      {
        for (j=(UDP_Segments_total-(UDP_Segments_left+1))*1392; j<ChargingManagementCore_payload_length_resetToFactoryData; j++)
          buffer[i++] = ChargingManagementCore_payload_buffer_resetToFactoryData[j];
      }
    }
  }
  
  // Rohdaten in UDP Paket schreiben
  EthPaket.udp.SetData( 0, buffer, i );

  // calculate UDP and IPv6 checksum and send Ethernet packet
  EthPaket.CompletePacket();
  output( EthPaket );
  
  // prüfen ob alle Segemente gesendet wurden, sonst senden erneut aufrufen
  ChargingManagementCore_Segmentation_Method_ID = MethodID;
  if (UDP_Segments_left>0)
    settimer(ChargingManagementCore_Segmentation_delay, 50);
}

on timer ChargingManagementCore_Segmentation_delay
{
  Send_Service_ChargingManagementCore_Notification (ChargingManagementCore_Segmentation_Method_ID);
}






////////// immediateChargingOptions Notification //////////

on envVar ChargingManagementCore_Notification_LengthIndicator_Struct_immediateChargingOptions
{
  ChargingManagementCore_Notification_immediateChargingOptions();
}
on envVar ChargingManagementCore_Notification_LengthIndicator_Element_immediateChargingOptions
{
  ChargingManagementCore_Notification_immediateChargingOptions();
}
on envVar ChargingManagementCore_Notification_immediateChargingOptions_type
{
  ChargingManagementCore_array_immediateChargingOptions_type[@ChargingManagementCore_Notification_immediateChargingOptions_Element] = @this;
  ChargingManagementCore_Notification_immediateChargingOptions();
}
on envVar ChargingManagementCore_Notification_immediateChargingOptions_targetSoc_serviceId
{
  ChargingManagementCore_array_immediateChargingOptions_targetSoc_serviceId[@ChargingManagementCore_Notification_immediateChargingOptions_Element] = @this;
  ChargingManagementCore_Notification_immediateChargingOptions();
}
on envVar ChargingManagementCore_Notification_immediateChargingOptions_targetSoc_serviceInstanceId
{
  ChargingManagementCore_array_immediateChargingOptions_targetSoc_serviceInstanceId[@ChargingManagementCore_Notification_immediateChargingOptions_Element] = @this;
  ChargingManagementCore_Notification_immediateChargingOptions();
}
on envVar ChargingManagementCore_Notification_immediateChargingOptions_targetSoc_resourceId
{
  ChargingManagementCore_array_immediateChargingOptions_targetSoc_resourceId[@ChargingManagementCore_Notification_immediateChargingOptions_Element] = @this;
  ChargingManagementCore_Notification_immediateChargingOptions();
}
on envVar ChargingManagementCore_Notification_immediateChargingOptions_targetSoc_elementId
{
  getvalue(this, buffer_uuid);
  for (k=0;k<16;k++)
    ChargingManagementCore_array_immediateChargingOptions_targetSoc_elementId[@ChargingManagementCore_Notification_immediateChargingOptions_Element][k] = buffer_uuid[k];
  ChargingManagementCore_Notification_immediateChargingOptions();
}
on envVar ChargingManagementCore_Notification_immediateChargingOptions_targetRange_serviceId
{
  ChargingManagementCore_array_immediateChargingOptions_targetRange_serviceId[@ChargingManagementCore_Notification_immediateChargingOptions_Element] = @this;
  ChargingManagementCore_Notification_immediateChargingOptions();
}
on envVar ChargingManagementCore_Notification_immediateChargingOptions_targetRange_serviceInstanceId
{
  ChargingManagementCore_array_immediateChargingOptions_targetRange_serviceInstanceId[@ChargingManagementCore_Notification_immediateChargingOptions_Element] = @this;
  ChargingManagementCore_Notification_immediateChargingOptions();
}
on envVar ChargingManagementCore_Notification_immediateChargingOptions_targetRange_resourceId
{
  ChargingManagementCore_array_immediateChargingOptions_targetRange_resourceId[@ChargingManagementCore_Notification_immediateChargingOptions_Element] = @this;
  ChargingManagementCore_Notification_immediateChargingOptions();
}
on envVar ChargingManagementCore_Notification_immediateChargingOptions_targetRange_elementId
{
  getvalue(this, buffer_uuid);
  for (k=0;k<16;k++)
    ChargingManagementCore_array_immediateChargingOptions_targetRange_elementId[@ChargingManagementCore_Notification_immediateChargingOptions_Element][k] = buffer_uuid[k];
  ChargingManagementCore_Notification_immediateChargingOptions();
}
on envVar ChargingManagementCore_Notification_immediateChargingOptions_maxChargeCurrentAc_serviceId
{
  ChargingManagementCore_array_immediateChargingOptions_maxChargeCurrentAc_serviceId[@ChargingManagementCore_Notification_immediateChargingOptions_Element] = @this;
  ChargingManagementCore_Notification_immediateChargingOptions();
}
on envVar ChargingManagementCore_Notification_immediateChargingOptions_maxChargeCurrentAc_serviceInstanceId
{
  ChargingManagementCore_array_immediateChargingOptions_maxChargeCurrentAc_serviceInstanceId[@ChargingManagementCore_Notification_immediateChargingOptions_Element] = @this;
  ChargingManagementCore_Notification_immediateChargingOptions();
}
on envVar ChargingManagementCore_Notification_immediateChargingOptions_maxChargeCurrentAc_resourceId
{
  ChargingManagementCore_array_immediateChargingOptions_maxChargeCurrentAc_resourceId[@ChargingManagementCore_Notification_immediateChargingOptions_Element] = @this;
  ChargingManagementCore_Notification_immediateChargingOptions();
}
on envVar ChargingManagementCore_Notification_immediateChargingOptions_maxChargeCurrentAc_elementId
{
  getvalue(this, buffer_uuid);
  for (k=0;k<16;k++)
    ChargingManagementCore_array_immediateChargingOptions_maxChargeCurrentAc_elementId[@ChargingManagementCore_Notification_immediateChargingOptions_Element][k] = buffer_uuid[k];
  ChargingManagementCore_Notification_immediateChargingOptions();
}
on envVar ChargingManagementCore_Notification_immediateChargingOptions_autounlockAc_serviceId
{
  ChargingManagementCore_array_immediateChargingOptions_autounlockAc_serviceId[@ChargingManagementCore_Notification_immediateChargingOptions_Element] = @this;
  ChargingManagementCore_Notification_immediateChargingOptions();
}
on envVar ChargingManagementCore_Notification_immediateChargingOptions_autounlockAc_serviceInstanceId
{
  ChargingManagementCore_array_immediateChargingOptions_autounlockAc_serviceInstanceId[@ChargingManagementCore_Notification_immediateChargingOptions_Element] = @this;
  ChargingManagementCore_Notification_immediateChargingOptions();
}
on envVar ChargingManagementCore_Notification_immediateChargingOptions_autounlockAc_resourceId
{
  ChargingManagementCore_array_immediateChargingOptions_autounlockAc_resourceId[@ChargingManagementCore_Notification_immediateChargingOptions_Element] = @this;
  ChargingManagementCore_Notification_immediateChargingOptions();
}
on envVar ChargingManagementCore_Notification_immediateChargingOptions_autounlockAc_elementId
{
  getvalue(this, buffer_uuid);
  for (k=0;k<16;k++)
    ChargingManagementCore_array_immediateChargingOptions_autounlockAc_elementId[@ChargingManagementCore_Notification_immediateChargingOptions_Element][k] = buffer_uuid[k];
  ChargingManagementCore_Notification_immediateChargingOptions();
}
on envVar ChargingManagementCore_Notification_immediateChargingOptions_autounlockDc_serviceId
{
  ChargingManagementCore_array_immediateChargingOptions_autounlockDc_serviceId[@ChargingManagementCore_Notification_immediateChargingOptions_Element] = @this;
  ChargingManagementCore_Notification_immediateChargingOptions();
}
on envVar ChargingManagementCore_Notification_immediateChargingOptions_autounlockDc_serviceInstanceId
{
  ChargingManagementCore_array_immediateChargingOptions_autounlockDc_serviceInstanceId[@ChargingManagementCore_Notification_immediateChargingOptions_Element] = @this;
  ChargingManagementCore_Notification_immediateChargingOptions();
}
on envVar ChargingManagementCore_Notification_immediateChargingOptions_autounlockDc_resourceId
{
  ChargingManagementCore_array_immediateChargingOptions_autounlockDc_resourceId[@ChargingManagementCore_Notification_immediateChargingOptions_Element] = @this;
  ChargingManagementCore_Notification_immediateChargingOptions();
}
on envVar ChargingManagementCore_Notification_immediateChargingOptions_autounlockDc_elementId
{
  getvalue(this, buffer_uuid);
  for (k=0;k<16;k++)
    ChargingManagementCore_array_immediateChargingOptions_autounlockDc_elementId[@ChargingManagementCore_Notification_immediateChargingOptions_Element][k] = buffer_uuid[k];
  ChargingManagementCore_Notification_immediateChargingOptions();
}
on envVar ChargingManagementCore_Notification_immediateChargingOptions_chargeModeSelection_serviceId
{
  ChargingManagementCore_array_immediateChargingOptions_chargeModeSelection_serviceId[@ChargingManagementCore_Notification_immediateChargingOptions_Element] = @this;
  ChargingManagementCore_Notification_immediateChargingOptions();
}
on envVar ChargingManagementCore_Notification_immediateChargingOptions_chargeModeSelection_serviceInstanceId
{
  ChargingManagementCore_array_immediateChargingOptions_chargeModeSelection_serviceInstanceId[@ChargingManagementCore_Notification_immediateChargingOptions_Element] = @this;
  ChargingManagementCore_Notification_immediateChargingOptions();
}
on envVar ChargingManagementCore_Notification_immediateChargingOptions_chargeModeSelection_resourceId
{
  ChargingManagementCore_array_immediateChargingOptions_chargeModeSelection_resourceId[@ChargingManagementCore_Notification_immediateChargingOptions_Element] = @this;
  ChargingManagementCore_Notification_immediateChargingOptions();
}
on envVar ChargingManagementCore_Notification_immediateChargingOptions_chargeModeSelection_elementId
{
  getvalue(this, buffer_uuid);
  for (k=0;k<16;k++)
    ChargingManagementCore_array_immediateChargingOptions_chargeModeSelection_elementId[@ChargingManagementCore_Notification_immediateChargingOptions_Element][k] = buffer_uuid[k];
  ChargingManagementCore_Notification_immediateChargingOptions();
}
on envVar ChargingManagementCore_Notification_immediateChargingOptions_type_available
{
  ChargingManagementCore_array_immediateChargingOptions_type_available[@ChargingManagementCore_Notification_immediateChargingOptions_Element] = @this;
  ChargingManagementCore_Notification_immediateChargingOptions();
}
on envVar ChargingManagementCore_Notification_immediateChargingOptions_targetSoc_available
{
  ChargingManagementCore_array_immediateChargingOptions_targetSoc_available[@ChargingManagementCore_Notification_immediateChargingOptions_Element] = @this;
  ChargingManagementCore_Notification_immediateChargingOptions();
}
on envVar ChargingManagementCore_Notification_immediateChargingOptions_targetRange_available
{
  ChargingManagementCore_array_immediateChargingOptions_targetRange_available[@ChargingManagementCore_Notification_immediateChargingOptions_Element] = @this;
  ChargingManagementCore_Notification_immediateChargingOptions();
}
on envVar ChargingManagementCore_Notification_immediateChargingOptions_maxChargeCurrentAc_available
{
  ChargingManagementCore_array_immediateChargingOptions_maxChargeCurrentAc_available[@ChargingManagementCore_Notification_immediateChargingOptions_Element] = @this;
  ChargingManagementCore_Notification_immediateChargingOptions();
}
on envVar ChargingManagementCore_Notification_immediateChargingOptions_autounlockAc_available
{
  ChargingManagementCore_array_immediateChargingOptions_autounlockAc_available[@ChargingManagementCore_Notification_immediateChargingOptions_Element] = @this;
  ChargingManagementCore_Notification_immediateChargingOptions();
}
on envVar ChargingManagementCore_Notification_immediateChargingOptions_autounlockDc_available
{
  ChargingManagementCore_array_immediateChargingOptions_autounlockDc_available[@ChargingManagementCore_Notification_immediateChargingOptions_Element] = @this;
  ChargingManagementCore_Notification_immediateChargingOptions();
}
on envVar ChargingManagementCore_Notification_immediateChargingOptions_chargeModeSelection_available
{
  ChargingManagementCore_array_immediateChargingOptions_chargeModeSelection_available[@ChargingManagementCore_Notification_immediateChargingOptions_Element] = @this;
  ChargingManagementCore_Notification_immediateChargingOptions();
}
on envVar ChargingManagementCore_Notification_immediateChargingOptions_Payload
{
  ChargingManagementCore_Notification_immediateChargingOptions_update();
}


ChargingManagementCore_Notification_immediateChargingOptions()
{
  word payload_counter = 0;
  word start_pos       = 0;
  word element_length  = 0;
  
  // Length Indicator Struct - Platzhalter
  payload_counter = 0+4;
  start_pos = 0;
  
  for (j=0; j<@ChargingManagementCore_Notification_immediateChargingOptions_Element_TotalNum; j++)
  {
    ChargingManagementCore_array_immediateChargingOptions_available_functions[j] = ChargingManagementCore_array_immediateChargingOptions_type_available[j]
                                                                                 + ChargingManagementCore_array_immediateChargingOptions_targetSoc_available[j]
                                                                                 + ChargingManagementCore_array_immediateChargingOptions_targetRange_available[j]
                                                                                 + ChargingManagementCore_array_immediateChargingOptions_maxChargeCurrentAc_available[j]
                                                                                 + ChargingManagementCore_array_immediateChargingOptions_autounlockAc_available[j]
                                                                                 + ChargingManagementCore_array_immediateChargingOptions_autounlockDc_available[j]
                                                                                 + ChargingManagementCore_array_immediateChargingOptions_chargeModeSelection_available[j];
    
    // Length Indicator Element - Platzhalter
    if (ChargingManagementCore_array_immediateChargingOptions_available_functions[j] > 0)
    {
      start_pos = payload_counter;
      payload_counter = payload_counter + 4;
    }
    else 
      start_pos = payload_counter;
    
    // 0 type (enum32)
    if (ChargingManagementCore_array_immediateChargingOptions_type_available[j] == 1)
    {
      tag_dataID = 0;
      ChargingManagementCore_payload_buffer_immediateChargingOptions[payload_counter++] = 2 * 16 /* Wiretype = 2 =^ 32 Bit */ + ((tag_dataID>>8) & 0x0F) /* DataID High Part */ ;
      ChargingManagementCore_payload_buffer_immediateChargingOptions[payload_counter++] = tag_dataID & 0xFF /* DataID Low Part */ ;
      
      ChargingManagementCore_payload_buffer_immediateChargingOptions[payload_counter++] = ChargingManagementCore_array_immediateChargingOptions_type[j]>>24 & 0xFF;
      ChargingManagementCore_payload_buffer_immediateChargingOptions[payload_counter++] = ChargingManagementCore_array_immediateChargingOptions_type[j]>>16 & 0xFF;
      ChargingManagementCore_payload_buffer_immediateChargingOptions[payload_counter++] = ChargingManagementCore_array_immediateChargingOptions_type[j]>> 8 & 0xFF;
      ChargingManagementCore_payload_buffer_immediateChargingOptions[payload_counter++] = ChargingManagementCore_array_immediateChargingOptions_type[j]     & 0xFF;
    }
    
    // 1 targetSoc (ref#ChargingManagementCore.valueControls.valueControlObject)
    if (ChargingManagementCore_array_immediateChargingOptions_targetSoc_available[j] == 1)
    {
      tag_dataID = 1;
      ChargingManagementCore_payload_buffer_immediateChargingOptions[payload_counter++] = 5 * 16 /* Wiretype = 5  =^ Array mit 1 Byte Länge */ + ((tag_dataID>>8) & 0x0F) /* DataID High Part */ ;
      ChargingManagementCore_payload_buffer_immediateChargingOptions[payload_counter++] = tag_dataID & 0xFF /* DataID Low Part */ ;
      
      ChargingManagementCore_payload_buffer_immediateChargingOptions[payload_counter++] = 22; // Array Length
      
      // Service ID
      ChargingManagementCore_payload_buffer_immediateChargingOptions[payload_counter++] = ChargingManagementCore_array_immediateChargingOptions_targetSoc_serviceId[j]>> 8 & 0xFF;
      ChargingManagementCore_payload_buffer_immediateChargingOptions[payload_counter++] = ChargingManagementCore_array_immediateChargingOptions_targetSoc_serviceId[j]     & 0xFF;
      
      // Service Instance ID
      ChargingManagementCore_payload_buffer_immediateChargingOptions[payload_counter++] = ChargingManagementCore_array_immediateChargingOptions_targetSoc_serviceInstanceId[j]>> 8 & 0xFF;
      ChargingManagementCore_payload_buffer_immediateChargingOptions[payload_counter++] = ChargingManagementCore_array_immediateChargingOptions_targetSoc_serviceInstanceId[j]     & 0xFF;
      
      // Resource ID
      ChargingManagementCore_payload_buffer_immediateChargingOptions[payload_counter++] = ChargingManagementCore_array_immediateChargingOptions_targetSoc_resourceId[j]>> 8 & 0xFF;
      ChargingManagementCore_payload_buffer_immediateChargingOptions[payload_counter++] = ChargingManagementCore_array_immediateChargingOptions_targetSoc_resourceId[j]     & 0xFF;
      
      // Element ID
      for (k=0; k<16; k++)
        ChargingManagementCore_payload_buffer_immediateChargingOptions[payload_counter++] = ChargingManagementCore_array_immediateChargingOptions_targetSoc_elementId[j][k] & 0xFF;
    }
    
    // 2 targetRange (ref#ChargingManagementCore.valueControls.valueControlObject)
    if (ChargingManagementCore_array_immediateChargingOptions_targetRange_available[j] == 1)
    {
      tag_dataID = 2;
      ChargingManagementCore_payload_buffer_immediateChargingOptions[payload_counter++] = 5 * 16 /* Wiretype = 5  =^ Array mit 1 Byte Länge */ + ((tag_dataID>>8) & 0x0F) /* DataID High Part */ ;
      ChargingManagementCore_payload_buffer_immediateChargingOptions[payload_counter++] = tag_dataID & 0xFF /* DataID Low Part */ ;
      
      ChargingManagementCore_payload_buffer_immediateChargingOptions[payload_counter++] = 22; // Array Length
      
      // Service ID
      ChargingManagementCore_payload_buffer_immediateChargingOptions[payload_counter++] = ChargingManagementCore_array_immediateChargingOptions_targetRange_serviceId[j]>> 8 & 0xFF;
      ChargingManagementCore_payload_buffer_immediateChargingOptions[payload_counter++] = ChargingManagementCore_array_immediateChargingOptions_targetRange_serviceId[j]     & 0xFF;
      
      // Service Instance ID
      ChargingManagementCore_payload_buffer_immediateChargingOptions[payload_counter++] = ChargingManagementCore_array_immediateChargingOptions_targetRange_serviceInstanceId[j]>> 8 & 0xFF;
      ChargingManagementCore_payload_buffer_immediateChargingOptions[payload_counter++] = ChargingManagementCore_array_immediateChargingOptions_targetRange_serviceInstanceId[j]     & 0xFF;
      
      // Resource ID
      ChargingManagementCore_payload_buffer_immediateChargingOptions[payload_counter++] = ChargingManagementCore_array_immediateChargingOptions_targetRange_resourceId[j]>> 8 & 0xFF;
      ChargingManagementCore_payload_buffer_immediateChargingOptions[payload_counter++] = ChargingManagementCore_array_immediateChargingOptions_targetRange_resourceId[j]     & 0xFF;
      
      // Element ID
      for (k=0; k<16; k++)
        ChargingManagementCore_payload_buffer_immediateChargingOptions[payload_counter++] = ChargingManagementCore_array_immediateChargingOptions_targetRange_elementId[j][k] & 0xFF;
    }
    
    // 3 maxChargeCurrentAc (ref#ChargingManagementCore.switchControls.switchControlObject)
    if (ChargingManagementCore_array_immediateChargingOptions_maxChargeCurrentAc_available[j] == 1)
    {
      tag_dataID = 3;
      ChargingManagementCore_payload_buffer_immediateChargingOptions[payload_counter++] = 5 * 16 /* Wiretype = 5  =^ Array mit 1 Byte Länge */ + ((tag_dataID>>8) & 0x0F) /* DataID High Part */ ;
      ChargingManagementCore_payload_buffer_immediateChargingOptions[payload_counter++] = tag_dataID & 0xFF /* DataID Low Part */ ;
      
      ChargingManagementCore_payload_buffer_immediateChargingOptions[payload_counter++] = 22; // Array Length
      
      // Service ID
      ChargingManagementCore_payload_buffer_immediateChargingOptions[payload_counter++] = ChargingManagementCore_array_immediateChargingOptions_maxChargeCurrentAc_serviceId[j]>> 8 & 0xFF;
      ChargingManagementCore_payload_buffer_immediateChargingOptions[payload_counter++] = ChargingManagementCore_array_immediateChargingOptions_maxChargeCurrentAc_serviceId[j]     & 0xFF;
      
      // Service Instance ID
      ChargingManagementCore_payload_buffer_immediateChargingOptions[payload_counter++] = ChargingManagementCore_array_immediateChargingOptions_maxChargeCurrentAc_serviceInstanceId[j]>> 8 & 0xFF;
      ChargingManagementCore_payload_buffer_immediateChargingOptions[payload_counter++] = ChargingManagementCore_array_immediateChargingOptions_maxChargeCurrentAc_serviceInstanceId[j]     & 0xFF;
      
      // Resource ID
      ChargingManagementCore_payload_buffer_immediateChargingOptions[payload_counter++] = ChargingManagementCore_array_immediateChargingOptions_maxChargeCurrentAc_resourceId[j]>> 8 & 0xFF;
      ChargingManagementCore_payload_buffer_immediateChargingOptions[payload_counter++] = ChargingManagementCore_array_immediateChargingOptions_maxChargeCurrentAc_resourceId[j]     & 0xFF;
      
      // Element ID
      for (k=0; k<16; k++)
        ChargingManagementCore_payload_buffer_immediateChargingOptions[payload_counter++] = ChargingManagementCore_array_immediateChargingOptions_maxChargeCurrentAc_elementId[j][k] & 0xFF;
    }
    
    // 4 autounlockAc (ref#ChargingManagementCore.switchControls.switchControlObject)
    if (ChargingManagementCore_array_immediateChargingOptions_autounlockAc_available[j] == 1)
    {
      tag_dataID = 4;
      ChargingManagementCore_payload_buffer_immediateChargingOptions[payload_counter++] = 5 * 16 /* Wiretype = 5  =^ Array mit 1 Byte Länge */ + ((tag_dataID>>8) & 0x0F) /* DataID High Part */ ;
      ChargingManagementCore_payload_buffer_immediateChargingOptions[payload_counter++] = tag_dataID & 0xFF /* DataID Low Part */ ;
      
      ChargingManagementCore_payload_buffer_immediateChargingOptions[payload_counter++] = 22; // Array Length
      
      // Service ID
      ChargingManagementCore_payload_buffer_immediateChargingOptions[payload_counter++] = ChargingManagementCore_array_immediateChargingOptions_autounlockAc_serviceId[j]>> 8 & 0xFF;
      ChargingManagementCore_payload_buffer_immediateChargingOptions[payload_counter++] = ChargingManagementCore_array_immediateChargingOptions_autounlockAc_serviceId[j]     & 0xFF;
    
      // Service Instance ID
      ChargingManagementCore_payload_buffer_immediateChargingOptions[payload_counter++] = ChargingManagementCore_array_immediateChargingOptions_autounlockAc_serviceInstanceId[j]>> 8 & 0xFF;
      ChargingManagementCore_payload_buffer_immediateChargingOptions[payload_counter++] = ChargingManagementCore_array_immediateChargingOptions_autounlockAc_serviceInstanceId[j]     & 0xFF;
      
      // Resource ID
      ChargingManagementCore_payload_buffer_immediateChargingOptions[payload_counter++] = ChargingManagementCore_array_immediateChargingOptions_autounlockAc_resourceId[j]>> 8 & 0xFF;
      ChargingManagementCore_payload_buffer_immediateChargingOptions[payload_counter++] = ChargingManagementCore_array_immediateChargingOptions_autounlockAc_resourceId[j]     & 0xFF;
      
      // Element ID
      for (k=0; k<16; k++)
        ChargingManagementCore_payload_buffer_immediateChargingOptions[payload_counter++] = ChargingManagementCore_array_immediateChargingOptions_autounlockAc_elementId[j][k] & 0xFF;
    }
    
    // 5 autounlockDc (ref#ChargingManagementCore.switchControls.switchControlObject)
    if (ChargingManagementCore_array_immediateChargingOptions_autounlockDc_available[j] == 1)
    {
      tag_dataID = 5;
      ChargingManagementCore_payload_buffer_immediateChargingOptions[payload_counter++] = 5 * 16 /* Wiretype = 5  =^ Array mit 1 Byte Länge */ + ((tag_dataID>>8) & 0x0F) /* DataID High Part */ ;
      ChargingManagementCore_payload_buffer_immediateChargingOptions[payload_counter++] = tag_dataID & 0xFF /* DataID Low Part */ ;
      
      ChargingManagementCore_payload_buffer_immediateChargingOptions[payload_counter++] = 22; // Array Length
      
      // Service ID
      ChargingManagementCore_payload_buffer_immediateChargingOptions[payload_counter++] = ChargingManagementCore_array_immediateChargingOptions_autounlockDc_serviceId[j]>> 8 & 0xFF;
      ChargingManagementCore_payload_buffer_immediateChargingOptions[payload_counter++] = ChargingManagementCore_array_immediateChargingOptions_autounlockDc_serviceId[j]     & 0xFF;
      
      // Service Instance ID
      ChargingManagementCore_payload_buffer_immediateChargingOptions[payload_counter++] = ChargingManagementCore_array_immediateChargingOptions_autounlockDc_serviceInstanceId[j]>> 8 & 0xFF;
      ChargingManagementCore_payload_buffer_immediateChargingOptions[payload_counter++] = ChargingManagementCore_array_immediateChargingOptions_autounlockDc_serviceInstanceId[j]     & 0xFF;
      
      // Resource ID
      ChargingManagementCore_payload_buffer_immediateChargingOptions[payload_counter++] = ChargingManagementCore_array_immediateChargingOptions_autounlockDc_resourceId[j]>> 8 & 0xFF;
      ChargingManagementCore_payload_buffer_immediateChargingOptions[payload_counter++] = ChargingManagementCore_array_immediateChargingOptions_autounlockDc_resourceId[j]     & 0xFF;
      
      // Element ID
      for (k=0; k<16; k++)
        ChargingManagementCore_payload_buffer_immediateChargingOptions[payload_counter++] = ChargingManagementCore_array_immediateChargingOptions_autounlockDc_elementId[j][k] & 0xFF;
    }
    
    // 6 chargeModeSelection (ref#ChargingManagementCore.switchControls.switchControlObject)
    if (ChargingManagementCore_array_immediateChargingOptions_chargeModeSelection_available[j] == 1)
    {
      tag_dataID = 6;
      ChargingManagementCore_payload_buffer_immediateChargingOptions[payload_counter++] = 5 * 16 /* Wiretype = 5  =^ Array mit 1 Byte Länge */ + ((tag_dataID>>8) & 0x0F) /* DataID High Part */ ;
      ChargingManagementCore_payload_buffer_immediateChargingOptions[payload_counter++] = tag_dataID & 0xFF /* DataID Low Part */ ;
      
      ChargingManagementCore_payload_buffer_immediateChargingOptions[payload_counter++] = 22; // Array Length
      
      // Service ID
      ChargingManagementCore_payload_buffer_immediateChargingOptions[payload_counter++] = ChargingManagementCore_array_immediateChargingOptions_chargeModeSelection_serviceId[j]>> 8 & 0xFF;
      ChargingManagementCore_payload_buffer_immediateChargingOptions[payload_counter++] = ChargingManagementCore_array_immediateChargingOptions_chargeModeSelection_serviceId[j]     & 0xFF;
      
      // Service Instance ID
      ChargingManagementCore_payload_buffer_immediateChargingOptions[payload_counter++] = ChargingManagementCore_array_immediateChargingOptions_chargeModeSelection_serviceInstanceId[j]>> 8 & 0xFF;
      ChargingManagementCore_payload_buffer_immediateChargingOptions[payload_counter++] = ChargingManagementCore_array_immediateChargingOptions_chargeModeSelection_serviceInstanceId[j]     & 0xFF;
      
      // Resource ID
      ChargingManagementCore_payload_buffer_immediateChargingOptions[payload_counter++] = ChargingManagementCore_array_immediateChargingOptions_chargeModeSelection_resourceId[j]>> 8 & 0xFF;
      ChargingManagementCore_payload_buffer_immediateChargingOptions[payload_counter++] = ChargingManagementCore_array_immediateChargingOptions_chargeModeSelection_resourceId[j]     & 0xFF;
      
      // Element ID
      for (k=0; k<16; k++)
        ChargingManagementCore_payload_buffer_immediateChargingOptions[payload_counter++] = ChargingManagementCore_array_immediateChargingOptions_chargeModeSelection_elementId[j][k] & 0xFF;
    }
    
    //Element Length
    element_length = payload_counter-start_pos;
    if (element_length >0) ChargingManagementCore_array_immediateChargingOptions_array_element_length[j] = element_length - 4;
    else                   ChargingManagementCore_array_immediateChargingOptions_array_element_length[j] = element_length;
    
    ChargingManagementCore_payload_buffer_immediateChargingOptions[start_pos++] = ChargingManagementCore_array_immediateChargingOptions_array_element_length[j]>>24 & 0xFF;
    ChargingManagementCore_payload_buffer_immediateChargingOptions[start_pos++] = ChargingManagementCore_array_immediateChargingOptions_array_element_length[j]>>16 & 0xFF;
    ChargingManagementCore_payload_buffer_immediateChargingOptions[start_pos++] = ChargingManagementCore_array_immediateChargingOptions_array_element_length[j]>> 8 & 0xFF;
    ChargingManagementCore_payload_buffer_immediateChargingOptions[start_pos++] = ChargingManagementCore_array_immediateChargingOptions_array_element_length[j]     & 0xFF;
    
    if (ChargingManagementCore_array_immediateChargingOptions_array_element_length[j] == 0) payload_counter = payload_counter+4;
  }
  
  // Struct Length
  ChargingManagementCore_array_immediateChargingOptions_struct_element_length = 4*@ChargingManagementCore_Notification_immediateChargingOptions_Element_TotalNum;

  for (k=0;k<@ChargingManagementCore_Notification_immediateChargingOptions_Element_TotalNum;k++)
    ChargingManagementCore_array_immediateChargingOptions_struct_element_length = ChargingManagementCore_array_immediateChargingOptions_struct_element_length + ChargingManagementCore_array_immediateChargingOptions_array_element_length[k];
  
  ChargingManagementCore_payload_buffer_immediateChargingOptions[0] = ChargingManagementCore_array_immediateChargingOptions_struct_element_length>>24 & 0xFF;
  ChargingManagementCore_payload_buffer_immediateChargingOptions[1] = ChargingManagementCore_array_immediateChargingOptions_struct_element_length>>16 & 0xFF;
  ChargingManagementCore_payload_buffer_immediateChargingOptions[2] = ChargingManagementCore_array_immediateChargingOptions_struct_element_length>> 8 & 0xFF;
  ChargingManagementCore_payload_buffer_immediateChargingOptions[3] = ChargingManagementCore_array_immediateChargingOptions_struct_element_length     & 0xFF;


  ChargingManagementCore_payload_length_immediateChargingOptions = ChargingManagementCore_array_immediateChargingOptions_struct_element_length+4;
  putvalue(ChargingManagementCore_Notification_immediateChargingOptions_Payload, ChargingManagementCore_payload_buffer_immediateChargingOptions, ChargingManagementCore_payload_length_immediateChargingOptions);
}

on envVar ChargingManagementCore_Notification_immediateChargingOptions_Element_TotalNum
{
  if (@this == 0) @this =  1;
  if (@this > 10) @this = 10;
  
  ChargingManagementCore_Notification_immediateChargingOptions();
  ChargingManagementCore_Notification_immediateChargingOptions_update();
}

on envVar ChargingManagementCore_Notification_immediateChargingOptions_Element
{
  ChargingManagementCore_Notification_immediateChargingOptions_update();
}

on envVar ChargingManagementCore_Notification_immediateChargingOptions_Element_Next
{
  if (@this == 1 && @ChargingManagementCore_Notification_immediateChargingOptions_Element < @ChargingManagementCore_Notification_immediateChargingOptions_Element_TotalNum - 1)
  {
    @ChargingManagementCore_Notification_immediateChargingOptions_Element = @ChargingManagementCore_Notification_immediateChargingOptions_Element + 1;
    ChargingManagementCore_Notification_immediateChargingOptions_update();
  }
}

on envVar ChargingManagementCore_Notification_immediateChargingOptions_Element_Previous
{
  if (@this == 1 && @ChargingManagementCore_Notification_immediateChargingOptions_Element > 0)
  {
    @ChargingManagementCore_Notification_immediateChargingOptions_Element = @ChargingManagementCore_Notification_immediateChargingOptions_Element - 1;
    ChargingManagementCore_Notification_immediateChargingOptions_update();
  }
}

ChargingManagementCore_Notification_immediateChargingOptions_update()
{
  @ChargingManagementCore_Notification_LengthIndicator_Element_immediateChargingOptions = ChargingManagementCore_array_immediateChargingOptions_array_element_length[@ChargingManagementCore_Notification_immediateChargingOptions_Element];
  @ChargingManagementCore_Notification_LengthIndicator_Struct_immediateChargingOptions  = ChargingManagementCore_array_immediateChargingOptions_struct_element_length;
  @ChargingManagementCore_Notification_Length_immediateChargingOptions                  = ChargingManagementCore_payload_length_immediateChargingOptions+8;
  
  @ChargingManagementCore_Notification_immediateChargingOptions_type                                  = ChargingManagementCore_array_immediateChargingOptions_type[@ChargingManagementCore_Notification_immediateChargingOptions_Element];
  @ChargingManagementCore_Notification_immediateChargingOptions_targetSoc_serviceId                   = ChargingManagementCore_array_immediateChargingOptions_targetSoc_serviceId[@ChargingManagementCore_Notification_immediateChargingOptions_Element];
  @ChargingManagementCore_Notification_immediateChargingOptions_targetSoc_serviceInstanceId           = ChargingManagementCore_array_immediateChargingOptions_targetSoc_serviceInstanceId[@ChargingManagementCore_Notification_immediateChargingOptions_Element];
  @ChargingManagementCore_Notification_immediateChargingOptions_targetSoc_resourceId                  = ChargingManagementCore_array_immediateChargingOptions_targetSoc_resourceId[@ChargingManagementCore_Notification_immediateChargingOptions_Element];
  @ChargingManagementCore_Notification_immediateChargingOptions_targetRange_serviceId                 = ChargingManagementCore_array_immediateChargingOptions_targetRange_serviceId[@ChargingManagementCore_Notification_immediateChargingOptions_Element];
  @ChargingManagementCore_Notification_immediateChargingOptions_targetRange_serviceInstanceId         = ChargingManagementCore_array_immediateChargingOptions_targetRange_serviceInstanceId[@ChargingManagementCore_Notification_immediateChargingOptions_Element];
  @ChargingManagementCore_Notification_immediateChargingOptions_targetRange_resourceId                = ChargingManagementCore_array_immediateChargingOptions_targetRange_resourceId[@ChargingManagementCore_Notification_immediateChargingOptions_Element];
  @ChargingManagementCore_Notification_immediateChargingOptions_maxChargeCurrentAc_serviceId          = ChargingManagementCore_array_immediateChargingOptions_maxChargeCurrentAc_serviceId[@ChargingManagementCore_Notification_immediateChargingOptions_Element];
  @ChargingManagementCore_Notification_immediateChargingOptions_maxChargeCurrentAc_serviceInstanceId  = ChargingManagementCore_array_immediateChargingOptions_maxChargeCurrentAc_serviceInstanceId[@ChargingManagementCore_Notification_immediateChargingOptions_Element];
  @ChargingManagementCore_Notification_immediateChargingOptions_maxChargeCurrentAc_resourceId         = ChargingManagementCore_array_immediateChargingOptions_maxChargeCurrentAc_resourceId[@ChargingManagementCore_Notification_immediateChargingOptions_Element];
  @ChargingManagementCore_Notification_immediateChargingOptions_autounlockAc_serviceId                = ChargingManagementCore_array_immediateChargingOptions_autounlockAc_serviceId[@ChargingManagementCore_Notification_immediateChargingOptions_Element];
  @ChargingManagementCore_Notification_immediateChargingOptions_autounlockAc_serviceInstanceId        = ChargingManagementCore_array_immediateChargingOptions_autounlockAc_serviceInstanceId[@ChargingManagementCore_Notification_immediateChargingOptions_Element];
  @ChargingManagementCore_Notification_immediateChargingOptions_autounlockAc_resourceId               = ChargingManagementCore_array_immediateChargingOptions_autounlockAc_resourceId[@ChargingManagementCore_Notification_immediateChargingOptions_Element];
  @ChargingManagementCore_Notification_immediateChargingOptions_autounlockDc_serviceId                = ChargingManagementCore_array_immediateChargingOptions_autounlockDc_serviceId[@ChargingManagementCore_Notification_immediateChargingOptions_Element];
  @ChargingManagementCore_Notification_immediateChargingOptions_autounlockDc_serviceInstanceId        = ChargingManagementCore_array_immediateChargingOptions_autounlockDc_serviceInstanceId[@ChargingManagementCore_Notification_immediateChargingOptions_Element];
  @ChargingManagementCore_Notification_immediateChargingOptions_autounlockDc_resourceId               = ChargingManagementCore_array_immediateChargingOptions_autounlockDc_resourceId[@ChargingManagementCore_Notification_immediateChargingOptions_Element];
  @ChargingManagementCore_Notification_immediateChargingOptions_chargeModeSelection_serviceId         = ChargingManagementCore_array_immediateChargingOptions_chargeModeSelection_serviceId[@ChargingManagementCore_Notification_immediateChargingOptions_Element];
  @ChargingManagementCore_Notification_immediateChargingOptions_chargeModeSelection_serviceInstanceId = ChargingManagementCore_array_immediateChargingOptions_chargeModeSelection_serviceInstanceId[@ChargingManagementCore_Notification_immediateChargingOptions_Element];
  @ChargingManagementCore_Notification_immediateChargingOptions_chargeModeSelection_resourceId        = ChargingManagementCore_array_immediateChargingOptions_chargeModeSelection_resourceId[@ChargingManagementCore_Notification_immediateChargingOptions_Element];
  
  putvalue(ChargingManagementCore_Notification_immediateChargingOptions_targetSoc_elementId,ChargingManagementCore_array_immediateChargingOptions_targetSoc_elementId[@ChargingManagementCore_Notification_immediateChargingOptions_Element]);
  putValue(ChargingManagementCore_Notification_immediateChargingOptions_targetRange_elementId, ChargingManagementCore_array_immediateChargingOptions_targetRange_elementId[@ChargingManagementCore_Notification_immediateChargingOptions_Element]);
  putValue(ChargingManagementCore_Notification_immediateChargingOptions_maxChargeCurrentAc_elementId, ChargingManagementCore_array_immediateChargingOptions_maxChargeCurrentAc_elementId[@ChargingManagementCore_Notification_immediateChargingOptions_Element]);
  putValue(ChargingManagementCore_Notification_immediateChargingOptions_autounlockAc_elementId, ChargingManagementCore_array_immediateChargingOptions_autounlockAc_elementId[@ChargingManagementCore_Notification_immediateChargingOptions_Element]);
  putValue(ChargingManagementCore_Notification_immediateChargingOptions_autounlockDc_elementId, ChargingManagementCore_array_immediateChargingOptions_autounlockDc_elementId[@ChargingManagementCore_Notification_immediateChargingOptions_Element]);
  putValue(ChargingManagementCore_Notification_immediateChargingOptions_chargeModeSelection_elementId, ChargingManagementCore_array_immediateChargingOptions_chargeModeSelection_elementId[@ChargingManagementCore_Notification_immediateChargingOptions_Element]);
  
  @ChargingManagementCore_Notification_immediateChargingOptions_type_available                = ChargingManagementCore_array_immediateChargingOptions_type_available[@ChargingManagementCore_Notification_immediateChargingOptions_Element];
  @ChargingManagementCore_Notification_immediateChargingOptions_targetSoc_available           = ChargingManagementCore_array_immediateChargingOptions_targetSoc_available[@ChargingManagementCore_Notification_immediateChargingOptions_Element];
  @ChargingManagementCore_Notification_immediateChargingOptions_targetRange_available         = ChargingManagementCore_array_immediateChargingOptions_targetRange_available[@ChargingManagementCore_Notification_immediateChargingOptions_Element];
  @ChargingManagementCore_Notification_immediateChargingOptions_maxChargeCurrentAc_available  = ChargingManagementCore_array_immediateChargingOptions_maxChargeCurrentAc_available[@ChargingManagementCore_Notification_immediateChargingOptions_Element];
  @ChargingManagementCore_Notification_immediateChargingOptions_autounlockAc_available        = ChargingManagementCore_array_immediateChargingOptions_autounlockAc_available[@ChargingManagementCore_Notification_immediateChargingOptions_Element];
  @ChargingManagementCore_Notification_immediateChargingOptions_autounlockDc_available        = ChargingManagementCore_array_immediateChargingOptions_autounlockDc_available[@ChargingManagementCore_Notification_immediateChargingOptions_Element];
  @ChargingManagementCore_Notification_immediateChargingOptions_chargeModeSelection_available = ChargingManagementCore_array_immediateChargingOptions_chargeModeSelection_available[@ChargingManagementCore_Notification_immediateChargingOptions_Element];
}







////////// chargingProcessInformation Notification //////////

on envVar ChargingManagementCore_Notification_LengthIndicator_Struct_chargingProcessInformation
{
  ChargingManagementCore_Notification_chargingProcessInformation();
}
on envVar ChargingManagementCore_Notification_LengthIndicator_Element_chargingProcessInformation
{
  ChargingManagementCore_Notification_chargingProcessInformation();
}
on envVar ChargingManagementCore_Notification_chargingProcessInformation_type
{
  ChargingManagementCore_array_chargingProcessInformation_type[@ChargingManagementCore_Notification_chargingProcessInformation_Element] = @this;
  ChargingManagementCore_Notification_chargingProcessInformation();
}
on envVar ChargingManagementCore_Notification_chargingProcessInformation_currentChargeState
{
  ChargingManagementCore_array_chargingProcessInformation_currentChargeState[@ChargingManagementCore_Notification_chargingProcessInformation_Element] = @this;
  ChargingManagementCore_Notification_chargingProcessInformation();
}
on envVar ChargingManagementCore_Notification_chargingProcessInformation_currentSoc_serviceId
{
  ChargingManagementCore_array_chargingProcessInformation_currentSoc_serviceId[@ChargingManagementCore_Notification_chargingProcessInformation_Element] = @this;
  ChargingManagementCore_Notification_chargingProcessInformation();
}
on envVar ChargingManagementCore_Notification_chargingProcessInformation_currentSoc_serviceInstanceId
{
  ChargingManagementCore_array_chargingProcessInformation_currentSoc_serviceInstanceId[@ChargingManagementCore_Notification_chargingProcessInformation_Element] = @this;
  ChargingManagementCore_Notification_chargingProcessInformation();
}
on envVar ChargingManagementCore_Notification_chargingProcessInformation_currentSoc_resourceId
{
  ChargingManagementCore_array_chargingProcessInformation_currentSoc_resourceId[@ChargingManagementCore_Notification_chargingProcessInformation_Element] = @this;
  ChargingManagementCore_Notification_chargingProcessInformation();
}
on envVar ChargingManagementCore_Notification_chargingProcessInformation_currentSoc_elementId
{
  getvalue(this, buffer_uuid);
  for (k=0;k<16;k++)
    ChargingManagementCore_array_chargingProcessInformation_currentSoc_elementId[@ChargingManagementCore_Notification_chargingProcessInformation_Element][k] = buffer_uuid[k];
  ChargingManagementCore_Notification_chargingProcessInformation();
}
on envVar ChargingManagementCore_Notification_chargingProcessInformation_remainingChargeTimeBulk_serviceId
{
  ChargingManagementCore_array_chargingProcessInformation_remainingChargeTimeBulk_serviceId[@ChargingManagementCore_Notification_chargingProcessInformation_Element] = @this;
  ChargingManagementCore_Notification_chargingProcessInformation();
}
on envVar ChargingManagementCore_Notification_chargingProcessInformation_remainingChargeTimeBulk_serviceInstanceId
{
  ChargingManagementCore_array_chargingProcessInformation_remainingChargeTimeBulk_serviceInstanceId[@ChargingManagementCore_Notification_chargingProcessInformation_Element] = @this;
  ChargingManagementCore_Notification_chargingProcessInformation();
}
on envVar ChargingManagementCore_Notification_chargingProcessInformation_remainingChargeTimeBulk_resourceId
{
  ChargingManagementCore_array_chargingProcessInformation_remainingChargeTimeBulk_resourceId[@ChargingManagementCore_Notification_chargingProcessInformation_Element] = @this;
  ChargingManagementCore_Notification_chargingProcessInformation();
}
on envVar ChargingManagementCore_Notification_chargingProcessInformation_remainingChargeTimeBulk_elementId
{
  getvalue(this, buffer_uuid);
  for (k=0;k<16;k++)
    ChargingManagementCore_array_chargingProcessInformation_remainingChargeTimeBulk_elementId[@ChargingManagementCore_Notification_chargingProcessInformation_Element][k] = buffer_uuid[k];
  ChargingManagementCore_Notification_chargingProcessInformation();
}
on envVar ChargingManagementCore_Notification_chargingProcessInformation_chargeBulkThreshold
{
  ChargingManagementCore_array_chargingProcessInformation_chargeBulkThreshold[@ChargingManagementCore_Notification_chargingProcessInformation_Element] = @this;
  ChargingManagementCore_Notification_chargingProcessInformation();
}
on envVar ChargingManagementCore_Notification_chargingProcessInformation_remainingChargeTimeComplete_serviceId
{
  ChargingManagementCore_array_chargingProcessInformation_remainingChargeTimeComplete_serviceId[@ChargingManagementCore_Notification_chargingProcessInformation_Element] = @this;
  ChargingManagementCore_Notification_chargingProcessInformation();
}
on envVar ChargingManagementCore_Notification_chargingProcessInformation_remainingChargeTimeComplete_serviceInstanceId
{
  ChargingManagementCore_array_chargingProcessInformation_remainingChargeTimeComplete_serviceInstanceId[@ChargingManagementCore_Notification_chargingProcessInformation_Element] = @this;
  ChargingManagementCore_Notification_chargingProcessInformation();
}
on envVar ChargingManagementCore_Notification_chargingProcessInformation_remainingChargeTimeComplete_resourceId
{
  ChargingManagementCore_array_chargingProcessInformation_remainingChargeTimeComplete_resourceId[@ChargingManagementCore_Notification_chargingProcessInformation_Element] = @this;
  ChargingManagementCore_Notification_chargingProcessInformation();
}
on envVar ChargingManagementCore_Notification_chargingProcessInformation_remainingChargeTimeComplete_elementId
{
  getvalue(this, buffer_uuid);
  for (k=0;k<16;k++)
    ChargingManagementCore_array_chargingProcessInformation_remainingChargeTimeComplete_elementId[@ChargingManagementCore_Notification_chargingProcessInformation_Element][k] = buffer_uuid[k];
  ChargingManagementCore_Notification_chargingProcessInformation();
}
on envVar ChargingManagementCore_Notification_chargingProcessInformation_chargeMode
{
  ChargingManagementCore_array_chargingProcessInformation_chargeMode[@ChargingManagementCore_Notification_chargingProcessInformation_Element] = @this;
  ChargingManagementCore_Notification_chargingProcessInformation();
}
on envVar ChargingManagementCore_Notification_chargingProcessInformation_profileChargeReason
{
  ChargingManagementCore_array_chargingProcessInformation_profileChargeReason[@ChargingManagementCore_Notification_chargingProcessInformation_Element] = @this;
  ChargingManagementCore_Notification_chargingProcessInformation();
}
on envVar ChargingManagementCore_Notification_chargingProcessInformation_chargeType
{
  ChargingManagementCore_array_chargingProcessInformation_chargeType[@ChargingManagementCore_Notification_chargingProcessInformation_Element] = @this;
  ChargingManagementCore_Notification_chargingProcessInformation();
}
on envVar ChargingManagementCore_Notification_chargingProcessInformation_chargeEnergy_serviceId
{
  ChargingManagementCore_array_chargingProcessInformation_chargeEnergy_serviceId[@ChargingManagementCore_Notification_chargingProcessInformation_Element] = @this;
  ChargingManagementCore_Notification_chargingProcessInformation();
}
on envVar ChargingManagementCore_Notification_chargingProcessInformation_chargeEnergy_serviceInstanceId
{
  ChargingManagementCore_array_chargingProcessInformation_chargeEnergy_serviceInstanceId[@ChargingManagementCore_Notification_chargingProcessInformation_Element] = @this;
  ChargingManagementCore_Notification_chargingProcessInformation();
}
on envVar ChargingManagementCore_Notification_chargingProcessInformation_chargeEnergy_resourceId
{
  ChargingManagementCore_array_chargingProcessInformation_chargeEnergy_resourceId[@ChargingManagementCore_Notification_chargingProcessInformation_Element] = @this;
  ChargingManagementCore_Notification_chargingProcessInformation();
}
on envVar ChargingManagementCore_Notification_chargingProcessInformation_chargeEnergy_elementId
{
  getvalue(this, buffer_uuid);
  for (k=0;k<16;k++)
    ChargingManagementCore_array_chargingProcessInformation_chargeEnergy_elementId[@ChargingManagementCore_Notification_chargingProcessInformation_Element][k] = buffer_uuid[k];
  ChargingManagementCore_Notification_chargingProcessInformation();
}
on envVar ChargingManagementCore_Notification_chargingProcessInformation_chargeRate_serviceId
{
  ChargingManagementCore_array_chargingProcessInformation_chargeRate_serviceId[@ChargingManagementCore_Notification_chargingProcessInformation_Element] = @this;
  ChargingManagementCore_Notification_chargingProcessInformation();
}
on envVar ChargingManagementCore_Notification_chargingProcessInformation_chargeRate_serviceInstanceId
{
  ChargingManagementCore_array_chargingProcessInformation_chargeRate_serviceInstanceId[@ChargingManagementCore_Notification_chargingProcessInformation_Element] = @this;
  ChargingManagementCore_Notification_chargingProcessInformation();
}
on envVar ChargingManagementCore_Notification_chargingProcessInformation_chargeRate_resourceId
{
  ChargingManagementCore_array_chargingProcessInformation_chargeRate_resourceId[@ChargingManagementCore_Notification_chargingProcessInformation_Element] = @this;
  ChargingManagementCore_Notification_chargingProcessInformation();
}
on envVar ChargingManagementCore_Notification_chargingProcessInformation_chargeRate_elementId
{
  getvalue(this, buffer_uuid);
  for (k=0;k<16;k++)
    ChargingManagementCore_array_chargingProcessInformation_chargeRate_elementId[@ChargingManagementCore_Notification_chargingProcessInformation_Element][k] = buffer_uuid[k];
  ChargingManagementCore_Notification_chargingProcessInformation();
}
on envVar ChargingManagementCore_Notification_chargingProcessInformation_chargePower_serviceId
{
  ChargingManagementCore_array_chargingProcessInformation_chargePower_serviceId[@ChargingManagementCore_Notification_chargingProcessInformation_Element] = @this;
  ChargingManagementCore_Notification_chargingProcessInformation();
}
on envVar ChargingManagementCore_Notification_chargingProcessInformation_chargePower_serviceInstanceId
{
  ChargingManagementCore_array_chargingProcessInformation_chargePower_serviceInstanceId[@ChargingManagementCore_Notification_chargingProcessInformation_Element] = @this;
  ChargingManagementCore_Notification_chargingProcessInformation();
}
on envVar ChargingManagementCore_Notification_chargingProcessInformation_chargePower_resourceId
{
  ChargingManagementCore_array_chargingProcessInformation_chargePower_resourceId[@ChargingManagementCore_Notification_chargingProcessInformation_Element] = @this;
  ChargingManagementCore_Notification_chargingProcessInformation();
}
on envVar ChargingManagementCore_Notification_chargingProcessInformation_chargePower_elementId
{
  getvalue(this, buffer_uuid);
  for (k=0;k<16;k++)
    ChargingManagementCore_array_chargingProcessInformation_chargePower_elementId[@ChargingManagementCore_Notification_chargingProcessInformation_Element][k] = buffer_uuid[k];
  ChargingManagementCore_Notification_chargingProcessInformation();
}
on envVar ChargingManagementCore_Notification_chargingProcessInformation_chargingScenario
{
  ChargingManagementCore_array_chargingProcessInformation_chargingScenario[@ChargingManagementCore_Notification_chargingProcessInformation_Element] = @this;
  ChargingManagementCore_Notification_chargingProcessInformation();
}
on envVar ChargingManagementCore_Notification_chargingProcessInformation_chargeTargetTime_serviceId
{
  ChargingManagementCore_array_chargingProcessInformation_chargeTargetTime_serviceId[@ChargingManagementCore_Notification_chargingProcessInformation_Element] = @this;
  ChargingManagementCore_Notification_chargingProcessInformation();
}
on envVar ChargingManagementCore_Notification_chargingProcessInformation_chargeTargetTime_serviceInstanceId
{
  ChargingManagementCore_array_chargingProcessInformation_chargeTargetTime_serviceInstanceId[@ChargingManagementCore_Notification_chargingProcessInformation_Element] = @this;
  ChargingManagementCore_Notification_chargingProcessInformation();
}
on envVar ChargingManagementCore_Notification_chargingProcessInformation_chargeTargetTime_resourceId
{
  ChargingManagementCore_array_chargingProcessInformation_chargeTargetTime_resourceId[@ChargingManagementCore_Notification_chargingProcessInformation_Element] = @this;
  ChargingManagementCore_Notification_chargingProcessInformation();
}
on envVar ChargingManagementCore_Notification_chargingProcessInformation_chargeTargetTime_elementId
{
  getvalue(this, buffer_uuid);
  for (k=0;k<16;k++)
    ChargingManagementCore_array_chargingProcessInformation_chargeTargetTime_elementId[@ChargingManagementCore_Notification_chargingProcessInformation_Element][k] = buffer_uuid[k];
  ChargingManagementCore_Notification_chargingProcessInformation();
}
on envVar ChargingManagementCore_Notification_chargingProcessInformation_chargeTargetTimeOffset_serviceId
{
  ChargingManagementCore_array_chargingProcessInformation_chargeTargetTimeOffset_serviceId[@ChargingManagementCore_Notification_chargingProcessInformation_Element] = @this;
  ChargingManagementCore_Notification_chargingProcessInformation();
}
on envVar ChargingManagementCore_Notification_chargingProcessInformation_chargeTargetTimeOffset_serviceInstanceId
{
  ChargingManagementCore_array_chargingProcessInformation_chargeTargetTimeOffset_serviceInstanceId[@ChargingManagementCore_Notification_chargingProcessInformation_Element] = @this;
  ChargingManagementCore_Notification_chargingProcessInformation();
}
on envVar ChargingManagementCore_Notification_chargingProcessInformation_chargeTargetTimeOffset_resourceId
{
  ChargingManagementCore_array_chargingProcessInformation_chargeTargetTimeOffset_resourceId[@ChargingManagementCore_Notification_chargingProcessInformation_Element] = @this;
  ChargingManagementCore_Notification_chargingProcessInformation();
}
on envVar ChargingManagementCore_Notification_chargingProcessInformation_chargeTargetTimeOffset_elementId
{
  getvalue(this, buffer_uuid);
  for (k=0;k<16;k++)
    ChargingManagementCore_array_chargingProcessInformation_chargeTargetTimeOffset_elementId[@ChargingManagementCore_Notification_chargingProcessInformation_Element][k] = buffer_uuid[k];
  ChargingManagementCore_Notification_chargingProcessInformation();
}
on envVar ChargingManagementCore_Notification_chargingProcessInformation_maxPowerChargingStation_serviceId
{
  ChargingManagementCore_array_chargingProcessInformation_maxPowerChargingStation_serviceId[@ChargingManagementCore_Notification_chargingProcessInformation_Element] = @this;
  ChargingManagementCore_Notification_chargingProcessInformation();
}
on envVar ChargingManagementCore_Notification_chargingProcessInformation_maxPowerChargingStation_serviceInstanceId
{
  ChargingManagementCore_array_chargingProcessInformation_maxPowerChargingStation_serviceInstanceId[@ChargingManagementCore_Notification_chargingProcessInformation_Element] = @this;
  ChargingManagementCore_Notification_chargingProcessInformation();
}
on envVar ChargingManagementCore_Notification_chargingProcessInformation_maxPowerChargingStation_resourceId
{
  ChargingManagementCore_array_chargingProcessInformation_maxPowerChargingStation_resourceId[@ChargingManagementCore_Notification_chargingProcessInformation_Element] = @this;
  ChargingManagementCore_Notification_chargingProcessInformation();
}
on envVar ChargingManagementCore_Notification_chargingProcessInformation_maxPowerChargingStation_elementId
{
  getvalue(this, buffer_uuid);
  for (k=0;k<16;k++)
    ChargingManagementCore_array_chargingProcessInformation_maxPowerChargingStation_elementId[@ChargingManagementCore_Notification_chargingProcessInformation_Element][k] = buffer_uuid[k];
  ChargingManagementCore_Notification_chargingProcessInformation();
}
on envVar ChargingManagementCore_Notification_chargingProcessInformation_type_available
{
  ChargingManagementCore_array_chargingProcessInformation_type_available[@ChargingManagementCore_Notification_chargingProcessInformation_Element] = @this;
  ChargingManagementCore_Notification_chargingProcessInformation();
}
on envVar ChargingManagementCore_Notification_chargingProcessInformation_currentChargeState_available
{
  ChargingManagementCore_array_chargingProcessInformation_currentChargeState_available[@ChargingManagementCore_Notification_chargingProcessInformation_Element] = @this;
  ChargingManagementCore_Notification_chargingProcessInformation();
}
on envVar ChargingManagementCore_Notification_chargingProcessInformation_currentSoc_available
{
  ChargingManagementCore_array_chargingProcessInformation_currentSoc_available[@ChargingManagementCore_Notification_chargingProcessInformation_Element] = @this;
  ChargingManagementCore_Notification_chargingProcessInformation();
}
on envVar ChargingManagementCore_Notification_chargingProcessInformation_remainingChargeTimeBulk_available
{
  ChargingManagementCore_array_chargingProcessInformation_remainingChargeTimeBulk_available[@ChargingManagementCore_Notification_chargingProcessInformation_Element] = @this;
  ChargingManagementCore_Notification_chargingProcessInformation();
}
on envVar ChargingManagementCore_Notification_chargingProcessInformation_chargeBulkThreshold_available
{
  ChargingManagementCore_array_chargingProcessInformation_chargeBulkThreshold_available[@ChargingManagementCore_Notification_chargingProcessInformation_Element] = @this;
  ChargingManagementCore_Notification_chargingProcessInformation();
}
on envVar ChargingManagementCore_Notification_chargingProcessInformation_remainingChargeTimeComplete_available
{
  ChargingManagementCore_array_chargingProcessInformation_remainingChargeTimeComplete_available[@ChargingManagementCore_Notification_chargingProcessInformation_Element] = @this;
  ChargingManagementCore_Notification_chargingProcessInformation();
}
on envVar ChargingManagementCore_Notification_chargingProcessInformation_chargeMode_available
{
  ChargingManagementCore_array_chargingProcessInformation_chargeMode_available[@ChargingManagementCore_Notification_chargingProcessInformation_Element] = @this;
  ChargingManagementCore_Notification_chargingProcessInformation();
}
on envVar ChargingManagementCore_Notification_chargingProcessInformation_profileChargeReason_available
{
  ChargingManagementCore_array_chargingProcessInformation_profileChargeReason_available[@ChargingManagementCore_Notification_chargingProcessInformation_Element] = @this;
  ChargingManagementCore_Notification_chargingProcessInformation();
}
on envVar ChargingManagementCore_Notification_chargingProcessInformation_chargeType_available
{
  ChargingManagementCore_array_chargingProcessInformation_chargeType_available[@ChargingManagementCore_Notification_chargingProcessInformation_Element] = @this;
  ChargingManagementCore_Notification_chargingProcessInformation();
}
on envVar ChargingManagementCore_Notification_chargingProcessInformation_chargeEnergy_available
{
  ChargingManagementCore_array_chargingProcessInformation_chargeEnergy_available[@ChargingManagementCore_Notification_chargingProcessInformation_Element] = @this;
  ChargingManagementCore_Notification_chargingProcessInformation();
}
on envVar ChargingManagementCore_Notification_chargingProcessInformation_chargeRate_available
{
  ChargingManagementCore_array_chargingProcessInformation_chargeRate_available[@ChargingManagementCore_Notification_chargingProcessInformation_Element] = @this;
  ChargingManagementCore_Notification_chargingProcessInformation();
}
on envVar ChargingManagementCore_Notification_chargingProcessInformation_chargePower_available
{
  ChargingManagementCore_array_chargingProcessInformation_chargePower_available[@ChargingManagementCore_Notification_chargingProcessInformation_Element] = @this;
  ChargingManagementCore_Notification_chargingProcessInformation();
}
on envVar ChargingManagementCore_Notification_chargingProcessInformation_chargingScenario_available
{
  ChargingManagementCore_array_chargingProcessInformation_chargingScenario_available[@ChargingManagementCore_Notification_chargingProcessInformation_Element] = @this;
  ChargingManagementCore_Notification_chargingProcessInformation();
}
on envVar ChargingManagementCore_Notification_chargingProcessInformation_chargeTargetTime_available
{
  ChargingManagementCore_array_chargingProcessInformation_chargeTargetTime_available[@ChargingManagementCore_Notification_chargingProcessInformation_Element] = @this;
  ChargingManagementCore_Notification_chargingProcessInformation();
}
on envVar ChargingManagementCore_Notification_chargingProcessInformation_chargeTargetTimeOffset_available
{
  ChargingManagementCore_array_chargingProcessInformation_chargeTargetTimeOffset_available[@ChargingManagementCore_Notification_chargingProcessInformation_Element] = @this;
  ChargingManagementCore_Notification_chargingProcessInformation();
}
on envVar ChargingManagementCore_Notification_chargingProcessInformation_maxPowerChargingStation_available
{
  ChargingManagementCore_array_chargingProcessInformation_maxPowerChargingStation_available[@ChargingManagementCore_Notification_chargingProcessInformation_Element] = @this;
  ChargingManagementCore_Notification_chargingProcessInformation();
}
on envVar ChargingManagementCore_Notification_chargingProcessInformation_Payload
{
  ChargingManagementCore_Notification_chargingProcessInformation_update();
}


ChargingManagementCore_Notification_chargingProcessInformation()
{
  word payload_counter = 0;
  word start_pos       = 0;
  word element_length  = 0;
  
  // Length Indicator Struct - Platzhalter
  payload_counter = 0+4;
  start_pos = 0;
  
  for (j=0; j<@ChargingManagementCore_Notification_chargingProcessInformation_Element_TotalNum; j++)
  {
    ChargingManagementCore_array_chargingProcessInformation_available_functions[j] = ChargingManagementCore_array_chargingProcessInformation_type_available[j]
                                                                                   + ChargingManagementCore_array_chargingProcessInformation_currentChargeState_available[j]
                                                                                   + ChargingManagementCore_array_chargingProcessInformation_currentSoc_available[j]
                                                                                   + ChargingManagementCore_array_chargingProcessInformation_remainingChargeTimeBulk_available[j]
                                                                                   + ChargingManagementCore_array_chargingProcessInformation_chargeBulkThreshold_available[j]
                                                                                   + ChargingManagementCore_array_chargingProcessInformation_remainingChargeTimeComplete_available[j]
                                                                                   + ChargingManagementCore_array_chargingProcessInformation_chargeMode_available[j]
                                                                                   + ChargingManagementCore_array_chargingProcessInformation_profileChargeReason_available[j]
                                                                                   + ChargingManagementCore_array_chargingProcessInformation_chargeType_available[j]
                                                                                   + ChargingManagementCore_array_chargingProcessInformation_chargeEnergy_available[j]
                                                                                   + ChargingManagementCore_array_chargingProcessInformation_chargeRate_available[j]
                                                                                   + ChargingManagementCore_array_chargingProcessInformation_chargePower_available[j]
                                                                                   + ChargingManagementCore_array_chargingProcessInformation_chargingScenario_available[j]
                                                                                   + ChargingManagementCore_array_chargingProcessInformation_chargeTargetTime_available[j]
                                                                                   + ChargingManagementCore_array_chargingProcessInformation_chargeTargetTimeOffset_available[j]
                                                                                   + ChargingManagementCore_array_chargingProcessInformation_maxPowerChargingStation_available[j];
    
    // Length Indicator Element - Platzhalter
    if (ChargingManagementCore_array_chargingProcessInformation_available_functions[j] > 0)
    {
      start_pos = payload_counter;
      payload_counter = payload_counter + 4;
    }
    else 
      start_pos = payload_counter;
    
    // 0 type (enum32)
    if (ChargingManagementCore_array_chargingProcessInformation_type_available[j] == 1)
    {
      tag_dataID = 0;
      ChargingManagementCore_payload_buffer_chargingProcessInformation[payload_counter++] = 2 * 16 /* Wiretype = 2 =^ 32 Bit */ + ((tag_dataID>>8) & 0x0F) /* DataID High Part */ ;
      ChargingManagementCore_payload_buffer_chargingProcessInformation[payload_counter++] = tag_dataID & 0xFF /* DataID Low Part */ ;
      
      ChargingManagementCore_payload_buffer_chargingProcessInformation[payload_counter++] = ChargingManagementCore_array_chargingProcessInformation_type[j]>>24 & 0xFF;
      ChargingManagementCore_payload_buffer_chargingProcessInformation[payload_counter++] = ChargingManagementCore_array_chargingProcessInformation_type[j]>>16 & 0xFF;
      ChargingManagementCore_payload_buffer_chargingProcessInformation[payload_counter++] = ChargingManagementCore_array_chargingProcessInformation_type[j]>> 8 & 0xFF;
      ChargingManagementCore_payload_buffer_chargingProcessInformation[payload_counter++] = ChargingManagementCore_array_chargingProcessInformation_type[j]     & 0xFF;
    }
    
    // 1 currentChargeState (enum32)
    if (ChargingManagementCore_array_chargingProcessInformation_currentChargeState_available[j] == 1)
    {
      tag_dataID = 1;
      ChargingManagementCore_payload_buffer_chargingProcessInformation[payload_counter++] = 2 * 16 /* Wiretype = 2 =^ 32 Bit */ + ((tag_dataID>>8) & 0x0F) /* DataID High Part */ ;
      ChargingManagementCore_payload_buffer_chargingProcessInformation[payload_counter++] = tag_dataID & 0xFF /* DataID Low Part */ ;
      
      ChargingManagementCore_payload_buffer_chargingProcessInformation[payload_counter++] = ChargingManagementCore_array_chargingProcessInformation_currentChargeState[j]>>24 & 0xFF;
      ChargingManagementCore_payload_buffer_chargingProcessInformation[payload_counter++] = ChargingManagementCore_array_chargingProcessInformation_currentChargeState[j]>>16 & 0xFF;
      ChargingManagementCore_payload_buffer_chargingProcessInformation[payload_counter++] = ChargingManagementCore_array_chargingProcessInformation_currentChargeState[j]>> 8 & 0xFF;
      ChargingManagementCore_payload_buffer_chargingProcessInformation[payload_counter++] = ChargingManagementCore_array_chargingProcessInformation_currentChargeState[j]     & 0xFF;
    }
    
    
    // 2 currentSoc (ref#ChargingManagementCore.valueIndications.valueIndicationObject)
    if (ChargingManagementCore_array_chargingProcessInformation_currentSoc_available[j] == 1)
    {
      tag_dataID = 2;
      ChargingManagementCore_payload_buffer_chargingProcessInformation[payload_counter++] = 5 * 16 /* Wiretype = 5  =^ Array mit 1 Byte Länge */ + ((tag_dataID>>8) & 0x0F) /* DataID High Part */ ;
      ChargingManagementCore_payload_buffer_chargingProcessInformation[payload_counter++] = tag_dataID & 0xFF /* DataID Low Part */ ;
      
      ChargingManagementCore_payload_buffer_chargingProcessInformation[payload_counter++] = 22; // Array Length
      
      // Service ID
      ChargingManagementCore_payload_buffer_chargingProcessInformation[payload_counter++] = ChargingManagementCore_array_chargingProcessInformation_currentSoc_serviceId[j]>> 8 & 0xFF;
      ChargingManagementCore_payload_buffer_chargingProcessInformation[payload_counter++] = ChargingManagementCore_array_chargingProcessInformation_currentSoc_serviceId[j]     & 0xFF;
      
      // Service Instance ID
      ChargingManagementCore_payload_buffer_chargingProcessInformation[payload_counter++] = ChargingManagementCore_array_chargingProcessInformation_currentSoc_serviceInstanceId[j]>> 8 & 0xFF;
      ChargingManagementCore_payload_buffer_chargingProcessInformation[payload_counter++] = ChargingManagementCore_array_chargingProcessInformation_currentSoc_serviceInstanceId[j]     & 0xFF;
      
      // Resource ID
      ChargingManagementCore_payload_buffer_chargingProcessInformation[payload_counter++] = ChargingManagementCore_array_chargingProcessInformation_currentSoc_resourceId[j]>> 8 & 0xFF;
      ChargingManagementCore_payload_buffer_chargingProcessInformation[payload_counter++] = ChargingManagementCore_array_chargingProcessInformation_currentSoc_resourceId[j]     & 0xFF;
      
      // Element ID
      for (k=0; k<16; k++)
        ChargingManagementCore_payload_buffer_chargingProcessInformation[payload_counter++] = ChargingManagementCore_array_chargingProcessInformation_currentSoc_elementId[j][k] & 0xFF;
    }
    
    
    // 3 remainingChargeTimeBulk (ref#ChargingManagementCore.valueIndications.valueIndicationObject)
    if (ChargingManagementCore_array_chargingProcessInformation_remainingChargeTimeBulk_available[j] == 1)
    {
      tag_dataID = 3;
      ChargingManagementCore_payload_buffer_chargingProcessInformation[payload_counter++] = 5 * 16 /* Wiretype = 5  =^ Array mit 1 Byte Länge */ + ((tag_dataID>>8) & 0x0F) /* DataID High Part */ ;
      ChargingManagementCore_payload_buffer_chargingProcessInformation[payload_counter++] = tag_dataID & 0xFF /* DataID Low Part */ ;
      
      ChargingManagementCore_payload_buffer_chargingProcessInformation[payload_counter++] = 22; // Array Length
      
      // Service ID
      ChargingManagementCore_payload_buffer_chargingProcessInformation[payload_counter++] = ChargingManagementCore_array_chargingProcessInformation_remainingChargeTimeBulk_serviceId[j]>> 8 & 0xFF;
      ChargingManagementCore_payload_buffer_chargingProcessInformation[payload_counter++] = ChargingManagementCore_array_chargingProcessInformation_remainingChargeTimeBulk_serviceId[j]     & 0xFF;
      
      // Service Instance ID
      ChargingManagementCore_payload_buffer_chargingProcessInformation[payload_counter++] = ChargingManagementCore_array_chargingProcessInformation_remainingChargeTimeBulk_serviceInstanceId[j]>> 8 & 0xFF;
      ChargingManagementCore_payload_buffer_chargingProcessInformation[payload_counter++] = ChargingManagementCore_array_chargingProcessInformation_remainingChargeTimeBulk_serviceInstanceId[j]     & 0xFF;
      
      // Resource ID
      ChargingManagementCore_payload_buffer_chargingProcessInformation[payload_counter++] = ChargingManagementCore_array_chargingProcessInformation_remainingChargeTimeBulk_resourceId[j]>> 8 & 0xFF;
      ChargingManagementCore_payload_buffer_chargingProcessInformation[payload_counter++] = ChargingManagementCore_array_chargingProcessInformation_remainingChargeTimeBulk_resourceId[j]     & 0xFF;
      
      // Element ID
      for (k=0; k<16; k++)
        ChargingManagementCore_payload_buffer_chargingProcessInformation[payload_counter++] = ChargingManagementCore_array_chargingProcessInformation_remainingChargeTimeBulk_elementId[j][k] & 0xFF;
    }
    
    
    // 4 chargeBulkThreshold (uint32)
    if (ChargingManagementCore_array_chargingProcessInformation_chargeBulkThreshold_available[j] == 1)
    {
      tag_dataID = 4;
      ChargingManagementCore_payload_buffer_chargingProcessInformation[payload_counter++] = 2 * 16 /* Wiretype = 2 =^ 32 Bit */ + ((tag_dataID>>8) & 0x0F) /* DataID High Part */ ;
      ChargingManagementCore_payload_buffer_chargingProcessInformation[payload_counter++] = tag_dataID & 0xFF /* DataID Low Part */ ;
      
      ChargingManagementCore_payload_buffer_chargingProcessInformation[payload_counter++] = ChargingManagementCore_array_chargingProcessInformation_chargeBulkThreshold[j]>>24 & 0xFF;
      ChargingManagementCore_payload_buffer_chargingProcessInformation[payload_counter++] = ChargingManagementCore_array_chargingProcessInformation_chargeBulkThreshold[j]>>16 & 0xFF;
      ChargingManagementCore_payload_buffer_chargingProcessInformation[payload_counter++] = ChargingManagementCore_array_chargingProcessInformation_chargeBulkThreshold[j]>> 8 & 0xFF;
      ChargingManagementCore_payload_buffer_chargingProcessInformation[payload_counter++] = ChargingManagementCore_array_chargingProcessInformation_chargeBulkThreshold[j]     & 0xFF;
    }
    
    
    // 5 remainingChargeTimeComplete (ref#ChargingManagementCore.valueIndications.valueIndicationObject)
    if (ChargingManagementCore_array_chargingProcessInformation_remainingChargeTimeComplete_available[j] == 1)
    {
      tag_dataID = 5;
      ChargingManagementCore_payload_buffer_chargingProcessInformation[payload_counter++] = 5 * 16 /* Wiretype = 5  =^ Array mit 1 Byte Länge */ + ((tag_dataID>>8) & 0x0F) /* DataID High Part */ ;
      ChargingManagementCore_payload_buffer_chargingProcessInformation[payload_counter++] = tag_dataID & 0xFF /* DataID Low Part */ ;
      
      ChargingManagementCore_payload_buffer_chargingProcessInformation[payload_counter++] = 22; // Array Length
      
      // Service ID
      ChargingManagementCore_payload_buffer_chargingProcessInformation[payload_counter++] = ChargingManagementCore_array_chargingProcessInformation_remainingChargeTimeComplete_serviceId[j]>> 8 & 0xFF;
      ChargingManagementCore_payload_buffer_chargingProcessInformation[payload_counter++] = ChargingManagementCore_array_chargingProcessInformation_remainingChargeTimeComplete_serviceId[j]     & 0xFF;
      
      // Service Instance ID
      ChargingManagementCore_payload_buffer_chargingProcessInformation[payload_counter++] = ChargingManagementCore_array_chargingProcessInformation_remainingChargeTimeComplete_serviceInstanceId[j]>> 8 & 0xFF;
      ChargingManagementCore_payload_buffer_chargingProcessInformation[payload_counter++] = ChargingManagementCore_array_chargingProcessInformation_remainingChargeTimeComplete_serviceInstanceId[j]     & 0xFF;
      
      // Resource ID
      ChargingManagementCore_payload_buffer_chargingProcessInformation[payload_counter++] = ChargingManagementCore_array_chargingProcessInformation_remainingChargeTimeComplete_resourceId[j]>> 8 & 0xFF;
      ChargingManagementCore_payload_buffer_chargingProcessInformation[payload_counter++] = ChargingManagementCore_array_chargingProcessInformation_remainingChargeTimeComplete_resourceId[j]     & 0xFF;
      
      // Element ID
      for (k=0; k<16; k++)
        ChargingManagementCore_payload_buffer_chargingProcessInformation[payload_counter++] = ChargingManagementCore_array_chargingProcessInformation_remainingChargeTimeComplete_elementId[j][k] & 0xFF;
    }
    
    
    // 6 chargeMode (enum32)
    if (ChargingManagementCore_array_chargingProcessInformation_chargeMode_available[j] == 1)
    {
      tag_dataID = 6;
      ChargingManagementCore_payload_buffer_chargingProcessInformation[payload_counter++] = 2 * 16 /* Wiretype = 2 =^ 32 Bit */ + ((tag_dataID>>8) & 0x0F) /* DataID High Part */ ;
      ChargingManagementCore_payload_buffer_chargingProcessInformation[payload_counter++] = tag_dataID & 0xFF /* DataID Low Part */ ;
      
      ChargingManagementCore_payload_buffer_chargingProcessInformation[payload_counter++] = ChargingManagementCore_array_chargingProcessInformation_chargeMode[j]>>24 & 0xFF;
      ChargingManagementCore_payload_buffer_chargingProcessInformation[payload_counter++] = ChargingManagementCore_array_chargingProcessInformation_chargeMode[j]>>16 & 0xFF;
      ChargingManagementCore_payload_buffer_chargingProcessInformation[payload_counter++] = ChargingManagementCore_array_chargingProcessInformation_chargeMode[j]>> 8 & 0xFF;
      ChargingManagementCore_payload_buffer_chargingProcessInformation[payload_counter++] = ChargingManagementCore_array_chargingProcessInformation_chargeMode[j]     & 0xFF;
    }
    
    
    // 7 profileChargeReason (enum32)
    if (ChargingManagementCore_array_chargingProcessInformation_profileChargeReason_available[j] == 1)
    {
      tag_dataID = 7;
      ChargingManagementCore_payload_buffer_chargingProcessInformation[payload_counter++] = 2 * 16 /* Wiretype = 2 =^ 32 Bit */ + ((tag_dataID>>8) & 0x0F) /* DataID High Part */ ;
      ChargingManagementCore_payload_buffer_chargingProcessInformation[payload_counter++] = tag_dataID & 0xFF /* DataID Low Part */ ;
      
      ChargingManagementCore_payload_buffer_chargingProcessInformation[payload_counter++] = ChargingManagementCore_array_chargingProcessInformation_profileChargeReason[j]>>24 & 0xFF;
      ChargingManagementCore_payload_buffer_chargingProcessInformation[payload_counter++] = ChargingManagementCore_array_chargingProcessInformation_profileChargeReason[j]>>16 & 0xFF;
      ChargingManagementCore_payload_buffer_chargingProcessInformation[payload_counter++] = ChargingManagementCore_array_chargingProcessInformation_profileChargeReason[j]>> 8 & 0xFF;
      ChargingManagementCore_payload_buffer_chargingProcessInformation[payload_counter++] = ChargingManagementCore_array_chargingProcessInformation_profileChargeReason[j]     & 0xFF;
    }
    
    
    // 8 chargeType (enum32)
    if (ChargingManagementCore_array_chargingProcessInformation_chargeType_available[j] == 1)
    {
      tag_dataID = 8;
      ChargingManagementCore_payload_buffer_chargingProcessInformation[payload_counter++] = 2 * 16 /* Wiretype = 2 =^ 32 Bit */ + ((tag_dataID>>8) & 0x0F) /* DataID High Part */ ;
      ChargingManagementCore_payload_buffer_chargingProcessInformation[payload_counter++] = tag_dataID & 0xFF /* DataID Low Part */ ;
      
      ChargingManagementCore_payload_buffer_chargingProcessInformation[payload_counter++] = ChargingManagementCore_array_chargingProcessInformation_chargeType[j]>>24 & 0xFF;
      ChargingManagementCore_payload_buffer_chargingProcessInformation[payload_counter++] = ChargingManagementCore_array_chargingProcessInformation_chargeType[j]>>16 & 0xFF;
      ChargingManagementCore_payload_buffer_chargingProcessInformation[payload_counter++] = ChargingManagementCore_array_chargingProcessInformation_chargeType[j]>> 8 & 0xFF;
      ChargingManagementCore_payload_buffer_chargingProcessInformation[payload_counter++] = ChargingManagementCore_array_chargingProcessInformation_chargeType[j]     & 0xFF;
    }
    
    
    // 9 chargeEnergy (ref#ChargingManagementCore.valueIndications.valueIndicationObject)
    if (ChargingManagementCore_array_chargingProcessInformation_chargeEnergy_available[j] == 1)
    {
      tag_dataID = 9 ;
      ChargingManagementCore_payload_buffer_chargingProcessInformation[payload_counter++] = 5 * 16 /* Wiretype = 5  =^ Array mit 1 Byte Länge */ + ((tag_dataID>>8) & 0x0F) /* DataID High Part */ ;
      ChargingManagementCore_payload_buffer_chargingProcessInformation[payload_counter++] = tag_dataID & 0xFF /* DataID Low Part */ ;
      
      ChargingManagementCore_payload_buffer_chargingProcessInformation[payload_counter++] = 22; // Array Length
      
      // Service ID
      ChargingManagementCore_payload_buffer_chargingProcessInformation[payload_counter++] = ChargingManagementCore_array_chargingProcessInformation_chargeEnergy_serviceId[j]>> 8 & 0xFF;
      ChargingManagementCore_payload_buffer_chargingProcessInformation[payload_counter++] = ChargingManagementCore_array_chargingProcessInformation_chargeEnergy_serviceId[j]     & 0xFF;
    
      // Service Instance ID
      ChargingManagementCore_payload_buffer_chargingProcessInformation[payload_counter++] = ChargingManagementCore_array_chargingProcessInformation_chargeEnergy_serviceInstanceId[j]>> 8 & 0xFF;
      ChargingManagementCore_payload_buffer_chargingProcessInformation[payload_counter++] = ChargingManagementCore_array_chargingProcessInformation_chargeEnergy_serviceInstanceId[j]     & 0xFF;
      
      // Resource ID
      ChargingManagementCore_payload_buffer_chargingProcessInformation[payload_counter++] = ChargingManagementCore_array_chargingProcessInformation_chargeEnergy_resourceId[j]>> 8 & 0xFF;
      ChargingManagementCore_payload_buffer_chargingProcessInformation[payload_counter++] = ChargingManagementCore_array_chargingProcessInformation_chargeEnergy_resourceId[j]     & 0xFF;
      
      // Element ID
      for (k=0; k<16; k++)
        ChargingManagementCore_payload_buffer_chargingProcessInformation[payload_counter++] = ChargingManagementCore_array_chargingProcessInformation_chargeEnergy_elementId[j][k] & 0xFF;
    }
    
    
    // 10 chargeRate (ref#ChargingManagementCore.valueIndications.valueIndicationObject)
    if (ChargingManagementCore_array_chargingProcessInformation_chargeRate_available[j] == 1)
    {
      tag_dataID = 10;
      ChargingManagementCore_payload_buffer_chargingProcessInformation[payload_counter++] = 5 * 16 /* Wiretype = 5  =^ Array mit 1 Byte Länge */ + ((tag_dataID>>8) & 0x0F) /* DataID High Part */ ;
      ChargingManagementCore_payload_buffer_chargingProcessInformation[payload_counter++] = tag_dataID & 0xFF /* DataID Low Part */ ;
      
      ChargingManagementCore_payload_buffer_chargingProcessInformation[payload_counter++] = 22; // Array Length
      
      // Service ID
      ChargingManagementCore_payload_buffer_chargingProcessInformation[payload_counter++] = ChargingManagementCore_array_chargingProcessInformation_chargeRate_serviceId[j]>> 8 & 0xFF;
      ChargingManagementCore_payload_buffer_chargingProcessInformation[payload_counter++] = ChargingManagementCore_array_chargingProcessInformation_chargeRate_serviceId[j]     & 0xFF;
      
      // Service Instance ID
      ChargingManagementCore_payload_buffer_chargingProcessInformation[payload_counter++] = ChargingManagementCore_array_chargingProcessInformation_chargeRate_serviceInstanceId[j]>> 8 & 0xFF;
      ChargingManagementCore_payload_buffer_chargingProcessInformation[payload_counter++] = ChargingManagementCore_array_chargingProcessInformation_chargeRate_serviceInstanceId[j]     & 0xFF;
      
      // Resource ID
      ChargingManagementCore_payload_buffer_chargingProcessInformation[payload_counter++] = ChargingManagementCore_array_chargingProcessInformation_chargeRate_resourceId[j]>> 8 & 0xFF;
      ChargingManagementCore_payload_buffer_chargingProcessInformation[payload_counter++] = ChargingManagementCore_array_chargingProcessInformation_chargeRate_resourceId[j]     & 0xFF;
      
      // Element ID
      for (k=0; k<16; k++)
        ChargingManagementCore_payload_buffer_chargingProcessInformation[payload_counter++] = ChargingManagementCore_array_chargingProcessInformation_chargeRate_elementId[j][k] & 0xFF;
    }
    
    
    // 11 chargePower (ref#ChargingManagementCore.valueIndications.valueIndicationObject)
    if (ChargingManagementCore_array_chargingProcessInformation_chargePower_available[j] == 1)
    {
      tag_dataID = 11;
      ChargingManagementCore_payload_buffer_chargingProcessInformation[payload_counter++] = 5 * 16 /* Wiretype = 5  =^ Array mit 1 Byte Länge */ + ((tag_dataID>>8) & 0x0F) /* DataID High Part */ ;
      ChargingManagementCore_payload_buffer_chargingProcessInformation[payload_counter++] = tag_dataID & 0xFF /* DataID Low Part */ ;
      
      ChargingManagementCore_payload_buffer_chargingProcessInformation[payload_counter++] = 22; // Array Length
      
      // Service ID
      ChargingManagementCore_payload_buffer_chargingProcessInformation[payload_counter++] = ChargingManagementCore_array_chargingProcessInformation_chargePower_serviceId[j]>> 8 & 0xFF;
      ChargingManagementCore_payload_buffer_chargingProcessInformation[payload_counter++] = ChargingManagementCore_array_chargingProcessInformation_chargePower_serviceId[j]     & 0xFF;
      
      // Service Instance ID
      ChargingManagementCore_payload_buffer_chargingProcessInformation[payload_counter++] = ChargingManagementCore_array_chargingProcessInformation_chargePower_serviceInstanceId[j]>> 8 & 0xFF;
      ChargingManagementCore_payload_buffer_chargingProcessInformation[payload_counter++] = ChargingManagementCore_array_chargingProcessInformation_chargePower_serviceInstanceId[j]     & 0xFF;
      
      // Resource ID
      ChargingManagementCore_payload_buffer_chargingProcessInformation[payload_counter++] = ChargingManagementCore_array_chargingProcessInformation_chargePower_resourceId[j]>> 8 & 0xFF;
      ChargingManagementCore_payload_buffer_chargingProcessInformation[payload_counter++] = ChargingManagementCore_array_chargingProcessInformation_chargePower_resourceId[j]     & 0xFF;
      
      // Element ID
      for (k=0; k<16; k++)
        ChargingManagementCore_payload_buffer_chargingProcessInformation[payload_counter++] = ChargingManagementCore_array_chargingProcessInformation_chargePower_elementId[j][k] & 0xFF;
    }
    
     
    // 12 chargingScenario (enum32)
    if (ChargingManagementCore_array_chargingProcessInformation_chargingScenario_available[j] == 1)
    {
      tag_dataID = 12;
      ChargingManagementCore_payload_buffer_chargingProcessInformation[payload_counter++] = 2 * 16 /* Wiretype = 2 =^ 32 Bit */ + ((tag_dataID>>8) & 0x0F) /* DataID High Part */ ;
      ChargingManagementCore_payload_buffer_chargingProcessInformation[payload_counter++] = tag_dataID & 0xFF /* DataID Low Part */ ;
      
      ChargingManagementCore_payload_buffer_chargingProcessInformation[payload_counter++] = ChargingManagementCore_array_chargingProcessInformation_chargingScenario[j]>>24 & 0xFF;
      ChargingManagementCore_payload_buffer_chargingProcessInformation[payload_counter++] = ChargingManagementCore_array_chargingProcessInformation_chargingScenario[j]>>16 & 0xFF;
      ChargingManagementCore_payload_buffer_chargingProcessInformation[payload_counter++] = ChargingManagementCore_array_chargingProcessInformation_chargingScenario[j]>> 8 & 0xFF;
      ChargingManagementCore_payload_buffer_chargingProcessInformation[payload_counter++] = ChargingManagementCore_array_chargingProcessInformation_chargingScenario[j]     & 0xFF;
    }
  
    // 13 chargeTargetTime (ref#ChargingManagementCore.valueIndications.valueIndicationObject)
    if (ChargingManagementCore_array_chargingProcessInformation_chargeTargetTime_available[j] == 1)
    {
      tag_dataID = 13;
      ChargingManagementCore_payload_buffer_chargingProcessInformation[payload_counter++] = 5 * 16 /* Wiretype = 5  =^ Array mit 1 Byte Länge */ + ((tag_dataID>>8) & 0x0F) /* DataID High Part */ ;
      ChargingManagementCore_payload_buffer_chargingProcessInformation[payload_counter++] = tag_dataID & 0xFF /* DataID Low Part */ ;
      
      ChargingManagementCore_payload_buffer_chargingProcessInformation[payload_counter++] = 22; // Array Length
      
      // Service ID
      ChargingManagementCore_payload_buffer_chargingProcessInformation[payload_counter++] = ChargingManagementCore_array_chargingProcessInformation_chargeTargetTime_serviceId[j]>> 8 & 0xFF;
      ChargingManagementCore_payload_buffer_chargingProcessInformation[payload_counter++] = ChargingManagementCore_array_chargingProcessInformation_chargeTargetTime_serviceId[j]     & 0xFF;
      
      // Service Instance ID
      ChargingManagementCore_payload_buffer_chargingProcessInformation[payload_counter++] = ChargingManagementCore_array_chargingProcessInformation_chargeTargetTime_serviceInstanceId[j]>> 8 & 0xFF;
      ChargingManagementCore_payload_buffer_chargingProcessInformation[payload_counter++] = ChargingManagementCore_array_chargingProcessInformation_chargeTargetTime_serviceInstanceId[j]     & 0xFF;
      
      // Resource ID
      ChargingManagementCore_payload_buffer_chargingProcessInformation[payload_counter++] = ChargingManagementCore_array_chargingProcessInformation_chargeTargetTime_resourceId[j]>> 8 & 0xFF;
      ChargingManagementCore_payload_buffer_chargingProcessInformation[payload_counter++] = ChargingManagementCore_array_chargingProcessInformation_chargeTargetTime_resourceId[j]     & 0xFF;
      
      // Element ID
      for (k=0; k<16; k++)
        ChargingManagementCore_payload_buffer_chargingProcessInformation[payload_counter++] = ChargingManagementCore_array_chargingProcessInformation_chargeTargetTime_elementId[j][k] & 0xFF;
    }
    
    // 14 chargeTargetTimeOffset (ref#ChargingManagementCore.valueIndications.valueIndicationObject)
    if (ChargingManagementCore_array_chargingProcessInformation_chargeTargetTimeOffset_available[j] == 1)
    {
      tag_dataID = 14;
      ChargingManagementCore_payload_buffer_chargingProcessInformation[payload_counter++] = 5 * 16 /* Wiretype = 5  =^ Array mit 1 Byte Länge */ + ((tag_dataID>>8) & 0x0F) /* DataID High Part */ ;
      ChargingManagementCore_payload_buffer_chargingProcessInformation[payload_counter++] = tag_dataID & 0xFF /* DataID Low Part */ ;
      
      ChargingManagementCore_payload_buffer_chargingProcessInformation[payload_counter++] = 22; // Array Length
      
      // Service ID
      ChargingManagementCore_payload_buffer_chargingProcessInformation[payload_counter++] = ChargingManagementCore_array_chargingProcessInformation_chargeTargetTimeOffset_serviceId[j]>> 8 & 0xFF;
      ChargingManagementCore_payload_buffer_chargingProcessInformation[payload_counter++] = ChargingManagementCore_array_chargingProcessInformation_chargeTargetTimeOffset_serviceId[j]     & 0xFF;
      
      // Service Instance ID
      ChargingManagementCore_payload_buffer_chargingProcessInformation[payload_counter++] = ChargingManagementCore_array_chargingProcessInformation_chargeTargetTimeOffset_serviceInstanceId[j]>> 8 & 0xFF;
      ChargingManagementCore_payload_buffer_chargingProcessInformation[payload_counter++] = ChargingManagementCore_array_chargingProcessInformation_chargeTargetTimeOffset_serviceInstanceId[j]     & 0xFF;
      
      // Resource ID
      ChargingManagementCore_payload_buffer_chargingProcessInformation[payload_counter++] = ChargingManagementCore_array_chargingProcessInformation_chargeTargetTimeOffset_resourceId[j]>> 8 & 0xFF;
      ChargingManagementCore_payload_buffer_chargingProcessInformation[payload_counter++] = ChargingManagementCore_array_chargingProcessInformation_chargeTargetTimeOffset_resourceId[j]     & 0xFF;
      
      // Element ID
      for (k=0; k<16; k++)
        ChargingManagementCore_payload_buffer_chargingProcessInformation[payload_counter++] = ChargingManagementCore_array_chargingProcessInformation_chargeTargetTimeOffset_elementId[j][k] & 0xFF;
    }
    
    // 15 maxPowerChargingStation (ref#ChargingManagementCore.valueIndications.valueIndicationObject)
    if (ChargingManagementCore_array_chargingProcessInformation_maxPowerChargingStation_available[j] == 1)
    {
      tag_dataID = 15;
      ChargingManagementCore_payload_buffer_chargingProcessInformation[payload_counter++] = 5 * 16 /* Wiretype = 5  =^ Array mit 1 Byte Länge */ + ((tag_dataID>>8) & 0x0F) /* DataID High Part */ ;
      ChargingManagementCore_payload_buffer_chargingProcessInformation[payload_counter++] = tag_dataID & 0xFF /* DataID Low Part */ ;
      
      ChargingManagementCore_payload_buffer_chargingProcessInformation[payload_counter++] = 22; // Array Length
      
      // Service ID
      ChargingManagementCore_payload_buffer_chargingProcessInformation[payload_counter++] = ChargingManagementCore_array_chargingProcessInformation_maxPowerChargingStation_serviceId[j]>> 8 & 0xFF;
      ChargingManagementCore_payload_buffer_chargingProcessInformation[payload_counter++] = ChargingManagementCore_array_chargingProcessInformation_maxPowerChargingStation_serviceId[j]     & 0xFF;
      
      // Service Instance ID
      ChargingManagementCore_payload_buffer_chargingProcessInformation[payload_counter++] = ChargingManagementCore_array_chargingProcessInformation_maxPowerChargingStation_serviceInstanceId[j]>> 8 & 0xFF;
      ChargingManagementCore_payload_buffer_chargingProcessInformation[payload_counter++] = ChargingManagementCore_array_chargingProcessInformation_maxPowerChargingStation_serviceInstanceId[j]     & 0xFF;
      
      // Resource ID
      ChargingManagementCore_payload_buffer_chargingProcessInformation[payload_counter++] = ChargingManagementCore_array_chargingProcessInformation_maxPowerChargingStation_resourceId[j]>> 8 & 0xFF;
      ChargingManagementCore_payload_buffer_chargingProcessInformation[payload_counter++] = ChargingManagementCore_array_chargingProcessInformation_maxPowerChargingStation_resourceId[j]     & 0xFF;
      
      // Element ID
      for (k=0; k<16; k++)
        ChargingManagementCore_payload_buffer_chargingProcessInformation[payload_counter++] = ChargingManagementCore_array_chargingProcessInformation_maxPowerChargingStation_elementId[j][k] & 0xFF;
    }
    
    //Element Length
    element_length = payload_counter-start_pos;
    if (element_length >0) ChargingManagementCore_array_chargingProcessInformation_array_element_length[j] = element_length - 4;
    else                   ChargingManagementCore_array_chargingProcessInformation_array_element_length[j] = element_length;
    
    ChargingManagementCore_payload_buffer_chargingProcessInformation[start_pos++] = ChargingManagementCore_array_chargingProcessInformation_array_element_length[j]>>24 & 0xFF;
    ChargingManagementCore_payload_buffer_chargingProcessInformation[start_pos++] = ChargingManagementCore_array_chargingProcessInformation_array_element_length[j]>>16 & 0xFF;
    ChargingManagementCore_payload_buffer_chargingProcessInformation[start_pos++] = ChargingManagementCore_array_chargingProcessInformation_array_element_length[j]>> 8 & 0xFF;
    ChargingManagementCore_payload_buffer_chargingProcessInformation[start_pos++] = ChargingManagementCore_array_chargingProcessInformation_array_element_length[j]     & 0xFF;
    
    if (ChargingManagementCore_array_chargingProcessInformation_array_element_length[j] == 0) payload_counter = payload_counter+4;
  }
  
  // Struct Length
  ChargingManagementCore_array_chargingProcessInformation_struct_element_length = 4*@ChargingManagementCore_Notification_chargingProcessInformation_Element_TotalNum;

  for (k=0;k<@ChargingManagementCore_Notification_chargingProcessInformation_Element_TotalNum;k++)
    ChargingManagementCore_array_chargingProcessInformation_struct_element_length = ChargingManagementCore_array_chargingProcessInformation_struct_element_length + ChargingManagementCore_array_chargingProcessInformation_array_element_length[k];
  
  ChargingManagementCore_payload_buffer_chargingProcessInformation[0] = ChargingManagementCore_array_chargingProcessInformation_struct_element_length>>24 & 0xFF;
  ChargingManagementCore_payload_buffer_chargingProcessInformation[1] = ChargingManagementCore_array_chargingProcessInformation_struct_element_length>>16 & 0xFF;
  ChargingManagementCore_payload_buffer_chargingProcessInformation[2] = ChargingManagementCore_array_chargingProcessInformation_struct_element_length>> 8 & 0xFF;
  ChargingManagementCore_payload_buffer_chargingProcessInformation[3] = ChargingManagementCore_array_chargingProcessInformation_struct_element_length     & 0xFF;


  ChargingManagementCore_payload_length_chargingProcessInformation = ChargingManagementCore_array_chargingProcessInformation_struct_element_length+4;
  putvalue(ChargingManagementCore_Notification_chargingProcessInformation_Payload, ChargingManagementCore_payload_buffer_chargingProcessInformation, ChargingManagementCore_payload_length_chargingProcessInformation);
}

on envVar ChargingManagementCore_Notification_chargingProcessInformation_Element_TotalNum
{
  if (@this == 0) @this =  1;
  if (@this > 10) @this = 10;
  
  ChargingManagementCore_Notification_chargingProcessInformation();
  ChargingManagementCore_Notification_chargingProcessInformation_update();
}

on envVar ChargingManagementCore_Notification_chargingProcessInformation_Element
{
  ChargingManagementCore_Notification_chargingProcessInformation_update();
}

on envVar ChargingManagementCore_Notification_chargingProcessInformation_Element_Next
{
  if (@this == 1 && @ChargingManagementCore_Notification_chargingProcessInformation_Element < @ChargingManagementCore_Notification_chargingProcessInformation_Element_TotalNum - 1)
  {
    @ChargingManagementCore_Notification_chargingProcessInformation_Element = @ChargingManagementCore_Notification_chargingProcessInformation_Element + 1;
    ChargingManagementCore_Notification_chargingProcessInformation_update();
  }
}

on envVar ChargingManagementCore_Notification_chargingProcessInformation_Element_Previous
{
  if (@this == 1 && @ChargingManagementCore_Notification_chargingProcessInformation_Element > 0)
  {
    @ChargingManagementCore_Notification_chargingProcessInformation_Element = @ChargingManagementCore_Notification_chargingProcessInformation_Element - 1;
    ChargingManagementCore_Notification_chargingProcessInformation_update();
  }
}
ChargingManagementCore_Notification_chargingProcessInformation_update()
{
  @ChargingManagementCore_Notification_LengthIndicator_Element_chargingProcessInformation = ChargingManagementCore_array_chargingProcessInformation_array_element_length[@ChargingManagementCore_Notification_chargingProcessInformation_Element];
  @ChargingManagementCore_Notification_LengthIndicator_Struct_chargingProcessInformation  = ChargingManagementCore_array_chargingProcessInformation_struct_element_length;
  @ChargingManagementCore_Notification_Length_chargingProcessInformation                  = ChargingManagementCore_payload_length_chargingProcessInformation+8;
  
  @ChargingManagementCore_Notification_chargingProcessInformation_type                                          = ChargingManagementCore_array_chargingProcessInformation_type[@ChargingManagementCore_Notification_chargingProcessInformation_Element];
  @ChargingManagementCore_Notification_chargingProcessInformation_currentChargeState                            = ChargingManagementCore_array_chargingProcessInformation_currentChargeState[@ChargingManagementCore_Notification_chargingProcessInformation_Element];
  @ChargingManagementCore_Notification_chargingProcessInformation_currentSoc_serviceId                          = ChargingManagementCore_array_chargingProcessInformation_currentSoc_serviceId[@ChargingManagementCore_Notification_chargingProcessInformation_Element];
  @ChargingManagementCore_Notification_chargingProcessInformation_currentSoc_serviceInstanceId                  = ChargingManagementCore_array_chargingProcessInformation_currentSoc_serviceInstanceId[@ChargingManagementCore_Notification_chargingProcessInformation_Element];
  @ChargingManagementCore_Notification_chargingProcessInformation_currentSoc_resourceId                         = ChargingManagementCore_array_chargingProcessInformation_currentSoc_resourceId[@ChargingManagementCore_Notification_chargingProcessInformation_Element];
  @ChargingManagementCore_Notification_chargingProcessInformation_remainingChargeTimeBulk_serviceId             = ChargingManagementCore_array_chargingProcessInformation_remainingChargeTimeBulk_serviceId[@ChargingManagementCore_Notification_chargingProcessInformation_Element];
  @ChargingManagementCore_Notification_chargingProcessInformation_remainingChargeTimeBulk_serviceInstanceId     = ChargingManagementCore_array_chargingProcessInformation_remainingChargeTimeBulk_serviceInstanceId[@ChargingManagementCore_Notification_chargingProcessInformation_Element];
  @ChargingManagementCore_Notification_chargingProcessInformation_remainingChargeTimeBulk_resourceId            = ChargingManagementCore_array_chargingProcessInformation_remainingChargeTimeBulk_resourceId[@ChargingManagementCore_Notification_chargingProcessInformation_Element];
  @ChargingManagementCore_Notification_chargingProcessInformation_chargeBulkThreshold                           = ChargingManagementCore_array_chargingProcessInformation_chargeBulkThreshold[@ChargingManagementCore_Notification_chargingProcessInformation_Element];
  @ChargingManagementCore_Notification_chargingProcessInformation_remainingChargeTimeComplete_serviceId         = ChargingManagementCore_array_chargingProcessInformation_remainingChargeTimeComplete_serviceId[@ChargingManagementCore_Notification_chargingProcessInformation_Element];
  @ChargingManagementCore_Notification_chargingProcessInformation_remainingChargeTimeComplete_serviceInstanceId = ChargingManagementCore_array_chargingProcessInformation_remainingChargeTimeComplete_serviceInstanceId[@ChargingManagementCore_Notification_chargingProcessInformation_Element];
  @ChargingManagementCore_Notification_chargingProcessInformation_remainingChargeTimeComplete_resourceId        = ChargingManagementCore_array_chargingProcessInformation_remainingChargeTimeComplete_resourceId[@ChargingManagementCore_Notification_chargingProcessInformation_Element];
  @ChargingManagementCore_Notification_chargingProcessInformation_chargeMode                                    = ChargingManagementCore_array_chargingProcessInformation_chargeMode[@ChargingManagementCore_Notification_chargingProcessInformation_Element];
  @ChargingManagementCore_Notification_chargingProcessInformation_profileChargeReason                           = ChargingManagementCore_array_chargingProcessInformation_profileChargeReason[@ChargingManagementCore_Notification_chargingProcessInformation_Element];
  @ChargingManagementCore_Notification_chargingProcessInformation_chargeType                                    = ChargingManagementCore_array_chargingProcessInformation_chargeType[@ChargingManagementCore_Notification_chargingProcessInformation_Element];
  @ChargingManagementCore_Notification_chargingProcessInformation_chargeEnergy_serviceId                        = ChargingManagementCore_array_chargingProcessInformation_chargeEnergy_serviceId[@ChargingManagementCore_Notification_chargingProcessInformation_Element];
  @ChargingManagementCore_Notification_chargingProcessInformation_chargeEnergy_serviceInstanceId                = ChargingManagementCore_array_chargingProcessInformation_chargeEnergy_serviceInstanceId[@ChargingManagementCore_Notification_chargingProcessInformation_Element];
  @ChargingManagementCore_Notification_chargingProcessInformation_chargeEnergy_resourceId                       = ChargingManagementCore_array_chargingProcessInformation_chargeEnergy_resourceId[@ChargingManagementCore_Notification_chargingProcessInformation_Element];
  @ChargingManagementCore_Notification_chargingProcessInformation_chargeRate_serviceId                          = ChargingManagementCore_array_chargingProcessInformation_chargeRate_serviceId[@ChargingManagementCore_Notification_chargingProcessInformation_Element];
  @ChargingManagementCore_Notification_chargingProcessInformation_chargeRate_serviceInstanceId                  = ChargingManagementCore_array_chargingProcessInformation_chargeRate_serviceInstanceId[@ChargingManagementCore_Notification_chargingProcessInformation_Element];
  @ChargingManagementCore_Notification_chargingProcessInformation_chargeRate_resourceId                         = ChargingManagementCore_array_chargingProcessInformation_chargeRate_resourceId[@ChargingManagementCore_Notification_chargingProcessInformation_Element];
  @ChargingManagementCore_Notification_chargingProcessInformation_chargePower_serviceId                         = ChargingManagementCore_array_chargingProcessInformation_chargePower_serviceId[@ChargingManagementCore_Notification_chargingProcessInformation_Element];
  @ChargingManagementCore_Notification_chargingProcessInformation_chargePower_serviceInstanceId                 = ChargingManagementCore_array_chargingProcessInformation_chargePower_serviceInstanceId[@ChargingManagementCore_Notification_chargingProcessInformation_Element];
  @ChargingManagementCore_Notification_chargingProcessInformation_chargePower_resourceId                        = ChargingManagementCore_array_chargingProcessInformation_chargePower_resourceId[@ChargingManagementCore_Notification_chargingProcessInformation_Element];
  @ChargingManagementCore_Notification_chargingProcessInformation_chargingScenario                              = ChargingManagementCore_array_chargingProcessInformation_chargingScenario[@ChargingManagementCore_Notification_chargingProcessInformation_Element];
  @ChargingManagementCore_Notification_chargingProcessInformation_chargeTargetTime_serviceId                    = ChargingManagementCore_array_chargingProcessInformation_chargeTargetTime_serviceId[@ChargingManagementCore_Notification_chargingProcessInformation_Element];
  @ChargingManagementCore_Notification_chargingProcessInformation_chargeTargetTime_serviceInstanceId            = ChargingManagementCore_array_chargingProcessInformation_chargeTargetTime_serviceInstanceId[@ChargingManagementCore_Notification_chargingProcessInformation_Element];
  @ChargingManagementCore_Notification_chargingProcessInformation_chargeTargetTime_resourceId                   = ChargingManagementCore_array_chargingProcessInformation_chargeTargetTime_resourceId[@ChargingManagementCore_Notification_chargingProcessInformation_Element];
  @ChargingManagementCore_Notification_chargingProcessInformation_chargeTargetTimeOffset_serviceId              = ChargingManagementCore_array_chargingProcessInformation_chargeTargetTimeOffset_serviceId[@ChargingManagementCore_Notification_chargingProcessInformation_Element];
  @ChargingManagementCore_Notification_chargingProcessInformation_chargeTargetTimeOffset_serviceInstanceId      = ChargingManagementCore_array_chargingProcessInformation_chargeTargetTimeOffset_serviceInstanceId[@ChargingManagementCore_Notification_chargingProcessInformation_Element];
  @ChargingManagementCore_Notification_chargingProcessInformation_chargeTargetTimeOffset_resourceId             = ChargingManagementCore_array_chargingProcessInformation_chargeTargetTimeOffset_resourceId[@ChargingManagementCore_Notification_chargingProcessInformation_Element];
  @ChargingManagementCore_Notification_chargingProcessInformation_maxPowerChargingStation_serviceId             = ChargingManagementCore_array_chargingProcessInformation_maxPowerChargingStation_serviceId[@ChargingManagementCore_Notification_chargingProcessInformation_Element];
  @ChargingManagementCore_Notification_chargingProcessInformation_maxPowerChargingStation_serviceInstanceId     = ChargingManagementCore_array_chargingProcessInformation_maxPowerChargingStation_serviceInstanceId[@ChargingManagementCore_Notification_chargingProcessInformation_Element];
  @ChargingManagementCore_Notification_chargingProcessInformation_maxPowerChargingStation_resourceId            = ChargingManagementCore_array_chargingProcessInformation_maxPowerChargingStation_resourceId[@ChargingManagementCore_Notification_chargingProcessInformation_Element];
  
  putValue (ChargingManagementCore_Notification_chargingProcessInformation_currentSoc_elementId, ChargingManagementCore_array_chargingProcessInformation_currentSoc_elementId[@ChargingManagementCore_Notification_chargingProcessInformation_Element]);
  putValue (ChargingManagementCore_Notification_chargingProcessInformation_remainingChargeTimeBulk_elementId, ChargingManagementCore_array_chargingProcessInformation_remainingChargeTimeBulk_elementId[@ChargingManagementCore_Notification_chargingProcessInformation_Element]);
  putValue (ChargingManagementCore_Notification_chargingProcessInformation_remainingChargeTimeComplete_elementId, ChargingManagementCore_array_chargingProcessInformation_remainingChargeTimeComplete_elementId[@ChargingManagementCore_Notification_chargingProcessInformation_Element]);
  putValue (ChargingManagementCore_Notification_chargingProcessInformation_chargeEnergy_elementId, ChargingManagementCore_array_chargingProcessInformation_chargeEnergy_elementId[@ChargingManagementCore_Notification_chargingProcessInformation_Element]);
  putValue (ChargingManagementCore_Notification_chargingProcessInformation_chargePower_elementId, ChargingManagementCore_array_chargingProcessInformation_chargePower_elementId[@ChargingManagementCore_Notification_chargingProcessInformation_Element]);
  putValue (ChargingManagementCore_Notification_chargingProcessInformation_chargeTargetTime_elementId, ChargingManagementCore_array_chargingProcessInformation_chargeTargetTime_elementId[@ChargingManagementCore_Notification_chargingProcessInformation_Element]);
  putValue (ChargingManagementCore_Notification_chargingProcessInformation_chargeTargetTimeOffset_elementId, ChargingManagementCore_array_chargingProcessInformation_chargeTargetTimeOffset_elementId[@ChargingManagementCore_Notification_chargingProcessInformation_Element]);
  putValue (ChargingManagementCore_Notification_chargingProcessInformation_maxPowerChargingStation_elementId, ChargingManagementCore_array_chargingProcessInformation_maxPowerChargingStation_elementId[@ChargingManagementCore_Notification_chargingProcessInformation_Element]);
  
  @ChargingManagementCore_Notification_chargingProcessInformation_type_available                        = ChargingManagementCore_array_chargingProcessInformation_type_available[@ChargingManagementCore_Notification_chargingProcessInformation_Element];
  @ChargingManagementCore_Notification_chargingProcessInformation_currentChargeState_available          = ChargingManagementCore_array_chargingProcessInformation_currentChargeState_available[@ChargingManagementCore_Notification_chargingProcessInformation_Element];
  @ChargingManagementCore_Notification_chargingProcessInformation_currentSoc_available                  = ChargingManagementCore_array_chargingProcessInformation_currentSoc_available[@ChargingManagementCore_Notification_chargingProcessInformation_Element];
  @ChargingManagementCore_Notification_chargingProcessInformation_remainingChargeTimeBulk_available     = ChargingManagementCore_array_chargingProcessInformation_remainingChargeTimeBulk_available[@ChargingManagementCore_Notification_chargingProcessInformation_Element];
  @ChargingManagementCore_Notification_chargingProcessInformation_chargeBulkThreshold_available         = ChargingManagementCore_array_chargingProcessInformation_chargeBulkThreshold_available[@ChargingManagementCore_Notification_chargingProcessInformation_Element];
  @ChargingManagementCore_Notification_chargingProcessInformation_remainingChargeTimeComplete_available = ChargingManagementCore_array_chargingProcessInformation_remainingChargeTimeComplete_available[@ChargingManagementCore_Notification_chargingProcessInformation_Element];
  @ChargingManagementCore_Notification_chargingProcessInformation_chargeMode_available                  = ChargingManagementCore_array_chargingProcessInformation_chargeMode_available[@ChargingManagementCore_Notification_chargingProcessInformation_Element];
  @ChargingManagementCore_Notification_chargingProcessInformation_profileChargeReason_available         = ChargingManagementCore_array_chargingProcessInformation_profileChargeReason_available[@ChargingManagementCore_Notification_chargingProcessInformation_Element];
  @ChargingManagementCore_Notification_chargingProcessInformation_chargeType_available                  = ChargingManagementCore_array_chargingProcessInformation_chargeType_available[@ChargingManagementCore_Notification_chargingProcessInformation_Element];
  @ChargingManagementCore_Notification_chargingProcessInformation_chargeEnergy_available                = ChargingManagementCore_array_chargingProcessInformation_chargeEnergy_available[@ChargingManagementCore_Notification_chargingProcessInformation_Element];
  @ChargingManagementCore_Notification_chargingProcessInformation_chargeRate_available                  = ChargingManagementCore_array_chargingProcessInformation_chargeRate_available[@ChargingManagementCore_Notification_chargingProcessInformation_Element];
  @ChargingManagementCore_Notification_chargingProcessInformation_chargePower_available                 = ChargingManagementCore_array_chargingProcessInformation_chargePower_available[@ChargingManagementCore_Notification_chargingProcessInformation_Element];
  @ChargingManagementCore_Notification_chargingProcessInformation_chargingScenario_available            = ChargingManagementCore_array_chargingProcessInformation_chargingScenario_available[@ChargingManagementCore_Notification_chargingProcessInformation_Element];
  @ChargingManagementCore_Notification_chargingProcessInformation_chargeTargetTime_available            = ChargingManagementCore_array_chargingProcessInformation_chargeTargetTime_available[@ChargingManagementCore_Notification_chargingProcessInformation_Element];
  @ChargingManagementCore_Notification_chargingProcessInformation_chargeTargetTimeOffset_available      = ChargingManagementCore_array_chargingProcessInformation_chargeTargetTimeOffset_available[@ChargingManagementCore_Notification_chargingProcessInformation_Element];
  @ChargingManagementCore_Notification_chargingProcessInformation_maxPowerChargingStation_available     = ChargingManagementCore_array_chargingProcessInformation_maxPowerChargingStation_available[@ChargingManagementCore_Notification_chargingProcessInformation_Element];
}






////////// chargingPlugs Notification //////////

on envVar ChargingManagementCore_Notification_LengthIndicator_Struct_chargingPlugs
{
  ChargingManagementCore_Notification_chargingPlugs();
}
on envVar ChargingManagementCore_Notification_LengthIndicator_Element_chargingPlugs
{
  ChargingManagementCore_Notification_chargingPlugs();
}
on envVar ChargingManagementCore_Notification_chargingPlugs_type
{
  ChargingManagementCore_array_chargingPlugs_type[@ChargingManagementCore_Notification_chargingPlugs_Element] = @this;
  ChargingManagementCore_Notification_chargingPlugs();
}
on envVar ChargingManagementCore_Notification_chargingPlugs_plugLockState_serviceId
{
  ChargingManagementCore_array_chargingPlugs_plugLockState_serviceId[@ChargingManagementCore_Notification_chargingPlugs_Element] = @this;
  ChargingManagementCore_Notification_chargingPlugs();
}
on envVar ChargingManagementCore_Notification_chargingPlugs_plugLockState_serviceInstanceId
{
  ChargingManagementCore_array_chargingPlugs_plugLockState_serviceInstanceId[@ChargingManagementCore_Notification_chargingPlugs_Element] = @this;
  ChargingManagementCore_Notification_chargingPlugs();
}
on envVar ChargingManagementCore_Notification_chargingPlugs_plugLockState_resourceId
{
  ChargingManagementCore_array_chargingPlugs_plugLockState_resourceId[@ChargingManagementCore_Notification_chargingPlugs_Element] = @this;
  ChargingManagementCore_Notification_chargingPlugs();
}
on envVar ChargingManagementCore_Notification_chargingPlugs_plugLockState_elementId
{
  getvalue(this, buffer_uuid);
  for (k=0;k<16;k++)
    ChargingManagementCore_array_chargingPlugs_plugLockState_elementId[@ChargingManagementCore_Notification_chargingPlugs_Element][k] = buffer_uuid[k];
  ChargingManagementCore_Notification_chargingPlugs();
}
on envVar ChargingManagementCore_Notification_chargingPlugs_flapLockState_serviceId
{
  ChargingManagementCore_array_chargingPlugs_flapLockState_serviceId[@ChargingManagementCore_Notification_chargingPlugs_Element] = @this;
  ChargingManagementCore_Notification_chargingPlugs();
}
on envVar ChargingManagementCore_Notification_chargingPlugs_flapLockState_serviceInstanceId
{
  ChargingManagementCore_array_chargingPlugs_flapLockState_serviceInstanceId[@ChargingManagementCore_Notification_chargingPlugs_Element] = @this;
  ChargingManagementCore_Notification_chargingPlugs();
}
on envVar ChargingManagementCore_Notification_chargingPlugs_flapLockState_resourceId
{
  ChargingManagementCore_array_chargingPlugs_flapLockState_resourceId[@ChargingManagementCore_Notification_chargingPlugs_Element] = @this;
  ChargingManagementCore_Notification_chargingPlugs();
}
on envVar ChargingManagementCore_Notification_chargingPlugs_flapLockState_elementId
{
  getvalue(this, buffer_uuid);
  for (k=0;k<16;k++)
    ChargingManagementCore_array_chargingPlugs_flapLockState_elementId[@ChargingManagementCore_Notification_chargingPlugs_Element][k] = buffer_uuid[k];
  ChargingManagementCore_Notification_chargingPlugs();
}
on envVar ChargingManagementCore_Notification_chargingPlugs_plugType
{
  ChargingManagementCore_array_chargingPlugs_plugType[@ChargingManagementCore_Notification_chargingPlugs_Element] = @this;
  ChargingManagementCore_Notification_chargingPlugs();
}
on envVar ChargingManagementCore_Notification_chargingPlugs_plugConnectionState
{
  ChargingManagementCore_array_chargingPlugs_plugConnectionState[@ChargingManagementCore_Notification_chargingPlugs_Element] = @this;
  ChargingManagementCore_Notification_chargingPlugs();
}
on envVar ChargingManagementCore_Notification_chargingPlugs_infrastructureState
{
  ChargingManagementCore_array_chargingPlugs_infrastructureState[@ChargingManagementCore_Notification_chargingPlugs_Element] = @this;
  ChargingManagementCore_Notification_chargingPlugs();
}
on envVar ChargingManagementCore_Notification_chargingPlugs_type_available
{
  ChargingManagementCore_array_chargingPlugs_type_available[@ChargingManagementCore_Notification_chargingPlugs_Element] = @this;
  ChargingManagementCore_Notification_chargingPlugs();
}
on envVar ChargingManagementCore_Notification_chargingPlugs_plugLockState_available
{
  ChargingManagementCore_array_chargingPlugs_plugLockState_available[@ChargingManagementCore_Notification_chargingPlugs_Element] = @this;
  ChargingManagementCore_Notification_chargingPlugs();
}
on envVar ChargingManagementCore_Notification_chargingPlugs_flapLockState_available
{
  ChargingManagementCore_array_chargingPlugs_flapLockState_available[@ChargingManagementCore_Notification_chargingPlugs_Element] = @this;
  ChargingManagementCore_Notification_chargingPlugs();
}
on envVar ChargingManagementCore_Notification_chargingPlugs_plugType_available
{
  ChargingManagementCore_array_chargingPlugs_plugType_available[@ChargingManagementCore_Notification_chargingPlugs_Element] = @this;
  ChargingManagementCore_Notification_chargingPlugs();
}
on envVar ChargingManagementCore_Notification_chargingPlugs_plugConnectionState_available
{
  ChargingManagementCore_array_chargingPlugs_plugConnectionState_available[@ChargingManagementCore_Notification_chargingPlugs_Element] = @this;
  ChargingManagementCore_Notification_chargingPlugs();
}
on envVar ChargingManagementCore_Notification_chargingPlugs_infrastructureState_available
{
  ChargingManagementCore_array_chargingPlugs_infrastructureState_available[@ChargingManagementCore_Notification_chargingPlugs_Element] = @this;
  ChargingManagementCore_Notification_chargingPlugs();
}
on envVar ChargingManagementCore_Notification_chargingPlugs_Payload
{
  ChargingManagementCore_Notification_chargingPlugs_update();
}


ChargingManagementCore_Notification_chargingPlugs()
{
  word payload_counter = 0;
  word start_pos       = 0;
  word element_length  = 0;
  
  // Length Indicator Struct - Platzhalter
  payload_counter = 0+4;
  start_pos = 0;
  
  for (j=0; j<@ChargingManagementCore_Notification_chargingPlugs_Element_TotalNum; j++)
  {
    ChargingManagementCore_array_chargingPlugs_available_functions[j] = ChargingManagementCore_array_chargingPlugs_type_available[j]
                                                                      + ChargingManagementCore_array_chargingPlugs_plugLockState_available[j]
                                                                      + ChargingManagementCore_array_chargingPlugs_flapLockState_available[j]
                                                                      + ChargingManagementCore_array_chargingPlugs_plugType_available[j]
                                                                      + ChargingManagementCore_array_chargingPlugs_plugConnectionState_available[j]
                                                                      + ChargingManagementCore_array_chargingPlugs_infrastructureState_available[j];
    
    // Length Indicator Element - Platzhalter
    if (ChargingManagementCore_array_chargingPlugs_available_functions[j] > 0)
    {
      start_pos = payload_counter;
      payload_counter = payload_counter + 4;
    }
    else 
      start_pos = payload_counter;
    
    // 0 type (enum32)
    if (ChargingManagementCore_array_chargingPlugs_type_available[j] == 1)
    {
      tag_dataID = 0;
      ChargingManagementCore_payload_buffer_chargingPlugs[payload_counter++] = 2 * 16 /* Wiretype = 2 =^ 32 Bit */ + ((tag_dataID>>8) & 0x0F) /* DataID High Part */ ;
      ChargingManagementCore_payload_buffer_chargingPlugs[payload_counter++] = tag_dataID & 0xFF /* DataID Low Part */ ;
      
      ChargingManagementCore_payload_buffer_chargingPlugs[payload_counter++] = ChargingManagementCore_array_chargingPlugs_type[j]>>24 & 0xFF;
      ChargingManagementCore_payload_buffer_chargingPlugs[payload_counter++] = ChargingManagementCore_array_chargingPlugs_type[j]>>16 & 0xFF;
      ChargingManagementCore_payload_buffer_chargingPlugs[payload_counter++] = ChargingManagementCore_array_chargingPlugs_type[j]>> 8 & 0xFF;
      ChargingManagementCore_payload_buffer_chargingPlugs[payload_counter++] = ChargingManagementCore_array_chargingPlugs_type[j]     & 0xFF;
    }
    
    
    // 1 plugLockState (ref#ChargingManagementCore.switchControls.switchControlObject)
    if (ChargingManagementCore_array_chargingPlugs_plugLockState_available[j] == 1)
    {
      tag_dataID = 1;
      ChargingManagementCore_payload_buffer_chargingPlugs[payload_counter++] = 5 * 16 /* Wiretype = 5  =^ Array mit 1 Byte Länge */ + ((tag_dataID>>8) & 0x0F) /* DataID High Part */ ;
      ChargingManagementCore_payload_buffer_chargingPlugs[payload_counter++] = tag_dataID & 0xFF /* DataID Low Part */ ;
      
      ChargingManagementCore_payload_buffer_chargingPlugs[payload_counter++] = 22; // Array Length
      
      // Service ID
      ChargingManagementCore_payload_buffer_chargingPlugs[payload_counter++] = ChargingManagementCore_array_chargingPlugs_plugLockState_serviceId[j]>> 8 & 0xFF;
      ChargingManagementCore_payload_buffer_chargingPlugs[payload_counter++] = ChargingManagementCore_array_chargingPlugs_plugLockState_serviceId[j]     & 0xFF;
      
      // Service Instance ID
      ChargingManagementCore_payload_buffer_chargingPlugs[payload_counter++] = ChargingManagementCore_array_chargingPlugs_plugLockState_serviceInstanceId[j]>> 8 & 0xFF;
      ChargingManagementCore_payload_buffer_chargingPlugs[payload_counter++] = ChargingManagementCore_array_chargingPlugs_plugLockState_serviceInstanceId[j]     & 0xFF;
      
      // Resource ID
      ChargingManagementCore_payload_buffer_chargingPlugs[payload_counter++] = ChargingManagementCore_array_chargingPlugs_plugLockState_resourceId[j]>> 8 & 0xFF;
      ChargingManagementCore_payload_buffer_chargingPlugs[payload_counter++] = ChargingManagementCore_array_chargingPlugs_plugLockState_resourceId[j]     & 0xFF;
      
      // Element ID
      for (k=0; k<16; k++)
        ChargingManagementCore_payload_buffer_chargingPlugs[payload_counter++] = ChargingManagementCore_array_chargingPlugs_plugLockState_elementId[j][k] & 0xFF;
    }
    
    
    // 2 flapLockState (ref#ChargingManagementCore.switchControls.switchControlObject)
    if (ChargingManagementCore_array_chargingPlugs_flapLockState_available[j] == 1)
    {
      tag_dataID = 2;
      ChargingManagementCore_payload_buffer_chargingPlugs[payload_counter++] = 5 * 16 /* Wiretype = 5  =^ Array mit 1 Byte Länge */ + ((tag_dataID>>8) & 0x0F) /* DataID High Part */ ;
      ChargingManagementCore_payload_buffer_chargingPlugs[payload_counter++] = tag_dataID & 0xFF /* DataID Low Part */ ;
      
      ChargingManagementCore_payload_buffer_chargingPlugs[payload_counter++] = 22; // Array Length
      
      // Service ID
      ChargingManagementCore_payload_buffer_chargingPlugs[payload_counter++] = ChargingManagementCore_array_chargingPlugs_flapLockState_serviceId[j]>> 8 & 0xFF;
      ChargingManagementCore_payload_buffer_chargingPlugs[payload_counter++] = ChargingManagementCore_array_chargingPlugs_flapLockState_serviceId[j]     & 0xFF;
      
      // Service Instance ID
      ChargingManagementCore_payload_buffer_chargingPlugs[payload_counter++] = ChargingManagementCore_array_chargingPlugs_flapLockState_serviceInstanceId[j]>> 8 & 0xFF;
      ChargingManagementCore_payload_buffer_chargingPlugs[payload_counter++] = ChargingManagementCore_array_chargingPlugs_flapLockState_serviceInstanceId[j]     & 0xFF;
      
      // Resource ID
      ChargingManagementCore_payload_buffer_chargingPlugs[payload_counter++] = ChargingManagementCore_array_chargingPlugs_flapLockState_resourceId[j]>> 8 & 0xFF;
      ChargingManagementCore_payload_buffer_chargingPlugs[payload_counter++] = ChargingManagementCore_array_chargingPlugs_flapLockState_resourceId[j]     & 0xFF;
      
      // Element ID
      for (k=0; k<16; k++)
        ChargingManagementCore_payload_buffer_chargingPlugs[payload_counter++] = ChargingManagementCore_array_chargingPlugs_flapLockState_elementId[j][k] & 0xFF;
    }
    
    
    // 3 plugType (enum32)
    if (ChargingManagementCore_array_chargingPlugs_plugType_available[j] == 1)
    {
      tag_dataID = 3;
      ChargingManagementCore_payload_buffer_chargingPlugs[payload_counter++] = 2 * 16 /* Wiretype = 2 =^ 32 Bit */ + ((tag_dataID>>8) & 0x0F) /* DataID High Part */ ;
      ChargingManagementCore_payload_buffer_chargingPlugs[payload_counter++] = tag_dataID & 0xFF /* DataID Low Part */ ;
      
      ChargingManagementCore_payload_buffer_chargingPlugs[payload_counter++] = ChargingManagementCore_array_chargingPlugs_plugType[j]>>24 & 0xFF;
      ChargingManagementCore_payload_buffer_chargingPlugs[payload_counter++] = ChargingManagementCore_array_chargingPlugs_plugType[j]>>16 & 0xFF;
      ChargingManagementCore_payload_buffer_chargingPlugs[payload_counter++] = ChargingManagementCore_array_chargingPlugs_plugType[j]>> 8 & 0xFF;
      ChargingManagementCore_payload_buffer_chargingPlugs[payload_counter++] = ChargingManagementCore_array_chargingPlugs_plugType[j]     & 0xFF;
    }
    
    
    // 4 plugConnectionState (enum32)
    if (ChargingManagementCore_array_chargingPlugs_plugConnectionState_available[j] == 1)
    {
      tag_dataID = 4;
      ChargingManagementCore_payload_buffer_chargingPlugs[payload_counter++] = 2 * 16 /* Wiretype = 2 =^ 32 Bit */ + ((tag_dataID>>8) & 0x0F) /* DataID High Part */ ;
      ChargingManagementCore_payload_buffer_chargingPlugs[payload_counter++] = tag_dataID & 0xFF /* DataID Low Part */ ;
      
      ChargingManagementCore_payload_buffer_chargingPlugs[payload_counter++] = ChargingManagementCore_array_chargingPlugs_plugConnectionState[j]>>24 & 0xFF;
      ChargingManagementCore_payload_buffer_chargingPlugs[payload_counter++] = ChargingManagementCore_array_chargingPlugs_plugConnectionState[j]>>16 & 0xFF;
      ChargingManagementCore_payload_buffer_chargingPlugs[payload_counter++] = ChargingManagementCore_array_chargingPlugs_plugConnectionState[j]>> 8 & 0xFF;
      ChargingManagementCore_payload_buffer_chargingPlugs[payload_counter++] = ChargingManagementCore_array_chargingPlugs_plugConnectionState[j]     & 0xFF;
    }
    
    
    // 5 infrastructureState (enum32)
    if (ChargingManagementCore_array_chargingPlugs_infrastructureState_available[j] == 1)
    {
      tag_dataID = 5;
      ChargingManagementCore_payload_buffer_chargingPlugs[payload_counter++] = 2 * 16 /* Wiretype = 2 =^ 32 Bit */ + ((tag_dataID>>8) & 0x0F) /* DataID High Part */ ;
      ChargingManagementCore_payload_buffer_chargingPlugs[payload_counter++] = tag_dataID & 0xFF /* DataID Low Part */ ;
      
      ChargingManagementCore_payload_buffer_chargingPlugs[payload_counter++] = ChargingManagementCore_array_chargingPlugs_infrastructureState[j]>>24 & 0xFF;
      ChargingManagementCore_payload_buffer_chargingPlugs[payload_counter++] = ChargingManagementCore_array_chargingPlugs_infrastructureState[j]>>16 & 0xFF;
      ChargingManagementCore_payload_buffer_chargingPlugs[payload_counter++] = ChargingManagementCore_array_chargingPlugs_infrastructureState[j]>> 8 & 0xFF;
      ChargingManagementCore_payload_buffer_chargingPlugs[payload_counter++] = ChargingManagementCore_array_chargingPlugs_infrastructureState[j]     & 0xFF;
    }
    
    //Element Length
    element_length = payload_counter-start_pos;
    if (element_length >0) ChargingManagementCore_array_chargingPlugs_array_element_length[j] = element_length - 4;
    else                   ChargingManagementCore_array_chargingPlugs_array_element_length[j] = element_length;
    
    ChargingManagementCore_payload_buffer_chargingPlugs[start_pos++] = ChargingManagementCore_array_chargingPlugs_array_element_length[j]>>24 & 0xFF;
    ChargingManagementCore_payload_buffer_chargingPlugs[start_pos++] = ChargingManagementCore_array_chargingPlugs_array_element_length[j]>>16 & 0xFF;
    ChargingManagementCore_payload_buffer_chargingPlugs[start_pos++] = ChargingManagementCore_array_chargingPlugs_array_element_length[j]>> 8 & 0xFF;
    ChargingManagementCore_payload_buffer_chargingPlugs[start_pos++] = ChargingManagementCore_array_chargingPlugs_array_element_length[j]     & 0xFF;
    
    if (ChargingManagementCore_array_chargingPlugs_array_element_length[j] == 0) payload_counter = payload_counter+4;
  }
  
  // Struct Length
  ChargingManagementCore_array_chargingPlugs_struct_element_length = 4*@ChargingManagementCore_Notification_chargingPlugs_Element_TotalNum;

  for (k=0;k<@ChargingManagementCore_Notification_chargingPlugs_Element_TotalNum;k++)
    ChargingManagementCore_array_chargingPlugs_struct_element_length = ChargingManagementCore_array_chargingPlugs_struct_element_length + ChargingManagementCore_array_chargingPlugs_array_element_length[k];
  
  ChargingManagementCore_payload_buffer_chargingPlugs[0] = ChargingManagementCore_array_chargingPlugs_struct_element_length>>24 & 0xFF;
  ChargingManagementCore_payload_buffer_chargingPlugs[1] = ChargingManagementCore_array_chargingPlugs_struct_element_length>>16 & 0xFF;
  ChargingManagementCore_payload_buffer_chargingPlugs[2] = ChargingManagementCore_array_chargingPlugs_struct_element_length>> 8 & 0xFF;
  ChargingManagementCore_payload_buffer_chargingPlugs[3] = ChargingManagementCore_array_chargingPlugs_struct_element_length     & 0xFF;


  ChargingManagementCore_payload_length_chargingPlugs = ChargingManagementCore_array_chargingPlugs_struct_element_length+4;
  putvalue(ChargingManagementCore_Notification_chargingPlugs_Payload, ChargingManagementCore_payload_buffer_chargingPlugs, ChargingManagementCore_payload_length_chargingPlugs);
}

on envVar ChargingManagementCore_Notification_chargingPlugs_Element_TotalNum
{
  if (@this == 0) @this =  1;
  if (@this > 10) @this = 10;
  
  ChargingManagementCore_Notification_chargingPlugs();
  ChargingManagementCore_Notification_chargingPlugs_update();
}

on envVar ChargingManagementCore_Notification_chargingPlugs_Element
{
  ChargingManagementCore_Notification_chargingPlugs_update();
}

on envVar ChargingManagementCore_Notification_chargingPlugs_Element_Next
{
  if (@this == 1 && @ChargingManagementCore_Notification_chargingPlugs_Element < @ChargingManagementCore_Notification_chargingPlugs_Element_TotalNum - 1)
  {
    @ChargingManagementCore_Notification_chargingPlugs_Element = @ChargingManagementCore_Notification_chargingPlugs_Element + 1;
    ChargingManagementCore_Notification_chargingPlugs_update();
  }
}

on envVar ChargingManagementCore_Notification_chargingPlugs_Element_Previous
{
  if (@this == 1 && @ChargingManagementCore_Notification_chargingPlugs_Element > 0)
  {
    @ChargingManagementCore_Notification_chargingPlugs_Element = @ChargingManagementCore_Notification_chargingPlugs_Element - 1;
    ChargingManagementCore_Notification_chargingPlugs_update();
  }
}

ChargingManagementCore_Notification_chargingPlugs_update()
{
  @ChargingManagementCore_Notification_LengthIndicator_Element_chargingPlugs = ChargingManagementCore_array_chargingPlugs_array_element_length[@ChargingManagementCore_Notification_chargingPlugs_Element];
  @ChargingManagementCore_Notification_LengthIndicator_Struct_chargingPlugs  = ChargingManagementCore_array_chargingPlugs_struct_element_length;
  @ChargingManagementCore_Notification_Length_chargingPlugs                  = ChargingManagementCore_payload_length_chargingPlugs+8;
  
  @ChargingManagementCore_Notification_chargingPlugs_type                              = ChargingManagementCore_array_chargingPlugs_type[@ChargingManagementCore_Notification_chargingPlugs_Element];
  @ChargingManagementCore_Notification_chargingPlugs_plugLockState_serviceId           = ChargingManagementCore_array_chargingPlugs_plugLockState_serviceId[@ChargingManagementCore_Notification_chargingPlugs_Element];
  @ChargingManagementCore_Notification_chargingPlugs_plugLockState_serviceInstanceId   = ChargingManagementCore_array_chargingPlugs_plugLockState_serviceInstanceId[@ChargingManagementCore_Notification_chargingPlugs_Element];
  @ChargingManagementCore_Notification_chargingPlugs_plugLockState_resourceId          = ChargingManagementCore_array_chargingPlugs_plugLockState_resourceId[@ChargingManagementCore_Notification_chargingPlugs_Element];
  @ChargingManagementCore_Notification_chargingPlugs_flapLockState_serviceId           = ChargingManagementCore_array_chargingPlugs_flapLockState_serviceId[@ChargingManagementCore_Notification_chargingPlugs_Element];
  @ChargingManagementCore_Notification_chargingPlugs_flapLockState_serviceInstanceId   = ChargingManagementCore_array_chargingPlugs_flapLockState_serviceInstanceId[@ChargingManagementCore_Notification_chargingPlugs_Element];
  @ChargingManagementCore_Notification_chargingPlugs_flapLockState_resourceId          = ChargingManagementCore_array_chargingPlugs_flapLockState_resourceId[@ChargingManagementCore_Notification_chargingPlugs_Element];
  @ChargingManagementCore_Notification_chargingPlugs_plugType                          = ChargingManagementCore_array_chargingPlugs_plugType[@ChargingManagementCore_Notification_chargingPlugs_Element];
  @ChargingManagementCore_Notification_chargingPlugs_plugConnectionState               = ChargingManagementCore_array_chargingPlugs_plugConnectionState[@ChargingManagementCore_Notification_chargingPlugs_Element];
  @ChargingManagementCore_Notification_chargingPlugs_infrastructureState               = ChargingManagementCore_array_chargingPlugs_infrastructureState[@ChargingManagementCore_Notification_chargingPlugs_Element];
  
  putValue (ChargingManagementCore_Notification_chargingPlugs_plugLockState_elementId, ChargingManagementCore_array_chargingPlugs_plugLockState_elementId[@ChargingManagementCore_Notification_chargingPlugs_Element]);
  putValue (ChargingManagementCore_Notification_chargingPlugs_flapLockState_elementId, ChargingManagementCore_array_chargingPlugs_flapLockState_elementId[@ChargingManagementCore_Notification_chargingPlugs_Element]);
  
  @ChargingManagementCore_Notification_chargingPlugs_type_available                = ChargingManagementCore_array_chargingPlugs_type_available[@ChargingManagementCore_Notification_chargingPlugs_Element];
  @ChargingManagementCore_Notification_chargingPlugs_plugLockState_available       = ChargingManagementCore_array_chargingPlugs_plugLockState_available[@ChargingManagementCore_Notification_chargingPlugs_Element];
  @ChargingManagementCore_Notification_chargingPlugs_flapLockState_available       = ChargingManagementCore_array_chargingPlugs_flapLockState_available[@ChargingManagementCore_Notification_chargingPlugs_Element];
  @ChargingManagementCore_Notification_chargingPlugs_plugType_available            = ChargingManagementCore_array_chargingPlugs_plugType_available[@ChargingManagementCore_Notification_chargingPlugs_Element];
  @ChargingManagementCore_Notification_chargingPlugs_plugConnectionState_available = ChargingManagementCore_array_chargingPlugs_plugConnectionState_available[@ChargingManagementCore_Notification_chargingPlugs_Element];
  @ChargingManagementCore_Notification_chargingPlugs_infrastructureState_available = ChargingManagementCore_array_chargingPlugs_infrastructureState_available[@ChargingManagementCore_Notification_chargingPlugs_Element];
}








////////// immediateActions Notification //////////

on envVar ChargingManagementCore_Notification_LengthIndicator_Struct_immediateActions
{
  ChargingManagementCore_Notification_immediateActions();
}
on envVar ChargingManagementCore_Notification_LengthIndicator_Element_immediateActions
{
  ChargingManagementCore_Notification_immediateActions();
}
on envVar ChargingManagementCore_Notification_immediateActions_type
{
  ChargingManagementCore_array_immediateActions_type[@ChargingManagementCore_Notification_immediateActions_Element] = @this;
  ChargingManagementCore_Notification_immediateActions();
}
on envVar ChargingManagementCore_Notification_immediateActions_immediateActionSoc_serviceId
{
  ChargingManagementCore_array_immediateActions_immediateActionSoc_serviceId[@ChargingManagementCore_Notification_immediateActions_Element] = @this;
  ChargingManagementCore_Notification_immediateActions();
}
on envVar ChargingManagementCore_Notification_immediateActions_immediateActionSoc_serviceInstanceId
{
  ChargingManagementCore_array_immediateActions_immediateActionSoc_serviceInstanceId[@ChargingManagementCore_Notification_immediateActions_Element] = @this;
  ChargingManagementCore_Notification_immediateActions();
}
on envVar ChargingManagementCore_Notification_immediateActions_immediateActionSoc_resourceId
{
  ChargingManagementCore_array_immediateActions_immediateActionSoc_resourceId[@ChargingManagementCore_Notification_immediateActions_Element] = @this;
  ChargingManagementCore_Notification_immediateActions();
}
on envVar ChargingManagementCore_Notification_immediateActions_immediateActionSoc_elementId
{
  getvalue(this, buffer_uuid);
  for (k=0;k<16;k++)
    ChargingManagementCore_array_immediateActions_immediateActionSoc_elementId[@ChargingManagementCore_Notification_immediateActions_Element][k] = buffer_uuid[k];
  ChargingManagementCore_Notification_immediateActions();
}
on envVar ChargingManagementCore_Notification_immediateActions_immediateActionRange_serviceId
{
  ChargingManagementCore_array_immediateActions_immediateActionRange_serviceId[@ChargingManagementCore_Notification_immediateActions_Element] = @this;
  ChargingManagementCore_Notification_immediateActions();
}
on envVar ChargingManagementCore_Notification_immediateActions_immediateActionRange_serviceInstanceId
{
  ChargingManagementCore_array_immediateActions_immediateActionRange_serviceInstanceId[@ChargingManagementCore_Notification_immediateActions_Element] = @this;
  ChargingManagementCore_Notification_immediateActions();
}
on envVar ChargingManagementCore_Notification_immediateActions_immediateActionRange_resourceId
{
  ChargingManagementCore_array_immediateActions_immediateActionRange_resourceId[@ChargingManagementCore_Notification_immediateActions_Element] = @this;
  ChargingManagementCore_Notification_immediateActions();
}
on envVar ChargingManagementCore_Notification_immediateActions_immediateActionRange_elementId
{
  getvalue(this, buffer_uuid);
  for (k=0;k<16;k++)
    ChargingManagementCore_array_immediateActions_immediateActionRange_elementId[@ChargingManagementCore_Notification_immediateActions_Element][k] = buffer_uuid[k];
  ChargingManagementCore_Notification_immediateActions();
}
on envVar ChargingManagementCore_Notification_immediateActions_immediateActionTime_serviceId
{
  ChargingManagementCore_array_immediateActions_immediateActionTime_serviceId[@ChargingManagementCore_Notification_immediateActions_Element] = @this;
  ChargingManagementCore_Notification_immediateActions();
}
on envVar ChargingManagementCore_Notification_immediateActions_immediateActionTime_serviceInstanceId
{
  ChargingManagementCore_array_immediateActions_immediateActionTime_serviceInstanceId[@ChargingManagementCore_Notification_immediateActions_Element] = @this;
  ChargingManagementCore_Notification_immediateActions();
}
on envVar ChargingManagementCore_Notification_immediateActions_immediateActionTime_resourceId
{
  ChargingManagementCore_array_immediateActions_immediateActionTime_resourceId[@ChargingManagementCore_Notification_immediateActions_Element] = @this;
  ChargingManagementCore_Notification_immediateActions();
}
on envVar ChargingManagementCore_Notification_immediateActions_immediateActionTime_elementId
{
  getvalue(this, buffer_uuid);
  for (k=0;k<16;k++)
    ChargingManagementCore_array_immediateActions_immediateActionTime_elementId[@ChargingManagementCore_Notification_immediateActions_Element][k] = buffer_uuid[k];
  ChargingManagementCore_Notification_immediateActions();
}
on envVar ChargingManagementCore_Notification_immediateActions_startStopCharging_serviceId
{
  ChargingManagementCore_array_immediateActions_startStopCharging_serviceId[@ChargingManagementCore_Notification_immediateActions_Element] = @this;
  ChargingManagementCore_Notification_immediateActions();
}
on envVar ChargingManagementCore_Notification_immediateActions_startStopCharging_serviceInstanceId
{
  ChargingManagementCore_array_immediateActions_startStopCharging_serviceInstanceId[@ChargingManagementCore_Notification_immediateActions_Element] = @this;
  ChargingManagementCore_Notification_immediateActions();
}
on envVar ChargingManagementCore_Notification_immediateActions_startStopCharging_resourceId
{
  ChargingManagementCore_array_immediateActions_startStopCharging_resourceId[@ChargingManagementCore_Notification_immediateActions_Element] = @this;
  ChargingManagementCore_Notification_immediateActions();
}
on envVar ChargingManagementCore_Notification_immediateActions_startStopCharging_elementId
{
  getvalue(this, buffer_uuid);
  for (k=0;k<16;k++)
    ChargingManagementCore_array_immediateActions_startStopCharging_elementId[@ChargingManagementCore_Notification_immediateActions_Element][k] = buffer_uuid[k];
  ChargingManagementCore_Notification_immediateActions();
}
on envVar ChargingManagementCore_Notification_immediateActions_type_available
{
  ChargingManagementCore_array_immediateActions_type_available[@ChargingManagementCore_Notification_immediateActions_Element] = @this;
  ChargingManagementCore_Notification_immediateActions();
}
on envVar ChargingManagementCore_Notification_immediateActions_immediateActionSoc_available
{
  ChargingManagementCore_array_immediateActions_immediateActionSoc_available[@ChargingManagementCore_Notification_immediateActions_Element] = @this;
  ChargingManagementCore_Notification_immediateActions();
}
on envVar ChargingManagementCore_Notification_immediateActions_immediateActionRange_available
{
  ChargingManagementCore_array_immediateActions_immediateActionRange_available[@ChargingManagementCore_Notification_immediateActions_Element] = @this;
  ChargingManagementCore_Notification_immediateActions();
}
on envVar ChargingManagementCore_Notification_immediateActions_immediateActionTime_available
{
  ChargingManagementCore_array_immediateActions_immediateActionTime_available[@ChargingManagementCore_Notification_immediateActions_Element] = @this;
  ChargingManagementCore_Notification_immediateActions();
}
on envVar ChargingManagementCore_Notification_immediateActions_startStopCharging_available
{
  ChargingManagementCore_array_immediateActions_startStopCharging_available[@ChargingManagementCore_Notification_immediateActions_Element] = @this;
  ChargingManagementCore_Notification_immediateActions();
}
on envVar ChargingManagementCore_Notification_immediateActions_Payload
{
  ChargingManagementCore_Notification_immediateActions_update();
}


ChargingManagementCore_Notification_immediateActions()
{
  word payload_counter = 0;
  word start_pos       = 0;
  word element_length  = 0;
  
  // Length Indicator Struct - Platzhalter
  payload_counter = 0+4;
  start_pos = 0;
  
  for (j=0; j<@ChargingManagementCore_Notification_immediateActions_Element_TotalNum; j++)
  {
    ChargingManagementCore_array_immediateActions_available_functions[j] = ChargingManagementCore_array_immediateActions_type_available[j]
                                                                         + ChargingManagementCore_array_immediateActions_immediateActionSoc_available[j]
                                                                         + ChargingManagementCore_array_immediateActions_immediateActionRange_available[j]
                                                                         + ChargingManagementCore_array_immediateActions_immediateActionTime_available[j]
                                                                         + ChargingManagementCore_array_immediateActions_startStopCharging_available[j];
    
    // Length Indicator Element - Platzhalter
    if (ChargingManagementCore_array_immediateActions_available_functions[j] > 0)
    {
      start_pos = payload_counter;
      payload_counter = payload_counter + 4;
    }
    else 
      start_pos = payload_counter;
    
    // 0 type (enum32)
    if (ChargingManagementCore_array_immediateActions_type_available[j] == 1)
    {
      tag_dataID = 0;
      ChargingManagementCore_payload_buffer_immediateActions[payload_counter++] = 2 * 16 /* Wiretype = 2 =^ 32 Bit */ + ((tag_dataID>>8) & 0x0F) /* DataID High Part */ ;
      ChargingManagementCore_payload_buffer_immediateActions[payload_counter++] = tag_dataID & 0xFF /* DataID Low Part */ ;
      
      ChargingManagementCore_payload_buffer_immediateActions[payload_counter++] = ChargingManagementCore_array_immediateActions_type[j]>>24 & 0xFF;
      ChargingManagementCore_payload_buffer_immediateActions[payload_counter++] = ChargingManagementCore_array_immediateActions_type[j]>>16 & 0xFF;
      ChargingManagementCore_payload_buffer_immediateActions[payload_counter++] = ChargingManagementCore_array_immediateActions_type[j]>> 8 & 0xFF;
      ChargingManagementCore_payload_buffer_immediateActions[payload_counter++] = ChargingManagementCore_array_immediateActions_type[j]     & 0xFF;
    }
    
    
    // 1 immediateActionSoc (ref#ChargingManagementCore.valueControls.valueControlObject)
    if (ChargingManagementCore_array_immediateActions_immediateActionSoc_available[j] == 1)
    {
      tag_dataID = 1;
      ChargingManagementCore_payload_buffer_immediateActions[payload_counter++] = 5 * 16 /* Wiretype = 5  =^ Array mit 1 Byte Länge */ + ((tag_dataID>>8) & 0x0F) /* DataID High Part */ ;
      ChargingManagementCore_payload_buffer_immediateActions[payload_counter++] = tag_dataID & 0xFF /* DataID Low Part */ ;
      
      ChargingManagementCore_payload_buffer_immediateActions[payload_counter++] = 22; // Array Length
      
      // Service ID
      ChargingManagementCore_payload_buffer_immediateActions[payload_counter++] = ChargingManagementCore_array_immediateActions_immediateActionSoc_serviceId[j]>> 8 & 0xFF;
      ChargingManagementCore_payload_buffer_immediateActions[payload_counter++] = ChargingManagementCore_array_immediateActions_immediateActionSoc_serviceId[j]     & 0xFF;
      
      // Service Instance ID
      ChargingManagementCore_payload_buffer_immediateActions[payload_counter++] = ChargingManagementCore_array_immediateActions_immediateActionSoc_serviceInstanceId[j]>> 8 & 0xFF;
      ChargingManagementCore_payload_buffer_immediateActions[payload_counter++] = ChargingManagementCore_array_immediateActions_immediateActionSoc_serviceInstanceId[j]     & 0xFF;
      
      // Resource ID
      ChargingManagementCore_payload_buffer_immediateActions[payload_counter++] = ChargingManagementCore_array_immediateActions_immediateActionSoc_resourceId[j]>> 8 & 0xFF;
      ChargingManagementCore_payload_buffer_immediateActions[payload_counter++] = ChargingManagementCore_array_immediateActions_immediateActionSoc_resourceId[j]     & 0xFF;
      
      // Element ID
      for (k=0; k<16; k++)
        ChargingManagementCore_payload_buffer_immediateActions[payload_counter++] = ChargingManagementCore_array_immediateActions_immediateActionSoc_elementId[j][k] & 0xFF;
    }
    
    
    // 2 immediateActionRange (ref#ChargingManagementCore.valueControls.valueControlObject)
    if (ChargingManagementCore_array_immediateActions_immediateActionRange_available[j] == 1)
    {
      tag_dataID = 2;
      ChargingManagementCore_payload_buffer_immediateActions[payload_counter++] = 5 * 16 /* Wiretype = 5  =^ Array mit 1 Byte Länge */ + ((tag_dataID>>8) & 0x0F) /* DataID High Part */ ;
      ChargingManagementCore_payload_buffer_immediateActions[payload_counter++] = tag_dataID & 0xFF /* DataID Low Part */ ;
      
      ChargingManagementCore_payload_buffer_immediateActions[payload_counter++] = 22; // Array Length
      
      // Service ID
      ChargingManagementCore_payload_buffer_immediateActions[payload_counter++] = ChargingManagementCore_array_immediateActions_immediateActionRange_serviceId[j]>> 8 & 0xFF;
      ChargingManagementCore_payload_buffer_immediateActions[payload_counter++] = ChargingManagementCore_array_immediateActions_immediateActionRange_serviceId[j]     & 0xFF;
      
      // Service Instance ID
      ChargingManagementCore_payload_buffer_immediateActions[payload_counter++] = ChargingManagementCore_array_immediateActions_immediateActionRange_serviceInstanceId[j]>> 8 & 0xFF;
      ChargingManagementCore_payload_buffer_immediateActions[payload_counter++] = ChargingManagementCore_array_immediateActions_immediateActionRange_serviceInstanceId[j]     & 0xFF;
      
      // Resource ID
      ChargingManagementCore_payload_buffer_immediateActions[payload_counter++] = ChargingManagementCore_array_immediateActions_immediateActionRange_resourceId[j]>> 8 & 0xFF;
      ChargingManagementCore_payload_buffer_immediateActions[payload_counter++] = ChargingManagementCore_array_immediateActions_immediateActionRange_resourceId[j]     & 0xFF;
      
      // Element ID
      for (k=0; k<16; k++)
        ChargingManagementCore_payload_buffer_immediateActions[payload_counter++] = ChargingManagementCore_array_immediateActions_immediateActionRange_elementId[j][k] & 0xFF;
    }
    
    
    // 3 immediateActionTime (ref#ChargingManagementCore.valueControls.valueControlObject)
    if (ChargingManagementCore_array_immediateActions_immediateActionTime_available[j] == 1)
    {
      tag_dataID = 3;
      ChargingManagementCore_payload_buffer_immediateActions[payload_counter++] = 5 * 16 /* Wiretype = 5  =^ Array mit 1 Byte Länge */ + ((tag_dataID>>8) & 0x0F) /* DataID High Part */ ;
      ChargingManagementCore_payload_buffer_immediateActions[payload_counter++] = tag_dataID & 0xFF /* DataID Low Part */ ;
      
      ChargingManagementCore_payload_buffer_immediateActions[payload_counter++] = 22; // Array Length
      
      // Service ID
      ChargingManagementCore_payload_buffer_immediateActions[payload_counter++] = ChargingManagementCore_array_immediateActions_immediateActionTime_serviceId[j]>> 8 & 0xFF;
      ChargingManagementCore_payload_buffer_immediateActions[payload_counter++] = ChargingManagementCore_array_immediateActions_immediateActionTime_serviceId[j]     & 0xFF;
      
      // Service Instance ID
      ChargingManagementCore_payload_buffer_immediateActions[payload_counter++] = ChargingManagementCore_array_immediateActions_immediateActionTime_serviceInstanceId[j]>> 8 & 0xFF;
      ChargingManagementCore_payload_buffer_immediateActions[payload_counter++] = ChargingManagementCore_array_immediateActions_immediateActionTime_serviceInstanceId[j]     & 0xFF;
      
      // Resource ID
      ChargingManagementCore_payload_buffer_immediateActions[payload_counter++] = ChargingManagementCore_array_immediateActions_immediateActionTime_resourceId[j]>> 8 & 0xFF;
      ChargingManagementCore_payload_buffer_immediateActions[payload_counter++] = ChargingManagementCore_array_immediateActions_immediateActionTime_resourceId[j]     & 0xFF;
      
      // Element ID
      for (k=0; k<16; k++)
        ChargingManagementCore_payload_buffer_immediateActions[payload_counter++] = ChargingManagementCore_array_immediateActions_immediateActionTime_elementId[j][k] & 0xFF;
    }
    
    
    // 4 startStopCharging (ref#ChargingManagementCore.switchControls.switchControlObject)
    if (ChargingManagementCore_array_immediateActions_startStopCharging_available[j] == 1)
    {
      tag_dataID = 4;
      ChargingManagementCore_payload_buffer_immediateActions[payload_counter++] = 5 * 16 /* Wiretype = 5  =^ Array mit 1 Byte Länge */ + ((tag_dataID>>8) & 0x0F) /* DataID High Part */ ;
      ChargingManagementCore_payload_buffer_immediateActions[payload_counter++] = tag_dataID & 0xFF /* DataID Low Part */ ;
      
      ChargingManagementCore_payload_buffer_immediateActions[payload_counter++] = 22; // Array Length
      
      // Service ID
      ChargingManagementCore_payload_buffer_immediateActions[payload_counter++] = ChargingManagementCore_array_immediateActions_startStopCharging_serviceId[j]>> 8 & 0xFF;
      ChargingManagementCore_payload_buffer_immediateActions[payload_counter++] = ChargingManagementCore_array_immediateActions_startStopCharging_serviceId[j]     & 0xFF;
      
      // Service Instance ID
      ChargingManagementCore_payload_buffer_immediateActions[payload_counter++] = ChargingManagementCore_array_immediateActions_startStopCharging_serviceInstanceId[j]>> 8 & 0xFF;
      ChargingManagementCore_payload_buffer_immediateActions[payload_counter++] = ChargingManagementCore_array_immediateActions_startStopCharging_serviceInstanceId[j]     & 0xFF;
      
      // Resource ID
      ChargingManagementCore_payload_buffer_immediateActions[payload_counter++] = ChargingManagementCore_array_immediateActions_startStopCharging_resourceId[j]>> 8 & 0xFF;
      ChargingManagementCore_payload_buffer_immediateActions[payload_counter++] = ChargingManagementCore_array_immediateActions_startStopCharging_resourceId[j]     & 0xFF;
      
      // Element ID
      for (k=0; k<16; k++)
        ChargingManagementCore_payload_buffer_immediateActions[payload_counter++] = ChargingManagementCore_array_immediateActions_startStopCharging_elementId[j][k] & 0xFF;
    }
    
    //Element Length
    element_length = payload_counter-start_pos;
    if (element_length >0) ChargingManagementCore_array_immediateActions_array_element_length[j] = element_length - 4;
    else                   ChargingManagementCore_array_immediateActions_array_element_length[j] = element_length;
    
    ChargingManagementCore_payload_buffer_immediateActions[start_pos++] = ChargingManagementCore_array_immediateActions_array_element_length[j]>>24 & 0xFF;
    ChargingManagementCore_payload_buffer_immediateActions[start_pos++] = ChargingManagementCore_array_immediateActions_array_element_length[j]>>16 & 0xFF;
    ChargingManagementCore_payload_buffer_immediateActions[start_pos++] = ChargingManagementCore_array_immediateActions_array_element_length[j]>> 8 & 0xFF;
    ChargingManagementCore_payload_buffer_immediateActions[start_pos++] = ChargingManagementCore_array_immediateActions_array_element_length[j]     & 0xFF;
    
    if (ChargingManagementCore_array_immediateActions_array_element_length[j] == 0) payload_counter = payload_counter+4;
  }
  
  // Struct Length
  ChargingManagementCore_array_immediateActions_struct_element_length = 4*@ChargingManagementCore_Notification_immediateActions_Element_TotalNum;

  for (k=0;k<@ChargingManagementCore_Notification_immediateActions_Element_TotalNum;k++)
    ChargingManagementCore_array_immediateActions_struct_element_length = ChargingManagementCore_array_immediateActions_struct_element_length + ChargingManagementCore_array_immediateActions_array_element_length[k];
  
  ChargingManagementCore_payload_buffer_immediateActions[0] = ChargingManagementCore_array_immediateActions_struct_element_length>>24 & 0xFF;
  ChargingManagementCore_payload_buffer_immediateActions[1] = ChargingManagementCore_array_immediateActions_struct_element_length>>16 & 0xFF;
  ChargingManagementCore_payload_buffer_immediateActions[2] = ChargingManagementCore_array_immediateActions_struct_element_length>> 8 & 0xFF;
  ChargingManagementCore_payload_buffer_immediateActions[3] = ChargingManagementCore_array_immediateActions_struct_element_length     & 0xFF;


  ChargingManagementCore_payload_length_immediateActions = ChargingManagementCore_array_immediateActions_struct_element_length+4;
  putvalue(ChargingManagementCore_Notification_immediateActions_Payload, ChargingManagementCore_payload_buffer_immediateActions, ChargingManagementCore_payload_length_immediateActions);
}

on envVar ChargingManagementCore_Notification_immediateActions_Element_TotalNum
{
  if (@this == 0) @this =  1;
  if (@this > 10) @this = 10;
  
  ChargingManagementCore_Notification_immediateActions();
  ChargingManagementCore_Notification_immediateActions_update();
}

on envVar ChargingManagementCore_Notification_immediateActions_Element
{
  ChargingManagementCore_Notification_immediateActions_update();
}

on envVar ChargingManagementCore_Notification_immediateActions_Element_Next
{
  if (@this == 1 && @ChargingManagementCore_Notification_immediateActions_Element < @ChargingManagementCore_Notification_immediateActions_Element_TotalNum - 1)
  {
    @ChargingManagementCore_Notification_immediateActions_Element = @ChargingManagementCore_Notification_immediateActions_Element + 1;
    ChargingManagementCore_Notification_immediateActions_update();
  }
}

on envVar ChargingManagementCore_Notification_immediateActions_Element_Previous
{
  if (@this == 1 && @ChargingManagementCore_Notification_immediateActions_Element > 0)
  {
    @ChargingManagementCore_Notification_immediateActions_Element = @ChargingManagementCore_Notification_immediateActions_Element - 1;
    ChargingManagementCore_Notification_immediateActions_update();
  }
}

ChargingManagementCore_Notification_immediateActions_update()
{
  @ChargingManagementCore_Notification_LengthIndicator_Element_immediateActions = ChargingManagementCore_array_immediateActions_array_element_length[@ChargingManagementCore_Notification_immediateActions_Element];
  @ChargingManagementCore_Notification_LengthIndicator_Struct_immediateActions  = ChargingManagementCore_array_immediateActions_struct_element_length;
  @ChargingManagementCore_Notification_Length_immediateActions                  = ChargingManagementCore_payload_length_immediateActions+8;
  
  @ChargingManagementCore_Notification_immediateActions_type                                   = ChargingManagementCore_array_immediateActions_type[@ChargingManagementCore_Notification_immediateActions_Element];
  @ChargingManagementCore_Notification_immediateActions_immediateActionSoc_serviceId           = ChargingManagementCore_array_immediateActions_immediateActionSoc_serviceId[@ChargingManagementCore_Notification_immediateActions_Element];
  @ChargingManagementCore_Notification_immediateActions_immediateActionSoc_serviceInstanceId   = ChargingManagementCore_array_immediateActions_immediateActionSoc_serviceInstanceId[@ChargingManagementCore_Notification_immediateActions_Element];
  @ChargingManagementCore_Notification_immediateActions_immediateActionSoc_resourceId          = ChargingManagementCore_array_immediateActions_immediateActionSoc_resourceId[@ChargingManagementCore_Notification_immediateActions_Element];
  @ChargingManagementCore_Notification_immediateActions_immediateActionRange_serviceId         = ChargingManagementCore_array_immediateActions_immediateActionRange_serviceId[@ChargingManagementCore_Notification_immediateActions_Element];
  @ChargingManagementCore_Notification_immediateActions_immediateActionRange_serviceInstanceId = ChargingManagementCore_array_immediateActions_immediateActionRange_serviceInstanceId[@ChargingManagementCore_Notification_immediateActions_Element];
  @ChargingManagementCore_Notification_immediateActions_immediateActionRange_resourceId        = ChargingManagementCore_array_immediateActions_immediateActionRange_resourceId[@ChargingManagementCore_Notification_immediateActions_Element];
  @ChargingManagementCore_Notification_immediateActions_immediateActionTime_serviceId          = ChargingManagementCore_array_immediateActions_immediateActionTime_serviceId[@ChargingManagementCore_Notification_immediateActions_Element];
  @ChargingManagementCore_Notification_immediateActions_immediateActionTime_serviceInstanceId  = ChargingManagementCore_array_immediateActions_immediateActionTime_serviceInstanceId[@ChargingManagementCore_Notification_immediateActions_Element];
  @ChargingManagementCore_Notification_immediateActions_immediateActionTime_resourceId         = ChargingManagementCore_array_immediateActions_immediateActionTime_resourceId[@ChargingManagementCore_Notification_immediateActions_Element];
  @ChargingManagementCore_Notification_immediateActions_startStopCharging_serviceId            = ChargingManagementCore_array_immediateActions_startStopCharging_serviceId[@ChargingManagementCore_Notification_immediateActions_Element];
  @ChargingManagementCore_Notification_immediateActions_startStopCharging_serviceInstanceId    = ChargingManagementCore_array_immediateActions_startStopCharging_serviceInstanceId[@ChargingManagementCore_Notification_immediateActions_Element];
  @ChargingManagementCore_Notification_immediateActions_startStopCharging_resourceId           = ChargingManagementCore_array_immediateActions_startStopCharging_resourceId[@ChargingManagementCore_Notification_immediateActions_Element];
  
  putValue (ChargingManagementCore_Notification_immediateActions_immediateActionSoc_elementId, ChargingManagementCore_array_immediateActions_immediateActionSoc_elementId[@ChargingManagementCore_Notification_immediateActions_Element]);
  putValue (ChargingManagementCore_Notification_immediateActions_immediateActionRange_elementId, ChargingManagementCore_array_immediateActions_immediateActionRange_elementId[@ChargingManagementCore_Notification_immediateActions_Element]);
  putValue (ChargingManagementCore_Notification_immediateActions_immediateActionTime_elementId, ChargingManagementCore_array_immediateActions_immediateActionTime_elementId[@ChargingManagementCore_Notification_immediateActions_Element]);
  putValue (ChargingManagementCore_Notification_immediateActions_startStopCharging_elementId, ChargingManagementCore_array_immediateActions_startStopCharging_elementId[@ChargingManagementCore_Notification_immediateActions_Element]);
  
  @ChargingManagementCore_Notification_immediateActions_type_available                 = ChargingManagementCore_array_immediateActions_type_available[@ChargingManagementCore_Notification_immediateActions_Element];
  @ChargingManagementCore_Notification_immediateActions_immediateActionSoc_available   = ChargingManagementCore_array_immediateActions_immediateActionSoc_available[@ChargingManagementCore_Notification_immediateActions_Element];
  @ChargingManagementCore_Notification_immediateActions_immediateActionRange_available = ChargingManagementCore_array_immediateActions_immediateActionRange_available[@ChargingManagementCore_Notification_immediateActions_Element];
  @ChargingManagementCore_Notification_immediateActions_immediateActionTime_available  = ChargingManagementCore_array_immediateActions_immediateActionTime_available[@ChargingManagementCore_Notification_immediateActions_Element];
  @ChargingManagementCore_Notification_immediateActions_startStopCharging_available    = ChargingManagementCore_array_immediateActions_startStopCharging_available[@ChargingManagementCore_Notification_immediateActions_Element];
}








////////// notificationMarkers Notification //////////

on envVar ChargingManagementCore_Notification_LengthIndicator_Struct_notificationMarkers
{
  ChargingManagementCore_Notification_notificationMarkers();
}
on envVar ChargingManagementCore_Notification_LengthIndicator_Element_notificationMarkers
{
  ChargingManagementCore_Notification_notificationMarkers();
}
on envVar ChargingManagementCore_Notification_notificationMarkers_type
{
  ChargingManagementCore_array_notificationMarkers_type[@ChargingManagementCore_Notification_notificationMarkers_Element] = @this;
  ChargingManagementCore_Notification_notificationMarkers();
}
on envVar ChargingManagementCore_Notification_notificationMarkers_notificationSocValue_serviceId
{
  ChargingManagementCore_array_notificationMarkers_notificationSocValue_serviceId[@ChargingManagementCore_Notification_notificationMarkers_Element] = @this;
  ChargingManagementCore_Notification_notificationMarkers();
}
on envVar ChargingManagementCore_Notification_notificationMarkers_notificationSocValue_serviceInstanceId
{
  ChargingManagementCore_array_notificationMarkers_notificationSocValue_serviceInstanceId[@ChargingManagementCore_Notification_notificationMarkers_Element] = @this;
  ChargingManagementCore_Notification_notificationMarkers();
}
on envVar ChargingManagementCore_Notification_notificationMarkers_notificationSocValue_resourceId
{
  ChargingManagementCore_array_notificationMarkers_notificationSocValue_resourceId[@ChargingManagementCore_Notification_notificationMarkers_Element] = @this;
  ChargingManagementCore_Notification_notificationMarkers();
}
on envVar ChargingManagementCore_Notification_notificationMarkers_notificationSocValue_elementId
{
  getvalue(this, buffer_uuid);
  for (k=0;k<16;k++)
    ChargingManagementCore_array_notificationMarkers_notificationSocValue_elementId[@ChargingManagementCore_Notification_notificationMarkers_Element][k] = buffer_uuid[k];
  ChargingManagementCore_Notification_notificationMarkers();
}
on envVar ChargingManagementCore_Notification_notificationMarkers_notificationRangeValue_serviceId
{
  ChargingManagementCore_array_notificationMarkers_notificationRangeValue_serviceId[@ChargingManagementCore_Notification_notificationMarkers_Element] = @this;
  ChargingManagementCore_Notification_notificationMarkers();
}
on envVar ChargingManagementCore_Notification_notificationMarkers_notificationRangeValue_serviceInstanceId
{
  ChargingManagementCore_array_notificationMarkers_notificationRangeValue_serviceInstanceId[@ChargingManagementCore_Notification_notificationMarkers_Element] = @this;
  ChargingManagementCore_Notification_notificationMarkers();
}
on envVar ChargingManagementCore_Notification_notificationMarkers_notificationRangeValue_resourceId
{
  ChargingManagementCore_array_notificationMarkers_notificationRangeValue_resourceId[@ChargingManagementCore_Notification_notificationMarkers_Element] = @this;
  ChargingManagementCore_Notification_notificationMarkers();
}
on envVar ChargingManagementCore_Notification_notificationMarkers_notificationRangeValue_elementId
{
  getvalue(this, buffer_uuid);
  for (k=0;k<16;k++)
    ChargingManagementCore_array_notificationMarkers_notificationRangeValue_elementId[@ChargingManagementCore_Notification_notificationMarkers_Element][k] = buffer_uuid[k];
  ChargingManagementCore_Notification_notificationMarkers();
}
on envVar ChargingManagementCore_Notification_notificationMarkers_notificationTimeValue_serviceId
{
  ChargingManagementCore_array_notificationMarkers_notificationTimeValue_serviceId[@ChargingManagementCore_Notification_notificationMarkers_Element] = @this;
  ChargingManagementCore_Notification_notificationMarkers();
}
on envVar ChargingManagementCore_Notification_notificationMarkers_notificationTimeValue_serviceInstanceId
{
  ChargingManagementCore_array_notificationMarkers_notificationTimeValue_serviceInstanceId[@ChargingManagementCore_Notification_notificationMarkers_Element] = @this;
  ChargingManagementCore_Notification_notificationMarkers();
}
on envVar ChargingManagementCore_Notification_notificationMarkers_notificationTimeValue_resourceId
{
  ChargingManagementCore_array_notificationMarkers_notificationTimeValue_resourceId[@ChargingManagementCore_Notification_notificationMarkers_Element] = @this;
  ChargingManagementCore_Notification_notificationMarkers();
}
on envVar ChargingManagementCore_Notification_notificationMarkers_notificationTimeValue_elementId
{
  getvalue(this, buffer_uuid);
  for (k=0;k<16;k++)
    ChargingManagementCore_array_notificationMarkers_notificationTimeValue_elementId[@ChargingManagementCore_Notification_notificationMarkers_Element][k] = buffer_uuid[k];
  ChargingManagementCore_Notification_notificationMarkers();
}
on envVar ChargingManagementCore_Notification_notificationMarkers_isToBeNotified
{
  ChargingManagementCore_array_notificationMarkers_isToBeNotified[@ChargingManagementCore_Notification_notificationMarkers_Element] = @this;
  ChargingManagementCore_Notification_notificationMarkers();
}
on envVar ChargingManagementCore_Notification_notificationMarkers_type_available
{
  ChargingManagementCore_array_notificationMarkers_type_available[@ChargingManagementCore_Notification_notificationMarkers_Element] = @this;
  ChargingManagementCore_Notification_notificationMarkers();
}
on envVar ChargingManagementCore_Notification_notificationMarkers_notificationSocValue_available
{
  ChargingManagementCore_array_notificationMarkers_notificationSocValue_available[@ChargingManagementCore_Notification_notificationMarkers_Element] = @this;
  ChargingManagementCore_Notification_notificationMarkers();
}
on envVar ChargingManagementCore_Notification_notificationMarkers_notificationRangeValue_available
{
  ChargingManagementCore_array_notificationMarkers_notificationRangeValue_available[@ChargingManagementCore_Notification_notificationMarkers_Element] = @this;
  ChargingManagementCore_Notification_notificationMarkers();
}
on envVar ChargingManagementCore_Notification_notificationMarkers_notificationTimeValue_available
{
  ChargingManagementCore_array_notificationMarkers_notificationTimeValue_available[@ChargingManagementCore_Notification_notificationMarkers_Element] = @this;
  ChargingManagementCore_Notification_notificationMarkers();
}
on envVar ChargingManagementCore_Notification_notificationMarkers_isToBeNotified_available
{
  ChargingManagementCore_array_notificationMarkers_isToBeNotified_available[@ChargingManagementCore_Notification_notificationMarkers_Element] = @this;
  ChargingManagementCore_Notification_notificationMarkers();
}
on envVar ChargingManagementCore_Notification_notificationMarkers_Payload
{
  ChargingManagementCore_Notification_notificationMarkers_update();
}


ChargingManagementCore_Notification_notificationMarkers()
{
  word payload_counter = 0;
  word start_pos       = 0;
  word element_length  = 0;
  
  // Length Indicator Struct - Platzhalter
  payload_counter = 0+4;
  start_pos = 0;
  
  for (j=0; j<@ChargingManagementCore_Notification_notificationMarkers_Element_TotalNum; j++)
  {
    ChargingManagementCore_array_notificationMarkers_available_functions[j] = ChargingManagementCore_array_notificationMarkers_type_available[j]
                                                                            + ChargingManagementCore_array_notificationMarkers_notificationSocValue_available[j]
                                                                            + ChargingManagementCore_array_notificationMarkers_notificationRangeValue_available[j]
                                                                            + ChargingManagementCore_array_notificationMarkers_notificationTimeValue_available[j]
                                                                            + ChargingManagementCore_array_notificationMarkers_isToBeNotified_available[j];
    
    // Length Indicator Element - Platzhalter
    if (ChargingManagementCore_array_notificationMarkers_available_functions[j] > 0)
    {
      start_pos = payload_counter;
      payload_counter = payload_counter + 4;
    }
    else 
      start_pos = payload_counter;
    
    
    // 0 type (enum32)
    if (ChargingManagementCore_array_notificationMarkers_type_available[j] == 1)
    {
      tag_dataID = 0;
      ChargingManagementCore_payload_buffer_notificationMarkers[payload_counter++] = 2 * 16 /* Wiretype = 2 =^ 32 Bit */ + ((tag_dataID>>8) & 0x0F) /* DataID High Part */ ;
      ChargingManagementCore_payload_buffer_notificationMarkers[payload_counter++] = tag_dataID & 0xFF /* DataID Low Part */ ;
      
      ChargingManagementCore_payload_buffer_notificationMarkers[payload_counter++] = ChargingManagementCore_array_notificationMarkers_type[j]>>24 & 0xFF;
      ChargingManagementCore_payload_buffer_notificationMarkers[payload_counter++] = ChargingManagementCore_array_notificationMarkers_type[j]>>16 & 0xFF;
      ChargingManagementCore_payload_buffer_notificationMarkers[payload_counter++] = ChargingManagementCore_array_notificationMarkers_type[j]>> 8 & 0xFF;
      ChargingManagementCore_payload_buffer_notificationMarkers[payload_counter++] = ChargingManagementCore_array_notificationMarkers_type[j]     & 0xFF;
    }
    
    
    // 1 notificationSocValue (ref#ChargingManagementCore.valueControls.valueControlObject)
    if (ChargingManagementCore_array_notificationMarkers_notificationSocValue_available[j] == 1)
    {
      tag_dataID = 1;
      ChargingManagementCore_payload_buffer_notificationMarkers[payload_counter++] = 5 * 16 /* Wiretype = 5  =^ Array mit 1 Byte Länge */ + ((tag_dataID>>8) & 0x0F) /* DataID High Part */ ;
      ChargingManagementCore_payload_buffer_notificationMarkers[payload_counter++] = tag_dataID & 0xFF /* DataID Low Part */ ;
      
      ChargingManagementCore_payload_buffer_notificationMarkers[payload_counter++] = 22; // Array Length
      
      // Service ID
      ChargingManagementCore_payload_buffer_notificationMarkers[payload_counter++] = ChargingManagementCore_array_notificationMarkers_notificationSocValue_serviceId[j]>> 8 & 0xFF;
      ChargingManagementCore_payload_buffer_notificationMarkers[payload_counter++] = ChargingManagementCore_array_notificationMarkers_notificationSocValue_serviceId[j]     & 0xFF;
      
      // Service Instance ID
      ChargingManagementCore_payload_buffer_notificationMarkers[payload_counter++] = ChargingManagementCore_array_notificationMarkers_notificationSocValue_serviceInstanceId[j]>> 8 & 0xFF;
      ChargingManagementCore_payload_buffer_notificationMarkers[payload_counter++] = ChargingManagementCore_array_notificationMarkers_notificationSocValue_serviceInstanceId[j]     & 0xFF;
      
      // Resource ID
      ChargingManagementCore_payload_buffer_notificationMarkers[payload_counter++] = ChargingManagementCore_array_notificationMarkers_notificationSocValue_resourceId[j]>> 8 & 0xFF;
      ChargingManagementCore_payload_buffer_notificationMarkers[payload_counter++] = ChargingManagementCore_array_notificationMarkers_notificationSocValue_resourceId[j]     & 0xFF;
      
      // Element ID
      for (k=0; k<16; k++)
        ChargingManagementCore_payload_buffer_notificationMarkers[payload_counter++] = ChargingManagementCore_array_notificationMarkers_notificationSocValue_elementId[j][k] & 0xFF;
    }
    
    
    // 2 notificationRangeValue (ref#ChargingManagementCore.valueControls.valueControlObject)
    if (ChargingManagementCore_array_notificationMarkers_notificationRangeValue_available[j] == 1)
    {
      tag_dataID = 2;
      ChargingManagementCore_payload_buffer_notificationMarkers[payload_counter++] = 5 * 16 /* Wiretype = 5  =^ Array mit 1 Byte Länge */ + ((tag_dataID>>8) & 0x0F) /* DataID High Part */ ;
      ChargingManagementCore_payload_buffer_notificationMarkers[payload_counter++] = tag_dataID & 0xFF /* DataID Low Part */ ;
      
      ChargingManagementCore_payload_buffer_notificationMarkers[payload_counter++] = 22; // Array Length
      
      // Service ID
      ChargingManagementCore_payload_buffer_notificationMarkers[payload_counter++] = ChargingManagementCore_array_notificationMarkers_notificationRangeValue_serviceId[j]>> 8 & 0xFF;
      ChargingManagementCore_payload_buffer_notificationMarkers[payload_counter++] = ChargingManagementCore_array_notificationMarkers_notificationRangeValue_serviceId[j]     & 0xFF;
      
      // Service Instance ID
      ChargingManagementCore_payload_buffer_notificationMarkers[payload_counter++] = ChargingManagementCore_array_notificationMarkers_notificationRangeValue_serviceInstanceId[j]>> 8 & 0xFF;
      ChargingManagementCore_payload_buffer_notificationMarkers[payload_counter++] = ChargingManagementCore_array_notificationMarkers_notificationRangeValue_serviceInstanceId[j]     & 0xFF;
      
      // Resource ID
      ChargingManagementCore_payload_buffer_notificationMarkers[payload_counter++] = ChargingManagementCore_array_notificationMarkers_notificationRangeValue_resourceId[j]>> 8 & 0xFF;
      ChargingManagementCore_payload_buffer_notificationMarkers[payload_counter++] = ChargingManagementCore_array_notificationMarkers_notificationRangeValue_resourceId[j]     & 0xFF;
      
      // Element ID
      for (k=0; k<16; k++)
        ChargingManagementCore_payload_buffer_notificationMarkers[payload_counter++] = ChargingManagementCore_array_notificationMarkers_notificationRangeValue_elementId[j][k] & 0xFF;
    }
    
    
    // 3 notificationTimeValue (ref#ChargingManagementCore.valueControls.valueControlObject)
    if (ChargingManagementCore_array_notificationMarkers_notificationTimeValue_available[j] == 1)
    {
      tag_dataID = 3;
      ChargingManagementCore_payload_buffer_notificationMarkers[payload_counter++] = 5 * 16 /* Wiretype = 5  =^ Array mit 1 Byte Länge */ + ((tag_dataID>>8) & 0x0F) /* DataID High Part */ ;
      ChargingManagementCore_payload_buffer_notificationMarkers[payload_counter++] = tag_dataID & 0xFF /* DataID Low Part */ ;
      
      ChargingManagementCore_payload_buffer_notificationMarkers[payload_counter++] = 22; // Array Length
      
      // Service ID
      ChargingManagementCore_payload_buffer_notificationMarkers[payload_counter++] = ChargingManagementCore_array_notificationMarkers_notificationTimeValue_serviceId[j]>> 8 & 0xFF;
      ChargingManagementCore_payload_buffer_notificationMarkers[payload_counter++] = ChargingManagementCore_array_notificationMarkers_notificationTimeValue_serviceId[j]     & 0xFF;
      
      // Service Instance ID
      ChargingManagementCore_payload_buffer_notificationMarkers[payload_counter++] = ChargingManagementCore_array_notificationMarkers_notificationTimeValue_serviceInstanceId[j]>> 8 & 0xFF;
      ChargingManagementCore_payload_buffer_notificationMarkers[payload_counter++] = ChargingManagementCore_array_notificationMarkers_notificationTimeValue_serviceInstanceId[j]     & 0xFF;
      
      // Resource ID
      ChargingManagementCore_payload_buffer_notificationMarkers[payload_counter++] = ChargingManagementCore_array_notificationMarkers_notificationTimeValue_resourceId[j]>> 8 & 0xFF;
      ChargingManagementCore_payload_buffer_notificationMarkers[payload_counter++] = ChargingManagementCore_array_notificationMarkers_notificationTimeValue_resourceId[j]     & 0xFF;
      
      // Element ID
      for (k=0; k<16; k++)
        ChargingManagementCore_payload_buffer_notificationMarkers[payload_counter++] = ChargingManagementCore_array_notificationMarkers_notificationTimeValue_elementId[j][k] & 0xFF;
    }
    
    // 4 isToBeNotified (boolean)
    if (ChargingManagementCore_array_notificationMarkers_isToBeNotified_available[j] == 1)
    {
      tag_dataID = 4;
      ChargingManagementCore_payload_buffer_notificationMarkers[payload_counter++] = 0 * 16 /* Wiretype = 0 =^ 8 Bit */ + ((tag_dataID>>8) & 0x0F) /* DataID High Part */ ;
      ChargingManagementCore_payload_buffer_notificationMarkers[payload_counter++] = tag_dataID & 0xFF /* DataID Low Part */ ;
      
      ChargingManagementCore_payload_buffer_notificationMarkers[payload_counter++] = ChargingManagementCore_array_notificationMarkers_isToBeNotified[j] & 0xFF;
    }
    
    
    //Element Length
    element_length = payload_counter-start_pos;
    if (element_length >0) ChargingManagementCore_array_notificationMarkers_array_element_length[j] = element_length - 4;
    else                   ChargingManagementCore_array_notificationMarkers_array_element_length[j] = element_length;
    
    ChargingManagementCore_payload_buffer_notificationMarkers[start_pos++] = ChargingManagementCore_array_notificationMarkers_array_element_length[j]>>24 & 0xFF;
    ChargingManagementCore_payload_buffer_notificationMarkers[start_pos++] = ChargingManagementCore_array_notificationMarkers_array_element_length[j]>>16 & 0xFF;
    ChargingManagementCore_payload_buffer_notificationMarkers[start_pos++] = ChargingManagementCore_array_notificationMarkers_array_element_length[j]>> 8 & 0xFF;
    ChargingManagementCore_payload_buffer_notificationMarkers[start_pos++] = ChargingManagementCore_array_notificationMarkers_array_element_length[j]     & 0xFF;
    
    if (ChargingManagementCore_array_notificationMarkers_array_element_length[j] == 0) payload_counter = payload_counter+4;
  }
  
  // Struct Length
  ChargingManagementCore_array_notificationMarkers_struct_element_length = 4*@ChargingManagementCore_Notification_notificationMarkers_Element_TotalNum;

  for (k=0;k<@ChargingManagementCore_Notification_notificationMarkers_Element_TotalNum;k++)
    ChargingManagementCore_array_notificationMarkers_struct_element_length = ChargingManagementCore_array_notificationMarkers_struct_element_length + ChargingManagementCore_array_notificationMarkers_array_element_length[k];
  
  ChargingManagementCore_payload_buffer_notificationMarkers[0] = ChargingManagementCore_array_notificationMarkers_struct_element_length>>24 & 0xFF;
  ChargingManagementCore_payload_buffer_notificationMarkers[1] = ChargingManagementCore_array_notificationMarkers_struct_element_length>>16 & 0xFF;
  ChargingManagementCore_payload_buffer_notificationMarkers[2] = ChargingManagementCore_array_notificationMarkers_struct_element_length>> 8 & 0xFF;
  ChargingManagementCore_payload_buffer_notificationMarkers[3] = ChargingManagementCore_array_notificationMarkers_struct_element_length     & 0xFF;


  ChargingManagementCore_payload_length_notificationMarkers = ChargingManagementCore_array_notificationMarkers_struct_element_length+4;
  putvalue(ChargingManagementCore_Notification_notificationMarkers_Payload, ChargingManagementCore_payload_buffer_notificationMarkers, ChargingManagementCore_payload_length_notificationMarkers);
}

on envVar ChargingManagementCore_Notification_notificationMarkers_Element_TotalNum
{
  if (@this == 0) @this =  1;
  if (@this > 10) @this = 10;
  
  ChargingManagementCore_Notification_notificationMarkers();
  ChargingManagementCore_Notification_notificationMarkers_update();
}

on envVar ChargingManagementCore_Notification_notificationMarkers_Element
{
  ChargingManagementCore_Notification_notificationMarkers_update();
}

on envVar ChargingManagementCore_Notification_notificationMarkers_Element_Next
{
  if (@this == 1 && @ChargingManagementCore_Notification_notificationMarkers_Element < @ChargingManagementCore_Notification_notificationMarkers_Element_TotalNum - 1)
  {
    @ChargingManagementCore_Notification_notificationMarkers_Element = @ChargingManagementCore_Notification_notificationMarkers_Element + 1;
    ChargingManagementCore_Notification_notificationMarkers_update();
  }
}

on envVar ChargingManagementCore_Notification_notificationMarkers_Element_Previous
{
  if (@this == 1 && @ChargingManagementCore_Notification_notificationMarkers_Element > 0)
  {
    @ChargingManagementCore_Notification_notificationMarkers_Element = @ChargingManagementCore_Notification_notificationMarkers_Element - 1;
    ChargingManagementCore_Notification_notificationMarkers_update();
  }
}

ChargingManagementCore_Notification_notificationMarkers_update()
{
  @ChargingManagementCore_Notification_LengthIndicator_Element_notificationMarkers = ChargingManagementCore_array_notificationMarkers_array_element_length[@ChargingManagementCore_Notification_notificationMarkers_Element];
  @ChargingManagementCore_Notification_LengthIndicator_Struct_notificationMarkers  = ChargingManagementCore_array_notificationMarkers_struct_element_length;
  @ChargingManagementCore_Notification_Length_notificationMarkers                  = ChargingManagementCore_payload_length_notificationMarkers+8;
  
  @ChargingManagementCore_Notification_notificationMarkers_type                                     = ChargingManagementCore_array_notificationMarkers_type[@ChargingManagementCore_Notification_notificationMarkers_Element];
  @ChargingManagementCore_Notification_notificationMarkers_notificationSocValue_serviceId           = ChargingManagementCore_array_notificationMarkers_notificationSocValue_serviceId[@ChargingManagementCore_Notification_notificationMarkers_Element];
  @ChargingManagementCore_Notification_notificationMarkers_notificationSocValue_serviceInstanceId   = ChargingManagementCore_array_notificationMarkers_notificationSocValue_serviceInstanceId[@ChargingManagementCore_Notification_notificationMarkers_Element];
  @ChargingManagementCore_Notification_notificationMarkers_notificationSocValue_resourceId          = ChargingManagementCore_array_notificationMarkers_notificationSocValue_resourceId[@ChargingManagementCore_Notification_notificationMarkers_Element];
  @ChargingManagementCore_Notification_notificationMarkers_notificationRangeValue_serviceId         = ChargingManagementCore_array_notificationMarkers_notificationRangeValue_serviceId[@ChargingManagementCore_Notification_notificationMarkers_Element];
  @ChargingManagementCore_Notification_notificationMarkers_notificationRangeValue_serviceInstanceId = ChargingManagementCore_array_notificationMarkers_notificationRangeValue_serviceInstanceId[@ChargingManagementCore_Notification_notificationMarkers_Element];
  @ChargingManagementCore_Notification_notificationMarkers_notificationRangeValue_resourceId        = ChargingManagementCore_array_notificationMarkers_notificationRangeValue_resourceId[@ChargingManagementCore_Notification_notificationMarkers_Element];
  @ChargingManagementCore_Notification_notificationMarkers_notificationTimeValue_serviceId          = ChargingManagementCore_array_notificationMarkers_notificationTimeValue_serviceId[@ChargingManagementCore_Notification_notificationMarkers_Element];
  @ChargingManagementCore_Notification_notificationMarkers_notificationTimeValue_serviceInstanceId  = ChargingManagementCore_array_notificationMarkers_notificationTimeValue_serviceInstanceId[@ChargingManagementCore_Notification_notificationMarkers_Element];
  @ChargingManagementCore_Notification_notificationMarkers_notificationTimeValue_resourceId         = ChargingManagementCore_array_notificationMarkers_notificationTimeValue_resourceId[@ChargingManagementCore_Notification_notificationMarkers_Element];
  @ChargingManagementCore_Notification_notificationMarkers_isToBeNotified                           = ChargingManagementCore_array_notificationMarkers_isToBeNotified[@ChargingManagementCore_Notification_notificationMarkers_Element];
  
  putValue (ChargingManagementCore_Notification_notificationMarkers_notificationSocValue_elementId, ChargingManagementCore_array_notificationMarkers_notificationSocValue_elementId[@ChargingManagementCore_Notification_notificationMarkers_Element]);
  putValue (ChargingManagementCore_Notification_notificationMarkers_notificationRangeValue_elementId, ChargingManagementCore_array_notificationMarkers_notificationRangeValue_elementId[@ChargingManagementCore_Notification_notificationMarkers_Element]);
  putValue (ChargingManagementCore_Notification_notificationMarkers_notificationTimeValue_elementId, ChargingManagementCore_array_notificationMarkers_notificationTimeValue_elementId[@ChargingManagementCore_Notification_notificationMarkers_Element]);
  
  @ChargingManagementCore_Notification_notificationMarkers_type_available                   = ChargingManagementCore_array_notificationMarkers_type_available[@ChargingManagementCore_Notification_notificationMarkers_Element];
  @ChargingManagementCore_Notification_notificationMarkers_notificationSocValue_available   = ChargingManagementCore_array_notificationMarkers_notificationSocValue_available[@ChargingManagementCore_Notification_notificationMarkers_Element];
  @ChargingManagementCore_Notification_notificationMarkers_notificationRangeValue_available = ChargingManagementCore_array_notificationMarkers_notificationRangeValue_available[@ChargingManagementCore_Notification_notificationMarkers_Element];
  @ChargingManagementCore_Notification_notificationMarkers_notificationTimeValue_available  = ChargingManagementCore_array_notificationMarkers_notificationTimeValue_available[@ChargingManagementCore_Notification_notificationMarkers_Element];
  @ChargingManagementCore_Notification_notificationMarkers_isToBeNotified_available         = ChargingManagementCore_array_notificationMarkers_isToBeNotified_available[@ChargingManagementCore_Notification_notificationMarkers_Element];
}







////////// notifications Notification //////////

on envVar ChargingManagementCore_Notification_LengthIndicator_Struct_notifications
{
  ChargingManagementCore_Notification_notifications();
}
on envVar ChargingManagementCore_Notification_LengthIndicator_Element_notifications
{
  ChargingManagementCore_Notification_notifications();
}
on envVar ChargingManagementCore_Notification_notifications_type
{
  ChargingManagementCore_array_notifications_type[@ChargingManagementCore_Notification_notifications_Element] = @this;
  ChargingManagementCore_Notification_notifications();
}
on envVar ChargingManagementCore_Notification_notifications_value
{
  ChargingManagementCore_array_notifications_value[@ChargingManagementCore_Notification_notifications_Element] = @this;
  ChargingManagementCore_Notification_notifications();
}
on envVar ChargingManagementCore_Notification_notifications_additionalInformation
{
  ChargingManagementCore_array_notifications_additionalInformation[@ChargingManagementCore_Notification_notifications_Element] = @this;
  ChargingManagementCore_Notification_notifications();
}
on envVar ChargingManagementCore_Notification_notifications_type_available
{
  ChargingManagementCore_array_notifications_type_available[@ChargingManagementCore_Notification_notifications_Element] = @this;
  ChargingManagementCore_Notification_notifications();
}
on envVar ChargingManagementCore_Notification_notifications_value_available
{
  ChargingManagementCore_array_notifications_value_available[@ChargingManagementCore_Notification_notifications_Element] = @this;
  ChargingManagementCore_Notification_notifications();
}
on envVar ChargingManagementCore_Notification_notifications_additionalInformation_available
{
  ChargingManagementCore_array_notifications_additionalInformation_available[@ChargingManagementCore_Notification_notifications_Element] = @this;
  ChargingManagementCore_Notification_notifications();
}
on envVar ChargingManagementCore_Notification_notifications_Payload
{
  ChargingManagementCore_Notification_notifications_update();
}


ChargingManagementCore_Notification_notifications()
{
  word payload_counter = 0;
  word start_pos       = 0;
  word element_length  = 0;
  
  // Length Indicator Struct - Platzhalter
  payload_counter = 0+4;
  start_pos = 0;
  
  for (j=0; j<@ChargingManagementCore_Notification_notifications_Element_TotalNum; j++)
  {
    ChargingManagementCore_array_notifications_available_functions[j] = ChargingManagementCore_array_notifications_type_available[j]
                                                                      + ChargingManagementCore_array_notifications_value_available[j]
                                                                      + ChargingManagementCore_array_notifications_additionalInformation_available[j];
    
    // Length Indicator Element - Platzhalter
    if (ChargingManagementCore_array_notifications_available_functions[j] > 0)
    {
      start_pos = payload_counter;
      payload_counter = payload_counter + 4;
    }
    else 
      start_pos = payload_counter;
    
    
    // 0 type (enum32)
    if (ChargingManagementCore_array_notifications_type_available[j] == 1)
    {
      tag_dataID = 0;
      ChargingManagementCore_payload_buffer_notifications[payload_counter++] = 2 * 16 /* Wiretype = 2 =^ 32 Bit */ + ((tag_dataID>>8) & 0x0F) /* DataID High Part */ ;
      ChargingManagementCore_payload_buffer_notifications[payload_counter++] = tag_dataID & 0xFF /* DataID Low Part */ ;
      
      ChargingManagementCore_payload_buffer_notifications[payload_counter++] = ChargingManagementCore_array_notifications_type[j]>>24 & 0xFF;
      ChargingManagementCore_payload_buffer_notifications[payload_counter++] = ChargingManagementCore_array_notifications_type[j]>>16 & 0xFF;
      ChargingManagementCore_payload_buffer_notifications[payload_counter++] = ChargingManagementCore_array_notifications_type[j]>> 8 & 0xFF;
      ChargingManagementCore_payload_buffer_notifications[payload_counter++] = ChargingManagementCore_array_notifications_type[j]     & 0xFF;
    }
    
    
    // 1 value (enum32)
    if (ChargingManagementCore_array_notifications_value_available[j] == 1)
    {
      tag_dataID = 1;
      ChargingManagementCore_payload_buffer_notifications[payload_counter++] = 2 * 16 /* Wiretype = 2 =^ 32 Bit */ + ((tag_dataID>>8) & 0x0F) /* DataID High Part */ ;
      ChargingManagementCore_payload_buffer_notifications[payload_counter++] = tag_dataID & 0xFF /* DataID Low Part */ ;
      
      ChargingManagementCore_payload_buffer_notifications[payload_counter++] = ChargingManagementCore_array_notifications_value[j]>>24 & 0xFF;
      ChargingManagementCore_payload_buffer_notifications[payload_counter++] = ChargingManagementCore_array_notifications_value[j]>>16 & 0xFF;
      ChargingManagementCore_payload_buffer_notifications[payload_counter++] = ChargingManagementCore_array_notifications_value[j]>> 8 & 0xFF;
      ChargingManagementCore_payload_buffer_notifications[payload_counter++] = ChargingManagementCore_array_notifications_value[j]     & 0xFF;
    }
    
    
    // 2 additionalInformation (enum32)
    if (ChargingManagementCore_array_notifications_additionalInformation_available[j] == 1)
    {
      tag_dataID = 2;
      ChargingManagementCore_payload_buffer_notifications[payload_counter++] = 2 * 16 /* Wiretype = 2 =^ 32 Bit */ + ((tag_dataID>>8) & 0x0F) /* DataID High Part */ ;
      ChargingManagementCore_payload_buffer_notifications[payload_counter++] = tag_dataID & 0xFF /* DataID Low Part */ ;
      
      ChargingManagementCore_payload_buffer_notifications[payload_counter++] = ChargingManagementCore_array_notifications_additionalInformation[j]>>24 & 0xFF;
      ChargingManagementCore_payload_buffer_notifications[payload_counter++] = ChargingManagementCore_array_notifications_additionalInformation[j]>>16 & 0xFF;
      ChargingManagementCore_payload_buffer_notifications[payload_counter++] = ChargingManagementCore_array_notifications_additionalInformation[j]>> 8 & 0xFF;
      ChargingManagementCore_payload_buffer_notifications[payload_counter++] = ChargingManagementCore_array_notifications_additionalInformation[j]     & 0xFF;
    }
    
    
    //Element Length
    element_length = payload_counter-start_pos;
    if (element_length >0) ChargingManagementCore_array_notifications_array_element_length[j] = element_length - 4;
    else                   ChargingManagementCore_array_notifications_array_element_length[j] = element_length;
    
    ChargingManagementCore_payload_buffer_notifications[start_pos++] = ChargingManagementCore_array_notifications_array_element_length[j]>>24 & 0xFF;
    ChargingManagementCore_payload_buffer_notifications[start_pos++] = ChargingManagementCore_array_notifications_array_element_length[j]>>16 & 0xFF;
    ChargingManagementCore_payload_buffer_notifications[start_pos++] = ChargingManagementCore_array_notifications_array_element_length[j]>> 8 & 0xFF;
    ChargingManagementCore_payload_buffer_notifications[start_pos++] = ChargingManagementCore_array_notifications_array_element_length[j]     & 0xFF;
    
    if (ChargingManagementCore_array_notifications_array_element_length[j] == 0) payload_counter = payload_counter+4;
  }
  
  // Struct Length
  ChargingManagementCore_array_notifications_struct_element_length = 4*@ChargingManagementCore_Notification_notifications_Element_TotalNum;

  for (k=0;k<@ChargingManagementCore_Notification_notifications_Element_TotalNum;k++)
    ChargingManagementCore_array_notifications_struct_element_length = ChargingManagementCore_array_notifications_struct_element_length + ChargingManagementCore_array_notifications_array_element_length[k];
  
  ChargingManagementCore_payload_buffer_notifications[0] = ChargingManagementCore_array_notifications_struct_element_length>>24 & 0xFF;
  ChargingManagementCore_payload_buffer_notifications[1] = ChargingManagementCore_array_notifications_struct_element_length>>16 & 0xFF;
  ChargingManagementCore_payload_buffer_notifications[2] = ChargingManagementCore_array_notifications_struct_element_length>> 8 & 0xFF;
  ChargingManagementCore_payload_buffer_notifications[3] = ChargingManagementCore_array_notifications_struct_element_length     & 0xFF;


  ChargingManagementCore_payload_length_notifications = ChargingManagementCore_array_notifications_struct_element_length+4;
  putvalue(ChargingManagementCore_Notification_notifications_Payload, ChargingManagementCore_payload_buffer_notifications, ChargingManagementCore_payload_length_notifications);
}

on envVar ChargingManagementCore_Notification_notifications_Element_TotalNum
{
  if (@this == 0) @this =  1;
  if (@this > 10) @this = 10;
  
  ChargingManagementCore_Notification_notifications();
  ChargingManagementCore_Notification_notifications_update();
}

on envVar ChargingManagementCore_Notification_notifications_Element
{
  ChargingManagementCore_Notification_notifications_update();
}

on envVar ChargingManagementCore_Notification_notifications_Element_Next
{
  if (@this == 1 && @ChargingManagementCore_Notification_notifications_Element < @ChargingManagementCore_Notification_notifications_Element_TotalNum - 1)
  {
    @ChargingManagementCore_Notification_notifications_Element = @ChargingManagementCore_Notification_notifications_Element + 1;
    ChargingManagementCore_Notification_notifications_update();
  }
}

on envVar ChargingManagementCore_Notification_notifications_Element_Previous
{
  if (@this == 1 && @ChargingManagementCore_Notification_notifications_Element > 0)
  {
    @ChargingManagementCore_Notification_notifications_Element = @ChargingManagementCore_Notification_notifications_Element - 1;
    ChargingManagementCore_Notification_notifications_update();
  }
}

ChargingManagementCore_Notification_notifications_update()
{
  @ChargingManagementCore_Notification_LengthIndicator_Element_notifications = ChargingManagementCore_array_notifications_array_element_length[@ChargingManagementCore_Notification_notifications_Element];
  @ChargingManagementCore_Notification_LengthIndicator_Struct_notifications  = ChargingManagementCore_array_notifications_struct_element_length;
  @ChargingManagementCore_Notification_Length_notifications                  = ChargingManagementCore_payload_length_notifications+8;
  
  @ChargingManagementCore_Notification_notifications_type                  = ChargingManagementCore_array_notifications_type[@ChargingManagementCore_Notification_notifications_Element];
  @ChargingManagementCore_Notification_notifications_value                 = ChargingManagementCore_array_notifications_value[@ChargingManagementCore_Notification_notifications_Element];
  @ChargingManagementCore_Notification_notifications_additionalInformation = ChargingManagementCore_array_notifications_additionalInformation[@ChargingManagementCore_Notification_notifications_Element];
  
  @ChargingManagementCore_Notification_notifications_type_available                  = ChargingManagementCore_array_notifications_type_available[@ChargingManagementCore_Notification_notifications_Element];
  @ChargingManagementCore_Notification_notifications_value_available                 = ChargingManagementCore_array_notifications_value_available[@ChargingManagementCore_Notification_notifications_Element];
  @ChargingManagementCore_Notification_notifications_additionalInformation_available = ChargingManagementCore_array_notifications_additionalInformation_available[@ChargingManagementCore_Notification_notifications_Element];
}






////////// pastErrorInformation Notification //////////

on envVar ChargingManagementCore_Notification_LengthIndicator_Struct_pastErrorInformation
{
  ChargingManagementCore_Notification_pastErrorInformation();
}
on envVar ChargingManagementCore_Notification_LengthIndicator_Element_pastErrorInformation
{
  ChargingManagementCore_Notification_pastErrorInformation();
}
on envVar ChargingManagementCore_Notification_pastErrorInformation_type
{
  ChargingManagementCore_array_pastErrorInformation_type[@ChargingManagementCore_Notification_pastErrorInformation_Element] = @this;
  ChargingManagementCore_Notification_pastErrorInformation();
}
on envVar ChargingManagementCore_Notification_pastErrorInformation_value
{
  ChargingManagementCore_array_pastErrorInformation_value[@ChargingManagementCore_Notification_pastErrorInformation_Element] = @this;
  ChargingManagementCore_Notification_pastErrorInformation();
}
on envVar ChargingManagementCore_Notification_pastErrorInformation_additionalInformation
{
  ChargingManagementCore_array_pastErrorInformation_additionalInformation[@ChargingManagementCore_Notification_pastErrorInformation_Element] = @this;
  ChargingManagementCore_Notification_pastErrorInformation();
}
on envVar ChargingManagementCore_Notification_pastErrorInformation_confirmedByUser
{
  ChargingManagementCore_array_pastErrorInformation_confirmedByUser[@ChargingManagementCore_Notification_pastErrorInformation_Element] = @this;
  ChargingManagementCore_Notification_pastErrorInformation();
}
on envVar ChargingManagementCore_Notification_pastErrorInformation_type_available
{
  ChargingManagementCore_array_pastErrorInformation_type_available[@ChargingManagementCore_Notification_pastErrorInformation_Element] = @this;
  ChargingManagementCore_Notification_pastErrorInformation();
}
on envVar ChargingManagementCore_Notification_pastErrorInformation_value_available
{
  ChargingManagementCore_array_pastErrorInformation_value_available[@ChargingManagementCore_Notification_pastErrorInformation_Element] = @this;
  ChargingManagementCore_Notification_pastErrorInformation();
}
on envVar ChargingManagementCore_Notification_pastErrorInformation_additionalInformation_available
{
  ChargingManagementCore_array_pastErrorInformation_additionalInformation_available[@ChargingManagementCore_Notification_pastErrorInformation_Element] = @this;
  ChargingManagementCore_Notification_pastErrorInformation();
}
on envVar ChargingManagementCore_Notification_pastErrorInformation_confirmedByUser_available
{
  ChargingManagementCore_array_pastErrorInformation_confirmedByUser_available[@ChargingManagementCore_Notification_pastErrorInformation_Element] = @this;
  ChargingManagementCore_Notification_pastErrorInformation();
}
on envVar ChargingManagementCore_Notification_pastErrorInformation_Payload
{
  ChargingManagementCore_Notification_pastErrorInformation_update();
}


ChargingManagementCore_Notification_pastErrorInformation()
{
  word payload_counter = 0;
  word start_pos       = 0;
  word element_length  = 0;
  
  // Length Indicator Struct - Platzhalter
  payload_counter = 0+4;
  start_pos = 0;
  
  for (j=0; j<@ChargingManagementCore_Notification_pastErrorInformation_Element_TotalNum; j++)
  {
    ChargingManagementCore_array_pastErrorInformation_available_functions[j] = ChargingManagementCore_array_pastErrorInformation_type_available[j]
                                                                             + ChargingManagementCore_array_pastErrorInformation_value_available[j]
                                                                             + ChargingManagementCore_array_pastErrorInformation_additionalInformation_available[j]
                                                                             + ChargingManagementCore_array_pastErrorInformation_confirmedByUser_available[j];
    
    // Length Indicator Element - Platzhalter
    if (ChargingManagementCore_array_pastErrorInformation_available_functions[j] > 0)
    {
      start_pos = payload_counter;
      payload_counter = payload_counter + 4;
    }
    else 
      start_pos = payload_counter;
    
    
    // 0 type (enum32)
    if (ChargingManagementCore_array_pastErrorInformation_type_available[j] == 1)
    {
      tag_dataID = 0;
      ChargingManagementCore_payload_buffer_pastErrorInformation[payload_counter++] = 2 * 16 /* Wiretype = 2 =^ 32 Bit */ + ((tag_dataID>>8) & 0x0F) /* DataID High Part */ ;
      ChargingManagementCore_payload_buffer_pastErrorInformation[payload_counter++] = tag_dataID & 0xFF /* DataID Low Part */ ;
      
      ChargingManagementCore_payload_buffer_pastErrorInformation[payload_counter++] = ChargingManagementCore_array_pastErrorInformation_type[j]>>24 & 0xFF;
      ChargingManagementCore_payload_buffer_pastErrorInformation[payload_counter++] = ChargingManagementCore_array_pastErrorInformation_type[j]>>16 & 0xFF;
      ChargingManagementCore_payload_buffer_pastErrorInformation[payload_counter++] = ChargingManagementCore_array_pastErrorInformation_type[j]>> 8 & 0xFF;
      ChargingManagementCore_payload_buffer_pastErrorInformation[payload_counter++] = ChargingManagementCore_array_pastErrorInformation_type[j]     & 0xFF;
    }
    
    
    // 1 value (enum32)
    if (ChargingManagementCore_array_pastErrorInformation_value_available[j] == 1)
    {
      tag_dataID = 1;
      ChargingManagementCore_payload_buffer_pastErrorInformation[payload_counter++] = 2 * 16 /* Wiretype = 2 =^ 32 Bit */ + ((tag_dataID>>8) & 0x0F) /* DataID High Part */ ;
      ChargingManagementCore_payload_buffer_pastErrorInformation[payload_counter++] = tag_dataID & 0xFF /* DataID Low Part */ ;
      
      ChargingManagementCore_payload_buffer_pastErrorInformation[payload_counter++] = ChargingManagementCore_array_pastErrorInformation_value[j]>>24 & 0xFF;
      ChargingManagementCore_payload_buffer_pastErrorInformation[payload_counter++] = ChargingManagementCore_array_pastErrorInformation_value[j]>>16 & 0xFF;
      ChargingManagementCore_payload_buffer_pastErrorInformation[payload_counter++] = ChargingManagementCore_array_pastErrorInformation_value[j]>> 8 & 0xFF;
      ChargingManagementCore_payload_buffer_pastErrorInformation[payload_counter++] = ChargingManagementCore_array_pastErrorInformation_value[j]     & 0xFF;
    }
    
    
    // 2 additionalInformation (enum32)
    if (ChargingManagementCore_array_pastErrorInformation_additionalInformation_available[j] == 1)
    {
      tag_dataID = 2;
      ChargingManagementCore_payload_buffer_pastErrorInformation[payload_counter++] = 2 * 16 /* Wiretype = 2 =^ 32 Bit */ + ((tag_dataID>>8) & 0x0F) /* DataID High Part */ ;
      ChargingManagementCore_payload_buffer_pastErrorInformation[payload_counter++] = tag_dataID & 0xFF /* DataID Low Part */ ;
      
      ChargingManagementCore_payload_buffer_pastErrorInformation[payload_counter++] = ChargingManagementCore_array_pastErrorInformation_additionalInformation[j]>>24 & 0xFF;
      ChargingManagementCore_payload_buffer_pastErrorInformation[payload_counter++] = ChargingManagementCore_array_pastErrorInformation_additionalInformation[j]>>16 & 0xFF;
      ChargingManagementCore_payload_buffer_pastErrorInformation[payload_counter++] = ChargingManagementCore_array_pastErrorInformation_additionalInformation[j]>> 8 & 0xFF;
      ChargingManagementCore_payload_buffer_pastErrorInformation[payload_counter++] = ChargingManagementCore_array_pastErrorInformation_additionalInformation[j]     & 0xFF;
    }
    
    
    // 3 confirmedByUser (boolean)
    if (ChargingManagementCore_array_pastErrorInformation_confirmedByUser_available[j] == 1)
    {
      tag_dataID = 3;
      ChargingManagementCore_payload_buffer_pastErrorInformation[payload_counter++] = 0 * 16 /* Wiretype = 0 =^ 8 Bit */ + ((tag_dataID>>8) & 0x0F) /* DataID High Part */ ;
      ChargingManagementCore_payload_buffer_pastErrorInformation[payload_counter++] = tag_dataID & 0xFF /* DataID Low Part */ ;
      
      ChargingManagementCore_payload_buffer_pastErrorInformation[payload_counter++] = ChargingManagementCore_array_pastErrorInformation_confirmedByUser[j]     & 0xFF;
    }
    
    
    //Element Length
    element_length = payload_counter-start_pos;
    if (element_length >0) ChargingManagementCore_array_pastErrorInformation_array_element_length[j] = element_length - 4;
    else                   ChargingManagementCore_array_pastErrorInformation_array_element_length[j] = element_length;
    
    ChargingManagementCore_payload_buffer_pastErrorInformation[start_pos++] = ChargingManagementCore_array_pastErrorInformation_array_element_length[j]>>24 & 0xFF;
    ChargingManagementCore_payload_buffer_pastErrorInformation[start_pos++] = ChargingManagementCore_array_pastErrorInformation_array_element_length[j]>>16 & 0xFF;
    ChargingManagementCore_payload_buffer_pastErrorInformation[start_pos++] = ChargingManagementCore_array_pastErrorInformation_array_element_length[j]>> 8 & 0xFF;
    ChargingManagementCore_payload_buffer_pastErrorInformation[start_pos++] = ChargingManagementCore_array_pastErrorInformation_array_element_length[j]     & 0xFF;
    
    if (ChargingManagementCore_array_pastErrorInformation_array_element_length[j] == 0) payload_counter = payload_counter+4;
  }
  
  // Struct Length
  ChargingManagementCore_array_pastErrorInformation_struct_element_length = 4*@ChargingManagementCore_Notification_pastErrorInformation_Element_TotalNum;

  for (k=0;k<@ChargingManagementCore_Notification_pastErrorInformation_Element_TotalNum;k++)
    ChargingManagementCore_array_pastErrorInformation_struct_element_length = ChargingManagementCore_array_pastErrorInformation_struct_element_length + ChargingManagementCore_array_pastErrorInformation_array_element_length[k];
  
  ChargingManagementCore_payload_buffer_pastErrorInformation[0] = ChargingManagementCore_array_pastErrorInformation_struct_element_length>>24 & 0xFF;
  ChargingManagementCore_payload_buffer_pastErrorInformation[1] = ChargingManagementCore_array_pastErrorInformation_struct_element_length>>16 & 0xFF;
  ChargingManagementCore_payload_buffer_pastErrorInformation[2] = ChargingManagementCore_array_pastErrorInformation_struct_element_length>> 8 & 0xFF;
  ChargingManagementCore_payload_buffer_pastErrorInformation[3] = ChargingManagementCore_array_pastErrorInformation_struct_element_length     & 0xFF;


  ChargingManagementCore_payload_length_pastErrorInformation = ChargingManagementCore_array_pastErrorInformation_struct_element_length+4;
  putvalue(ChargingManagementCore_Notification_pastErrorInformation_Payload, ChargingManagementCore_payload_buffer_pastErrorInformation, ChargingManagementCore_payload_length_pastErrorInformation);
}

on envVar ChargingManagementCore_Notification_pastErrorInformation_Element_TotalNum
{
  if (@this == 0) @this =  1;
  if (@this > 10) @this = 10;
  
  ChargingManagementCore_Notification_pastErrorInformation();
  ChargingManagementCore_Notification_pastErrorInformation_update();
}

on envVar ChargingManagementCore_Notification_pastErrorInformation_Element
{
  ChargingManagementCore_Notification_pastErrorInformation_update();
}

on envVar ChargingManagementCore_Notification_pastErrorInformation_Element_Next
{
  if (@this == 1 && @ChargingManagementCore_Notification_pastErrorInformation_Element < @ChargingManagementCore_Notification_pastErrorInformation_Element_TotalNum - 1)
  {
    @ChargingManagementCore_Notification_pastErrorInformation_Element = @ChargingManagementCore_Notification_pastErrorInformation_Element + 1;
    ChargingManagementCore_Notification_pastErrorInformation_update();
  }
}

on envVar ChargingManagementCore_Notification_pastErrorInformation_Element_Previous
{
  if (@this == 1 && @ChargingManagementCore_Notification_pastErrorInformation_Element > 0)
  {
    @ChargingManagementCore_Notification_pastErrorInformation_Element = @ChargingManagementCore_Notification_pastErrorInformation_Element - 1;
    ChargingManagementCore_Notification_pastErrorInformation_update();
  }
}

ChargingManagementCore_Notification_pastErrorInformation_update()
{
  @ChargingManagementCore_Notification_LengthIndicator_Element_pastErrorInformation = ChargingManagementCore_array_pastErrorInformation_array_element_length[@ChargingManagementCore_Notification_pastErrorInformation_Element];
  @ChargingManagementCore_Notification_LengthIndicator_Struct_pastErrorInformation  = ChargingManagementCore_array_pastErrorInformation_struct_element_length;
  @ChargingManagementCore_Notification_Length_pastErrorInformation                  = ChargingManagementCore_payload_length_pastErrorInformation+8;
  
  @ChargingManagementCore_Notification_pastErrorInformation_type                  = ChargingManagementCore_array_pastErrorInformation_type[@ChargingManagementCore_Notification_pastErrorInformation_Element];
  @ChargingManagementCore_Notification_pastErrorInformation_value                 = ChargingManagementCore_array_pastErrorInformation_value[@ChargingManagementCore_Notification_pastErrorInformation_Element];
  @ChargingManagementCore_Notification_pastErrorInformation_additionalInformation = ChargingManagementCore_array_pastErrorInformation_additionalInformation[@ChargingManagementCore_Notification_pastErrorInformation_Element];
  @ChargingManagementCore_Notification_pastErrorInformation_confirmedByUser       = ChargingManagementCore_array_pastErrorInformation_confirmedByUser[@ChargingManagementCore_Notification_pastErrorInformation_Element];
  
  @ChargingManagementCore_Notification_pastErrorInformation_type_available                  = ChargingManagementCore_array_pastErrorInformation_type_available[@ChargingManagementCore_Notification_pastErrorInformation_Element];
  @ChargingManagementCore_Notification_pastErrorInformation_value_available                 = ChargingManagementCore_array_pastErrorInformation_value_available[@ChargingManagementCore_Notification_pastErrorInformation_Element];
  @ChargingManagementCore_Notification_pastErrorInformation_additionalInformation_available = ChargingManagementCore_array_pastErrorInformation_additionalInformation_available[@ChargingManagementCore_Notification_pastErrorInformation_Element];
  @ChargingManagementCore_Notification_pastErrorInformation_confirmedByUser_available       = ChargingManagementCore_array_pastErrorInformation_confirmedByUser_available[@ChargingManagementCore_Notification_pastErrorInformation_Element];
}





////////// views Notification //////////

on envVar ChargingManagementCore_Notification_LengthIndicator_Struct_views
{
  ChargingManagementCore_Notification_views();
}
on envVar ChargingManagementCore_Notification_LengthIndicator_Element_views
{
  ChargingManagementCore_Notification_views();
}
on envVar ChargingManagementCore_Notification_views_type
{
  ChargingManagementCore_array_views_type[@ChargingManagementCore_Notification_views_Element] = @this;
  ChargingManagementCore_Notification_views();
}
on envVar ChargingManagementCore_Notification_views_content
{
  ChargingManagementCore_array_views_content[@ChargingManagementCore_Notification_views_Element] = @this;
  ChargingManagementCore_Notification_views();
}
on envVar ChargingManagementCore_Notification_views_visibility
{
  ChargingManagementCore_array_views_visibility[@ChargingManagementCore_Notification_views_Element] = @this;
  ChargingManagementCore_Notification_views();
}
on envVar ChargingManagementCore_Notification_views_type_available
{
  ChargingManagementCore_array_views_type_available[@ChargingManagementCore_Notification_views_Element] = @this;
  ChargingManagementCore_Notification_views();
}
on envVar ChargingManagementCore_Notification_views_content_available
{
  ChargingManagementCore_array_views_content_available[@ChargingManagementCore_Notification_views_Element] = @this;
  ChargingManagementCore_Notification_views();
}
on envVar ChargingManagementCore_Notification_views_visibility_available
{
  ChargingManagementCore_array_views_visibility_available[@ChargingManagementCore_Notification_views_Element] = @this;
  ChargingManagementCore_Notification_views();
}
on envVar ChargingManagementCore_Notification_views_Payload
{
  ChargingManagementCore_Notification_views_update();
}


ChargingManagementCore_Notification_views()
{
  word payload_counter = 0;
  word start_pos       = 0;
  word element_length  = 0;
  
  // Length Indicator Struct - Platzhalter
  payload_counter = 0+4;
  start_pos = 0;
  
  for (j=0; j<@ChargingManagementCore_Notification_views_Element_TotalNum; j++)
  {
    ChargingManagementCore_array_views_available_functions[j] = ChargingManagementCore_array_views_type_available[j]
                                                              + ChargingManagementCore_array_views_content_available[j]
                                                              + ChargingManagementCore_array_views_visibility_available[j];
    
    // Length Indicator Element - Platzhalter
    if (ChargingManagementCore_array_views_available_functions[j] > 0)
    {
      start_pos = payload_counter;
      payload_counter = payload_counter + 4;
    }
    else 
      start_pos = payload_counter;
    
    
    // 0 type (enum32)
    if (ChargingManagementCore_array_views_type_available[j] == 1)
    {
      tag_dataID = 0;
      ChargingManagementCore_payload_buffer_views[payload_counter++] = 2 * 16 /* Wiretype = 2 =^ 32 Bit */ + ((tag_dataID>>8) & 0x0F) /* DataID High Part */ ;
      ChargingManagementCore_payload_buffer_views[payload_counter++] = tag_dataID & 0xFF /* DataID Low Part */ ;
      
      ChargingManagementCore_payload_buffer_views[payload_counter++] = ChargingManagementCore_array_views_type[j]>>24 & 0xFF;
      ChargingManagementCore_payload_buffer_views[payload_counter++] = ChargingManagementCore_array_views_type[j]>>16 & 0xFF;
      ChargingManagementCore_payload_buffer_views[payload_counter++] = ChargingManagementCore_array_views_type[j]>> 8 & 0xFF;
      ChargingManagementCore_payload_buffer_views[payload_counter++] = ChargingManagementCore_array_views_type[j]     & 0xFF;
    }
    
    
    // 1 content (enum32)
    if (ChargingManagementCore_array_views_content_available[j] == 1)
    {
      tag_dataID = 1;
      ChargingManagementCore_payload_buffer_views[payload_counter++] = 2 * 16 /* Wiretype = 2 =^ 32 Bit */ + ((tag_dataID>>8) & 0x0F) /* DataID High Part */ ;
      ChargingManagementCore_payload_buffer_views[payload_counter++] = tag_dataID & 0xFF /* DataID Low Part */ ;
      
      ChargingManagementCore_payload_buffer_views[payload_counter++] = ChargingManagementCore_array_views_content[j]>>24 & 0xFF;
      ChargingManagementCore_payload_buffer_views[payload_counter++] = ChargingManagementCore_array_views_content[j]>>16 & 0xFF;
      ChargingManagementCore_payload_buffer_views[payload_counter++] = ChargingManagementCore_array_views_content[j]>> 8 & 0xFF;
      ChargingManagementCore_payload_buffer_views[payload_counter++] = ChargingManagementCore_array_views_content[j]     & 0xFF;
    }
    
    
    // 2 visibility (enum32)
    if (ChargingManagementCore_array_views_visibility_available[j] == 1)
    {
      tag_dataID = 2;
      ChargingManagementCore_payload_buffer_views[payload_counter++] = 2 * 16 /* Wiretype = 2 =^ 32 Bit */ + ((tag_dataID>>8) & 0x0F) /* DataID High Part */ ;
      ChargingManagementCore_payload_buffer_views[payload_counter++] = tag_dataID & 0xFF /* DataID Low Part */ ;
      
      ChargingManagementCore_payload_buffer_views[payload_counter++] = ChargingManagementCore_array_views_visibility[j]>>24 & 0xFF;
      ChargingManagementCore_payload_buffer_views[payload_counter++] = ChargingManagementCore_array_views_visibility[j]>>16 & 0xFF;
      ChargingManagementCore_payload_buffer_views[payload_counter++] = ChargingManagementCore_array_views_visibility[j]>> 8 & 0xFF;
      ChargingManagementCore_payload_buffer_views[payload_counter++] = ChargingManagementCore_array_views_visibility[j]     & 0xFF;
    }
    
    
    //Element Length
    element_length = payload_counter-start_pos;
    if (element_length >0) ChargingManagementCore_array_views_array_element_length[j] = element_length - 4;
    else                   ChargingManagementCore_array_views_array_element_length[j] = element_length;
    
    ChargingManagementCore_payload_buffer_views[start_pos++] = ChargingManagementCore_array_views_array_element_length[j]>>24 & 0xFF;
    ChargingManagementCore_payload_buffer_views[start_pos++] = ChargingManagementCore_array_views_array_element_length[j]>>16 & 0xFF;
    ChargingManagementCore_payload_buffer_views[start_pos++] = ChargingManagementCore_array_views_array_element_length[j]>> 8 & 0xFF;
    ChargingManagementCore_payload_buffer_views[start_pos++] = ChargingManagementCore_array_views_array_element_length[j]     & 0xFF;
    
    if (ChargingManagementCore_array_views_array_element_length[j] == 0) payload_counter = payload_counter+4;
  }
  
  // Struct Length
  ChargingManagementCore_array_views_struct_element_length = 4*@ChargingManagementCore_Notification_views_Element_TotalNum;

  for (k=0;k<@ChargingManagementCore_Notification_views_Element_TotalNum;k++)
    ChargingManagementCore_array_views_struct_element_length = ChargingManagementCore_array_views_struct_element_length + ChargingManagementCore_array_views_array_element_length[k];
  
  ChargingManagementCore_payload_buffer_views[0] = ChargingManagementCore_array_views_struct_element_length>>24 & 0xFF;
  ChargingManagementCore_payload_buffer_views[1] = ChargingManagementCore_array_views_struct_element_length>>16 & 0xFF;
  ChargingManagementCore_payload_buffer_views[2] = ChargingManagementCore_array_views_struct_element_length>> 8 & 0xFF;
  ChargingManagementCore_payload_buffer_views[3] = ChargingManagementCore_array_views_struct_element_length     & 0xFF;


  ChargingManagementCore_payload_length_views = ChargingManagementCore_array_views_struct_element_length+4;
  putvalue(ChargingManagementCore_Notification_views_Payload, ChargingManagementCore_payload_buffer_views, ChargingManagementCore_payload_length_views);
}

on envVar ChargingManagementCore_Notification_views_Element_TotalNum
{
  if (@this == 0) @this =  1;
  if (@this > 10) @this = 10;
  
  ChargingManagementCore_Notification_views();
  ChargingManagementCore_Notification_views_update();
}

on envVar ChargingManagementCore_Notification_views_Element
{
  ChargingManagementCore_Notification_views_update();
}

on envVar ChargingManagementCore_Notification_views_Element_Next
{
  if (@this == 1 && @ChargingManagementCore_Notification_views_Element < @ChargingManagementCore_Notification_views_Element_TotalNum - 1)
  {
    @ChargingManagementCore_Notification_views_Element = @ChargingManagementCore_Notification_views_Element + 1;
    ChargingManagementCore_Notification_views_update();
  }
}

on envVar ChargingManagementCore_Notification_views_Element_Previous
{
  if (@this == 1 && @ChargingManagementCore_Notification_views_Element > 0)
  {
    @ChargingManagementCore_Notification_views_Element = @ChargingManagementCore_Notification_views_Element - 1;
    ChargingManagementCore_Notification_views_update();
  }
}

ChargingManagementCore_Notification_views_update()
{
  @ChargingManagementCore_Notification_LengthIndicator_Element_views = ChargingManagementCore_array_views_array_element_length[@ChargingManagementCore_Notification_views_Element];
  @ChargingManagementCore_Notification_LengthIndicator_Struct_views  = ChargingManagementCore_array_views_struct_element_length;
  @ChargingManagementCore_Notification_Length_views                  = ChargingManagementCore_payload_length_views+8;
  
  @ChargingManagementCore_Notification_views_type       = ChargingManagementCore_array_views_type[@ChargingManagementCore_Notification_views_Element];
  @ChargingManagementCore_Notification_views_content    = ChargingManagementCore_array_views_content[@ChargingManagementCore_Notification_views_Element];
  @ChargingManagementCore_Notification_views_visibility = ChargingManagementCore_array_views_visibility[@ChargingManagementCore_Notification_views_Element];
  
  @ChargingManagementCore_Notification_views_type_available       = ChargingManagementCore_array_views_type_available[@ChargingManagementCore_Notification_views_Element];
  @ChargingManagementCore_Notification_views_content_available    = ChargingManagementCore_array_views_content_available[@ChargingManagementCore_Notification_views_Element];
  @ChargingManagementCore_Notification_views_visibility_available = ChargingManagementCore_array_views_visibility_available[@ChargingManagementCore_Notification_views_Element];
}






////////// oruUpdateApprovals Notification //////////

on envVar ChargingManagementCore_Notification_LengthIndicator_Struct_oruUpdateApprovals
{
  ChargingManagementCore_Notification_oruUpdateApprovals();
}
on envVar ChargingManagementCore_Notification_LengthIndicator_Element_oruUpdateApprovals
{
  ChargingManagementCore_Notification_oruUpdateApprovals();
}
on envVar ChargingManagementCore_Notification_oruUpdateApprovals_type
{
  ChargingManagementCore_array_oruUpdateApprovals_type[@ChargingManagementCore_Notification_oruUpdateApprovals_Element] = @this;
  ChargingManagementCore_Notification_oruUpdateApprovals();
}
on envVar ChargingManagementCore_Notification_oruUpdateApprovals_updateApproval
{
  ChargingManagementCore_array_oruUpdateApprovals_updateApproval[@ChargingManagementCore_Notification_oruUpdateApprovals_Element] = @this;
  ChargingManagementCore_Notification_oruUpdateApprovals();
}
on envVar ChargingManagementCore_Notification_oruUpdateApprovals_type_available
{
  ChargingManagementCore_array_oruUpdateApprovals_type_available[@ChargingManagementCore_Notification_oruUpdateApprovals_Element] = @this;
  ChargingManagementCore_Notification_oruUpdateApprovals();
}
on envVar ChargingManagementCore_Notification_oruUpdateApprovals_updateApproval_available
{
  ChargingManagementCore_array_oruUpdateApprovals_updateApproval_available[@ChargingManagementCore_Notification_oruUpdateApprovals_Element] = @this;
  ChargingManagementCore_Notification_oruUpdateApprovals();
}
on envVar ChargingManagementCore_Notification_oruUpdateApprovals_Payload
{
  ChargingManagementCore_Notification_oruUpdateApprovals_update();
}


ChargingManagementCore_Notification_oruUpdateApprovals()
{
  word payload_counter = 0;
  word start_pos       = 0;
  word element_length  = 0;
  
  // Length Indicator Struct - Platzhalter
  payload_counter = 0+4;
  start_pos = 0;
  
  for (j=0; j<@ChargingManagementCore_Notification_oruUpdateApprovals_Element_TotalNum; j++)
  {
    ChargingManagementCore_array_oruUpdateApprovals_available_functions[j] = ChargingManagementCore_array_oruUpdateApprovals_type_available[j]
                                                                           + ChargingManagementCore_array_oruUpdateApprovals_updateApproval_available[j];
    
    // Length Indicator Element - Platzhalter
    if (ChargingManagementCore_array_oruUpdateApprovals_available_functions[j] > 0)
    {
      start_pos = payload_counter;
      payload_counter = payload_counter + 4;
    }
    else 
      start_pos = payload_counter;
    
    
    // 0 type (enum32)
    if (ChargingManagementCore_array_oruUpdateApprovals_type_available[j] == 1)
    {
      tag_dataID = 0;
      ChargingManagementCore_payload_buffer_oruUpdateApprovals[payload_counter++] = 2 * 16 /* Wiretype = 2 =^ 32 Bit */ + ((tag_dataID>>8) & 0x0F) /* DataID High Part */ ;
      ChargingManagementCore_payload_buffer_oruUpdateApprovals[payload_counter++] = tag_dataID & 0xFF /* DataID Low Part */ ;
      
      ChargingManagementCore_payload_buffer_oruUpdateApprovals[payload_counter++] = ChargingManagementCore_array_oruUpdateApprovals_type[j]>>24 & 0xFF;
      ChargingManagementCore_payload_buffer_oruUpdateApprovals[payload_counter++] = ChargingManagementCore_array_oruUpdateApprovals_type[j]>>16 & 0xFF;
      ChargingManagementCore_payload_buffer_oruUpdateApprovals[payload_counter++] = ChargingManagementCore_array_oruUpdateApprovals_type[j]>> 8 & 0xFF;
      ChargingManagementCore_payload_buffer_oruUpdateApprovals[payload_counter++] = ChargingManagementCore_array_oruUpdateApprovals_type[j]     & 0xFF;
    }
    
    
    // 1 updateApproval (boolean)
    if (ChargingManagementCore_array_oruUpdateApprovals_updateApproval_available[j] == 1)
    {
      tag_dataID = 1;
      ChargingManagementCore_payload_buffer_oruUpdateApprovals[payload_counter++] = 0 * 16 /* Wiretype = 0 =^ 8 Bit */ + ((tag_dataID>>8) & 0x0F) /* DataID High Part */ ;
      ChargingManagementCore_payload_buffer_oruUpdateApprovals[payload_counter++] = tag_dataID & 0xFF /* DataID Low Part */ ;
      
      ChargingManagementCore_payload_buffer_oruUpdateApprovals[payload_counter++] = ChargingManagementCore_array_oruUpdateApprovals_updateApproval[j]     & 0xFF;
    }
    
    
    //Element Length
    element_length = payload_counter-start_pos;
    if (element_length >0) ChargingManagementCore_array_oruUpdateApprovals_array_element_length[j] = element_length - 4;
    else                   ChargingManagementCore_array_oruUpdateApprovals_array_element_length[j] = element_length;
    
    ChargingManagementCore_payload_buffer_oruUpdateApprovals[start_pos++] = ChargingManagementCore_array_oruUpdateApprovals_array_element_length[j]>>24 & 0xFF;
    ChargingManagementCore_payload_buffer_oruUpdateApprovals[start_pos++] = ChargingManagementCore_array_oruUpdateApprovals_array_element_length[j]>>16 & 0xFF;
    ChargingManagementCore_payload_buffer_oruUpdateApprovals[start_pos++] = ChargingManagementCore_array_oruUpdateApprovals_array_element_length[j]>> 8 & 0xFF;
    ChargingManagementCore_payload_buffer_oruUpdateApprovals[start_pos++] = ChargingManagementCore_array_oruUpdateApprovals_array_element_length[j]     & 0xFF;
    
    if (ChargingManagementCore_array_oruUpdateApprovals_array_element_length[j] == 0) payload_counter = payload_counter+4;
  }
  
  // Struct Length
  ChargingManagementCore_array_oruUpdateApprovals_struct_element_length = 4*@ChargingManagementCore_Notification_oruUpdateApprovals_Element_TotalNum;

  for (k=0;k<@ChargingManagementCore_Notification_oruUpdateApprovals_Element_TotalNum;k++)
    ChargingManagementCore_array_oruUpdateApprovals_struct_element_length = ChargingManagementCore_array_oruUpdateApprovals_struct_element_length + ChargingManagementCore_array_oruUpdateApprovals_array_element_length[k];
  
  ChargingManagementCore_payload_buffer_oruUpdateApprovals[0] = ChargingManagementCore_array_oruUpdateApprovals_struct_element_length>>24 & 0xFF;
  ChargingManagementCore_payload_buffer_oruUpdateApprovals[1] = ChargingManagementCore_array_oruUpdateApprovals_struct_element_length>>16 & 0xFF;
  ChargingManagementCore_payload_buffer_oruUpdateApprovals[2] = ChargingManagementCore_array_oruUpdateApprovals_struct_element_length>> 8 & 0xFF;
  ChargingManagementCore_payload_buffer_oruUpdateApprovals[3] = ChargingManagementCore_array_oruUpdateApprovals_struct_element_length     & 0xFF;


  ChargingManagementCore_payload_length_oruUpdateApprovals = ChargingManagementCore_array_oruUpdateApprovals_struct_element_length+4;
  putvalue(ChargingManagementCore_Notification_oruUpdateApprovals_Payload, ChargingManagementCore_payload_buffer_oruUpdateApprovals, ChargingManagementCore_payload_length_oruUpdateApprovals);
}

on envVar ChargingManagementCore_Notification_oruUpdateApprovals_Element_TotalNum
{
  if (@this == 0) @this =  1;
  if (@this > 10) @this = 10;
  
  ChargingManagementCore_Notification_oruUpdateApprovals();
  ChargingManagementCore_Notification_oruUpdateApprovals_update();
}

on envVar ChargingManagementCore_Notification_oruUpdateApprovals_Element
{
  ChargingManagementCore_Notification_oruUpdateApprovals_update();
}

on envVar ChargingManagementCore_Notification_oruUpdateApprovals_Element_Next
{
  if (@this == 1 && @ChargingManagementCore_Notification_oruUpdateApprovals_Element < @ChargingManagementCore_Notification_oruUpdateApprovals_Element_TotalNum - 1)
  {
    @ChargingManagementCore_Notification_oruUpdateApprovals_Element = @ChargingManagementCore_Notification_oruUpdateApprovals_Element + 1;
    ChargingManagementCore_Notification_oruUpdateApprovals_update();
  }
}

on envVar ChargingManagementCore_Notification_oruUpdateApprovals_Element_Previous
{
  if (@this == 1 && @ChargingManagementCore_Notification_oruUpdateApprovals_Element > 0)
  {
    @ChargingManagementCore_Notification_oruUpdateApprovals_Element = @ChargingManagementCore_Notification_oruUpdateApprovals_Element - 1;
    ChargingManagementCore_Notification_oruUpdateApprovals_update();
  }
}

ChargingManagementCore_Notification_oruUpdateApprovals_update()
{
  @ChargingManagementCore_Notification_LengthIndicator_Element_oruUpdateApprovals = ChargingManagementCore_array_oruUpdateApprovals_array_element_length[@ChargingManagementCore_Notification_oruUpdateApprovals_Element];
  @ChargingManagementCore_Notification_LengthIndicator_Struct_oruUpdateApprovals  = ChargingManagementCore_array_oruUpdateApprovals_struct_element_length;
  @ChargingManagementCore_Notification_Length_oruUpdateApprovals                  = ChargingManagementCore_payload_length_oruUpdateApprovals+8;
  
  @ChargingManagementCore_Notification_oruUpdateApprovals_type           = ChargingManagementCore_array_oruUpdateApprovals_type[@ChargingManagementCore_Notification_oruUpdateApprovals_Element];
  @ChargingManagementCore_Notification_oruUpdateApprovals_updateApproval = ChargingManagementCore_array_oruUpdateApprovals_updateApproval[@ChargingManagementCore_Notification_oruUpdateApprovals_Element];
  
  @ChargingManagementCore_Notification_oruUpdateApprovals_type_available           = ChargingManagementCore_array_oruUpdateApprovals_type_available[@ChargingManagementCore_Notification_oruUpdateApprovals_Element];
  @ChargingManagementCore_Notification_oruUpdateApprovals_updateApproval_available = ChargingManagementCore_array_oruUpdateApprovals_updateApproval_available[@ChargingManagementCore_Notification_oruUpdateApprovals_Element];
}







////////// switchControls Notification //////////

on envVar ChargingManagementCore_Notification_LengthIndicator_Struct_switchControls
{
  ChargingManagementCore_Notification_switchControls();
}
on envVar ChargingManagementCore_Notification_LengthIndicator_Element_switchControls
{
  ChargingManagementCore_Notification_switchControls();
}
on envVar ChargingManagementCore_Notification_switchControls_id
{
  getvalue(this, buffer_uuid);
  for (k=0;k<16;k++)
    ChargingManagementCore_array_switchControls_id[@ChargingManagementCore_Notification_switchControls_Element][k] = buffer_uuid[k];
  ChargingManagementCore_Notification_switchControls();
}
on envVar ChargingManagementCore_Notification_switchControls_switchValue
{
  ChargingManagementCore_array_switchControls_switchValue[@ChargingManagementCore_Notification_switchControls_Element] = @this;
  ChargingManagementCore_Notification_switchControls();
}
on envVar ChargingManagementCore_Notification_switchControls_switchValueConfiguration
{
  ChargingManagementCore_array_switchControls_switchValueConfiguration[@ChargingManagementCore_Notification_switchControls_Element][@ChargingManagementCore_Notification_switchControls_switchValueConfiguration_Element] = @this;
  ChargingManagementCore_Notification_switchControls();
}
on envVar ChargingManagementCore_Notification_switchControls_restrictionReason
{
  ChargingManagementCore_array_switchControls_restrictionReason[@ChargingManagementCore_Notification_switchControls_Element] = @this;
  ChargingManagementCore_Notification_switchControls();
}
on envVar ChargingManagementCore_Notification_switchControls_type
{
  ChargingManagementCore_array_switchControls_type[@ChargingManagementCore_Notification_switchControls_Element] = @this;
  ChargingManagementCore_Notification_switchControls();
}
on envVar ChargingManagementCore_Notification_switchControls_id_available
{
  ChargingManagementCore_array_switchControls_id_available[@ChargingManagementCore_Notification_switchControls_Element] = @this;
  ChargingManagementCore_Notification_switchControls();
}
on envVar ChargingManagementCore_Notification_switchControls_switchValue_available
{
  ChargingManagementCore_array_switchControls_switchValue_available[@ChargingManagementCore_Notification_switchControls_Element] = @this;
  ChargingManagementCore_Notification_switchControls();
}
on envVar ChargingManagementCore_Notification_switchControls_switchValueConfiguration_available
{
  ChargingManagementCore_array_switchControls_switchValueConfiguration_available[@ChargingManagementCore_Notification_switchControls_Element] = @this;
  ChargingManagementCore_Notification_switchControls();
}
on envVar ChargingManagementCore_Notification_switchControls_restrictionReason_available
{
  ChargingManagementCore_array_switchControls_restrictionReason_available[@ChargingManagementCore_Notification_switchControls_Element] = @this;
  ChargingManagementCore_Notification_switchControls();
}
on envVar ChargingManagementCore_Notification_switchControls_type_available
{
  ChargingManagementCore_array_switchControls_type_available[@ChargingManagementCore_Notification_switchControls_Element] = @this;
  ChargingManagementCore_Notification_switchControls();
}
on envVar ChargingManagementCore_Notification_switchControls_Payload
{
  ChargingManagementCore_Notification_switchControls_update();
}


ChargingManagementCore_Notification_switchControls()
{
  word payload_counter = 0;
  word start_pos       = 0;
  word element_length  = 0;
  
  // Length Indicator Struct - Platzhalter
  payload_counter = 0+4;
  start_pos = 0;
  
  for (j=0; j<@ChargingManagementCore_Notification_switchControls_Element_TotalNum; j++)
  {
    ChargingManagementCore_array_switchControls_available_functions[j] = ChargingManagementCore_array_switchControls_id_available[j]
                                                                       + ChargingManagementCore_array_switchControls_switchValue_available[j]
                                                                       + ChargingManagementCore_array_switchControls_switchValueConfiguration_available[j]
                                                                       + ChargingManagementCore_array_switchControls_restrictionReason_available[j]
                                                                       + ChargingManagementCore_array_switchControls_type_available[j];
    
    // Length Indicator Element - Platzhalter
    if (ChargingManagementCore_array_switchControls_available_functions[j] > 0)
    {
      start_pos = payload_counter;
      payload_counter = payload_counter + 4;
    }
    else 
      start_pos = payload_counter;
    
    
    // 0 id (uuid 16byte)
    if (ChargingManagementCore_array_switchControls_id_available[j] == 1)
    {
      tag_dataID = 0;
      ChargingManagementCore_payload_buffer_switchControls[payload_counter++] = 5 * 16 /* Wiretype = 5 =^ Array mit 1 Byte Länge */ + ((tag_dataID>>8) & 0x0F) /* DataID High Part */ ;
      ChargingManagementCore_payload_buffer_switchControls[payload_counter++] = tag_dataID & 0xFF /* DataID Low Part */ ;
      
      ChargingManagementCore_payload_buffer_switchControls[payload_counter++] = 16; // Array Length
      
      for (k=0; k<16; k++)
        ChargingManagementCore_payload_buffer_switchControls[payload_counter++] = ChargingManagementCore_array_switchControls_id[j][k] & 0xFF;
    }
    
    
    // 1 switchValue (enum32)
    if (ChargingManagementCore_array_switchControls_switchValue_available[j] == 1)
    {
      tag_dataID = 1;
      ChargingManagementCore_payload_buffer_switchControls[payload_counter++] = 2 * 16 /* Wiretype = 2 =^ 32 Bit */ + ((tag_dataID>>8) & 0x0F) /* DataID High Part */ ;
      ChargingManagementCore_payload_buffer_switchControls[payload_counter++] = tag_dataID & 0xFF /* DataID Low Part */ ;
      
      ChargingManagementCore_payload_buffer_switchControls[payload_counter++] = ChargingManagementCore_array_switchControls_switchValue[j]>>24 & 0xFF;
      ChargingManagementCore_payload_buffer_switchControls[payload_counter++] = ChargingManagementCore_array_switchControls_switchValue[j]>>16 & 0xFF;
      ChargingManagementCore_payload_buffer_switchControls[payload_counter++] = ChargingManagementCore_array_switchControls_switchValue[j]>> 8 & 0xFF;
      ChargingManagementCore_payload_buffer_switchControls[payload_counter++] = ChargingManagementCore_array_switchControls_switchValue[j]     & 0xFF;
    }
    
    
    // 2 switchValueConfiguration (enum32 array)
    if (ChargingManagementCore_array_switchControls_switchValueConfiguration_available[j] == 1)
    {
      tag_dataID = 2;
      ChargingManagementCore_payload_buffer_switchControls[payload_counter++] = 7 * 16 /* Wiretype = 7 =^ Array mit 4 Byte Länge */ + ((tag_dataID>>8) & 0x0F) /* DataID High Part */ ;
      ChargingManagementCore_payload_buffer_switchControls[payload_counter++] = tag_dataID & 0xFF /* DataID Low Part */ ;
      
      // Array Length
      ChargingManagementCore_array_switchControls_switchValueConfiguration_length = 4 * ChargingManagementCore_array_switchControls_switchValueConfiguration_nr_of_elements[j];
      ChargingManagementCore_payload_buffer_switchControls[payload_counter++] = ChargingManagementCore_array_switchControls_switchValueConfiguration_length>>24 & 0xFF;
      ChargingManagementCore_payload_buffer_switchControls[payload_counter++] = ChargingManagementCore_array_switchControls_switchValueConfiguration_length>>16 & 0xFF;
      ChargingManagementCore_payload_buffer_switchControls[payload_counter++] = ChargingManagementCore_array_switchControls_switchValueConfiguration_length>> 8 & 0xFF;
      ChargingManagementCore_payload_buffer_switchControls[payload_counter++] = ChargingManagementCore_array_switchControls_switchValueConfiguration_length     & 0xFF;
      
      for (k=0; k<ChargingManagementCore_array_switchControls_switchValueConfiguration_nr_of_elements[j]; k++)
      {
        ChargingManagementCore_payload_buffer_switchControls[payload_counter++] = ChargingManagementCore_array_switchControls_switchValueConfiguration[j][k]>>24 & 0xFF;
        ChargingManagementCore_payload_buffer_switchControls[payload_counter++] = ChargingManagementCore_array_switchControls_switchValueConfiguration[j][k]>>16 & 0xFF;
        ChargingManagementCore_payload_buffer_switchControls[payload_counter++] = ChargingManagementCore_array_switchControls_switchValueConfiguration[j][k]>> 8 & 0xFF;
        ChargingManagementCore_payload_buffer_switchControls[payload_counter++] = ChargingManagementCore_array_switchControls_switchValueConfiguration[j][k]     & 0xFF;
      }
    }
    
    
    // 3 restrictionReason (enum32)
    if (ChargingManagementCore_array_switchControls_restrictionReason_available[j] == 1)
    {
      tag_dataID = 3;
      ChargingManagementCore_payload_buffer_switchControls[payload_counter++] = 2 * 16 /* Wiretype = 2 =^ 32 Bit */ + ((tag_dataID>>8) & 0x0F) /* DataID High Part */ ;
      ChargingManagementCore_payload_buffer_switchControls[payload_counter++] = tag_dataID & 0xFF /* DataID Low Part */ ;
      
      ChargingManagementCore_payload_buffer_switchControls[payload_counter++] = ChargingManagementCore_array_switchControls_restrictionReason[j]>>24 & 0xFF;
      ChargingManagementCore_payload_buffer_switchControls[payload_counter++] = ChargingManagementCore_array_switchControls_restrictionReason[j]>>16 & 0xFF;
      ChargingManagementCore_payload_buffer_switchControls[payload_counter++] = ChargingManagementCore_array_switchControls_restrictionReason[j]>> 8 & 0xFF;
      ChargingManagementCore_payload_buffer_switchControls[payload_counter++] = ChargingManagementCore_array_switchControls_restrictionReason[j]     & 0xFF;
    }
    
    
    // 4 type (enum32)
    if (ChargingManagementCore_array_switchControls_type_available[j] == 1)
    {
      tag_dataID = 4;
      ChargingManagementCore_payload_buffer_switchControls[payload_counter++] = 2 * 16 /* Wiretype = 2 =^ 32 Bit */ + ((tag_dataID>>8) & 0x0F) /* DataID High Part */ ;
      ChargingManagementCore_payload_buffer_switchControls[payload_counter++] = tag_dataID & 0xFF /* DataID Low Part */ ;
      
      ChargingManagementCore_payload_buffer_switchControls[payload_counter++] = ChargingManagementCore_array_switchControls_type[j]>>24 & 0xFF;
      ChargingManagementCore_payload_buffer_switchControls[payload_counter++] = ChargingManagementCore_array_switchControls_type[j]>>16 & 0xFF;
      ChargingManagementCore_payload_buffer_switchControls[payload_counter++] = ChargingManagementCore_array_switchControls_type[j]>> 8 & 0xFF;
      ChargingManagementCore_payload_buffer_switchControls[payload_counter++] = ChargingManagementCore_array_switchControls_type[j]     & 0xFF;
    }
    
    
    //Element Length
    element_length = payload_counter-start_pos;
    if (element_length >0) ChargingManagementCore_array_switchControls_array_element_length[j] = element_length - 4;
    else                   ChargingManagementCore_array_switchControls_array_element_length[j] = element_length;
    
    ChargingManagementCore_payload_buffer_switchControls[start_pos++] = ChargingManagementCore_array_switchControls_array_element_length[j]>>24 & 0xFF;
    ChargingManagementCore_payload_buffer_switchControls[start_pos++] = ChargingManagementCore_array_switchControls_array_element_length[j]>>16 & 0xFF;
    ChargingManagementCore_payload_buffer_switchControls[start_pos++] = ChargingManagementCore_array_switchControls_array_element_length[j]>> 8 & 0xFF;
    ChargingManagementCore_payload_buffer_switchControls[start_pos++] = ChargingManagementCore_array_switchControls_array_element_length[j]     & 0xFF;
    
    if (ChargingManagementCore_array_switchControls_array_element_length[j] == 0) payload_counter = payload_counter+4;
  }
  
  // Struct Length
  ChargingManagementCore_array_switchControls_struct_element_length = 4*@ChargingManagementCore_Notification_switchControls_Element_TotalNum;

  for (k=0;k<@ChargingManagementCore_Notification_switchControls_Element_TotalNum;k++)
    ChargingManagementCore_array_switchControls_struct_element_length = ChargingManagementCore_array_switchControls_struct_element_length + ChargingManagementCore_array_switchControls_array_element_length[k];
  
  ChargingManagementCore_payload_buffer_switchControls[0] = ChargingManagementCore_array_switchControls_struct_element_length>>24 & 0xFF;
  ChargingManagementCore_payload_buffer_switchControls[1] = ChargingManagementCore_array_switchControls_struct_element_length>>16 & 0xFF;
  ChargingManagementCore_payload_buffer_switchControls[2] = ChargingManagementCore_array_switchControls_struct_element_length>> 8 & 0xFF;
  ChargingManagementCore_payload_buffer_switchControls[3] = ChargingManagementCore_array_switchControls_struct_element_length     & 0xFF;


  ChargingManagementCore_payload_length_switchControls = ChargingManagementCore_array_switchControls_struct_element_length+4;
  putvalue(ChargingManagementCore_Notification_switchControls_Payload, ChargingManagementCore_payload_buffer_switchControls, ChargingManagementCore_payload_length_switchControls);
}

on envVar ChargingManagementCore_Notification_switchControls_Element_TotalNum
{
  if (@this == 0) @this =  1;
  if (@this > 10) @this = 10;
  
  ChargingManagementCore_Notification_switchControls();
  ChargingManagementCore_Notification_switchControls_update();
}

on envVar ChargingManagementCore_Notification_switchControls_Element
{
  ChargingManagementCore_Notification_switchControls_update();
}

on envVar ChargingManagementCore_Notification_switchControls_Element_Next
{
  if (@this == 1 && @ChargingManagementCore_Notification_switchControls_Element < @ChargingManagementCore_Notification_switchControls_Element_TotalNum - 1)
  {
    @ChargingManagementCore_Notification_switchControls_Element = @ChargingManagementCore_Notification_switchControls_Element + 1;
    ChargingManagementCore_Notification_switchControls_update();
  }
}

on envVar ChargingManagementCore_Notification_switchControls_Element_Previous
{
  if (@this == 1 && @ChargingManagementCore_Notification_switchControls_Element > 0)
  {
    @ChargingManagementCore_Notification_switchControls_Element = @ChargingManagementCore_Notification_switchControls_Element - 1;
    ChargingManagementCore_Notification_switchControls_update();
  }
}

on envVar ChargingManagementCore_Notification_switchControls_switchValueConfiguration_Element_TotalNum
{
  if (@this == 0) @this =  1;
  if (@this > 10) @this = 10;
  
  ChargingManagementCore_array_switchControls_switchValueConfiguration_nr_of_elements[@ChargingManagementCore_Notification_switchControls_Element] = @this;
  ChargingManagementCore_Notification_switchControls();
  ChargingManagementCore_Notification_switchControls_update();
}

on envVar ChargingManagementCore_Notification_switchControls_switchValueConfiguration_Element
{
  ChargingManagementCore_Notification_switchControls_update();
}

on envVar ChargingManagementCore_Notification_switchControls_switchValueConfiguration_Element_Next
{
  if (@this == 1 && @ChargingManagementCore_Notification_switchControls_switchValueConfiguration_Element < @ChargingManagementCore_Notification_switchControls_switchValueConfiguration_Element_TotalNum - 1)
  {
    @ChargingManagementCore_Notification_switchControls_switchValueConfiguration_Element = @ChargingManagementCore_Notification_switchControls_switchValueConfiguration_Element + 1;
    
    @ChargingManagementCore_Notification_switchControls_switchValueConfiguration = ChargingManagementCore_array_switchControls_switchValueConfiguration[@ChargingManagementCore_Notification_switchControls_Element][@ChargingManagementCore_Notification_switchControls_switchValueConfiguration_Element];
  }
}

on envVar ChargingManagementCore_Notification_switchControls_switchValueConfiguration_Element_Previous
{
  if (@this == 1 && @ChargingManagementCore_Notification_switchControls_switchValueConfiguration_Element > 0)
  {
    @ChargingManagementCore_Notification_switchControls_switchValueConfiguration_Element = @ChargingManagementCore_Notification_switchControls_switchValueConfiguration_Element - 1;
    
    @ChargingManagementCore_Notification_switchControls_switchValueConfiguration = ChargingManagementCore_array_switchControls_switchValueConfiguration[@ChargingManagementCore_Notification_switchControls_Element][@ChargingManagementCore_Notification_switchControls_switchValueConfiguration_Element];
  }
}

ChargingManagementCore_Notification_switchControls_update()
{
  @ChargingManagementCore_Notification_LengthIndicator_Element_switchControls = ChargingManagementCore_array_switchControls_array_element_length[@ChargingManagementCore_Notification_switchControls_Element];
  @ChargingManagementCore_Notification_LengthIndicator_Struct_switchControls  = ChargingManagementCore_array_switchControls_struct_element_length;
  @ChargingManagementCore_Notification_Length_switchControls                  = ChargingManagementCore_payload_length_switchControls+8;
  
  @ChargingManagementCore_Notification_switchControls_switchValue              = ChargingManagementCore_array_switchControls_switchValue[@ChargingManagementCore_Notification_switchControls_Element];
  @ChargingManagementCore_Notification_switchControls_switchValueConfiguration = ChargingManagementCore_array_switchControls_switchValueConfiguration[@ChargingManagementCore_Notification_switchControls_Element][@ChargingManagementCore_Notification_switchControls_switchValueConfiguration_Element];
  @ChargingManagementCore_Notification_switchControls_restrictionReason        = ChargingManagementCore_array_switchControls_restrictionReason[@ChargingManagementCore_Notification_switchControls_Element];
  @ChargingManagementCore_Notification_switchControls_type                     = ChargingManagementCore_array_switchControls_type[@ChargingManagementCore_Notification_switchControls_Element];
  
  putValue (ChargingManagementCore_Notification_switchControls_id, ChargingManagementCore_array_switchControls_id[@ChargingManagementCore_Notification_switchControls_Element]);
  
  @ChargingManagementCore_Notification_switchControls_switchValueConfiguration_Element_TotalNum = ChargingManagementCore_array_switchControls_switchValueConfiguration_nr_of_elements[@ChargingManagementCore_Notification_switchControls_Element];
  
  @ChargingManagementCore_Notification_switchControls_id_available                       = ChargingManagementCore_array_switchControls_id_available[@ChargingManagementCore_Notification_switchControls_Element];
  @ChargingManagementCore_Notification_switchControls_switchValue_available              = ChargingManagementCore_array_switchControls_switchValue_available[@ChargingManagementCore_Notification_switchControls_Element];
  @ChargingManagementCore_Notification_switchControls_switchValueConfiguration_available = ChargingManagementCore_array_switchControls_switchValueConfiguration_available[@ChargingManagementCore_Notification_switchControls_Element];
  @ChargingManagementCore_Notification_switchControls_restrictionReason_available        = ChargingManagementCore_array_switchControls_restrictionReason_available[@ChargingManagementCore_Notification_switchControls_Element];
  @ChargingManagementCore_Notification_switchControls_type_available                     = ChargingManagementCore_array_switchControls_type_available[@ChargingManagementCore_Notification_switchControls_Element];
}






////////// valueControls Notification //////////

on envVar ChargingManagementCore_Notification_LengthIndicator_Struct_valueControls
{
  ChargingManagementCore_Notification_valueControls();
}
on envVar ChargingManagementCore_Notification_LengthIndicator_Element_valueControls
{
  ChargingManagementCore_Notification_valueControls();
}
on envVar ChargingManagementCore_Notification_valueControls_id
{
  getvalue(this, buffer_uuid);
  for (k=0;k<16;k++)
    ChargingManagementCore_array_valueControls_id[@ChargingManagementCore_Notification_valueControls_Element][k] = buffer_uuid[k];
  ChargingManagementCore_Notification_valueControls();
}
on envVar ChargingManagementCore_Notification_valueControls_currentValue
{
  ChargingManagementCore_array_valueControls_currentValue[@ChargingManagementCore_Notification_valueControls_Element] = @this;
  ChargingManagementCore_Notification_valueControls();
}
on envVar ChargingManagementCore_Notification_valueControls_maxValue
{
  ChargingManagementCore_array_valueControls_maxValue[@ChargingManagementCore_Notification_valueControls_Element] = @this;
  ChargingManagementCore_Notification_valueControls();
}
on envVar ChargingManagementCore_Notification_valueControls_minValue
{
  ChargingManagementCore_array_valueControls_minValue[@ChargingManagementCore_Notification_valueControls_Element] = @this;
  ChargingManagementCore_Notification_valueControls();
}
on envVar ChargingManagementCore_Notification_valueControls_unitPercent
{
  ChargingManagementCore_array_valueControls_unitPercent[@ChargingManagementCore_Notification_valueControls_Element] = @this;
  ChargingManagementCore_Notification_valueControls();
}
on envVar ChargingManagementCore_Notification_valueControls_unitDistance
{
  ChargingManagementCore_array_valueControls_unitDistance[@ChargingManagementCore_Notification_valueControls_Element] = @this;
  ChargingManagementCore_Notification_valueControls();
}
on envVar ChargingManagementCore_Notification_valueControls_unitTime
{
  ChargingManagementCore_array_valueControls_unitTime[@ChargingManagementCore_Notification_valueControls_Element] = @this;
  ChargingManagementCore_Notification_valueControls();
}
on envVar ChargingManagementCore_Notification_valueControls_resolution
{
  ChargingManagementCore_array_valueControls_resolution[@ChargingManagementCore_Notification_valueControls_Element] = @this;
  ChargingManagementCore_Notification_valueControls();
}
on envVar ChargingManagementCore_Notification_valueControls_restrictionReason
{
  ChargingManagementCore_array_valueControls_restrictionReason[@ChargingManagementCore_Notification_valueControls_Element] = @this;
  ChargingManagementCore_Notification_valueControls();
}
on envVar ChargingManagementCore_Notification_valueControls_type
{
  ChargingManagementCore_array_valueControls_type[@ChargingManagementCore_Notification_valueControls_Element] = @this;
  ChargingManagementCore_Notification_valueControls();
}
on envVar ChargingManagementCore_Notification_valueControls_specialState
{
  ChargingManagementCore_array_valueControls_specialState[@ChargingManagementCore_Notification_valueControls_Element] = @this;
  ChargingManagementCore_Notification_valueControls();
}
on envVar ChargingManagementCore_Notification_valueControls_specialStateConfiguration
{
  ChargingManagementCore_array_valueControls_specialStateConfiguration[@ChargingManagementCore_Notification_valueControls_Element][@ChargingManagementCore_Notification_valueControls_specialStateConfiguration_Element] = @this;
  ChargingManagementCore_Notification_valueControls();
}
on envVar ChargingManagementCore_Notification_valueControls_id_available
{
  ChargingManagementCore_array_valueControls_id_available[@ChargingManagementCore_Notification_valueControls_Element] = @this;
  ChargingManagementCore_Notification_valueControls();
}
on envVar ChargingManagementCore_Notification_valueControls_currentValue_available
{
  ChargingManagementCore_array_valueControls_currentValue_available[@ChargingManagementCore_Notification_valueControls_Element] = @this;
  ChargingManagementCore_Notification_valueControls();
}
on envVar ChargingManagementCore_Notification_valueControls_maxValue_available
{
  ChargingManagementCore_array_valueControls_maxValue_available[@ChargingManagementCore_Notification_valueControls_Element] = @this;
  ChargingManagementCore_Notification_valueControls();
}
on envVar ChargingManagementCore_Notification_valueControls_minValue_available
{
  ChargingManagementCore_array_valueControls_minValue_available[@ChargingManagementCore_Notification_valueControls_Element] = @this;
  ChargingManagementCore_Notification_valueControls();
}
on envVar ChargingManagementCore_Notification_valueControls_unitPercent_available
{
  ChargingManagementCore_array_valueControls_unitPercent_available[@ChargingManagementCore_Notification_valueControls_Element] = @this;
  ChargingManagementCore_Notification_valueControls();
}
on envVar ChargingManagementCore_Notification_valueControls_unitDistance_available
{
  ChargingManagementCore_array_valueControls_unitDistance_available[@ChargingManagementCore_Notification_valueControls_Element] = @this;
  ChargingManagementCore_Notification_valueControls();
}
on envVar ChargingManagementCore_Notification_valueControls_unitTime_available
{
  ChargingManagementCore_array_valueControls_unitTime_available[@ChargingManagementCore_Notification_valueControls_Element] = @this;
  ChargingManagementCore_Notification_valueControls();
}
on envVar ChargingManagementCore_Notification_valueControls_resolution_available
{
  ChargingManagementCore_array_valueControls_resolution_available[@ChargingManagementCore_Notification_valueControls_Element] = @this;
  ChargingManagementCore_Notification_valueControls();
}
on envVar ChargingManagementCore_Notification_valueControls_restrictionReason_available
{
  ChargingManagementCore_array_valueControls_restrictionReason_available[@ChargingManagementCore_Notification_valueControls_Element] = @this;
  ChargingManagementCore_Notification_valueControls();
}
on envVar ChargingManagementCore_Notification_valueControls_type_available
{
  ChargingManagementCore_array_valueControls_type_available[@ChargingManagementCore_Notification_valueControls_Element] = @this;
  ChargingManagementCore_Notification_valueControls();
}
on envVar ChargingManagementCore_Notification_valueControls_specialState_available
{
  ChargingManagementCore_array_valueControls_specialState_available[@ChargingManagementCore_Notification_valueControls_Element] = @this;
  ChargingManagementCore_Notification_valueControls();
}
on envVar ChargingManagementCore_Notification_valueControls_specialStateConfiguration_available
{
  ChargingManagementCore_array_valueControls_specialStateConfiguration_available[@ChargingManagementCore_Notification_valueControls_Element] = @this;
  ChargingManagementCore_Notification_valueControls();
}
on envVar ChargingManagementCore_Notification_valueControls_Payload
{
  ChargingManagementCore_Notification_valueControls_update();
}


ChargingManagementCore_Notification_valueControls()
{
  word payload_counter = 0;
  word start_pos       = 0;
  word element_length  = 0;
  
  // Length Indicator Struct - Platzhalter
  payload_counter = 0+4;
  start_pos = 0;
  
  for (j=0; j<@ChargingManagementCore_Notification_valueControls_Element_TotalNum; j++)
  {
    ChargingManagementCore_array_valueControls_available_functions[j] = ChargingManagementCore_array_valueControls_id_available[j]
                                                                      + ChargingManagementCore_array_valueControls_currentValue_available[j]
                                                                      + ChargingManagementCore_array_valueControls_maxValue_available[j]
                                                                      + ChargingManagementCore_array_valueControls_minValue_available[j]
                                                                      + ChargingManagementCore_array_valueControls_unitPercent_available[j]
                                                                      + ChargingManagementCore_array_valueControls_unitDistance_available[j]
                                                                      + ChargingManagementCore_array_valueControls_unitTime_available[j]
                                                                      + ChargingManagementCore_array_valueControls_resolution_available[j]
                                                                      + ChargingManagementCore_array_valueControls_restrictionReason_available[j]
                                                                      + ChargingManagementCore_array_valueControls_type_available[j]
                                                                      + ChargingManagementCore_array_valueControls_specialState_available[j]
                                                                      + ChargingManagementCore_array_valueControls_specialStateConfiguration_available[j];

    
    // Length Indicator Element - Platzhalter
    if (ChargingManagementCore_array_valueControls_available_functions[j] > 0)
    {
      start_pos = payload_counter;
      payload_counter = payload_counter + 4;
    }
    else 
      start_pos = payload_counter;
    
    
    // 0 id (uuid 16byte)
    if (ChargingManagementCore_array_valueControls_id_available[j] == 1)
    {
      tag_dataID = 0;
      ChargingManagementCore_payload_buffer_valueControls[payload_counter++] = 5 * 16 /* Wiretype = 5 =^ Array mit 1 Byte Länge */ + ((tag_dataID>>8) & 0x0F) /* DataID High Part */ ;
      ChargingManagementCore_payload_buffer_valueControls[payload_counter++] = tag_dataID & 0xFF /* DataID Low Part */ ;
      
      ChargingManagementCore_payload_buffer_valueControls[payload_counter++] = 16; // Array Length
      
      for (k=0; k<16; k++)
        ChargingManagementCore_payload_buffer_valueControls[payload_counter++] = ChargingManagementCore_array_valueControls_id[j][k] & 0xFF;
    }
    
    // 1 currentValue (uint32)
    if (ChargingManagementCore_array_valueControls_currentValue_available[j] == 1)
    {
      tag_dataID = 1;
      ChargingManagementCore_payload_buffer_valueControls[payload_counter++] = 2 * 16 /* Wiretype = 2 =^ 32 Bit */ + ((tag_dataID>>8) & 0x0F) /* DataID High Part */ ;
      ChargingManagementCore_payload_buffer_valueControls[payload_counter++] = tag_dataID & 0xFF /* DataID Low Part */ ;
      
      ChargingManagementCore_payload_buffer_valueControls[payload_counter++] = ChargingManagementCore_array_valueControls_currentValue[j]>>24 & 0xFF;
      ChargingManagementCore_payload_buffer_valueControls[payload_counter++] = ChargingManagementCore_array_valueControls_currentValue[j]>>16 & 0xFF;
      ChargingManagementCore_payload_buffer_valueControls[payload_counter++] = ChargingManagementCore_array_valueControls_currentValue[j]>> 8 & 0xFF;
      ChargingManagementCore_payload_buffer_valueControls[payload_counter++] = ChargingManagementCore_array_valueControls_currentValue[j]     & 0xFF;
    }
    
    // 2 maxValue (uint32)
    if (ChargingManagementCore_array_valueControls_maxValue_available[j] == 1)
    {
      tag_dataID = 2;
      ChargingManagementCore_payload_buffer_valueControls[payload_counter++] = 2 * 16 /* Wiretype = 2 =^ 32 Bit */ + ((tag_dataID>>8) & 0x0F) /* DataID High Part */ ;
      ChargingManagementCore_payload_buffer_valueControls[payload_counter++] = tag_dataID & 0xFF /* DataID Low Part */ ;
      
      ChargingManagementCore_payload_buffer_valueControls[payload_counter++] = ChargingManagementCore_array_valueControls_maxValue[j]>>24 & 0xFF;
      ChargingManagementCore_payload_buffer_valueControls[payload_counter++] = ChargingManagementCore_array_valueControls_maxValue[j]>>16 & 0xFF;
      ChargingManagementCore_payload_buffer_valueControls[payload_counter++] = ChargingManagementCore_array_valueControls_maxValue[j]>> 8 & 0xFF;
      ChargingManagementCore_payload_buffer_valueControls[payload_counter++] = ChargingManagementCore_array_valueControls_maxValue[j]     & 0xFF;
    }
    
    
    // 3 minValue (uint32)
    if (ChargingManagementCore_array_valueControls_minValue_available[j] == 1)
    {
      tag_dataID = 3;
      ChargingManagementCore_payload_buffer_valueControls[payload_counter++] = 2 * 16 /* Wiretype = 2 =^ 32 Bit */ + ((tag_dataID>>8) & 0x0F) /* DataID High Part */ ;
      ChargingManagementCore_payload_buffer_valueControls[payload_counter++] = tag_dataID & 0xFF /* DataID Low Part */ ;
      
      ChargingManagementCore_payload_buffer_valueControls[payload_counter++] = ChargingManagementCore_array_valueControls_minValue[j]>>24 & 0xFF;
      ChargingManagementCore_payload_buffer_valueControls[payload_counter++] = ChargingManagementCore_array_valueControls_minValue[j]>>16 & 0xFF;
      ChargingManagementCore_payload_buffer_valueControls[payload_counter++] = ChargingManagementCore_array_valueControls_minValue[j]>> 8 & 0xFF;
      ChargingManagementCore_payload_buffer_valueControls[payload_counter++] = ChargingManagementCore_array_valueControls_minValue[j]     & 0xFF;
    }
    
    
    // 4 unitPercent (enum32)
    if (ChargingManagementCore_array_valueControls_unitPercent_available[j] == 1)
    {
      tag_dataID = 4;
      ChargingManagementCore_payload_buffer_valueControls[payload_counter++] = 2 * 16 /* Wiretype = 2 =^ 32 Bit */ + ((tag_dataID>>8) & 0x0F) /* DataID High Part */ ;
      ChargingManagementCore_payload_buffer_valueControls[payload_counter++] = tag_dataID & 0xFF /* DataID Low Part */ ;
      
      ChargingManagementCore_payload_buffer_valueControls[payload_counter++] = ChargingManagementCore_array_valueControls_unitPercent[j]>>24 & 0xFF;
      ChargingManagementCore_payload_buffer_valueControls[payload_counter++] = ChargingManagementCore_array_valueControls_unitPercent[j]>>16 & 0xFF;
      ChargingManagementCore_payload_buffer_valueControls[payload_counter++] = ChargingManagementCore_array_valueControls_unitPercent[j]>> 8 & 0xFF;
      ChargingManagementCore_payload_buffer_valueControls[payload_counter++] = ChargingManagementCore_array_valueControls_unitPercent[j]     & 0xFF;
    }
    
    
    // 5 unitDistance (enum32)
    if (ChargingManagementCore_array_valueControls_unitDistance_available[j] == 1)
    {
      tag_dataID = 5;
      ChargingManagementCore_payload_buffer_valueControls[payload_counter++] = 2 * 16 /* Wiretype = 2 =^ 32 Bit */ + ((tag_dataID>>8) & 0x0F) /* DataID High Part */ ;
      ChargingManagementCore_payload_buffer_valueControls[payload_counter++] = tag_dataID & 0xFF /* DataID Low Part */ ;
      
      ChargingManagementCore_payload_buffer_valueControls[payload_counter++] = ChargingManagementCore_array_valueControls_unitDistance[j]>>24 & 0xFF;
      ChargingManagementCore_payload_buffer_valueControls[payload_counter++] = ChargingManagementCore_array_valueControls_unitDistance[j]>>16 & 0xFF;
      ChargingManagementCore_payload_buffer_valueControls[payload_counter++] = ChargingManagementCore_array_valueControls_unitDistance[j]>> 8 & 0xFF;
      ChargingManagementCore_payload_buffer_valueControls[payload_counter++] = ChargingManagementCore_array_valueControls_unitDistance[j]     & 0xFF;
    }
    
    
    // 6 unitTime (uint32)
    if (ChargingManagementCore_array_valueControls_unitTime_available[j] == 1)
    {
      tag_dataID = 6;
      ChargingManagementCore_payload_buffer_valueControls[payload_counter++] = 2 * 16 /* Wiretype = 2 =^ 32 Bit */ + ((tag_dataID>>8) & 0x0F) /* DataID High Part */ ;
      ChargingManagementCore_payload_buffer_valueControls[payload_counter++] = tag_dataID & 0xFF /* DataID Low Part */ ;
      
      ChargingManagementCore_payload_buffer_valueControls[payload_counter++] = ChargingManagementCore_array_valueControls_unitTime[j]>>24 & 0xFF;
      ChargingManagementCore_payload_buffer_valueControls[payload_counter++] = ChargingManagementCore_array_valueControls_unitTime[j]>>16 & 0xFF;
      ChargingManagementCore_payload_buffer_valueControls[payload_counter++] = ChargingManagementCore_array_valueControls_unitTime[j]>> 8 & 0xFF;
      ChargingManagementCore_payload_buffer_valueControls[payload_counter++] = ChargingManagementCore_array_valueControls_unitTime[j]     & 0xFF;
    }
    
    
    // 7 resolution (uint32)
    if (ChargingManagementCore_array_valueControls_resolution_available[j] == 1)
    {
      tag_dataID = 1;
      ChargingManagementCore_payload_buffer_valueControls[payload_counter++] = 2 * 16 /* Wiretype = 2 =^ 32 Bit */ + ((tag_dataID>>8) & 0x0F) /* DataID High Part */ ;
      ChargingManagementCore_payload_buffer_valueControls[payload_counter++] = tag_dataID & 0xFF /* DataID Low Part */ ;
      
      ChargingManagementCore_payload_buffer_valueControls[payload_counter++] = ChargingManagementCore_array_valueControls_resolution[j]>>24 & 0xFF;
      ChargingManagementCore_payload_buffer_valueControls[payload_counter++] = ChargingManagementCore_array_valueControls_resolution[j]>>16 & 0xFF;
      ChargingManagementCore_payload_buffer_valueControls[payload_counter++] = ChargingManagementCore_array_valueControls_resolution[j]>> 8 & 0xFF;
      ChargingManagementCore_payload_buffer_valueControls[payload_counter++] = ChargingManagementCore_array_valueControls_resolution[j]     & 0xFF;
    }
    
    
    // 8 restrictionReason (enum32)
    if (ChargingManagementCore_array_valueControls_restrictionReason_available[j] == 1)
    {
      tag_dataID = 8;
      ChargingManagementCore_payload_buffer_valueControls[payload_counter++] = 2 * 16 /* Wiretype = 2 =^ 32 Bit */ + ((tag_dataID>>8) & 0x0F) /* DataID High Part */ ;
      ChargingManagementCore_payload_buffer_valueControls[payload_counter++] = tag_dataID & 0xFF /* DataID Low Part */ ;
      
      ChargingManagementCore_payload_buffer_valueControls[payload_counter++] = ChargingManagementCore_array_valueControls_restrictionReason[j]>>24 & 0xFF;
      ChargingManagementCore_payload_buffer_valueControls[payload_counter++] = ChargingManagementCore_array_valueControls_restrictionReason[j]>>16 & 0xFF;
      ChargingManagementCore_payload_buffer_valueControls[payload_counter++] = ChargingManagementCore_array_valueControls_restrictionReason[j]>> 8 & 0xFF;
      ChargingManagementCore_payload_buffer_valueControls[payload_counter++] = ChargingManagementCore_array_valueControls_restrictionReason[j]     & 0xFF;
    }
    
    
    // 9 unitDistance (enum32)
    if (ChargingManagementCore_array_valueControls_unitDistance_available[j] == 1)
    {
      tag_dataID = 9;
      ChargingManagementCore_payload_buffer_valueControls[payload_counter++] = 2 * 16 /* Wiretype = 2 =^ 32 Bit */ + ((tag_dataID>>8) & 0x0F) /* DataID High Part */ ;
      ChargingManagementCore_payload_buffer_valueControls[payload_counter++] = tag_dataID & 0xFF /* DataID Low Part */ ;
      
      ChargingManagementCore_payload_buffer_valueControls[payload_counter++] = ChargingManagementCore_array_valueControls_type[j]>>24 & 0xFF;
      ChargingManagementCore_payload_buffer_valueControls[payload_counter++] = ChargingManagementCore_array_valueControls_type[j]>>16 & 0xFF;
      ChargingManagementCore_payload_buffer_valueControls[payload_counter++] = ChargingManagementCore_array_valueControls_type[j]>> 8 & 0xFF;
      ChargingManagementCore_payload_buffer_valueControls[payload_counter++] = ChargingManagementCore_array_valueControls_type[j]     & 0xFF;
    }
    
    
    // 10 specialState (enum32)
    if (ChargingManagementCore_array_valueControls_specialState_available[j] == 1)
    {
      tag_dataID = 10;
      ChargingManagementCore_payload_buffer_valueControls[payload_counter++] = 2 * 16 /* Wiretype = 2 =^ 32 Bit */ + ((tag_dataID>>8) & 0x0F) /* DataID High Part */ ;
      ChargingManagementCore_payload_buffer_valueControls[payload_counter++] = tag_dataID & 0xFF /* DataID Low Part */ ;
      
      ChargingManagementCore_payload_buffer_valueControls[payload_counter++] = ChargingManagementCore_array_valueControls_specialState[j]>>24 & 0xFF;
      ChargingManagementCore_payload_buffer_valueControls[payload_counter++] = ChargingManagementCore_array_valueControls_specialState[j]>>16 & 0xFF;
      ChargingManagementCore_payload_buffer_valueControls[payload_counter++] = ChargingManagementCore_array_valueControls_specialState[j]>> 8 & 0xFF;
      ChargingManagementCore_payload_buffer_valueControls[payload_counter++] = ChargingManagementCore_array_valueControls_specialState[j]     & 0xFF;
    }
    
    
    // 11 specialStateConfiguration (enum32 array)
    if (ChargingManagementCore_array_valueControls_specialStateConfiguration_available[j] == 1)
    {
      tag_dataID = 11;
      ChargingManagementCore_payload_buffer_valueControls[payload_counter++] = 7 * 16 /* Wiretype = 7 =^ Array mit 4 Byte Länge */ + ((tag_dataID>>8) & 0x0F) /* DataID High Part */ ;
      ChargingManagementCore_payload_buffer_valueControls[payload_counter++] = tag_dataID & 0xFF /* DataID Low Part */ ;
      
      // Array Length
      ChargingManagementCore_array_valueControls_specialStateConfiguration_length = 4 * ChargingManagementCore_array_valueControls_specialStateConfiguration_nr_of_elements[j];
      ChargingManagementCore_payload_buffer_valueControls[payload_counter++] = ChargingManagementCore_array_valueControls_specialStateConfiguration_length>>24 & 0xFF;
      ChargingManagementCore_payload_buffer_valueControls[payload_counter++] = ChargingManagementCore_array_valueControls_specialStateConfiguration_length>>16 & 0xFF;
      ChargingManagementCore_payload_buffer_valueControls[payload_counter++] = ChargingManagementCore_array_valueControls_specialStateConfiguration_length>> 8 & 0xFF;
      ChargingManagementCore_payload_buffer_valueControls[payload_counter++] = ChargingManagementCore_array_valueControls_specialStateConfiguration_length     & 0xFF;
      
      for (k=0; k<ChargingManagementCore_array_valueControls_specialStateConfiguration_nr_of_elements[j]; k++)
      {
        ChargingManagementCore_payload_buffer_valueControls[payload_counter++] = ChargingManagementCore_array_valueControls_specialStateConfiguration[j][k]>>24 & 0xFF;
        ChargingManagementCore_payload_buffer_valueControls[payload_counter++] = ChargingManagementCore_array_valueControls_specialStateConfiguration[j][k]>>16 & 0xFF;
        ChargingManagementCore_payload_buffer_valueControls[payload_counter++] = ChargingManagementCore_array_valueControls_specialStateConfiguration[j][k]>> 8 & 0xFF;
        ChargingManagementCore_payload_buffer_valueControls[payload_counter++] = ChargingManagementCore_array_valueControls_specialStateConfiguration[j][k]     & 0xFF;
      }
    }
    
    
    //Element Length
    element_length = payload_counter-start_pos;
    if (element_length >0) ChargingManagementCore_array_valueControls_array_element_length[j] = element_length - 4;
    else                   ChargingManagementCore_array_valueControls_array_element_length[j] = element_length;
    
    ChargingManagementCore_payload_buffer_valueControls[start_pos++] = ChargingManagementCore_array_valueControls_array_element_length[j]>>24 & 0xFF;
    ChargingManagementCore_payload_buffer_valueControls[start_pos++] = ChargingManagementCore_array_valueControls_array_element_length[j]>>16 & 0xFF;
    ChargingManagementCore_payload_buffer_valueControls[start_pos++] = ChargingManagementCore_array_valueControls_array_element_length[j]>> 8 & 0xFF;
    ChargingManagementCore_payload_buffer_valueControls[start_pos++] = ChargingManagementCore_array_valueControls_array_element_length[j]     & 0xFF;
    
    if (ChargingManagementCore_array_valueControls_array_element_length[j] == 0) payload_counter = payload_counter+4;
  }
  
  // Struct Length
  ChargingManagementCore_array_valueControls_struct_element_length = 4*@ChargingManagementCore_Notification_valueControls_Element_TotalNum;

  for (k=0;k<@ChargingManagementCore_Notification_valueControls_Element_TotalNum;k++)
    ChargingManagementCore_array_valueControls_struct_element_length = ChargingManagementCore_array_valueControls_struct_element_length + ChargingManagementCore_array_valueControls_array_element_length[k];
  
  ChargingManagementCore_payload_buffer_valueControls[0] = ChargingManagementCore_array_valueControls_struct_element_length>>24 & 0xFF;
  ChargingManagementCore_payload_buffer_valueControls[1] = ChargingManagementCore_array_valueControls_struct_element_length>>16 & 0xFF;
  ChargingManagementCore_payload_buffer_valueControls[2] = ChargingManagementCore_array_valueControls_struct_element_length>> 8 & 0xFF;
  ChargingManagementCore_payload_buffer_valueControls[3] = ChargingManagementCore_array_valueControls_struct_element_length     & 0xFF;


  ChargingManagementCore_payload_length_valueControls = ChargingManagementCore_array_valueControls_struct_element_length+4;
  putvalue(ChargingManagementCore_Notification_valueControls_Payload, ChargingManagementCore_payload_buffer_valueControls, ChargingManagementCore_payload_length_valueControls);
}

on envVar ChargingManagementCore_Notification_valueControls_Element_TotalNum
{
  if (@this == 0) @this =  1;
  if (@this > 10) @this = 10;
  
  ChargingManagementCore_Notification_valueControls();
  ChargingManagementCore_Notification_valueControls_update();
}

on envVar ChargingManagementCore_Notification_valueControls_Element
{
  ChargingManagementCore_Notification_valueControls_update();
}

on envVar ChargingManagementCore_Notification_valueControls_Element_Next
{
  if (@this == 1 && @ChargingManagementCore_Notification_valueControls_Element < @ChargingManagementCore_Notification_valueControls_Element_TotalNum - 1)
  {
    @ChargingManagementCore_Notification_valueControls_Element = @ChargingManagementCore_Notification_valueControls_Element + 1;
    ChargingManagementCore_Notification_valueControls_update();
  }
}

on envVar ChargingManagementCore_Notification_valueControls_Element_Previous
{
  if (@this == 1 && @ChargingManagementCore_Notification_valueControls_Element > 0)
  {
    @ChargingManagementCore_Notification_valueControls_Element = @ChargingManagementCore_Notification_valueControls_Element - 1;
    ChargingManagementCore_Notification_valueControls_update();
  }
}

on envVar ChargingManagementCore_Notification_valueControls_specialStateConfiguration_Element_TotalNum
{
  if (@this == 0) @this =  1;
  if (@this > 10) @this = 10;
  
  ChargingManagementCore_array_valueControls_specialStateConfiguration_nr_of_elements[@ChargingManagementCore_Notification_valueControls_Element] = @this;
  ChargingManagementCore_Notification_valueControls();
  ChargingManagementCore_Notification_valueControls_update();
}

on envVar ChargingManagementCore_Notification_valueControls_specialStateConfiguration_Element
{
  ChargingManagementCore_Notification_valueControls_update();
}

on envVar ChargingManagementCore_Notification_valueControls_specialStateConfiguration_Element_Next
{
  if (@this == 1 && @ChargingManagementCore_Notification_valueControls_specialStateConfiguration_Element < @ChargingManagementCore_Notification_valueControls_specialStateConfiguration_Element_TotalNum - 1)
  {
    @ChargingManagementCore_Notification_valueControls_specialStateConfiguration_Element = @ChargingManagementCore_Notification_valueControls_specialStateConfiguration_Element + 1;
    
    @ChargingManagementCore_Notification_valueControls_specialStateConfiguration = ChargingManagementCore_array_valueControls_specialStateConfiguration[@ChargingManagementCore_Notification_valueControls_Element][@ChargingManagementCore_Notification_valueControls_specialStateConfiguration_Element];
  }
}

on envVar ChargingManagementCore_Notification_valueControls_specialStateConfiguration_Element_Previous
{
  if (@this == 1 && @ChargingManagementCore_Notification_valueControls_specialStateConfiguration_Element > 0)
  {
    @ChargingManagementCore_Notification_valueControls_specialStateConfiguration_Element = @ChargingManagementCore_Notification_valueControls_specialStateConfiguration_Element - 1;
    
    @ChargingManagementCore_Notification_valueControls_specialStateConfiguration = ChargingManagementCore_array_valueControls_specialStateConfiguration[@ChargingManagementCore_Notification_valueControls_Element][@ChargingManagementCore_Notification_valueControls_specialStateConfiguration_Element];
  }
}

ChargingManagementCore_Notification_valueControls_update()
{
  @ChargingManagementCore_Notification_LengthIndicator_Element_valueControls = ChargingManagementCore_array_valueControls_array_element_length[@ChargingManagementCore_Notification_valueControls_Element];
  @ChargingManagementCore_Notification_LengthIndicator_Struct_valueControls  = ChargingManagementCore_array_valueControls_struct_element_length;
  @ChargingManagementCore_Notification_Length_valueControls                  = ChargingManagementCore_payload_length_valueControls+8;
  
  @ChargingManagementCore_Notification_valueControls_currentValue              = ChargingManagementCore_array_valueControls_currentValue[@ChargingManagementCore_Notification_valueControls_Element];
  @ChargingManagementCore_Notification_valueControls_maxValue                  = ChargingManagementCore_array_valueControls_maxValue[@ChargingManagementCore_Notification_valueControls_Element];
  @ChargingManagementCore_Notification_valueControls_minValue                  = ChargingManagementCore_array_valueControls_minValue[@ChargingManagementCore_Notification_valueControls_Element];
  @ChargingManagementCore_Notification_valueControls_unitPercent               = ChargingManagementCore_array_valueControls_unitPercent[@ChargingManagementCore_Notification_valueControls_Element];
  @ChargingManagementCore_Notification_valueControls_unitDistance              = ChargingManagementCore_array_valueControls_unitDistance[@ChargingManagementCore_Notification_valueControls_Element];
  @ChargingManagementCore_Notification_valueControls_unitTime                  = ChargingManagementCore_array_valueControls_unitTime[@ChargingManagementCore_Notification_valueControls_Element];
  @ChargingManagementCore_Notification_valueControls_resolution                = ChargingManagementCore_array_valueControls_resolution[@ChargingManagementCore_Notification_valueControls_Element];
  @ChargingManagementCore_Notification_valueControls_restrictionReason         = ChargingManagementCore_array_valueControls_restrictionReason[@ChargingManagementCore_Notification_valueControls_Element];
  @ChargingManagementCore_Notification_valueControls_type                      = ChargingManagementCore_array_valueControls_type[@ChargingManagementCore_Notification_valueControls_Element];
  @ChargingManagementCore_Notification_valueControls_specialState              = ChargingManagementCore_array_valueControls_specialState[@ChargingManagementCore_Notification_valueControls_Element];
  @ChargingManagementCore_Notification_valueControls_specialStateConfiguration = ChargingManagementCore_array_valueControls_specialStateConfiguration[@ChargingManagementCore_Notification_valueControls_Element][@ChargingManagementCore_Notification_valueControls_specialStateConfiguration_Element];
  
  putValue (ChargingManagementCore_Notification_valueControls_id, ChargingManagementCore_array_valueControls_id[@ChargingManagementCore_Notification_valueControls_Element]);
  
  @ChargingManagementCore_Notification_valueControls_specialStateConfiguration_Element_TotalNum = ChargingManagementCore_array_valueControls_specialStateConfiguration_nr_of_elements[@ChargingManagementCore_Notification_valueControls_Element];
  
  @ChargingManagementCore_Notification_valueControls_id_available                        = ChargingManagementCore_array_valueControls_id_available[@ChargingManagementCore_Notification_valueControls_Element];
  @ChargingManagementCore_Notification_valueControls_currentValue_available              = ChargingManagementCore_array_valueControls_currentValue_available[@ChargingManagementCore_Notification_valueControls_Element];
  @ChargingManagementCore_Notification_valueControls_maxValue_available                  = ChargingManagementCore_array_valueControls_maxValue_available[@ChargingManagementCore_Notification_valueControls_Element];
  @ChargingManagementCore_Notification_valueControls_minValue_available                  = ChargingManagementCore_array_valueControls_minValue_available[@ChargingManagementCore_Notification_valueControls_Element];
  @ChargingManagementCore_Notification_valueControls_unitPercent_available               = ChargingManagementCore_array_valueControls_unitPercent_available[@ChargingManagementCore_Notification_valueControls_Element];
  @ChargingManagementCore_Notification_valueControls_unitDistance_available              = ChargingManagementCore_array_valueControls_unitDistance_available[@ChargingManagementCore_Notification_valueControls_Element];
  @ChargingManagementCore_Notification_valueControls_unitTime_available                  = ChargingManagementCore_array_valueControls_unitTime_available[@ChargingManagementCore_Notification_valueControls_Element];
  @ChargingManagementCore_Notification_valueControls_resolution_available                = ChargingManagementCore_array_valueControls_resolution_available[@ChargingManagementCore_Notification_valueControls_Element];
  @ChargingManagementCore_Notification_valueControls_restrictionReason_available         = ChargingManagementCore_array_valueControls_restrictionReason_available[@ChargingManagementCore_Notification_valueControls_Element];
  @ChargingManagementCore_Notification_valueControls_type_available                      = ChargingManagementCore_array_valueControls_type_available[@ChargingManagementCore_Notification_valueControls_Element];
  @ChargingManagementCore_Notification_valueControls_specialState_available              = ChargingManagementCore_array_valueControls_specialState_available[@ChargingManagementCore_Notification_valueControls_Element];
  @ChargingManagementCore_Notification_valueControls_specialStateConfiguration_available = ChargingManagementCore_array_valueControls_specialStateConfiguration_available[@ChargingManagementCore_Notification_valueControls_Element];
}








////////// valueIndications Notification //////////

on envVar ChargingManagementCore_Notification_LengthIndicator_Struct_valueIndications
{
  ChargingManagementCore_Notification_valueIndications();
}
on envVar ChargingManagementCore_Notification_LengthIndicator_Element_valueIndications
{
  ChargingManagementCore_Notification_valueIndications();
}
on envVar ChargingManagementCore_Notification_valueIndications_id
{
  getvalue(this, buffer_uuid);
  for (k=0;k<16;k++)
    ChargingManagementCore_array_valueIndications_id[@ChargingManagementCore_Notification_valueIndications_Element][k] = buffer_uuid[k];
  ChargingManagementCore_Notification_valueIndications();
}
on envVar ChargingManagementCore_Notification_valueIndications_currentValue
{
  ChargingManagementCore_array_valueIndications_currentValue[@ChargingManagementCore_Notification_valueIndications_Element] = @this;
  ChargingManagementCore_Notification_valueIndications();
}
on envVar ChargingManagementCore_Notification_valueIndications_maxValue
{
  ChargingManagementCore_array_valueIndications_maxValue[@ChargingManagementCore_Notification_valueIndications_Element] = @this;
  ChargingManagementCore_Notification_valueIndications();
}
on envVar ChargingManagementCore_Notification_valueIndications_minValue
{
  ChargingManagementCore_array_valueIndications_minValue[@ChargingManagementCore_Notification_valueIndications_Element] = @this;
  ChargingManagementCore_Notification_valueIndications();
}
on envVar ChargingManagementCore_Notification_valueIndications_currentTimeDateValue
{
  for (k=0; k<100; k++)
    ChargingManagementCore_array_valueIndications_currentTimeDateValue[@ChargingManagementCore_Notification_valueIndications_Element][k] = 0x00;
  
  getvalue (this, buffer_char);
  for (k=0; k<getvaluesize(ChargingManagementCore_Notification_valueIndications_currentTimeDateValue)-1; k++)
    ChargingManagementCore_array_valueIndications_currentTimeDateValue[@ChargingManagementCore_Notification_valueIndications_Element][k] = buffer_char[k];

  ChargingManagementCore_Notification_valueIndications();
}
on envVar ChargingManagementCore_Notification_valueIndications_unitPercent
{
  ChargingManagementCore_array_valueIndications_unitPercent[@ChargingManagementCore_Notification_valueIndications_Element] = @this;
  ChargingManagementCore_Notification_valueIndications();
}
on envVar ChargingManagementCore_Notification_valueIndications_unitTime
{
  ChargingManagementCore_array_valueIndications_unitTime[@ChargingManagementCore_Notification_valueIndications_Element] = @this;
  ChargingManagementCore_Notification_valueIndications();
}
on envVar ChargingManagementCore_Notification_valueIndications_unitSpeed
{
  ChargingManagementCore_array_valueIndications_unitSpeed[@ChargingManagementCore_Notification_valueIndications_Element] = @this;
  ChargingManagementCore_Notification_valueIndications();
}
on envVar ChargingManagementCore_Notification_valueIndications_unitPower
{
  ChargingManagementCore_array_valueIndications_unitPower[@ChargingManagementCore_Notification_valueIndications_Element] = @this;
  ChargingManagementCore_Notification_valueIndications();
}
on envVar ChargingManagementCore_Notification_valueIndications_unitEnergy
{
  ChargingManagementCore_array_valueIndications_unitEnergy[@ChargingManagementCore_Notification_valueIndications_Element] = @this;
  ChargingManagementCore_Notification_valueIndications();
}
on envVar ChargingManagementCore_Notification_valueIndications_restrictionReason
{
  ChargingManagementCore_array_valueIndications_restrictionReason[@ChargingManagementCore_Notification_valueIndications_Element] = @this;
  ChargingManagementCore_Notification_valueIndications();
}
on envVar ChargingManagementCore_Notification_valueIndications_type
{
  ChargingManagementCore_array_valueIndications_type[@ChargingManagementCore_Notification_valueIndications_Element] = @this;
  ChargingManagementCore_Notification_valueIndications();
}
on envVar ChargingManagementCore_Notification_valueIndications_id_available
{
  ChargingManagementCore_array_valueIndications_id_available[@ChargingManagementCore_Notification_valueIndications_Element] = @this;
  ChargingManagementCore_Notification_valueIndications();
}
on envVar ChargingManagementCore_Notification_valueIndications_currentValue_available
{
  ChargingManagementCore_array_valueIndications_currentValue_available[@ChargingManagementCore_Notification_valueIndications_Element] = @this;
  ChargingManagementCore_Notification_valueIndications();
}
on envVar ChargingManagementCore_Notification_valueIndications_maxValue_available
{
  ChargingManagementCore_array_valueIndications_maxValue_available[@ChargingManagementCore_Notification_valueIndications_Element] = @this;
  ChargingManagementCore_Notification_valueIndications();
}
on envVar ChargingManagementCore_Notification_valueIndications_minValue_available
{
  ChargingManagementCore_array_valueIndications_minValue_available[@ChargingManagementCore_Notification_valueIndications_Element] = @this;
  ChargingManagementCore_Notification_valueIndications();
}
on envVar ChargingManagementCore_Notification_valueIndications_currentTimeDateValue_available
{
  ChargingManagementCore_array_valueIndications_currentTimeDateValue_available[@ChargingManagementCore_Notification_valueIndications_Element] = @this;
  ChargingManagementCore_Notification_valueIndications();
}
on envVar ChargingManagementCore_Notification_valueIndications_unitPercent_available
{
  ChargingManagementCore_array_valueIndications_unitPercent_available[@ChargingManagementCore_Notification_valueIndications_Element] = @this;
  ChargingManagementCore_Notification_valueIndications();
}
on envVar ChargingManagementCore_Notification_valueIndications_unitTime_available
{
  ChargingManagementCore_array_valueIndications_unitTime_available[@ChargingManagementCore_Notification_valueIndications_Element] = @this;
  ChargingManagementCore_Notification_valueIndications();
}
on envVar ChargingManagementCore_Notification_valueIndications_unitSpeed_available
{
  ChargingManagementCore_array_valueIndications_unitSpeed_available[@ChargingManagementCore_Notification_valueIndications_Element] = @this;
  ChargingManagementCore_Notification_valueIndications();
}
on envVar ChargingManagementCore_Notification_valueIndications_unitPower_available
{
  ChargingManagementCore_array_valueIndications_unitPower_available[@ChargingManagementCore_Notification_valueIndications_Element] = @this;
  ChargingManagementCore_Notification_valueIndications();
}
on envVar ChargingManagementCore_Notification_valueIndications_unitEnergy_available
{
  ChargingManagementCore_array_valueIndications_unitEnergy_available[@ChargingManagementCore_Notification_valueIndications_Element] = @this;
  ChargingManagementCore_Notification_valueIndications();
}
on envVar ChargingManagementCore_Notification_valueIndications_restrictionReason_available
{
  ChargingManagementCore_array_valueIndications_restrictionReason_available[@ChargingManagementCore_Notification_valueIndications_Element] = @this;
  ChargingManagementCore_Notification_valueIndications();
}
on envVar ChargingManagementCore_Notification_valueIndications_type_available
{
  ChargingManagementCore_array_valueIndications_type_available[@ChargingManagementCore_Notification_valueIndications_Element] = @this;
  ChargingManagementCore_Notification_valueIndications();
}
on envVar ChargingManagementCore_Notification_valueIndications_Payload
{
  ChargingManagementCore_Notification_valueIndications_update();
}


ChargingManagementCore_Notification_valueIndications()
{
  word payload_counter = 0;
  word start_pos       = 0;
  word element_length  = 0;
  
  // Length Indicator Struct - Platzhalter
  payload_counter = 0+4;
  start_pos = 0;
  
  for (j=0; j<@ChargingManagementCore_Notification_valueIndications_Element_TotalNum; j++)
  {
    ChargingManagementCore_array_valueIndications_available_functions[j] = ChargingManagementCore_array_valueIndications_id_available[j]
                                                                         + ChargingManagementCore_array_valueIndications_currentValue_available[j]
                                                                         + ChargingManagementCore_array_valueIndications_maxValue_available[j]
                                                                         + ChargingManagementCore_array_valueIndications_minValue_available[j]
                                                                         + ChargingManagementCore_array_valueIndications_currentTimeDateValue_available[j]
                                                                         + ChargingManagementCore_array_valueIndications_unitPercent_available[j]
                                                                         + ChargingManagementCore_array_valueIndications_unitTime_available[j]
                                                                         + ChargingManagementCore_array_valueIndications_unitSpeed_available[j]
                                                                         + ChargingManagementCore_array_valueIndications_unitPower_available[j]
                                                                         + ChargingManagementCore_array_valueIndications_unitEnergy_available[j]
                                                                         + ChargingManagementCore_array_valueIndications_restrictionReason_available[j]
                                                                         + ChargingManagementCore_array_valueIndications_type_available[j];
    
    // Length Indicator Element - Platzhalter
    if (ChargingManagementCore_array_valueIndications_available_functions[j] > 0)
    {
      start_pos = payload_counter;
      payload_counter = payload_counter + 4;
    }
    else 
      start_pos = payload_counter;
    
    
    // 0 id (uuid 16byte)
    if (ChargingManagementCore_array_valueIndications_id_available[j] == 1)
    {
      tag_dataID = 0;
      ChargingManagementCore_payload_buffer_valueIndications[payload_counter++] = 5 * 16 /* Wiretype = 5 =^ Array mit 1 Byte Länge */ + ((tag_dataID>>8) & 0x0F) /* DataID High Part */ ;
      ChargingManagementCore_payload_buffer_valueIndications[payload_counter++] = tag_dataID & 0xFF /* DataID Low Part */ ;
      
      ChargingManagementCore_payload_buffer_valueIndications[payload_counter++] = 16; // Array Length
      
      for (k=0; k<16; k++)
        ChargingManagementCore_payload_buffer_valueIndications[payload_counter++] = ChargingManagementCore_array_valueIndications_id[j][k] & 0xFF;
    }
    
    
    // 1 currentValue (float32)
    if (ChargingManagementCore_array_valueIndications_currentValue_available[j] == 1)
    {
      tag_dataID = 1;
      ChargingManagementCore_payload_buffer_valueIndications[payload_counter++] = 2 * 16 /* Wiretype = 2  =^ 32 Bit */ + ((tag_dataID>>8) & 0x0F) /* DataID High Part */ ;
      ChargingManagementCore_payload_buffer_valueIndications[payload_counter++] = tag_dataID & 0xFF /* DataID Low Part */ ;
      
      temp_converttodword = interpretAsDword (@ChargingManagementCore_Notification_valueIndications_currentValue);
      ChargingManagementCore_payload_buffer_valueIndications[payload_counter++] = temp_converttodword>>24 & 0xFF;
      ChargingManagementCore_payload_buffer_valueIndications[payload_counter++] = temp_converttodword>>16 & 0xFF;
      ChargingManagementCore_payload_buffer_valueIndications[payload_counter++] = temp_converttodword>> 8 & 0xFF;
      ChargingManagementCore_payload_buffer_valueIndications[payload_counter++] = temp_converttodword     & 0xFF;
    }
    
    
    // 2 maxValue (float32)
    if (ChargingManagementCore_array_valueIndications_maxValue_available[j] == 1)
    {
      tag_dataID = 2;
      ChargingManagementCore_payload_buffer_valueIndications[payload_counter++] = 2 * 16 /* Wiretype = 2  =^ 32 Bit */ + ((tag_dataID>>8) & 0x0F) /* DataID High Part */ ;
      ChargingManagementCore_payload_buffer_valueIndications[payload_counter++] = tag_dataID & 0xFF /* DataID Low Part */ ;
      
      temp_converttodword = interpretAsDword (@ChargingManagementCore_Notification_valueIndications_maxValue);
      ChargingManagementCore_payload_buffer_valueIndications[payload_counter++] = temp_converttodword>>24 & 0xFF;
      ChargingManagementCore_payload_buffer_valueIndications[payload_counter++] = temp_converttodword>>16 & 0xFF;
      ChargingManagementCore_payload_buffer_valueIndications[payload_counter++] = temp_converttodword>> 8 & 0xFF;
      ChargingManagementCore_payload_buffer_valueIndications[payload_counter++] = temp_converttodword     & 0xFF;
    }
    
    
    // 3 minValue (float32)
    if (ChargingManagementCore_array_valueIndications_minValue_available[j] == 1)
    {
      tag_dataID = 3;
      ChargingManagementCore_payload_buffer_valueIndications[payload_counter++] = 2 * 16 /* Wiretype = 2  =^ 32 Bit */ + ((tag_dataID>>8) & 0x0F) /* DataID High Part */ ;
      ChargingManagementCore_payload_buffer_valueIndications[payload_counter++] = tag_dataID & 0xFF /* DataID Low Part */ ;
      
      temp_converttodword = interpretAsDword (@ChargingManagementCore_Notification_valueIndications_minValue);
      ChargingManagementCore_payload_buffer_valueIndications[payload_counter++] = temp_converttodword>>24 & 0xFF;
      ChargingManagementCore_payload_buffer_valueIndications[payload_counter++] = temp_converttodword>>16 & 0xFF;
      ChargingManagementCore_payload_buffer_valueIndications[payload_counter++] = temp_converttodword>> 8 & 0xFF;
      ChargingManagementCore_payload_buffer_valueIndications[payload_counter++] = temp_converttodword     & 0xFF;
    }
    
    
    // 4 currentTimeDateValue (string)
    if (ChargingManagementCore_array_valueIndications_currentTimeDateValue_available[j] == 1)
    {
      tag_dataID = 4;
      ChargingManagementCore_payload_buffer_valueIndications[payload_counter++] = 5 * 16 /* Wiretype = 5 =^ Array mit 1 Byte Länge */ + ((tag_dataID>>8) & 0x0F) /* DataID High Part */ ;
      ChargingManagementCore_payload_buffer_valueIndications[payload_counter++] = tag_dataID & 0xFF /* DataID Low Part */ ;
      
      ChargingManagementCore_payload_buffer_valueIndications[payload_counter++] = strlen(ChargingManagementCore_array_valueIndications_currentTimeDateValue[j]);  
      
      if (strlen(ChargingManagementCore_array_valueIndications_currentTimeDateValue[j]) > 1)
      {
        for (k=0; k<strlen(ChargingManagementCore_array_valueIndications_currentTimeDateValue[j]); k++)
          ChargingManagementCore_payload_buffer_valueIndications[payload_counter++] = ChargingManagementCore_array_valueIndications_currentTimeDateValue[j][k];
      }
    }
    
    
    // 5 unitPercent (enum32)
    if (ChargingManagementCore_array_valueIndications_unitPercent_available[j] == 1)
    {
      tag_dataID = 5;
      ChargingManagementCore_payload_buffer_valueIndications[payload_counter++] = 2 * 16 /* Wiretype = 2 =^ 32 Bit */ + ((tag_dataID>>8) & 0x0F) /* DataID High Part */ ;
      ChargingManagementCore_payload_buffer_valueIndications[payload_counter++] = tag_dataID & 0xFF /* DataID Low Part */ ;
      
      ChargingManagementCore_payload_buffer_valueIndications[payload_counter++] = ChargingManagementCore_array_valueIndications_unitPercent[j]>>24 & 0xFF;
      ChargingManagementCore_payload_buffer_valueIndications[payload_counter++] = ChargingManagementCore_array_valueIndications_unitPercent[j]>>16 & 0xFF;
      ChargingManagementCore_payload_buffer_valueIndications[payload_counter++] = ChargingManagementCore_array_valueIndications_unitPercent[j]>> 8 & 0xFF;
      ChargingManagementCore_payload_buffer_valueIndications[payload_counter++] = ChargingManagementCore_array_valueIndications_unitPercent[j]     & 0xFF;
    }
    
    
    // 6 unitTime (enum32)
    if (ChargingManagementCore_array_valueIndications_unitTime_available[j] == 1)
    {
      tag_dataID = 6;
      ChargingManagementCore_payload_buffer_valueIndications[payload_counter++] = 2 * 16 /* Wiretype = 2 =^ 32 Bit */ + ((tag_dataID>>8) & 0x0F) /* DataID High Part */ ;
      ChargingManagementCore_payload_buffer_valueIndications[payload_counter++] = tag_dataID & 0xFF /* DataID Low Part */ ;
      
      ChargingManagementCore_payload_buffer_valueIndications[payload_counter++] = ChargingManagementCore_array_valueIndications_unitTime[j]>>24 & 0xFF;
      ChargingManagementCore_payload_buffer_valueIndications[payload_counter++] = ChargingManagementCore_array_valueIndications_unitTime[j]>>16 & 0xFF;
      ChargingManagementCore_payload_buffer_valueIndications[payload_counter++] = ChargingManagementCore_array_valueIndications_unitTime[j]>> 8 & 0xFF;
      ChargingManagementCore_payload_buffer_valueIndications[payload_counter++] = ChargingManagementCore_array_valueIndications_unitTime[j]     & 0xFF;
    }
    
    
    // 7 unitSpeed (enum32)
    if (ChargingManagementCore_array_valueIndications_unitSpeed_available[j] == 1)
    {
      tag_dataID = 7;
      ChargingManagementCore_payload_buffer_valueIndications[payload_counter++] = 2 * 16 /* Wiretype = 2 =^ 32 Bit */ + ((tag_dataID>>8) & 0x0F) /* DataID High Part */ ;
      ChargingManagementCore_payload_buffer_valueIndications[payload_counter++] = tag_dataID & 0xFF /* DataID Low Part */ ;
      
      ChargingManagementCore_payload_buffer_valueIndications[payload_counter++] = ChargingManagementCore_array_valueIndications_unitSpeed[j]>>24 & 0xFF;
      ChargingManagementCore_payload_buffer_valueIndications[payload_counter++] = ChargingManagementCore_array_valueIndications_unitSpeed[j]>>16 & 0xFF;
      ChargingManagementCore_payload_buffer_valueIndications[payload_counter++] = ChargingManagementCore_array_valueIndications_unitSpeed[j]>> 8 & 0xFF;
      ChargingManagementCore_payload_buffer_valueIndications[payload_counter++] = ChargingManagementCore_array_valueIndications_unitSpeed[j]     & 0xFF;
    }
    
    
    // 8 unitPower (enum32)
    if (ChargingManagementCore_array_valueIndications_unitPower_available[j] == 1)
    {
      tag_dataID = 8;
      ChargingManagementCore_payload_buffer_valueIndications[payload_counter++] = 2 * 16 /* Wiretype = 2 =^ 32 Bit */ + ((tag_dataID>>8) & 0x0F) /* DataID High Part */ ;
      ChargingManagementCore_payload_buffer_valueIndications[payload_counter++] = tag_dataID & 0xFF /* DataID Low Part */ ;
      
      ChargingManagementCore_payload_buffer_valueIndications[payload_counter++] = ChargingManagementCore_array_valueIndications_unitPower[j]>>24 & 0xFF;
      ChargingManagementCore_payload_buffer_valueIndications[payload_counter++] = ChargingManagementCore_array_valueIndications_unitPower[j]>>16 & 0xFF;
      ChargingManagementCore_payload_buffer_valueIndications[payload_counter++] = ChargingManagementCore_array_valueIndications_unitPower[j]>> 8 & 0xFF;
      ChargingManagementCore_payload_buffer_valueIndications[payload_counter++] = ChargingManagementCore_array_valueIndications_unitPower[j]     & 0xFF;
    }
    
    
    // 9 unitEnergy (enum32)
    if (ChargingManagementCore_array_valueIndications_unitEnergy_available[j] == 1)
    {
      tag_dataID = 9;
      ChargingManagementCore_payload_buffer_valueIndications[payload_counter++] = 2 * 16 /* Wiretype = 2 =^ 32 Bit */ + ((tag_dataID>>8) & 0x0F) /* DataID High Part */ ;
      ChargingManagementCore_payload_buffer_valueIndications[payload_counter++] = tag_dataID & 0xFF /* DataID Low Part */ ;
      
      ChargingManagementCore_payload_buffer_valueIndications[payload_counter++] = ChargingManagementCore_array_valueIndications_unitEnergy[j]>>24 & 0xFF;
      ChargingManagementCore_payload_buffer_valueIndications[payload_counter++] = ChargingManagementCore_array_valueIndications_unitEnergy[j]>>16 & 0xFF;
      ChargingManagementCore_payload_buffer_valueIndications[payload_counter++] = ChargingManagementCore_array_valueIndications_unitEnergy[j]>> 8 & 0xFF;
      ChargingManagementCore_payload_buffer_valueIndications[payload_counter++] = ChargingManagementCore_array_valueIndications_unitEnergy[j]     & 0xFF;
    }
    
    
    // 10 restrictionReason (enum32)
    if (ChargingManagementCore_array_valueIndications_restrictionReason_available[j] == 1)
    {
      tag_dataID = 10;
      ChargingManagementCore_payload_buffer_valueIndications[payload_counter++] = 2 * 16 /* Wiretype = 2 =^ 32 Bit */ + ((tag_dataID>>8) & 0x0F) /* DataID High Part */ ;
      ChargingManagementCore_payload_buffer_valueIndications[payload_counter++] = tag_dataID & 0xFF /* DataID Low Part */ ;
      
      ChargingManagementCore_payload_buffer_valueIndications[payload_counter++] = ChargingManagementCore_array_valueIndications_restrictionReason[j]>>24 & 0xFF;
      ChargingManagementCore_payload_buffer_valueIndications[payload_counter++] = ChargingManagementCore_array_valueIndications_restrictionReason[j]>>16 & 0xFF;
      ChargingManagementCore_payload_buffer_valueIndications[payload_counter++] = ChargingManagementCore_array_valueIndications_restrictionReason[j]>> 8 & 0xFF;
      ChargingManagementCore_payload_buffer_valueIndications[payload_counter++] = ChargingManagementCore_array_valueIndications_restrictionReason[j]     & 0xFF;
    }
    
    
    // 11 type (enum32)
    if (ChargingManagementCore_array_valueIndications_type_available[j] == 1)
    {
      tag_dataID = 11;
      ChargingManagementCore_payload_buffer_valueIndications[payload_counter++] = 2 * 16 /* Wiretype = 2 =^ 32 Bit */ + ((tag_dataID>>8) & 0x0F) /* DataID High Part */ ;
      ChargingManagementCore_payload_buffer_valueIndications[payload_counter++] = tag_dataID & 0xFF /* DataID Low Part */ ;
      
      ChargingManagementCore_payload_buffer_valueIndications[payload_counter++] = ChargingManagementCore_array_valueIndications_type[j]>>24 & 0xFF;
      ChargingManagementCore_payload_buffer_valueIndications[payload_counter++] = ChargingManagementCore_array_valueIndications_type[j]>>16 & 0xFF;
      ChargingManagementCore_payload_buffer_valueIndications[payload_counter++] = ChargingManagementCore_array_valueIndications_type[j]>> 8 & 0xFF;
      ChargingManagementCore_payload_buffer_valueIndications[payload_counter++] = ChargingManagementCore_array_valueIndications_type[j]     & 0xFF;
    }
    
    
    //Element Length
    element_length = payload_counter-start_pos;
    if (element_length >0) ChargingManagementCore_array_valueIndications_array_element_length[j] = element_length - 4;
    else                   ChargingManagementCore_array_valueIndications_array_element_length[j] = element_length;
    
    ChargingManagementCore_payload_buffer_valueIndications[start_pos++] = ChargingManagementCore_array_valueIndications_array_element_length[j]>>24 & 0xFF;
    ChargingManagementCore_payload_buffer_valueIndications[start_pos++] = ChargingManagementCore_array_valueIndications_array_element_length[j]>>16 & 0xFF;
    ChargingManagementCore_payload_buffer_valueIndications[start_pos++] = ChargingManagementCore_array_valueIndications_array_element_length[j]>> 8 & 0xFF;
    ChargingManagementCore_payload_buffer_valueIndications[start_pos++] = ChargingManagementCore_array_valueIndications_array_element_length[j]     & 0xFF;
    
    if (ChargingManagementCore_array_valueIndications_array_element_length[j] == 0) payload_counter = payload_counter+4;
  }
  
  // Struct Length
  ChargingManagementCore_array_valueIndications_struct_element_length = 4*@ChargingManagementCore_Notification_valueIndications_Element_TotalNum;

  for (k=0;k<@ChargingManagementCore_Notification_valueIndications_Element_TotalNum;k++)
    ChargingManagementCore_array_valueIndications_struct_element_length = ChargingManagementCore_array_valueIndications_struct_element_length + ChargingManagementCore_array_valueIndications_array_element_length[k];
  
  ChargingManagementCore_payload_buffer_valueIndications[0] = ChargingManagementCore_array_valueIndications_struct_element_length>>24 & 0xFF;
  ChargingManagementCore_payload_buffer_valueIndications[1] = ChargingManagementCore_array_valueIndications_struct_element_length>>16 & 0xFF;
  ChargingManagementCore_payload_buffer_valueIndications[2] = ChargingManagementCore_array_valueIndications_struct_element_length>> 8 & 0xFF;
  ChargingManagementCore_payload_buffer_valueIndications[3] = ChargingManagementCore_array_valueIndications_struct_element_length     & 0xFF;


  ChargingManagementCore_payload_length_valueIndications = ChargingManagementCore_array_valueIndications_struct_element_length+4;
  putvalue(ChargingManagementCore_Notification_valueIndications_Payload, ChargingManagementCore_payload_buffer_valueIndications, ChargingManagementCore_payload_length_valueIndications);
}

on envVar ChargingManagementCore_Notification_valueIndications_Element_TotalNum
{
  if (@this == 0) @this =  1;
  if (@this > 10) @this = 10;
  
  ChargingManagementCore_Notification_valueIndications();
  ChargingManagementCore_Notification_valueIndications_update();
}

on envVar ChargingManagementCore_Notification_valueIndications_Element
{
  ChargingManagementCore_Notification_valueIndications_update();
}

on envVar ChargingManagementCore_Notification_valueIndications_Element_Next
{
  if (@this == 1 && @ChargingManagementCore_Notification_valueIndications_Element < @ChargingManagementCore_Notification_valueIndications_Element_TotalNum - 1)
  {
    @ChargingManagementCore_Notification_valueIndications_Element = @ChargingManagementCore_Notification_valueIndications_Element + 1;
    ChargingManagementCore_Notification_valueIndications_update();
  }
}

on envVar ChargingManagementCore_Notification_valueIndications_Element_Previous
{
  if (@this == 1 && @ChargingManagementCore_Notification_valueIndications_Element > 0)
  {
    @ChargingManagementCore_Notification_valueIndications_Element = @ChargingManagementCore_Notification_valueIndications_Element - 1;
    ChargingManagementCore_Notification_valueIndications_update();
  }
}

ChargingManagementCore_Notification_valueIndications_update()
{
  @ChargingManagementCore_Notification_LengthIndicator_Element_valueIndications = ChargingManagementCore_array_valueIndications_array_element_length[@ChargingManagementCore_Notification_valueIndications_Element];
  @ChargingManagementCore_Notification_LengthIndicator_Struct_valueIndications  = ChargingManagementCore_array_valueIndications_struct_element_length;
  @ChargingManagementCore_Notification_Length_valueIndications                  = ChargingManagementCore_payload_length_valueIndications+8;
  
  @ChargingManagementCore_Notification_valueIndications_currentValue      = ChargingManagementCore_array_valueIndications_currentValue[@ChargingManagementCore_Notification_valueIndications_Element];
  @ChargingManagementCore_Notification_valueIndications_maxValue          = ChargingManagementCore_array_valueIndications_maxValue[@ChargingManagementCore_Notification_valueIndications_Element];
  @ChargingManagementCore_Notification_valueIndications_minValue          = ChargingManagementCore_array_valueIndications_minValue[@ChargingManagementCore_Notification_valueIndications_Element];
  @ChargingManagementCore_Notification_valueIndications_unitPercent       = ChargingManagementCore_array_valueIndications_unitPercent[@ChargingManagementCore_Notification_valueIndications_Element];
  @ChargingManagementCore_Notification_valueIndications_unitTime          = ChargingManagementCore_array_valueIndications_unitTime[@ChargingManagementCore_Notification_valueIndications_Element];
  @ChargingManagementCore_Notification_valueIndications_unitSpeed         = ChargingManagementCore_array_valueIndications_unitSpeed[@ChargingManagementCore_Notification_valueIndications_Element];
  @ChargingManagementCore_Notification_valueIndications_unitPower         = ChargingManagementCore_array_valueIndications_unitPower[@ChargingManagementCore_Notification_valueIndications_Element];
  @ChargingManagementCore_Notification_valueIndications_unitEnergy        = ChargingManagementCore_array_valueIndications_unitEnergy[@ChargingManagementCore_Notification_valueIndications_Element];
  @ChargingManagementCore_Notification_valueIndications_restrictionReason = ChargingManagementCore_array_valueIndications_restrictionReason[@ChargingManagementCore_Notification_valueIndications_Element];
  @ChargingManagementCore_Notification_valueIndications_type              = ChargingManagementCore_array_valueIndications_type[@ChargingManagementCore_Notification_valueIndications_Element];
  
  putValue (ChargingManagementCore_Notification_valueIndications_id,                   ChargingManagementCore_array_valueIndications_id[@ChargingManagementCore_Notification_valueIndications_Element]);
  putValue (ChargingManagementCore_Notification_valueIndications_currentTimeDateValue, ChargingManagementCore_array_valueIndications_currentTimeDateValue[@ChargingManagementCore_Notification_valueIndications_Element]);
  
  @ChargingManagementCore_Notification_valueIndications_id_available                   = ChargingManagementCore_array_valueIndications_id_available[@ChargingManagementCore_Notification_valueIndications_Element];
  @ChargingManagementCore_Notification_valueIndications_currentValue_available         = ChargingManagementCore_array_valueIndications_currentValue_available[@ChargingManagementCore_Notification_valueIndications_Element];
  @ChargingManagementCore_Notification_valueIndications_maxValue_available             = ChargingManagementCore_array_valueIndications_maxValue_available[@ChargingManagementCore_Notification_valueIndications_Element];
  @ChargingManagementCore_Notification_valueIndications_minValue_available             = ChargingManagementCore_array_valueIndications_minValue_available[@ChargingManagementCore_Notification_valueIndications_Element];
  @ChargingManagementCore_Notification_valueIndications_currentTimeDateValue_available = ChargingManagementCore_array_valueIndications_currentTimeDateValue_available[@ChargingManagementCore_Notification_valueIndications_Element];
  @ChargingManagementCore_Notification_valueIndications_unitPercent_available          = ChargingManagementCore_array_valueIndications_unitPercent_available[@ChargingManagementCore_Notification_valueIndications_Element];
  @ChargingManagementCore_Notification_valueIndications_unitTime_available             = ChargingManagementCore_array_valueIndications_unitTime_available[@ChargingManagementCore_Notification_valueIndications_Element];
  @ChargingManagementCore_Notification_valueIndications_unitSpeed_available            = ChargingManagementCore_array_valueIndications_unitSpeed_available[@ChargingManagementCore_Notification_valueIndications_Element];
  @ChargingManagementCore_Notification_valueIndications_unitPower_available            = ChargingManagementCore_array_valueIndications_unitPower_available[@ChargingManagementCore_Notification_valueIndications_Element];
  @ChargingManagementCore_Notification_valueIndications_unitEnergy_available           = ChargingManagementCore_array_valueIndications_unitEnergy_available[@ChargingManagementCore_Notification_valueIndications_Element];
  @ChargingManagementCore_Notification_valueIndications_restrictionReason_available    = ChargingManagementCore_array_valueIndications_restrictionReason_available[@ChargingManagementCore_Notification_valueIndications_Element];
  @ChargingManagementCore_Notification_valueIndications_type_available                 = ChargingManagementCore_array_valueIndications_type_available[@ChargingManagementCore_Notification_valueIndications_Element];
  
}






////////// resetToFactoryData Notification //////////

on envVar ChargingManagementCore_Notification_LengthIndicator_Struct_resetToFactoryData
{
  ChargingManagementCore_Notification_resetToFactoryData();
}
on envVar ChargingManagementCore_Notification_LengthIndicator_Element_resetToFactoryData
{
  ChargingManagementCore_Notification_resetToFactoryData();
}
on envVar ChargingManagementCore_Notification_resetToFactoryData_id
{
  getvalue(this, buffer_uuid);
  for (k=0;k<16;k++)
    ChargingManagementCore_array_resetToFactoryData_id[@ChargingManagementCore_Notification_resetToFactoryData_Element][k] = buffer_uuid[k];
  ChargingManagementCore_Notification_resetToFactoryData();
}
on envVar ChargingManagementCore_Notification_resetToFactoryData_resetToFactoryData
{
  ChargingManagementCore_array_resetToFactoryData_resetToFactoryData[@ChargingManagementCore_Notification_resetToFactoryData_Element] = @this;
  ChargingManagementCore_Notification_resetToFactoryData();
}
on envVar ChargingManagementCore_Notification_resetToFactoryData_id_available
{
  ChargingManagementCore_array_resetToFactoryData_id_available[@ChargingManagementCore_Notification_resetToFactoryData_Element] = @this;
  ChargingManagementCore_Notification_resetToFactoryData();
}
on envVar ChargingManagementCore_Notification_resetToFactoryData_resetToFactoryData_available
{
  ChargingManagementCore_array_resetToFactoryData_resetToFactoryData_available[@ChargingManagementCore_Notification_resetToFactoryData_Element] = @this;
  ChargingManagementCore_Notification_resetToFactoryData();
}
on envVar ChargingManagementCore_Notification_resetToFactoryData_Payload
{
  ChargingManagementCore_Notification_resetToFactoryData_update();
}


ChargingManagementCore_Notification_resetToFactoryData()
{
  word payload_counter = 0;
  word start_pos       = 0;
  word element_length  = 0;
  
  // Length Indicator Struct - Platzhalter
  payload_counter = 0+4;
  start_pos = 0;
  
  for (j=0; j<@ChargingManagementCore_Notification_resetToFactoryData_Element_TotalNum; j++)
  {
    ChargingManagementCore_array_resetToFactoryData_available_functions[j] = ChargingManagementCore_array_resetToFactoryData_id_available[j]
                                                                           + ChargingManagementCore_array_resetToFactoryData_resetToFactoryData_available[j];
    
    // Length Indicator Element - Platzhalter
    if (ChargingManagementCore_array_resetToFactoryData_available_functions[j] > 0)
    {
      start_pos = payload_counter;
      payload_counter = payload_counter + 4;
    }
    else 
      start_pos = payload_counter;
    
    
    // 0 id (uuid 16byte)
    if (ChargingManagementCore_array_resetToFactoryData_id_available[j] == 1)
    {
      tag_dataID = 0;
      ChargingManagementCore_payload_buffer_resetToFactoryData[payload_counter++] = 5 * 16 /* Wiretype = 5 =^ Array mit 1 Byte Länge */ + ((tag_dataID>>8) & 0x0F) /* DataID High Part */ ;
      ChargingManagementCore_payload_buffer_resetToFactoryData[payload_counter++] = tag_dataID & 0xFF /* DataID Low Part */ ;
      
      ChargingManagementCore_payload_buffer_resetToFactoryData[payload_counter++] = 16; // Array Length
      
      for (k=0; k<16; k++)
        ChargingManagementCore_payload_buffer_resetToFactoryData[payload_counter++] = ChargingManagementCore_array_resetToFactoryData_id[j][k] & 0xFF;
    }
    
    
    // 1 resetToFactoryData (enum32)
    if (ChargingManagementCore_array_resetToFactoryData_resetToFactoryData_available[j] == 1)
    {
      tag_dataID = 1;
      ChargingManagementCore_payload_buffer_resetToFactoryData[payload_counter++] = 2 * 16 /* Wiretype = 2 =^ 32 Bit */ + ((tag_dataID>>8) & 0x0F) /* DataID High Part */ ;
      ChargingManagementCore_payload_buffer_resetToFactoryData[payload_counter++] = tag_dataID & 0xFF /* DataID Low Part */ ;
      
      ChargingManagementCore_payload_buffer_resetToFactoryData[payload_counter++] = ChargingManagementCore_array_resetToFactoryData_resetToFactoryData[j]>>24 & 0xFF;
      ChargingManagementCore_payload_buffer_resetToFactoryData[payload_counter++] = ChargingManagementCore_array_resetToFactoryData_resetToFactoryData[j]>>16 & 0xFF;
      ChargingManagementCore_payload_buffer_resetToFactoryData[payload_counter++] = ChargingManagementCore_array_resetToFactoryData_resetToFactoryData[j]>> 8 & 0xFF;
      ChargingManagementCore_payload_buffer_resetToFactoryData[payload_counter++] = ChargingManagementCore_array_resetToFactoryData_resetToFactoryData[j]     & 0xFF;
    }
    
    
    //Element Length
    element_length = payload_counter-start_pos;
    if (element_length >0) ChargingManagementCore_array_resetToFactoryData_array_element_length[j] = element_length - 4;
    else                   ChargingManagementCore_array_resetToFactoryData_array_element_length[j] = element_length;
    
    ChargingManagementCore_payload_buffer_resetToFactoryData[start_pos++] = ChargingManagementCore_array_resetToFactoryData_array_element_length[j]>>24 & 0xFF;
    ChargingManagementCore_payload_buffer_resetToFactoryData[start_pos++] = ChargingManagementCore_array_resetToFactoryData_array_element_length[j]>>16 & 0xFF;
    ChargingManagementCore_payload_buffer_resetToFactoryData[start_pos++] = ChargingManagementCore_array_resetToFactoryData_array_element_length[j]>> 8 & 0xFF;
    ChargingManagementCore_payload_buffer_resetToFactoryData[start_pos++] = ChargingManagementCore_array_resetToFactoryData_array_element_length[j]     & 0xFF;
    
    if (ChargingManagementCore_array_resetToFactoryData_array_element_length[j] == 0) payload_counter = payload_counter+4;
  }
  
  // Struct Length
  ChargingManagementCore_array_resetToFactoryData_struct_element_length = 4*@ChargingManagementCore_Notification_resetToFactoryData_Element_TotalNum;

  for (k=0;k<@ChargingManagementCore_Notification_resetToFactoryData_Element_TotalNum;k++)
    ChargingManagementCore_array_resetToFactoryData_struct_element_length = ChargingManagementCore_array_resetToFactoryData_struct_element_length + ChargingManagementCore_array_resetToFactoryData_array_element_length[k];
  
  ChargingManagementCore_payload_buffer_resetToFactoryData[0] = ChargingManagementCore_array_resetToFactoryData_struct_element_length>>24 & 0xFF;
  ChargingManagementCore_payload_buffer_resetToFactoryData[1] = ChargingManagementCore_array_resetToFactoryData_struct_element_length>>16 & 0xFF;
  ChargingManagementCore_payload_buffer_resetToFactoryData[2] = ChargingManagementCore_array_resetToFactoryData_struct_element_length>> 8 & 0xFF;
  ChargingManagementCore_payload_buffer_resetToFactoryData[3] = ChargingManagementCore_array_resetToFactoryData_struct_element_length     & 0xFF;


  ChargingManagementCore_payload_length_resetToFactoryData = ChargingManagementCore_array_resetToFactoryData_struct_element_length+4;
  putvalue(ChargingManagementCore_Notification_resetToFactoryData_Payload, ChargingManagementCore_payload_buffer_resetToFactoryData, ChargingManagementCore_payload_length_resetToFactoryData);
}

on envVar ChargingManagementCore_Notification_resetToFactoryData_Element_TotalNum
{
  if (@this == 0) @this =  1;
  if (@this > 10) @this = 10;
  
  ChargingManagementCore_Notification_resetToFactoryData();
  ChargingManagementCore_Notification_resetToFactoryData_update();
}

on envVar ChargingManagementCore_Notification_resetToFactoryData_Element
{
  ChargingManagementCore_Notification_resetToFactoryData_update();
}

on envVar ChargingManagementCore_Notification_resetToFactoryData_Element_Next
{
  if (@this == 1 && @ChargingManagementCore_Notification_resetToFactoryData_Element < @ChargingManagementCore_Notification_resetToFactoryData_Element_TotalNum - 1)
  {
    @ChargingManagementCore_Notification_resetToFactoryData_Element = @ChargingManagementCore_Notification_resetToFactoryData_Element + 1;
    ChargingManagementCore_Notification_resetToFactoryData_update();
  }
}

on envVar ChargingManagementCore_Notification_resetToFactoryData_Element_Previous
{
  if (@this == 1 && @ChargingManagementCore_Notification_resetToFactoryData_Element > 0)
  {
    @ChargingManagementCore_Notification_resetToFactoryData_Element = @ChargingManagementCore_Notification_resetToFactoryData_Element - 1;
    ChargingManagementCore_Notification_resetToFactoryData_update();
  }
}

ChargingManagementCore_Notification_resetToFactoryData_update()
{
  @ChargingManagementCore_Notification_LengthIndicator_Element_resetToFactoryData = ChargingManagementCore_array_resetToFactoryData_array_element_length[@ChargingManagementCore_Notification_resetToFactoryData_Element];
  @ChargingManagementCore_Notification_LengthIndicator_Struct_resetToFactoryData  = ChargingManagementCore_array_resetToFactoryData_struct_element_length;
  @ChargingManagementCore_Notification_Length_resetToFactoryData                  = ChargingManagementCore_payload_length_resetToFactoryData+8;
  
  @ChargingManagementCore_Notification_resetToFactoryData_resetToFactoryData = ChargingManagementCore_array_resetToFactoryData_resetToFactoryData[@ChargingManagementCore_Notification_resetToFactoryData_Element];
  
  putValue (ChargingManagementCore_Notification_resetToFactoryData_id, ChargingManagementCore_array_resetToFactoryData_id[@ChargingManagementCore_Notification_valueIndications_Element]);
  
  @ChargingManagementCore_Notification_resetToFactoryData_id_available                 = ChargingManagementCore_array_resetToFactoryData_id_available[@ChargingManagementCore_Notification_resetToFactoryData_Element];
  @ChargingManagementCore_Notification_resetToFactoryData_resetToFactoryData_available = ChargingManagementCore_array_resetToFactoryData_resetToFactoryData_available[@ChargingManagementCore_Notification_resetToFactoryData_Element];
}












////////////////// Service ChargingManagementExtendedSync //////////////////

on envVar ServiceDiscovery_Offer_Service_ChargingManagementExtendedSync
{
  Send_ServiceDiscovery_Offer_Service_ICAS1Sys01();
}

on envVar ChargingManagementExtendedSync_Notification_estimatedTimesAndInfos_Send
{
  if (@this == 1)
  {
    UDP_Segments_total = @ChargingManagementExtendedSync_Notification_Length_estimatedTimesAndInfos/1404 + 1;
    UDP_Segments_left  = UDP_Segments_total;
    
    if (UDP_Segments_total > 1) seg_id_flag = 1;
    else                        seg_id_flag = 0;
    
    Send_Service_ChargingManagementExtendedSync_Notification (0xC010 & 0x0000FFFF);
  }
}
on envVar ChargingManagementExtendedSync_Notification_estimatedTimesAndInfos_Send_cyclic
{
  if (@this == 1)
    setTimercyclic (tChargingManagementExtendedSync_Notification_estimatedTimesAndInfos_Send, @ChargingManagementExtendedSync_Notification_estimatedTimesAndInfos_Send_cyclic_cycletime);
  else
    cancelTimer (tChargingManagementExtendedSync_Notification_estimatedTimesAndInfos_Send);
}
on envVar ChargingManagementExtendedSync_Notification_estimatedTimesAndInfos_Send_cyclic_cycletime
{
  if (@ChargingManagementExtendedSync_Notification_estimatedTimesAndInfos_Send_cyclic == 1)
  {
    cancelTimer (tChargingManagementExtendedSync_Notification_estimatedTimesAndInfos_Send);
    setTimercyclic (tChargingManagementExtendedSync_Notification_estimatedTimesAndInfos_Send, @this);
  }
}
on timer tChargingManagementExtendedSync_Notification_estimatedTimesAndInfos_Send
{
  UDP_Segments_total = @ChargingManagementExtendedSync_Notification_Length_estimatedTimesAndInfos/1404 + 1;
  UDP_Segments_left  = UDP_Segments_total;
  
  if (UDP_Segments_total > 1) seg_id_flag = 1;
  else                        seg_id_flag = 0;
    
  if (@Env_GlobalAppl == 1) Send_Service_ChargingManagementExtendedSync_Notification (0xC010 & 0x0000FFFF);
}

on envVar ChargingManagementExtendedSync_Notification_activeChargingProfiles_Send
{
  if (@this == 1)
  {
    UDP_Segments_total = @ChargingManagementExtendedSync_Notification_Length_activeChargingProfiles/1404 + 1;
    UDP_Segments_left  = UDP_Segments_total;
    
    if (UDP_Segments_total > 1) seg_id_flag = 1;
    else                        seg_id_flag = 0;
    
    Send_Service_ChargingManagementExtendedSync_Notification (0xC020 & 0x0000FFFF);
  }
}
on envVar ChargingManagementExtendedSync_Notification_activeChargingProfiles_Send_cyclic
{
  if (@this == 1)
    setTimercyclic (tChargingManagementExtendedSync_Notification_activeChargingProfiles_Send, @ChargingManagementExtendedSync_Notification_activeChargingProfiles_Send_cyclic_cycletime);
  else
    cancelTimer (tChargingManagementExtendedSync_Notification_activeChargingProfiles_Send);
}
on envVar ChargingManagementExtendedSync_Notification_activeChargingProfiles_Send_cyclic_cycletime
{
  if (@ChargingManagementExtendedSync_Notification_activeChargingProfiles_Send_cyclic == 1)
  {
    cancelTimer (tChargingManagementExtendedSync_Notification_activeChargingProfiles_Send);
    setTimercyclic (tChargingManagementExtendedSync_Notification_activeChargingProfiles_Send, @this);
  }
}
on timer tChargingManagementExtendedSync_Notification_activeChargingProfiles_Send
{
  UDP_Segments_total = @ChargingManagementExtendedSync_Notification_Length_activeChargingProfiles/1404 + 1;
  UDP_Segments_left  = UDP_Segments_total;
  
  if (UDP_Segments_total > 1) seg_id_flag = 1;
  else                        seg_id_flag = 0;
    
  if (@Env_GlobalAppl == 1) Send_Service_ChargingManagementExtendedSync_Notification (0xC020 & 0x0000FFFF);
}

on envVar ChargingManagementExtendedSync_Notification_nextChargingTimers_Send
{
  if (@this == 1)
  {
    UDP_Segments_total = @ChargingManagementExtendedSync_Notification_Length_nextChargingTimers/1404 + 1;
    UDP_Segments_left  = UDP_Segments_total;
    
    if (UDP_Segments_total > 1) seg_id_flag = 1;
    else                        seg_id_flag = 0;
    
    Send_Service_ChargingManagementExtendedSync_Notification (0xC030 & 0x0000FFFF);
  }
}
on envVar ChargingManagementExtendedSync_Notification_nextChargingTimers_Send_cyclic
{
  if (@this == 1)
    setTimercyclic (tChargingManagementExtendedSync_Notification_nextChargingTimers_Send, @ChargingManagementExtendedSync_Notification_nextChargingTimers_Send_cyclic_cycletime);
  else
    cancelTimer (tChargingManagementExtendedSync_Notification_nextChargingTimers_Send);
}
on envVar ChargingManagementExtendedSync_Notification_nextChargingTimers_Send_cyclic_cycletime
{
  if (@ChargingManagementExtendedSync_Notification_nextChargingTimers_Send_cyclic == 1)
  {
    cancelTimer (tChargingManagementExtendedSync_Notification_nextChargingTimers_Send);
    setTimercyclic (tChargingManagementExtendedSync_Notification_nextChargingTimers_Send, @this);
  }
}
on timer tChargingManagementExtendedSync_Notification_nextChargingTimers_Send
{
  UDP_Segments_total = @ChargingManagementExtendedSync_Notification_Length_nextChargingTimers/1404 + 1;
  UDP_Segments_left  = UDP_Segments_total;
  
  if (UDP_Segments_total > 1) seg_id_flag = 1;
  else                        seg_id_flag = 0;
    
  if (@Env_GlobalAppl == 1) Send_Service_ChargingManagementExtendedSync_Notification (0xC030 & 0x0000FFFF);
}

on envVar ChargingManagementExtendedSync_Notification_preferredChargingTimes_Send
{
  if (@this == 1)
  {
    UDP_Segments_total = @ChargingManagementExtendedSync_Notification_Length_preferredChargingTimes/1404 + 1;
    UDP_Segments_left  = UDP_Segments_total;
    
    if (UDP_Segments_total > 1) seg_id_flag = 1;
    else                        seg_id_flag = 0;
    
    Send_Service_ChargingManagementExtendedSync_Notification (0xC040 & 0x0000FFFF);
  }
}
on envVar ChargingManagementExtendedSync_Notification_preferredChargingTimes_Send_cyclic
{
  if (@this == 1)
    setTimercyclic (tChargingManagementExtendedSync_Notification_preferredChargingTimes_Send, @ChargingManagementExtendedSync_Notification_preferredChargingTimes_Send_cyclic_cycletime);
  else
    cancelTimer (tChargingManagementExtendedSync_Notification_preferredChargingTimes_Send);
}
on envVar ChargingManagementExtendedSync_Notification_preferredChargingTimes_Send_cyclic_cycletime
{
  if (@ChargingManagementExtendedSync_Notification_preferredChargingTimes_Send_cyclic == 1)
  {
    cancelTimer (tChargingManagementExtendedSync_Notification_preferredChargingTimes_Send);
    setTimercyclic (tChargingManagementExtendedSync_Notification_preferredChargingTimes_Send, @this);
  }
}
on timer tChargingManagementExtendedSync_Notification_preferredChargingTimes_Send
{
  UDP_Segments_total = @ChargingManagementExtendedSync_Notification_Length_preferredChargingTimes/1404 + 1;
  UDP_Segments_left  = UDP_Segments_total;
  
  if (UDP_Segments_total > 1) seg_id_flag = 1;
  else                        seg_id_flag = 0;
    
  if (@Env_GlobalAppl == 1) Send_Service_ChargingManagementExtendedSync_Notification (0xC040 & 0x0000FFFF);
}


Send_Service_ChargingManagementExtendedSync_Notification (word MethodID)
{
  ethernetPacket EthPaket;

  // Ethernet Packet - MAC Source address
  getvalue (ServiceDiscovery_EthernetPacket_MAC_Source_ICAS1Sys01, buffer_MAC);
  //EthPaket.source.ParseAddress ( buffer_MAC );
  EthPaket.source = ethGetMacAddressAsNumber (buffer_MAC);
  
  // Ethernet Packet - MAC Destination address
  getvalue (ServiceDiscovery_EthernetPacket_MAC_Destination, buffer_MAC);
  //EthPaket.destination.ParseAddress ( buffer_MAC );
  EthPaket.destination = ethGetMacAddressAsNumber (buffer_MAC);
  
  // Ethernet Packet - VLAN
  EthPaket.SetVlan (@ServiceDiscovery_EthernetPacket_VLAN_TPID, @ServiceDiscovery_EthernetPacket_VLAN_TCI);
  
  // Ethernet Packet - Type
  //EthPaket.ipv6.type = @EthernetPacket_Type;
  if (@ServiceDiscovery_EthernetPacket_Type == 0x86DD) EthPaket.ipv6.Init();
  
  
  // IPv6 Packet - Version
  EthPaket.ipv6.version = @ServiceDiscovery_IPv6Packet_Version;

  // IPv6 Packet - Traffic Class
  EthPaket.ipv6.class = @ServiceDiscovery_IPv6Packet_Traffic_Class;
  
  // IPv6 Packet - Flow Label
  EthPaket.ipv6.flow = @ServiceDiscovery_IPv6Packet_Flow_Label;
  
  // IPv6 Packet - Payload_Length
  EthPaket.ipv6.length = @ServiceDiscovery_IPv6Packet_Payload_Length;
  
  // IPv6 Packet - Next Header
  EthPaket.ipv6.next = @ServiceDiscovery_IPv6Packet_Next_Header;
  if (@ServiceDiscovery_IPv6Packet_Next_Header == 6) EthPaket.tcp.Init();
  if (@ServiceDiscovery_IPv6Packet_Next_Header == 17) EthPaket.udp.Init();
  
  // IPv6 Packet - Hop Limit
  EthPaket.ipv6.hopLimit = @ServiceDiscovery_IPv6Packet_Hop_Limit;

  // IPv6 Packet - IPv6 Destination address    // TODO: char array zu byte array
  buffer_ipv6[0]  = @ServiceDiscovery_IPv6Packet_IP_Destination_Unicast_01>>8 & 0xFF;
  buffer_ipv6[1]  = @ServiceDiscovery_IPv6Packet_IP_Destination_Unicast_01    & 0xFF;
  buffer_ipv6[2]  = @ServiceDiscovery_IPv6Packet_IP_Destination_Unicast_02>>8 & 0xFF;
  buffer_ipv6[3]  = @ServiceDiscovery_IPv6Packet_IP_Destination_Unicast_02    & 0xFF;
  buffer_ipv6[4]  = @ServiceDiscovery_IPv6Packet_IP_Destination_Unicast_03>>8 & 0xFF;
  buffer_ipv6[5]  = @ServiceDiscovery_IPv6Packet_IP_Destination_Unicast_03    & 0xFF;
  buffer_ipv6[6]  = @ServiceDiscovery_IPv6Packet_IP_Destination_Unicast_04>>8 & 0xFF;
  buffer_ipv6[7]  = @ServiceDiscovery_IPv6Packet_IP_Destination_Unicast_04    & 0xFF;
  buffer_ipv6[8]  = @ServiceDiscovery_IPv6Packet_IP_Destination_Unicast_05>>8 & 0xFF;
  buffer_ipv6[9]  = @ServiceDiscovery_IPv6Packet_IP_Destination_Unicast_05    & 0xFF;
  buffer_ipv6[10] = @ServiceDiscovery_IPv6Packet_IP_Destination_Unicast_06>>8 & 0xFF;
  buffer_ipv6[11] = @ServiceDiscovery_IPv6Packet_IP_Destination_Unicast_06    & 0xFF;
  buffer_ipv6[12] = @ServiceDiscovery_IPv6Packet_IP_Destination_Unicast_07>>8 & 0xFF;
  buffer_ipv6[13] = @ServiceDiscovery_IPv6Packet_IP_Destination_Unicast_07    & 0xFF;
  buffer_ipv6[14] = @ServiceDiscovery_IPv6Packet_IP_Destination_Unicast_08>>8 & 0xFF;
  buffer_ipv6[15] = @ServiceDiscovery_IPv6Packet_IP_Destination_Unicast_08    & 0xFF;
  EthPaket.ipv6.destination.SetData ( 0, buffer_ipv6, elcount(buffer_ipv6) );

  // IPv6 Packet - IPv6 Source address    // TODO: char array zu byte array
  buffer_ipv6[0]  = @ServiceDiscovery_IPv6Packet_IP_Source_ICAS1Sys01_01>>8 & 0xFF;
  buffer_ipv6[1]  = @ServiceDiscovery_IPv6Packet_IP_Source_ICAS1Sys01_01    & 0xFF;
  buffer_ipv6[2]  = @ServiceDiscovery_IPv6Packet_IP_Source_ICAS1Sys01_02>>8 & 0xFF;
  buffer_ipv6[3]  = @ServiceDiscovery_IPv6Packet_IP_Source_ICAS1Sys01_02    & 0xFF;
  buffer_ipv6[4]  = @ServiceDiscovery_IPv6Packet_IP_Source_ICAS1Sys01_03>>8 & 0xFF;
  buffer_ipv6[5]  = @ServiceDiscovery_IPv6Packet_IP_Source_ICAS1Sys01_03    & 0xFF;
  buffer_ipv6[6]  = @ServiceDiscovery_IPv6Packet_IP_Source_ICAS1Sys01_04>>8 & 0xFF;
  buffer_ipv6[7]  = @ServiceDiscovery_IPv6Packet_IP_Source_ICAS1Sys01_04    & 0xFF;
  buffer_ipv6[8]  = @ServiceDiscovery_IPv6Packet_IP_Source_ICAS1Sys01_05>>8 & 0xFF;
  buffer_ipv6[9]  = @ServiceDiscovery_IPv6Packet_IP_Source_ICAS1Sys01_05    & 0xFF;
  buffer_ipv6[10] = @ServiceDiscovery_IPv6Packet_IP_Source_ICAS1Sys01_06>>8 & 0xFF;
  buffer_ipv6[11] = @ServiceDiscovery_IPv6Packet_IP_Source_ICAS1Sys01_06    & 0xFF;
  buffer_ipv6[12] = @ServiceDiscovery_IPv6Packet_IP_Source_ICAS1Sys01_07>>8 & 0xFF;
  buffer_ipv6[13] = @ServiceDiscovery_IPv6Packet_IP_Source_ICAS1Sys01_07    & 0xFF;
  buffer_ipv6[14] = @ServiceDiscovery_IPv6Packet_IP_Source_ICAS1Sys01_08>>8 & 0xFF;
  buffer_ipv6[15] = @ServiceDiscovery_IPv6Packet_IP_Source_ICAS1Sys01_08    & 0xFF;
  EthPaket.ipv6.source.SetData ( 0, buffer_ipv6, elcount(buffer_ipv6) );

  
  // UDP Packet - Source Port
  EthPaket.udp.source = @ChargingManagementExtendedSync_Notification_Port_Source;
  
  // UDP Packet - Destination Port
  EthPaket.udp.destination = @ChargingManagementExtendedSync_Notification_Port_Destination;
  
  // UDP Packet - Length
  EthPaket.udp.length = @ServiceDiscovery_UDPPacket_Length;
  
  
  // SOME/IP Packet aus Rohdaten zusammenbauen (buffer array)
  i=0;
  
  // SOME/IP Packet - Message ID, Service ID [16 bit]
  buffer[i++] = @ChargingManagementExtendedSync_Notification_Message_ID_Service_ID>>8 & 0xFF;
  buffer[i++] = @ChargingManagementExtendedSync_Notification_Message_ID_Service_ID    & 0xFF;
  
  // SOME/IP Packet - Message ID, Message ID [16 bit]
  switch (MethodID)
  {
    case 0xC010: @ChargingManagementExtendedSync_Notification_Message_ID_Method_ID = @ChargingManagementExtendedSync_Notification_Message_ID_Method_ID_estimatedTimesAndInfos; break;
    case 0xC020: @ChargingManagementExtendedSync_Notification_Message_ID_Method_ID = @ChargingManagementExtendedSync_Notification_Message_ID_Method_ID_activeChargingProfiles; break;
    case 0xC030: @ChargingManagementExtendedSync_Notification_Message_ID_Method_ID = @ChargingManagementExtendedSync_Notification_Message_ID_Method_ID_nextChargingTimers; break;
    case 0xC040: @ChargingManagementExtendedSync_Notification_Message_ID_Method_ID = @ChargingManagementExtendedSync_Notification_Message_ID_Method_ID_preferredChargingTimes; break;
  }
  buffer[i++] = @ChargingManagementExtendedSync_Notification_Message_ID_Method_ID>>8 & 0xFF;
  buffer[i++] = @ChargingManagementExtendedSync_Notification_Message_ID_Method_ID    & 0xFF;
  
  // SOME/IP Packet - Length [32 bit]
  if (UDP_Segments_total == 1)
  {
    switch (MethodID)
    {
      case 0xC010: @ChargingManagementExtendedSync_Notification_Length = @ChargingManagementExtendedSync_Notification_Length_estimatedTimesAndInfos; break;
      case 0xC020: @ChargingManagementExtendedSync_Notification_Length = @ChargingManagementExtendedSync_Notification_Length_activeChargingProfiles; break;
      case 0xC030: @ChargingManagementExtendedSync_Notification_Length = @ChargingManagementExtendedSync_Notification_Length_nextChargingTimers; break;
      case 0xC040: @ChargingManagementExtendedSync_Notification_Length = @ChargingManagementExtendedSync_Notification_Length_preferredChargingTimes; break;
    }
  }
  else
  {
    if (UDP_Segments_left > 1)
    {
      switch (MethodID)
      {
        case 0xC010: @ChargingManagementExtendedSync_Notification_Length = 1404; break;
        case 0xC020: @ChargingManagementExtendedSync_Notification_Length = 1404; break;
        case 0xC030: @ChargingManagementExtendedSync_Notification_Length = 1404; break;
        case 0xC040: @ChargingManagementExtendedSync_Notification_Length = 1404; break;
      }
    }
    else
    {
      switch (MethodID)
      {
        case 0xC010: @ChargingManagementExtendedSync_Notification_Length = ChargingManagementExtendedSync_payload_length_estimatedTimesAndInfos - 1404*(UDP_Segments_total-UDP_Segments_left) + 24; break;
        case 0xC020: @ChargingManagementExtendedSync_Notification_Length = ChargingManagementExtendedSync_payload_length_activeChargingProfiles - 1404*(UDP_Segments_total-UDP_Segments_left) + 24; break;
        case 0xC030: @ChargingManagementExtendedSync_Notification_Length = ChargingManagementExtendedSync_payload_length_nextChargingTimers     - 1404*(UDP_Segments_total-UDP_Segments_left) + 24; break;
        case 0xC040: @ChargingManagementExtendedSync_Notification_Length = ChargingManagementExtendedSync_payload_length_preferredChargingTimes - 1404*(UDP_Segments_total-UDP_Segments_left) + 24; break;
      }
    }
  }
  buffer[i++] = @ChargingManagementExtendedSync_Notification_Length>>24 & 0xFF;
  buffer[i++] = @ChargingManagementExtendedSync_Notification_Length>>16 & 0xFF;
  buffer[i++] = @ChargingManagementExtendedSync_Notification_Length>> 8 & 0xFF;
  buffer[i++] = @ChargingManagementExtendedSync_Notification_Length     & 0xFF;
  
  // SOME/IP Packet - Request ID, Client ID [16 bit]
  buffer[i++] = @ChargingManagementExtendedSync_Notification_Request_ID_Client_ID>>8 & 0xFF;
  buffer[i++] = @ChargingManagementExtendedSync_Notification_Request_ID_Client_ID    & 0xFF;
  
  // SOME/IP Packet - Request ID, Session ID) [16 bit]
  if ((UDP_Segments_total == 1) || (seg_id_flag == 1))
  {
    @ServiceDiscovery_SOMEIPPacket_Notification_Request_ID_Session_ID = @ServiceDiscovery_SOMEIPPacket_Notification_Request_ID_Session_ID + 1;
    if (@ServiceDiscovery_SOMEIPPacket_Notification_Request_ID_Session_ID == 0x10000) @ServiceDiscovery_SOMEIPPacket_Notification_Request_ID_Session_ID = 1;
    seg_id_flag = 0;
  }
  
  buffer[i++] = @ServiceDiscovery_SOMEIPPacket_Notification_Request_ID_Session_ID>>8 & 0xFF;
  buffer[i++] = @ServiceDiscovery_SOMEIPPacket_Notification_Request_ID_Session_ID    & 0xFF;
  
  // SOME/IP Packet - Protocol Version [8 bit]
  buffer[i++] = @ChargingManagementExtendedSync_Notification_Protocol_Version;
  
  // SOME/IP Packet - Interface Version [8 bit]
  buffer[i++] = @ChargingManagementExtendedSync_Notification_Interface_Version;
  
  // SOME/IP Packet - Message Type [8 bit]
  buffer[i++] = @ChargingManagementExtendedSync_Notification_Message_Type;
  
  // SOME/IP Packet - Return Code [8 bit]
  buffer[i++] = @ChargingManagementExtendedSync_Notification_Return_Code;
  
  
  if (UDP_Segments_total > 1)
  {
    if (UDP_Segments_left >= 0)
    { 
      // Message Type neu setzen
      buffer[i-2] = @ChargingManagementExtendedSync_Notification_Message_Type + 0x20;
      
      // Offset (16byte Schritte, 1392/16 = 87)
      @ChargingManagementExtendedSync_Notification_Offset = 87 * (UDP_Segments_total - UDP_Segments_left);
      
      // More Segments Flag
      if (UDP_Segments_left > 1) @ChargingManagementExtendedSync_Notification_More_Segments_Flag = 1;
      else                       @ChargingManagementExtendedSync_Notification_More_Segments_Flag = 0;
      
      buffer[i++] =   @ChargingManagementExtendedSync_Notification_Offset>>20 & 0xFF;
      buffer[i++] =   @ChargingManagementExtendedSync_Notification_Offset>>12 & 0xFF;
      buffer[i++] =   @ChargingManagementExtendedSync_Notification_Offset>>4  & 0xFF;
      buffer[i++] = ((@ChargingManagementExtendedSync_Notification_Offset<<4) & 0xF0) + (@ChargingManagementExtendedSync_Notification_More_Segments_Flag & 0x01);
    }
  }
  
  UDP_Segments_left--;
  
  ////// estimatedTimesAndInfos notifier //////
  if (MethodID == 0xC010)
  {
    if (UDP_Segments_total == 1)
    {
      for (j=0; j<ChargingManagementExtendedSync_payload_length_estimatedTimesAndInfos; j++)
        buffer[i++] = ChargingManagementExtendedSync_payload_buffer_estimatedTimesAndInfos[j];
    }
    else
    {
      if (UDP_Segments_left >= 1)
      {
        for (j=(UDP_Segments_total-UDP_Segments_left-1)*1392; j<(UDP_Segments_total-UDP_Segments_left)*1392; j++)
          buffer[i++] = ChargingManagementExtendedSync_payload_buffer_estimatedTimesAndInfos[j];
      }
      else
      {
        for (j=(UDP_Segments_total-(UDP_Segments_left+1))*1392; j<ChargingManagementExtendedSync_payload_length_estimatedTimesAndInfos; j++)
          buffer[i++] = ChargingManagementExtendedSync_payload_buffer_estimatedTimesAndInfos[j];
      }
    }
  }
  
  ////// activeChargingProfiles notifier //////
  if (MethodID == 0xC020)
  {
    if (UDP_Segments_total == 1)
    {
      for (j=0; j<ChargingManagementExtendedSync_payload_length_activeChargingProfiles; j++)
        buffer[i++] = ChargingManagementExtendedSync_payload_buffer_activeChargingProfiles[j];
    }
    else
    {
      if (UDP_Segments_left >= 1)
      {
        for (j=(UDP_Segments_total-UDP_Segments_left-1)*1392; j<(UDP_Segments_total-UDP_Segments_left)*1392; j++)
          buffer[i++] = ChargingManagementExtendedSync_payload_buffer_activeChargingProfiles[j];
      }
      else
      {
        for (j=(UDP_Segments_total-(UDP_Segments_left+1))*1392; j<ChargingManagementExtendedSync_payload_length_activeChargingProfiles; j++)
          buffer[i++] = ChargingManagementExtendedSync_payload_buffer_activeChargingProfiles[j];
      }
    }
  }
  
  ////// nextChargingTimers notifier //////
  if (MethodID == 0xC030)
  {
    if (UDP_Segments_total == 1)
    {
      for (j=0; j<ChargingManagementExtendedSync_payload_length_nextChargingTimers; j++)
        buffer[i++] = ChargingManagementExtendedSync_payload_buffer_nextChargingTimers[j];
    }
    else
    {
      if (UDP_Segments_left >= 1)
      {
        for (j=(UDP_Segments_total-UDP_Segments_left-1)*1392; j<(UDP_Segments_total-UDP_Segments_left)*1392; j++)
          buffer[i++] = ChargingManagementExtendedSync_payload_buffer_nextChargingTimers[j];
      }
      else
      {
        for (j=(UDP_Segments_total-(UDP_Segments_left+1))*1392; j<ChargingManagementExtendedSync_payload_length_nextChargingTimers; j++)
          buffer[i++] = ChargingManagementExtendedSync_payload_buffer_nextChargingTimers[j];
      }
    }
  }
  
  ////// preferredChargingTimes notifier //////
  if (MethodID == 0xC040)
  {
    if (UDP_Segments_total == 1)
    {
      for (j=0; j<ChargingManagementExtendedSync_payload_length_preferredChargingTimes; j++)
        buffer[i++] = ChargingManagementExtendedSync_payload_buffer_preferredChargingTimes[j];
    }
    else
    {
      if (UDP_Segments_left >= 1)
      {
        for (j=(UDP_Segments_total-UDP_Segments_left-1)*1392; j<(UDP_Segments_total-UDP_Segments_left)*1392; j++)
          buffer[i++] = ChargingManagementExtendedSync_payload_buffer_preferredChargingTimes[j];
      }
      else
      {
        for (j=(UDP_Segments_total-(UDP_Segments_left+1))*1392; j<ChargingManagementExtendedSync_payload_length_preferredChargingTimes; j++)
          buffer[i++] = ChargingManagementExtendedSync_payload_buffer_preferredChargingTimes[j];
      }
    }
  }
  
  
  // Rohdaten in UDP Paket schreiben
  EthPaket.udp.SetData( 0, buffer, i );

  // calculate UDP and IPv6 checksum and send Ethernet packet
  EthPaket.CompletePacket();
  output( EthPaket );
  
  // prüfen ob alle Segemente gesendet wurden, sonst senden erneut aufrufen
  ChargingManagementExtendedSync_Segmentation_Method_ID = MethodID;
  if (UDP_Segments_left>0)
    settimer(ChargingManagementExtendedSync_Segmentation_delay, 50);
}

on timer ChargingManagementExtendedSync_Segmentation_delay
{
  Send_Service_ChargingManagementExtendedSync_Notification (ChargingManagementExtendedSync_Segmentation_Method_ID);
}








////////// estimatedTimesAndInfos Notification //////////

on envVar ChargingManagementExtendedSync_Notification_LengthIndicator_Struct_estimatedTimesAndInfos
{
  ChargingManagementExtendedSync_Notification_estimatedTimesAndInfos();
}
on envVar ChargingManagementExtendedSync_Notification_LengthIndicator_Element_estimatedTimesAndInfos
{
  ChargingManagementExtendedSync_Notification_estimatedTimesAndInfos();
}
on envVar ChargingManagementExtendedSync_Notification_estimatedTimesAndInfos_elementId
{
  ChargingManagementExtendedSync_array_estimatedTimesAndInfos_elementId[@ChargingManagementExtendedSync_Notification_estimatedTimesAndInfos_Element] = @this;
  ChargingManagementExtendedSync_Notification_estimatedTimesAndInfos();
}
on envVar ChargingManagementExtendedSync_Notification_estimatedTimesAndInfos_isExternalServiceAvailable
{
  ChargingManagementExtendedSync_array_estimatedTimesAndInfos_isExternalServiceAvailable[@ChargingManagementExtendedSync_Notification_estimatedTimesAndInfos_Element] = @this;
  ChargingManagementExtendedSync_Notification_estimatedTimesAndInfos();
}
on envVar ChargingManagementExtendedSync_Notification_estimatedTimesAndInfos_isEstimatedStartTimeRelevant
{
  ChargingManagementExtendedSync_array_estimatedTimesAndInfos_isEstimatedStartTimeRelevant[@ChargingManagementExtendedSync_Notification_estimatedTimesAndInfos_Element] = @this;
  ChargingManagementExtendedSync_Notification_estimatedTimesAndInfos();
}
on envVar ChargingManagementExtendedSync_Notification_estimatedTimesAndInfos_estimatedStartTimeYear
{
  ChargingManagementExtendedSync_array_estimatedTimesAndInfos_estimatedStartTimeYear[@ChargingManagementExtendedSync_Notification_estimatedTimesAndInfos_Element] = @this;
  ChargingManagementExtendedSync_Notification_estimatedTimesAndInfos();
}
on envVar ChargingManagementExtendedSync_Notification_estimatedTimesAndInfos_estimatedStartTimeMonth
{
  ChargingManagementExtendedSync_array_estimatedTimesAndInfos_estimatedStartTimeMonth[@ChargingManagementExtendedSync_Notification_estimatedTimesAndInfos_Element] = @this;
  ChargingManagementExtendedSync_Notification_estimatedTimesAndInfos();
}
on envVar ChargingManagementExtendedSync_Notification_estimatedTimesAndInfos_estimatedStartTimeDay
{
  ChargingManagementExtendedSync_array_estimatedTimesAndInfos_estimatedStartTimeDay[@ChargingManagementExtendedSync_Notification_estimatedTimesAndInfos_Element] = @this;
  ChargingManagementExtendedSync_Notification_estimatedTimesAndInfos();
}
on envVar ChargingManagementExtendedSync_Notification_estimatedTimesAndInfos_estimatedStartTimeHour
{
  ChargingManagementExtendedSync_array_estimatedTimesAndInfos_estimatedStartTimeHour[@ChargingManagementExtendedSync_Notification_estimatedTimesAndInfos_Element] = @this;
  ChargingManagementExtendedSync_Notification_estimatedTimesAndInfos();
}
on envVar ChargingManagementExtendedSync_Notification_estimatedTimesAndInfos_estimatedStartTimeMinute
{
  ChargingManagementExtendedSync_array_estimatedTimesAndInfos_estimatedStartTimeMinute[@ChargingManagementExtendedSync_Notification_estimatedTimesAndInfos_Element] = @this;
  ChargingManagementExtendedSync_Notification_estimatedTimesAndInfos();
}
on envVar ChargingManagementExtendedSync_Notification_estimatedTimesAndInfos_isEstimatedFinishTimeRelevant
{
  ChargingManagementExtendedSync_array_estimatedTimesAndInfos_isEstimatedFinishTimeRelevant[@ChargingManagementExtendedSync_Notification_estimatedTimesAndInfos_Element] = @this;
  ChargingManagementExtendedSync_Notification_estimatedTimesAndInfos();
}
on envVar ChargingManagementExtendedSync_Notification_estimatedTimesAndInfos_estimatedFinishTimeYear
{
  ChargingManagementExtendedSync_array_estimatedTimesAndInfos_estimatedFinishTimeYear[@ChargingManagementExtendedSync_Notification_estimatedTimesAndInfos_Element] = @this;
  ChargingManagementExtendedSync_Notification_estimatedTimesAndInfos();
}
on envVar ChargingManagementExtendedSync_Notification_estimatedTimesAndInfos_estimatedFinishTimeMonth
{
  ChargingManagementExtendedSync_array_estimatedTimesAndInfos_estimatedFinishTimeMonth[@ChargingManagementExtendedSync_Notification_estimatedTimesAndInfos_Element] = @this;
  ChargingManagementExtendedSync_Notification_estimatedTimesAndInfos();
}
on envVar ChargingManagementExtendedSync_Notification_estimatedTimesAndInfos_estimatedFinishTimeDay
{
  ChargingManagementExtendedSync_array_estimatedTimesAndInfos_estimatedFinishTimeDay[@ChargingManagementExtendedSync_Notification_estimatedTimesAndInfos_Element] = @this;
  ChargingManagementExtendedSync_Notification_estimatedTimesAndInfos();
}
on envVar ChargingManagementExtendedSync_Notification_estimatedTimesAndInfos_estimatedFinishTimeHour
{
  ChargingManagementExtendedSync_array_estimatedTimesAndInfos_estimatedFinishTimeHour[@ChargingManagementExtendedSync_Notification_estimatedTimesAndInfos_Element] = @this;
  ChargingManagementExtendedSync_Notification_estimatedTimesAndInfos();
}
on envVar ChargingManagementExtendedSync_Notification_estimatedTimesAndInfos_estimatedFinishTimeMinute
{
  ChargingManagementExtendedSync_array_estimatedTimesAndInfos_estimatedFinishTimeMinute[@ChargingManagementExtendedSync_Notification_estimatedTimesAndInfos_Element] = @this;
  ChargingManagementExtendedSync_Notification_estimatedTimesAndInfos();
}
on envVar ChargingManagementExtendedSync_Notification_estimatedTimesAndInfos_targetReachable
{
  ChargingManagementExtendedSync_array_estimatedTimesAndInfos_targetReachable[@ChargingManagementExtendedSync_Notification_estimatedTimesAndInfos_Element] = @this;
  ChargingManagementExtendedSync_Notification_estimatedTimesAndInfos();
}
on envVar ChargingManagementExtendedSync_Notification_estimatedTimesAndInfos_elementId_available
{
  ChargingManagementExtendedSync_array_estimatedTimesAndInfos_elementId_available[@ChargingManagementExtendedSync_Notification_estimatedTimesAndInfos_Element] = @this;
  ChargingManagementExtendedSync_Notification_estimatedTimesAndInfos();
}
on envVar ChargingManagementExtendedSync_Notification_estimatedTimesAndInfos_isExternalServiceAvailable_available
{
  ChargingManagementExtendedSync_array_estimatedTimesAndInfos_isExternalServiceAvailable_available[@ChargingManagementExtendedSync_Notification_estimatedTimesAndInfos_Element] = @this;
  ChargingManagementExtendedSync_Notification_estimatedTimesAndInfos();
}
on envVar ChargingManagementExtendedSync_Notification_estimatedTimesAndInfos_isEstimatedStartTimeRelevant_available
{
  ChargingManagementExtendedSync_array_estimatedTimesAndInfos_isEstimatedStartTimeRelevant_available[@ChargingManagementExtendedSync_Notification_estimatedTimesAndInfos_Element] = @this;
  ChargingManagementExtendedSync_Notification_estimatedTimesAndInfos();
}
on envVar ChargingManagementExtendedSync_Notification_estimatedTimesAndInfos_estimatedStartTimeYear_available
{
  ChargingManagementExtendedSync_array_estimatedTimesAndInfos_estimatedStartTimeYear_available[@ChargingManagementExtendedSync_Notification_estimatedTimesAndInfos_Element] = @this;
  ChargingManagementExtendedSync_Notification_estimatedTimesAndInfos();
}
on envVar ChargingManagementExtendedSync_Notification_estimatedTimesAndInfos_estimatedStartTimeMonth_available
{
  ChargingManagementExtendedSync_array_estimatedTimesAndInfos_estimatedStartTimeMonth_available[@ChargingManagementExtendedSync_Notification_estimatedTimesAndInfos_Element] = @this;
  ChargingManagementExtendedSync_Notification_estimatedTimesAndInfos();
}
on envVar ChargingManagementExtendedSync_Notification_estimatedTimesAndInfos_estimatedStartTimeDay_available
{
  ChargingManagementExtendedSync_array_estimatedTimesAndInfos_estimatedStartTimeDay_available[@ChargingManagementExtendedSync_Notification_estimatedTimesAndInfos_Element] = @this;
  ChargingManagementExtendedSync_Notification_estimatedTimesAndInfos();
}
on envVar ChargingManagementExtendedSync_Notification_estimatedTimesAndInfos_estimatedStartTimeHour_available
{
  ChargingManagementExtendedSync_array_estimatedTimesAndInfos_estimatedStartTimeHour_available[@ChargingManagementExtendedSync_Notification_estimatedTimesAndInfos_Element] = @this;
  ChargingManagementExtendedSync_Notification_estimatedTimesAndInfos();
}
on envVar ChargingManagementExtendedSync_Notification_estimatedTimesAndInfos_estimatedStartTimeMinute_available
{
  ChargingManagementExtendedSync_array_estimatedTimesAndInfos_estimatedStartTimeMinute_available[@ChargingManagementExtendedSync_Notification_estimatedTimesAndInfos_Element] = @this;
  ChargingManagementExtendedSync_Notification_estimatedTimesAndInfos();
}
on envVar ChargingManagementExtendedSync_Notification_estimatedTimesAndInfos_isEstimatedFinishTimeRelevant_available
{
  ChargingManagementExtendedSync_array_estimatedTimesAndInfos_isEstimatedFinishTimeRelevant_available[@ChargingManagementExtendedSync_Notification_estimatedTimesAndInfos_Element] = @this;
  ChargingManagementExtendedSync_Notification_estimatedTimesAndInfos();
}
on envVar ChargingManagementExtendedSync_Notification_estimatedTimesAndInfos_estimatedFinishTimeYear_available
{
  ChargingManagementExtendedSync_array_estimatedTimesAndInfos_estimatedFinishTimeYear_available[@ChargingManagementExtendedSync_Notification_estimatedTimesAndInfos_Element] = @this;
  ChargingManagementExtendedSync_Notification_estimatedTimesAndInfos();
}
on envVar ChargingManagementExtendedSync_Notification_estimatedTimesAndInfos_estimatedFinishTimeMonth_available
{
  ChargingManagementExtendedSync_array_estimatedTimesAndInfos_estimatedFinishTimeMonth_available[@ChargingManagementExtendedSync_Notification_estimatedTimesAndInfos_Element] = @this;
  ChargingManagementExtendedSync_Notification_estimatedTimesAndInfos();
}
on envVar ChargingManagementExtendedSync_Notification_estimatedTimesAndInfos_estimatedFinishTimeDay_available
{
  ChargingManagementExtendedSync_array_estimatedTimesAndInfos_estimatedFinishTimeDay_available[@ChargingManagementExtendedSync_Notification_estimatedTimesAndInfos_Element] = @this;
  ChargingManagementExtendedSync_Notification_estimatedTimesAndInfos();
}
on envVar ChargingManagementExtendedSync_Notification_estimatedTimesAndInfos_estimatedFinishTimeHour_available
{
  ChargingManagementExtendedSync_array_estimatedTimesAndInfos_estimatedFinishTimeHour_available[@ChargingManagementExtendedSync_Notification_estimatedTimesAndInfos_Element] = @this;
  ChargingManagementExtendedSync_Notification_estimatedTimesAndInfos();
}
on envVar ChargingManagementExtendedSync_Notification_estimatedTimesAndInfos_estimatedFinishTimeMinute_available
{
  ChargingManagementExtendedSync_array_estimatedTimesAndInfos_estimatedFinishTimeMinute_available[@ChargingManagementExtendedSync_Notification_estimatedTimesAndInfos_Element] = @this;
  ChargingManagementExtendedSync_Notification_estimatedTimesAndInfos();
}
on envVar ChargingManagementExtendedSync_Notification_estimatedTimesAndInfos_targetReachable_available
{
  ChargingManagementExtendedSync_array_estimatedTimesAndInfos_targetReachable_available[@ChargingManagementExtendedSync_Notification_estimatedTimesAndInfos_Element] = @this;
  ChargingManagementExtendedSync_Notification_estimatedTimesAndInfos();
}
on envVar ChargingManagementExtendedSync_Notification_estimatedTimesAndInfos_Payload
{
  ChargingManagementExtendedSync_Notification_estimatedTimesAndInfos_update();
}


ChargingManagementExtendedSync_Notification_estimatedTimesAndInfos()
{
  word payload_counter = 0;
  word start_pos       = 0;
  word element_length  = 0;
  
  // Length Indicator Struct - Platzhalter
  payload_counter = 0+4;
  start_pos = 0;
  
  for (j=0; j<@ChargingManagementExtendedSync_Notification_estimatedTimesAndInfos_Element_TotalNum; j++)
  {
    ChargingManagementExtendedSync_array_estimatedTimesAndInfos_available_functions[j] = ChargingManagementExtendedSync_array_estimatedTimesAndInfos_elementId_available[j]
                                                                                       + ChargingManagementExtendedSync_array_estimatedTimesAndInfos_isExternalServiceAvailable_available[j]
                                                                                       + ChargingManagementExtendedSync_array_estimatedTimesAndInfos_isEstimatedStartTimeRelevant_available[j]
                                                                                       + ChargingManagementExtendedSync_array_estimatedTimesAndInfos_estimatedStartTimeYear_available[j]
                                                                                       + ChargingManagementExtendedSync_array_estimatedTimesAndInfos_estimatedStartTimeMonth_available[j]
                                                                                       + ChargingManagementExtendedSync_array_estimatedTimesAndInfos_estimatedStartTimeDay_available[j]
                                                                                       + ChargingManagementExtendedSync_array_estimatedTimesAndInfos_estimatedStartTimeHour_available[j]
                                                                                       + ChargingManagementExtendedSync_array_estimatedTimesAndInfos_estimatedStartTimeMinute_available[j]
                                                                                       + ChargingManagementExtendedSync_array_estimatedTimesAndInfos_isEstimatedFinishTimeRelevant_available[j]
                                                                                       + ChargingManagementExtendedSync_array_estimatedTimesAndInfos_estimatedFinishTimeYear_available[j]
                                                                                       + ChargingManagementExtendedSync_array_estimatedTimesAndInfos_estimatedFinishTimeMonth_available[j]
                                                                                       + ChargingManagementExtendedSync_array_estimatedTimesAndInfos_estimatedFinishTimeDay_available[j]
                                                                                       + ChargingManagementExtendedSync_array_estimatedTimesAndInfos_estimatedFinishTimeHour_available[j]
                                                                                       + ChargingManagementExtendedSync_array_estimatedTimesAndInfos_estimatedFinishTimeMinute_available[j]
                                                                                       + ChargingManagementExtendedSync_array_estimatedTimesAndInfos_targetReachable_available[j];
    
    // Length Indicator Element - Platzhalter
    if (ChargingManagementExtendedSync_array_estimatedTimesAndInfos_available_functions[j] > 0)
    {
      start_pos = payload_counter;
      payload_counter = payload_counter + 4;
    }
    else 
      start_pos = payload_counter;
    
    
    // 0 elementId (uint32)
    if (ChargingManagementExtendedSync_array_estimatedTimesAndInfos_elementId_available[j] == 1)
    {
      tag_dataID = 0;
      ChargingManagementExtendedSync_payload_buffer_estimatedTimesAndInfos[payload_counter++] = 2 * 16 /* Wiretype = 2 =^ 32 Bit */ + ((tag_dataID>>8) & 0x0F) /* DataID High Part */ ;
      ChargingManagementExtendedSync_payload_buffer_estimatedTimesAndInfos[payload_counter++] = tag_dataID & 0xFF /* DataID Low Part */ ;
      
      ChargingManagementExtendedSync_payload_buffer_estimatedTimesAndInfos[payload_counter++] = ChargingManagementExtendedSync_array_estimatedTimesAndInfos_elementId[j]>>24 & 0xFF;
      ChargingManagementExtendedSync_payload_buffer_estimatedTimesAndInfos[payload_counter++] = ChargingManagementExtendedSync_array_estimatedTimesAndInfos_elementId[j]>>16 & 0xFF;
      ChargingManagementExtendedSync_payload_buffer_estimatedTimesAndInfos[payload_counter++] = ChargingManagementExtendedSync_array_estimatedTimesAndInfos_elementId[j]>> 8 & 0xFF;
      ChargingManagementExtendedSync_payload_buffer_estimatedTimesAndInfos[payload_counter++] = ChargingManagementExtendedSync_array_estimatedTimesAndInfos_elementId[j]     & 0xFF;
    }
    
    
    // 1 isExternalServiceAvailable (boolean)
    if (ChargingManagementExtendedSync_array_estimatedTimesAndInfos_isExternalServiceAvailable_available[j] == 1)
    {
      tag_dataID = 1;
      ChargingManagementExtendedSync_payload_buffer_estimatedTimesAndInfos[payload_counter++] = 0 * 16 /* Wiretype = 0 =^ 8 Bit */ + ((tag_dataID>>8) & 0x0F) /* DataID High Part */ ;
      ChargingManagementExtendedSync_payload_buffer_estimatedTimesAndInfos[payload_counter++] = tag_dataID & 0xFF /* DataID Low Part */ ;
      
      ChargingManagementExtendedSync_payload_buffer_estimatedTimesAndInfos[payload_counter++] = ChargingManagementExtendedSync_array_estimatedTimesAndInfos_isExternalServiceAvailable[j] & 0xFF;
    }
    
    
    // 2 isEstimatedStartTimeRelevant (boolean)
    if (ChargingManagementExtendedSync_array_estimatedTimesAndInfos_isEstimatedStartTimeRelevant_available[j] == 1)
    {
      tag_dataID = 2;
      ChargingManagementExtendedSync_payload_buffer_estimatedTimesAndInfos[payload_counter++] = 0 * 16 /* Wiretype = 0 =^ 8 Bit */ + ((tag_dataID>>8) & 0x0F) /* DataID High Part */ ;
      ChargingManagementExtendedSync_payload_buffer_estimatedTimesAndInfos[payload_counter++] = tag_dataID & 0xFF /* DataID Low Part */ ;
      
      ChargingManagementExtendedSync_payload_buffer_estimatedTimesAndInfos[payload_counter++] = ChargingManagementExtendedSync_array_estimatedTimesAndInfos_isEstimatedStartTimeRelevant[j] & 0xFF;
    }
    
    
    // 3 estimatedStartTimeYear (uint32)
    if (ChargingManagementExtendedSync_array_estimatedTimesAndInfos_estimatedStartTimeYear_available[j] == 1)
    {
      tag_dataID = 3;
      ChargingManagementExtendedSync_payload_buffer_estimatedTimesAndInfos[payload_counter++] = 2 * 16 /* Wiretype = 2 =^ 32 Bit */ + ((tag_dataID>>8) & 0x0F) /* DataID High Part */ ;
      ChargingManagementExtendedSync_payload_buffer_estimatedTimesAndInfos[payload_counter++] = tag_dataID & 0xFF /* DataID Low Part */ ;
      
      ChargingManagementExtendedSync_payload_buffer_estimatedTimesAndInfos[payload_counter++] = ChargingManagementExtendedSync_array_estimatedTimesAndInfos_estimatedStartTimeYear[j]>>24 & 0xFF;
      ChargingManagementExtendedSync_payload_buffer_estimatedTimesAndInfos[payload_counter++] = ChargingManagementExtendedSync_array_estimatedTimesAndInfos_estimatedStartTimeYear[j]>>16 & 0xFF;
      ChargingManagementExtendedSync_payload_buffer_estimatedTimesAndInfos[payload_counter++] = ChargingManagementExtendedSync_array_estimatedTimesAndInfos_estimatedStartTimeYear[j]>> 8 & 0xFF;
      ChargingManagementExtendedSync_payload_buffer_estimatedTimesAndInfos[payload_counter++] = ChargingManagementExtendedSync_array_estimatedTimesAndInfos_estimatedStartTimeYear[j]     & 0xFF;
    }
    
    
    // 4 estimatedStartTimeMonth (uint32)
    if (ChargingManagementExtendedSync_array_estimatedTimesAndInfos_estimatedStartTimeMonth_available[j] == 1)
    {
      tag_dataID = 4;
      ChargingManagementExtendedSync_payload_buffer_estimatedTimesAndInfos[payload_counter++] = 2 * 16 /* Wiretype = 2 =^ 32 Bit */ + ((tag_dataID>>8) & 0x0F) /* DataID High Part */ ;
      ChargingManagementExtendedSync_payload_buffer_estimatedTimesAndInfos[payload_counter++] = tag_dataID & 0xFF /* DataID Low Part */ ;
      
      ChargingManagementExtendedSync_payload_buffer_estimatedTimesAndInfos[payload_counter++] = ChargingManagementExtendedSync_array_estimatedTimesAndInfos_estimatedStartTimeMonth[j]>>24 & 0xFF;
      ChargingManagementExtendedSync_payload_buffer_estimatedTimesAndInfos[payload_counter++] = ChargingManagementExtendedSync_array_estimatedTimesAndInfos_estimatedStartTimeMonth[j]>>16 & 0xFF;
      ChargingManagementExtendedSync_payload_buffer_estimatedTimesAndInfos[payload_counter++] = ChargingManagementExtendedSync_array_estimatedTimesAndInfos_estimatedStartTimeMonth[j]>> 8 & 0xFF;
      ChargingManagementExtendedSync_payload_buffer_estimatedTimesAndInfos[payload_counter++] = ChargingManagementExtendedSync_array_estimatedTimesAndInfos_estimatedStartTimeMonth[j]     & 0xFF;
    }
    
    
    // 5 estimatedStartTimeDay (uint32)
    if (ChargingManagementExtendedSync_array_estimatedTimesAndInfos_estimatedStartTimeDay_available[j] == 1)
    {
      tag_dataID = 5;
      ChargingManagementExtendedSync_payload_buffer_estimatedTimesAndInfos[payload_counter++] = 2 * 16 /* Wiretype = 2 =^ 32 Bit */ + ((tag_dataID>>8) & 0x0F) /* DataID High Part */ ;
      ChargingManagementExtendedSync_payload_buffer_estimatedTimesAndInfos[payload_counter++] = tag_dataID & 0xFF /* DataID Low Part */ ;
      
      ChargingManagementExtendedSync_payload_buffer_estimatedTimesAndInfos[payload_counter++] = ChargingManagementExtendedSync_array_estimatedTimesAndInfos_estimatedStartTimeDay[j]>>24 & 0xFF;
      ChargingManagementExtendedSync_payload_buffer_estimatedTimesAndInfos[payload_counter++] = ChargingManagementExtendedSync_array_estimatedTimesAndInfos_estimatedStartTimeDay[j]>>16 & 0xFF;
      ChargingManagementExtendedSync_payload_buffer_estimatedTimesAndInfos[payload_counter++] = ChargingManagementExtendedSync_array_estimatedTimesAndInfos_estimatedStartTimeDay[j]>> 8 & 0xFF;
      ChargingManagementExtendedSync_payload_buffer_estimatedTimesAndInfos[payload_counter++] = ChargingManagementExtendedSync_array_estimatedTimesAndInfos_estimatedStartTimeDay[j]     & 0xFF;
    }
    
    
    // 6 estimatedStartTimeHour (uint32)
    if (ChargingManagementExtendedSync_array_estimatedTimesAndInfos_estimatedStartTimeHour_available[j] == 1)
    {
      tag_dataID = 6;
      ChargingManagementExtendedSync_payload_buffer_estimatedTimesAndInfos[payload_counter++] = 2 * 16 /* Wiretype = 2 =^ 32 Bit */ + ((tag_dataID>>8) & 0x0F) /* DataID High Part */ ;
      ChargingManagementExtendedSync_payload_buffer_estimatedTimesAndInfos[payload_counter++] = tag_dataID & 0xFF /* DataID Low Part */ ;
      
      ChargingManagementExtendedSync_payload_buffer_estimatedTimesAndInfos[payload_counter++] = ChargingManagementExtendedSync_array_estimatedTimesAndInfos_estimatedStartTimeHour[j]>>24 & 0xFF;
      ChargingManagementExtendedSync_payload_buffer_estimatedTimesAndInfos[payload_counter++] = ChargingManagementExtendedSync_array_estimatedTimesAndInfos_estimatedStartTimeHour[j]>>16 & 0xFF;
      ChargingManagementExtendedSync_payload_buffer_estimatedTimesAndInfos[payload_counter++] = ChargingManagementExtendedSync_array_estimatedTimesAndInfos_estimatedStartTimeHour[j]>> 8 & 0xFF;
      ChargingManagementExtendedSync_payload_buffer_estimatedTimesAndInfos[payload_counter++] = ChargingManagementExtendedSync_array_estimatedTimesAndInfos_estimatedStartTimeHour[j]     & 0xFF;
    }
    
    
    // 7 estimatedStartTimeMinute (uint32)
    if (ChargingManagementExtendedSync_array_estimatedTimesAndInfos_estimatedStartTimeMinute_available[j] == 1)
    {
      tag_dataID = 1;
      ChargingManagementExtendedSync_payload_buffer_estimatedTimesAndInfos[payload_counter++] = 2 * 16 /* Wiretype = 2 =^ 32 Bit */ + ((tag_dataID>>8) & 0x0F) /* DataID High Part */ ;
      ChargingManagementExtendedSync_payload_buffer_estimatedTimesAndInfos[payload_counter++] = tag_dataID & 0xFF /* DataID Low Part */ ;
      
      ChargingManagementExtendedSync_payload_buffer_estimatedTimesAndInfos[payload_counter++] = ChargingManagementExtendedSync_array_estimatedTimesAndInfos_estimatedStartTimeMinute[j]>>24 & 0xFF;
      ChargingManagementExtendedSync_payload_buffer_estimatedTimesAndInfos[payload_counter++] = ChargingManagementExtendedSync_array_estimatedTimesAndInfos_estimatedStartTimeMinute[j]>>16 & 0xFF;
      ChargingManagementExtendedSync_payload_buffer_estimatedTimesAndInfos[payload_counter++] = ChargingManagementExtendedSync_array_estimatedTimesAndInfos_estimatedStartTimeMinute[j]>> 8 & 0xFF;
      ChargingManagementExtendedSync_payload_buffer_estimatedTimesAndInfos[payload_counter++] = ChargingManagementExtendedSync_array_estimatedTimesAndInfos_estimatedStartTimeMinute[j]     & 0xFF;
    }
    
    
    // 8 isEstimatedFinishTimeRelevant (boolean)
    if (ChargingManagementExtendedSync_array_estimatedTimesAndInfos_isEstimatedFinishTimeRelevant_available[j] == 1)
    {
      tag_dataID = 8;
      ChargingManagementExtendedSync_payload_buffer_estimatedTimesAndInfos[payload_counter++] = 0 * 16 /* Wiretype = 0 =^ 8 Bit */ + ((tag_dataID>>8) & 0x0F) /* DataID High Part */ ;
      ChargingManagementExtendedSync_payload_buffer_estimatedTimesAndInfos[payload_counter++] = tag_dataID & 0xFF /* DataID Low Part */ ;
      
      ChargingManagementExtendedSync_payload_buffer_estimatedTimesAndInfos[payload_counter++] = ChargingManagementExtendedSync_array_estimatedTimesAndInfos_isEstimatedFinishTimeRelevant[j] & 0xFF;
    }
    
    
    // 9 estimatedFinishTimeYear (uint32)
    if (ChargingManagementExtendedSync_array_estimatedTimesAndInfos_estimatedFinishTimeYear_available[j] == 1)
    {
      tag_dataID = 9;
      ChargingManagementExtendedSync_payload_buffer_estimatedTimesAndInfos[payload_counter++] = 2 * 16 /* Wiretype = 2 =^ 32 Bit */ + ((tag_dataID>>8) & 0x0F) /* DataID High Part */ ;
      ChargingManagementExtendedSync_payload_buffer_estimatedTimesAndInfos[payload_counter++] = tag_dataID & 0xFF /* DataID Low Part */ ;
      
      ChargingManagementExtendedSync_payload_buffer_estimatedTimesAndInfos[payload_counter++] = ChargingManagementExtendedSync_array_estimatedTimesAndInfos_estimatedFinishTimeYear[j]>>24 & 0xFF;
      ChargingManagementExtendedSync_payload_buffer_estimatedTimesAndInfos[payload_counter++] = ChargingManagementExtendedSync_array_estimatedTimesAndInfos_estimatedFinishTimeYear[j]>>16 & 0xFF;
      ChargingManagementExtendedSync_payload_buffer_estimatedTimesAndInfos[payload_counter++] = ChargingManagementExtendedSync_array_estimatedTimesAndInfos_estimatedFinishTimeYear[j]>> 8 & 0xFF;
      ChargingManagementExtendedSync_payload_buffer_estimatedTimesAndInfos[payload_counter++] = ChargingManagementExtendedSync_array_estimatedTimesAndInfos_estimatedFinishTimeYear[j]     & 0xFF;
    }
    
    
    // 10 estimatedFinishTimeMonth (uint32)
    if (ChargingManagementExtendedSync_array_estimatedTimesAndInfos_estimatedFinishTimeMonth_available[j] == 1)
    {
      tag_dataID = 10;
      ChargingManagementExtendedSync_payload_buffer_estimatedTimesAndInfos[payload_counter++] = 2 * 16 /* Wiretype = 2 =^ 32 Bit */ + ((tag_dataID>>8) & 0x0F) /* DataID High Part */ ;
      ChargingManagementExtendedSync_payload_buffer_estimatedTimesAndInfos[payload_counter++] = tag_dataID & 0xFF /* DataID Low Part */ ;
      
      ChargingManagementExtendedSync_payload_buffer_estimatedTimesAndInfos[payload_counter++] = ChargingManagementExtendedSync_array_estimatedTimesAndInfos_estimatedFinishTimeMonth[j]>>24 & 0xFF;
      ChargingManagementExtendedSync_payload_buffer_estimatedTimesAndInfos[payload_counter++] = ChargingManagementExtendedSync_array_estimatedTimesAndInfos_estimatedFinishTimeMonth[j]>>16 & 0xFF;
      ChargingManagementExtendedSync_payload_buffer_estimatedTimesAndInfos[payload_counter++] = ChargingManagementExtendedSync_array_estimatedTimesAndInfos_estimatedFinishTimeMonth[j]>> 8 & 0xFF;
      ChargingManagementExtendedSync_payload_buffer_estimatedTimesAndInfos[payload_counter++] = ChargingManagementExtendedSync_array_estimatedTimesAndInfos_estimatedFinishTimeMonth[j]     & 0xFF;
    }
    
    
    // 11 estimatedFinishTimeDay (uint32)
    if (ChargingManagementExtendedSync_array_estimatedTimesAndInfos_estimatedFinishTimeDay_available[j] == 1)
    {
      tag_dataID = 11;
      ChargingManagementExtendedSync_payload_buffer_estimatedTimesAndInfos[payload_counter++] = 2 * 16 /* Wiretype = 2 =^ 32 Bit */ + ((tag_dataID>>8) & 0x0F) /* DataID High Part */ ;
      ChargingManagementExtendedSync_payload_buffer_estimatedTimesAndInfos[payload_counter++] = tag_dataID & 0xFF /* DataID Low Part */ ;
      
      ChargingManagementExtendedSync_payload_buffer_estimatedTimesAndInfos[payload_counter++] = ChargingManagementExtendedSync_array_estimatedTimesAndInfos_estimatedFinishTimeDay[j]>>24 & 0xFF;
      ChargingManagementExtendedSync_payload_buffer_estimatedTimesAndInfos[payload_counter++] = ChargingManagementExtendedSync_array_estimatedTimesAndInfos_estimatedFinishTimeDay[j]>>16 & 0xFF;
      ChargingManagementExtendedSync_payload_buffer_estimatedTimesAndInfos[payload_counter++] = ChargingManagementExtendedSync_array_estimatedTimesAndInfos_estimatedFinishTimeDay[j]>> 8 & 0xFF;
      ChargingManagementExtendedSync_payload_buffer_estimatedTimesAndInfos[payload_counter++] = ChargingManagementExtendedSync_array_estimatedTimesAndInfos_estimatedFinishTimeDay[j]     & 0xFF;
    }
    
    
    // 12 estimatedFinishTimeYear (uint32)
    if (ChargingManagementExtendedSync_array_estimatedTimesAndInfos_estimatedFinishTimeYear_available[j] == 1)
    {
      tag_dataID = 12;
      ChargingManagementExtendedSync_payload_buffer_estimatedTimesAndInfos[payload_counter++] = 2 * 16 /* Wiretype = 2 =^ 32 Bit */ + ((tag_dataID>>8) & 0x0F) /* DataID High Part */ ;
      ChargingManagementExtendedSync_payload_buffer_estimatedTimesAndInfos[payload_counter++] = tag_dataID & 0xFF /* DataID Low Part */ ;
      
      ChargingManagementExtendedSync_payload_buffer_estimatedTimesAndInfos[payload_counter++] = ChargingManagementExtendedSync_array_estimatedTimesAndInfos_estimatedFinishTimeHour[j]>>24 & 0xFF;
      ChargingManagementExtendedSync_payload_buffer_estimatedTimesAndInfos[payload_counter++] = ChargingManagementExtendedSync_array_estimatedTimesAndInfos_estimatedFinishTimeHour[j]>>16 & 0xFF;
      ChargingManagementExtendedSync_payload_buffer_estimatedTimesAndInfos[payload_counter++] = ChargingManagementExtendedSync_array_estimatedTimesAndInfos_estimatedFinishTimeHour[j]>> 8 & 0xFF;
      ChargingManagementExtendedSync_payload_buffer_estimatedTimesAndInfos[payload_counter++] = ChargingManagementExtendedSync_array_estimatedTimesAndInfos_estimatedFinishTimeHour[j]     & 0xFF;
    }
    
    
    // 13 estimatedFinishTimeYear (uint32)
    if (ChargingManagementExtendedSync_array_estimatedTimesAndInfos_estimatedFinishTimeYear_available[j] == 1)
    {
      tag_dataID = 13;
      ChargingManagementExtendedSync_payload_buffer_estimatedTimesAndInfos[payload_counter++] = 2 * 16 /* Wiretype = 2 =^ 32 Bit */ + ((tag_dataID>>8) & 0x0F) /* DataID High Part */ ;
      ChargingManagementExtendedSync_payload_buffer_estimatedTimesAndInfos[payload_counter++] = tag_dataID & 0xFF /* DataID Low Part */ ;
         
      ChargingManagementExtendedSync_payload_buffer_estimatedTimesAndInfos[payload_counter++] = ChargingManagementExtendedSync_array_estimatedTimesAndInfos_estimatedFinishTimeMinute[j]>>24 & 0xFF;
      ChargingManagementExtendedSync_payload_buffer_estimatedTimesAndInfos[payload_counter++] = ChargingManagementExtendedSync_array_estimatedTimesAndInfos_estimatedFinishTimeMinute[j]>>16 & 0xFF;
      ChargingManagementExtendedSync_payload_buffer_estimatedTimesAndInfos[payload_counter++] = ChargingManagementExtendedSync_array_estimatedTimesAndInfos_estimatedFinishTimeMinute[j]>> 8 & 0xFF;
      ChargingManagementExtendedSync_payload_buffer_estimatedTimesAndInfos[payload_counter++] = ChargingManagementExtendedSync_array_estimatedTimesAndInfos_estimatedFinishTimeMinute[j]     & 0xFF;
    }
    
    
    // 14 targetReachable (enum32)
    if (ChargingManagementExtendedSync_array_estimatedTimesAndInfos_targetReachable_available[j] == 1)
    {
      tag_dataID = 14;
      ChargingManagementExtendedSync_payload_buffer_estimatedTimesAndInfos[payload_counter++] = 2 * 16 /* Wiretype = 2 =^ 32 Bit */ + ((tag_dataID>>8) & 0x0F) /* DataID High Part */ ;
      ChargingManagementExtendedSync_payload_buffer_estimatedTimesAndInfos[payload_counter++] = tag_dataID & 0xFF /* DataID Low Part */ ;
         
      ChargingManagementExtendedSync_payload_buffer_estimatedTimesAndInfos[payload_counter++] = ChargingManagementExtendedSync_array_estimatedTimesAndInfos_targetReachable[j]>>24 & 0xFF;
      ChargingManagementExtendedSync_payload_buffer_estimatedTimesAndInfos[payload_counter++] = ChargingManagementExtendedSync_array_estimatedTimesAndInfos_targetReachable[j]>>16 & 0xFF;
      ChargingManagementExtendedSync_payload_buffer_estimatedTimesAndInfos[payload_counter++] = ChargingManagementExtendedSync_array_estimatedTimesAndInfos_targetReachable[j]>> 8 & 0xFF;
      ChargingManagementExtendedSync_payload_buffer_estimatedTimesAndInfos[payload_counter++] = ChargingManagementExtendedSync_array_estimatedTimesAndInfos_targetReachable[j]     & 0xFF;
    }
    
    
    //Element Length
    element_length = payload_counter-start_pos;
    if (element_length >0) ChargingManagementExtendedSync_array_estimatedTimesAndInfos_array_element_length[j] = element_length - 4;
    else                   ChargingManagementExtendedSync_array_estimatedTimesAndInfos_array_element_length[j] = element_length;
    
    ChargingManagementExtendedSync_payload_buffer_estimatedTimesAndInfos[start_pos++] = ChargingManagementExtendedSync_array_estimatedTimesAndInfos_array_element_length[j]>>24 & 0xFF;
    ChargingManagementExtendedSync_payload_buffer_estimatedTimesAndInfos[start_pos++] = ChargingManagementExtendedSync_array_estimatedTimesAndInfos_array_element_length[j]>>16 & 0xFF;
    ChargingManagementExtendedSync_payload_buffer_estimatedTimesAndInfos[start_pos++] = ChargingManagementExtendedSync_array_estimatedTimesAndInfos_array_element_length[j]>> 8 & 0xFF;
    ChargingManagementExtendedSync_payload_buffer_estimatedTimesAndInfos[start_pos++] = ChargingManagementExtendedSync_array_estimatedTimesAndInfos_array_element_length[j]     & 0xFF;
    
    if (ChargingManagementExtendedSync_array_estimatedTimesAndInfos_array_element_length[j] == 0) payload_counter = payload_counter+4;
  }
  
  // Struct Length
  ChargingManagementExtendedSync_array_estimatedTimesAndInfos_struct_element_length = 4*@ChargingManagementExtendedSync_Notification_estimatedTimesAndInfos_Element_TotalNum;

  for (k=0;k<@ChargingManagementExtendedSync_Notification_estimatedTimesAndInfos_Element_TotalNum;k++)
    ChargingManagementExtendedSync_array_estimatedTimesAndInfos_struct_element_length = ChargingManagementExtendedSync_array_estimatedTimesAndInfos_struct_element_length + ChargingManagementExtendedSync_array_estimatedTimesAndInfos_array_element_length[k];
  
  ChargingManagementExtendedSync_payload_buffer_estimatedTimesAndInfos[0] = ChargingManagementExtendedSync_array_estimatedTimesAndInfos_struct_element_length>>24 & 0xFF;
  ChargingManagementExtendedSync_payload_buffer_estimatedTimesAndInfos[1] = ChargingManagementExtendedSync_array_estimatedTimesAndInfos_struct_element_length>>16 & 0xFF;
  ChargingManagementExtendedSync_payload_buffer_estimatedTimesAndInfos[2] = ChargingManagementExtendedSync_array_estimatedTimesAndInfos_struct_element_length>> 8 & 0xFF;
  ChargingManagementExtendedSync_payload_buffer_estimatedTimesAndInfos[3] = ChargingManagementExtendedSync_array_estimatedTimesAndInfos_struct_element_length     & 0xFF;


  ChargingManagementExtendedSync_payload_length_estimatedTimesAndInfos = ChargingManagementExtendedSync_array_estimatedTimesAndInfos_struct_element_length+4;
  putvalue(ChargingManagementExtendedSync_Notification_estimatedTimesAndInfos_Payload, ChargingManagementExtendedSync_payload_buffer_estimatedTimesAndInfos, ChargingManagementExtendedSync_payload_length_estimatedTimesAndInfos);
}

on envVar ChargingManagementExtendedSync_Notification_estimatedTimesAndInfos_Element_TotalNum
{
  if (@this == 0) @this =  1;
  if (@this > 10) @this = 10;
  
  ChargingManagementExtendedSync_Notification_estimatedTimesAndInfos();
  ChargingManagementExtendedSync_Notification_estimatedTimesAndInfos_update();
}

on envVar ChargingManagementExtendedSync_Notification_estimatedTimesAndInfos_Element
{
  ChargingManagementExtendedSync_Notification_estimatedTimesAndInfos_update();
}

on envVar ChargingManagementExtendedSync_Notification_estimatedTimesAndInfos_Element_Next
{
  if (@this == 1 && @ChargingManagementExtendedSync_Notification_estimatedTimesAndInfos_Element < @ChargingManagementExtendedSync_Notification_estimatedTimesAndInfos_Element_TotalNum - 1)
  {
    @ChargingManagementExtendedSync_Notification_estimatedTimesAndInfos_Element = @ChargingManagementExtendedSync_Notification_estimatedTimesAndInfos_Element + 1;
    ChargingManagementExtendedSync_Notification_estimatedTimesAndInfos_update();
  }
}

on envVar ChargingManagementExtendedSync_Notification_estimatedTimesAndInfos_Element_Previous
{
  if (@this == 1 && @ChargingManagementExtendedSync_Notification_estimatedTimesAndInfos_Element > 0)
  {
    @ChargingManagementExtendedSync_Notification_estimatedTimesAndInfos_Element = @ChargingManagementExtendedSync_Notification_estimatedTimesAndInfos_Element - 1;
    ChargingManagementExtendedSync_Notification_estimatedTimesAndInfos_update();
  }
}

ChargingManagementExtendedSync_Notification_estimatedTimesAndInfos_update()
{
  @ChargingManagementExtendedSync_Notification_LengthIndicator_Element_estimatedTimesAndInfos = ChargingManagementExtendedSync_array_estimatedTimesAndInfos_array_element_length[@ChargingManagementExtendedSync_Notification_estimatedTimesAndInfos_Element];
  @ChargingManagementExtendedSync_Notification_LengthIndicator_Struct_estimatedTimesAndInfos  = ChargingManagementExtendedSync_array_estimatedTimesAndInfos_struct_element_length;
  @ChargingManagementExtendedSync_Notification_Length_estimatedTimesAndInfos                  = ChargingManagementExtendedSync_payload_length_estimatedTimesAndInfos+8;
  
  @ChargingManagementExtendedSync_Notification_estimatedTimesAndInfos_elementId                     = ChargingManagementExtendedSync_array_estimatedTimesAndInfos_elementId[@ChargingManagementExtendedSync_Notification_estimatedTimesAndInfos_Element];
  @ChargingManagementExtendedSync_Notification_estimatedTimesAndInfos_isExternalServiceAvailable    = ChargingManagementExtendedSync_array_estimatedTimesAndInfos_isExternalServiceAvailable[@ChargingManagementExtendedSync_Notification_estimatedTimesAndInfos_Element];
  @ChargingManagementExtendedSync_Notification_estimatedTimesAndInfos_isEstimatedStartTimeRelevant  = ChargingManagementExtendedSync_array_estimatedTimesAndInfos_isEstimatedStartTimeRelevant[@ChargingManagementExtendedSync_Notification_estimatedTimesAndInfos_Element];
  @ChargingManagementExtendedSync_Notification_estimatedTimesAndInfos_estimatedStartTimeYear        = ChargingManagementExtendedSync_array_estimatedTimesAndInfos_estimatedStartTimeYear[@ChargingManagementExtendedSync_Notification_estimatedTimesAndInfos_Element];
  @ChargingManagementExtendedSync_Notification_estimatedTimesAndInfos_estimatedStartTimeMonth       = ChargingManagementExtendedSync_array_estimatedTimesAndInfos_estimatedStartTimeMonth[@ChargingManagementExtendedSync_Notification_estimatedTimesAndInfos_Element];
  @ChargingManagementExtendedSync_Notification_estimatedTimesAndInfos_estimatedStartTimeDay         = ChargingManagementExtendedSync_array_estimatedTimesAndInfos_estimatedStartTimeDay[@ChargingManagementExtendedSync_Notification_estimatedTimesAndInfos_Element];
  @ChargingManagementExtendedSync_Notification_estimatedTimesAndInfos_estimatedStartTimeHour        = ChargingManagementExtendedSync_array_estimatedTimesAndInfos_estimatedStartTimeHour[@ChargingManagementExtendedSync_Notification_estimatedTimesAndInfos_Element];
  @ChargingManagementExtendedSync_Notification_estimatedTimesAndInfos_estimatedStartTimeMinute      = ChargingManagementExtendedSync_array_estimatedTimesAndInfos_estimatedStartTimeMinute[@ChargingManagementExtendedSync_Notification_estimatedTimesAndInfos_Element];
  @ChargingManagementExtendedSync_Notification_estimatedTimesAndInfos_isEstimatedFinishTimeRelevant = ChargingManagementExtendedSync_array_estimatedTimesAndInfos_isEstimatedFinishTimeRelevant[@ChargingManagementExtendedSync_Notification_estimatedTimesAndInfos_Element];
  @ChargingManagementExtendedSync_Notification_estimatedTimesAndInfos_estimatedFinishTimeYear       = ChargingManagementExtendedSync_array_estimatedTimesAndInfos_estimatedFinishTimeYear[@ChargingManagementExtendedSync_Notification_estimatedTimesAndInfos_Element];
  @ChargingManagementExtendedSync_Notification_estimatedTimesAndInfos_estimatedFinishTimeMonth      = ChargingManagementExtendedSync_array_estimatedTimesAndInfos_estimatedFinishTimeMonth[@ChargingManagementExtendedSync_Notification_estimatedTimesAndInfos_Element];
  @ChargingManagementExtendedSync_Notification_estimatedTimesAndInfos_estimatedFinishTimeDay        = ChargingManagementExtendedSync_array_estimatedTimesAndInfos_estimatedFinishTimeDay[@ChargingManagementExtendedSync_Notification_estimatedTimesAndInfos_Element];
  @ChargingManagementExtendedSync_Notification_estimatedTimesAndInfos_estimatedFinishTimeHour       = ChargingManagementExtendedSync_array_estimatedTimesAndInfos_estimatedFinishTimeHour[@ChargingManagementExtendedSync_Notification_estimatedTimesAndInfos_Element];
  @ChargingManagementExtendedSync_Notification_estimatedTimesAndInfos_estimatedFinishTimeMinute     = ChargingManagementExtendedSync_array_estimatedTimesAndInfos_estimatedFinishTimeMinute[@ChargingManagementExtendedSync_Notification_estimatedTimesAndInfos_Element];
  @ChargingManagementExtendedSync_Notification_estimatedTimesAndInfos_targetReachable               = ChargingManagementExtendedSync_array_estimatedTimesAndInfos_targetReachable[@ChargingManagementExtendedSync_Notification_estimatedTimesAndInfos_Element];
  
  @ChargingManagementExtendedSync_Notification_estimatedTimesAndInfos_elementId_available                     = ChargingManagementExtendedSync_array_estimatedTimesAndInfos_elementId_available[@ChargingManagementExtendedSync_Notification_estimatedTimesAndInfos_Element];
  @ChargingManagementExtendedSync_Notification_estimatedTimesAndInfos_isExternalServiceAvailable_available    = ChargingManagementExtendedSync_array_estimatedTimesAndInfos_isExternalServiceAvailable_available[@ChargingManagementExtendedSync_Notification_estimatedTimesAndInfos_Element];
  @ChargingManagementExtendedSync_Notification_estimatedTimesAndInfos_isEstimatedStartTimeRelevant_available  = ChargingManagementExtendedSync_array_estimatedTimesAndInfos_isEstimatedStartTimeRelevant_available[@ChargingManagementExtendedSync_Notification_estimatedTimesAndInfos_Element];
  @ChargingManagementExtendedSync_Notification_estimatedTimesAndInfos_estimatedStartTimeYear_available        = ChargingManagementExtendedSync_array_estimatedTimesAndInfos_estimatedStartTimeYear_available[@ChargingManagementExtendedSync_Notification_estimatedTimesAndInfos_Element];
  @ChargingManagementExtendedSync_Notification_estimatedTimesAndInfos_estimatedStartTimeMonth_available       = ChargingManagementExtendedSync_array_estimatedTimesAndInfos_estimatedStartTimeMonth_available[@ChargingManagementExtendedSync_Notification_estimatedTimesAndInfos_Element];
  @ChargingManagementExtendedSync_Notification_estimatedTimesAndInfos_estimatedStartTimeDay_available         = ChargingManagementExtendedSync_array_estimatedTimesAndInfos_estimatedStartTimeDay_available[@ChargingManagementExtendedSync_Notification_estimatedTimesAndInfos_Element];
  @ChargingManagementExtendedSync_Notification_estimatedTimesAndInfos_estimatedStartTimeHour_available        = ChargingManagementExtendedSync_array_estimatedTimesAndInfos_estimatedStartTimeHour_available[@ChargingManagementExtendedSync_Notification_estimatedTimesAndInfos_Element];
  @ChargingManagementExtendedSync_Notification_estimatedTimesAndInfos_estimatedStartTimeMinute_available      = ChargingManagementExtendedSync_array_estimatedTimesAndInfos_estimatedStartTimeMinute_available[@ChargingManagementExtendedSync_Notification_estimatedTimesAndInfos_Element];
  @ChargingManagementExtendedSync_Notification_estimatedTimesAndInfos_isEstimatedFinishTimeRelevant_available = ChargingManagementExtendedSync_array_estimatedTimesAndInfos_isEstimatedFinishTimeRelevant_available[@ChargingManagementExtendedSync_Notification_estimatedTimesAndInfos_Element];
  @ChargingManagementExtendedSync_Notification_estimatedTimesAndInfos_estimatedFinishTimeYear_available       = ChargingManagementExtendedSync_array_estimatedTimesAndInfos_estimatedFinishTimeYear_available[@ChargingManagementExtendedSync_Notification_estimatedTimesAndInfos_Element];
  @ChargingManagementExtendedSync_Notification_estimatedTimesAndInfos_estimatedFinishTimeMonth_available      = ChargingManagementExtendedSync_array_estimatedTimesAndInfos_estimatedFinishTimeMonth_available[@ChargingManagementExtendedSync_Notification_estimatedTimesAndInfos_Element];
  @ChargingManagementExtendedSync_Notification_estimatedTimesAndInfos_estimatedFinishTimeDay_available        = ChargingManagementExtendedSync_array_estimatedTimesAndInfos_estimatedFinishTimeDay_available[@ChargingManagementExtendedSync_Notification_estimatedTimesAndInfos_Element];
  @ChargingManagementExtendedSync_Notification_estimatedTimesAndInfos_estimatedFinishTimeHour_available       = ChargingManagementExtendedSync_array_estimatedTimesAndInfos_estimatedFinishTimeHour_available[@ChargingManagementExtendedSync_Notification_estimatedTimesAndInfos_Element];
  @ChargingManagementExtendedSync_Notification_estimatedTimesAndInfos_estimatedFinishTimeMinute_available     = ChargingManagementExtendedSync_array_estimatedTimesAndInfos_estimatedFinishTimeMinute_available[@ChargingManagementExtendedSync_Notification_estimatedTimesAndInfos_Element];
  @ChargingManagementExtendedSync_Notification_estimatedTimesAndInfos_targetReachable_available               = ChargingManagementExtendedSync_array_estimatedTimesAndInfos_targetReachable_available[@ChargingManagementExtendedSync_Notification_estimatedTimesAndInfos_Element];
}







////////// activeChargingProfiles Notification //////////

on envVar ChargingManagementExtendedSync_Notification_LengthIndicator_Struct_activeChargingProfiles
{
  ChargingManagementExtendedSync_Notification_activeChargingProfiles();
}
on envVar ChargingManagementExtendedSync_Notification_LengthIndicator_Element_activeChargingProfiles
{
  ChargingManagementExtendedSync_Notification_activeChargingProfiles();
}
on envVar ChargingManagementExtendedSync_Notification_activeChargingProfiles_elementId
{
  ChargingManagementExtendedSync_array_activeChargingProfiles_elementId[@ChargingManagementExtendedSync_Notification_activeChargingProfiles_Element] = @this;
  ChargingManagementExtendedSync_Notification_activeChargingProfiles();
}
on envVar ChargingManagementExtendedSync_Notification_activeChargingProfiles_isOwnCurrentUsed
{
  ChargingManagementExtendedSync_array_activeChargingProfiles_isOwnCurrentUsed[@ChargingManagementExtendedSync_Notification_activeChargingProfiles_Element] = @this;
  ChargingManagementExtendedSync_Notification_activeChargingProfiles();
}
on envVar ChargingManagementExtendedSync_Notification_activeChargingProfiles_isSmartChargingUsed
{
  ChargingManagementExtendedSync_array_activeChargingProfiles_isSmartChargingUsed[@ChargingManagementExtendedSync_Notification_activeChargingProfiles_Element] = @this;
  ChargingManagementExtendedSync_Notification_activeChargingProfiles();
}
on envVar ChargingManagementExtendedSync_Notification_activeChargingProfiles_targetSoc
{
  ChargingManagementExtendedSync_array_activeChargingProfiles_targetSoc[@ChargingManagementExtendedSync_Notification_activeChargingProfiles_Element] = @this;
  ChargingManagementExtendedSync_Notification_activeChargingProfiles();
}
on envVar ChargingManagementExtendedSync_Notification_activeChargingProfiles_targetRange
{
  ChargingManagementExtendedSync_array_activeChargingProfiles_targetRange[@ChargingManagementExtendedSync_Notification_activeChargingProfiles_Element] = @this;
  ChargingManagementExtendedSync_Notification_activeChargingProfiles();
}
on envVar ChargingManagementExtendedSync_Notification_activeChargingProfiles_minSoc
{
  ChargingManagementExtendedSync_array_activeChargingProfiles_minSoc[@ChargingManagementExtendedSync_Notification_activeChargingProfiles_Element] = @this;
  ChargingManagementExtendedSync_Notification_activeChargingProfiles();
}
on envVar ChargingManagementExtendedSync_Notification_activeChargingProfiles_maxChargeCurrent
{
  ChargingManagementExtendedSync_array_activeChargingProfiles_maxChargeCurrent[@ChargingManagementExtendedSync_Notification_activeChargingProfiles_Element] = @this;
  ChargingManagementExtendedSync_Notification_activeChargingProfiles();
}
on envVar ChargingManagementExtendedSync_Notification_activeChargingProfiles_autounlockAc
{
  ChargingManagementExtendedSync_array_activeChargingProfiles_autounlockAc[@ChargingManagementExtendedSync_Notification_activeChargingProfiles_Element] = @this;
  ChargingManagementExtendedSync_Notification_activeChargingProfiles();
}
on envVar ChargingManagementExtendedSync_Notification_activeChargingProfiles_autounlockDc
{
  ChargingManagementExtendedSync_array_activeChargingProfiles_autounlockDc[@ChargingManagementExtendedSync_Notification_activeChargingProfiles_Element] = @this;
  ChargingManagementExtendedSync_Notification_activeChargingProfiles();
}
on envVar ChargingManagementExtendedSync_Notification_activeChargingProfiles_elementId_available
{
  ChargingManagementExtendedSync_array_activeChargingProfiles_elementId_available[@ChargingManagementExtendedSync_Notification_activeChargingProfiles_Element] = @this;
  ChargingManagementExtendedSync_Notification_activeChargingProfiles();
}
on envVar ChargingManagementExtendedSync_Notification_activeChargingProfiles_isOwnCurrentUsed_available
{
  ChargingManagementExtendedSync_array_activeChargingProfiles_isOwnCurrentUsed_available[@ChargingManagementExtendedSync_Notification_activeChargingProfiles_Element] = @this;
  ChargingManagementExtendedSync_Notification_activeChargingProfiles();
}
on envVar ChargingManagementExtendedSync_Notification_activeChargingProfiles_isSmartChargingUsed_available
{
  ChargingManagementExtendedSync_array_activeChargingProfiles_isSmartChargingUsed_available[@ChargingManagementExtendedSync_Notification_activeChargingProfiles_Element] = @this;
  ChargingManagementExtendedSync_Notification_activeChargingProfiles();
}
on envVar ChargingManagementExtendedSync_Notification_activeChargingProfiles_targetSoc_available
{
  ChargingManagementExtendedSync_array_activeChargingProfiles_targetSoc_available[@ChargingManagementExtendedSync_Notification_activeChargingProfiles_Element] = @this;
  ChargingManagementExtendedSync_Notification_activeChargingProfiles();
}
on envVar ChargingManagementExtendedSync_Notification_activeChargingProfiles_targetRange_available
{
  ChargingManagementExtendedSync_array_activeChargingProfiles_targetRange_available[@ChargingManagementExtendedSync_Notification_activeChargingProfiles_Element] = @this;
  ChargingManagementExtendedSync_Notification_activeChargingProfiles();
}
on envVar ChargingManagementExtendedSync_Notification_activeChargingProfiles_minSoc_available
{
  ChargingManagementExtendedSync_array_activeChargingProfiles_minSoc_available[@ChargingManagementExtendedSync_Notification_activeChargingProfiles_Element] = @this;
  ChargingManagementExtendedSync_Notification_activeChargingProfiles();
}
on envVar ChargingManagementExtendedSync_Notification_activeChargingProfiles_maxChargeCurrent_available
{
  ChargingManagementExtendedSync_array_activeChargingProfiles_maxChargeCurrent_available[@ChargingManagementExtendedSync_Notification_activeChargingProfiles_Element] = @this;
  ChargingManagementExtendedSync_Notification_activeChargingProfiles();
}
on envVar ChargingManagementExtendedSync_Notification_activeChargingProfiles_autounlockAc_available
{
  ChargingManagementExtendedSync_array_activeChargingProfiles_autounlockAc_available[@ChargingManagementExtendedSync_Notification_activeChargingProfiles_Element] = @this;
  ChargingManagementExtendedSync_Notification_activeChargingProfiles();
}
on envVar ChargingManagementExtendedSync_Notification_activeChargingProfiles_autounlockDc_available
{
  ChargingManagementExtendedSync_array_activeChargingProfiles_autounlockDc_available[@ChargingManagementExtendedSync_Notification_activeChargingProfiles_Element] = @this;
  ChargingManagementExtendedSync_Notification_activeChargingProfiles();
}
on envVar ChargingManagementExtendedSync_Notification_activeChargingProfiles_Payload
{
  ChargingManagementExtendedSync_Notification_activeChargingProfiles_update();
}


ChargingManagementExtendedSync_Notification_activeChargingProfiles()
{
  word payload_counter = 0;
  word start_pos       = 0;
  word element_length  = 0;
  
  // Length Indicator Struct - Platzhalter
  payload_counter = 0+4;
  start_pos = 0;
  
  for (j=0; j<@ChargingManagementExtendedSync_Notification_activeChargingProfiles_Element_TotalNum; j++)
  {
    ChargingManagementExtendedSync_array_activeChargingProfiles_available_functions[j] = ChargingManagementExtendedSync_array_activeChargingProfiles_elementId_available[j]
                                                                                       + ChargingManagementExtendedSync_array_activeChargingProfiles_isOwnCurrentUsed_available[j]
                                                                                       + ChargingManagementExtendedSync_array_activeChargingProfiles_isSmartChargingUsed_available[j]
                                                                                       + ChargingManagementExtendedSync_array_activeChargingProfiles_targetSoc_available[j]
                                                                                       + ChargingManagementExtendedSync_array_activeChargingProfiles_targetRange_available[j]
                                                                                       + ChargingManagementExtendedSync_array_activeChargingProfiles_minSoc_available[j]
                                                                                       + ChargingManagementExtendedSync_array_activeChargingProfiles_maxChargeCurrent_available[j]
                                                                                       + ChargingManagementExtendedSync_array_activeChargingProfiles_autounlockAc_available[j]
                                                                                       + ChargingManagementExtendedSync_array_activeChargingProfiles_autounlockDc_available[j];
    
    // Length Indicator Element - Platzhalter
    if (ChargingManagementExtendedSync_array_activeChargingProfiles_available_functions[j] > 0)
    {
      start_pos = payload_counter;
      payload_counter = payload_counter + 4;
    }
    else 
      start_pos = payload_counter;
    
    
    // 0 elementId (uint32)
    if (ChargingManagementExtendedSync_array_activeChargingProfiles_elementId_available[j] == 1)
    {
      tag_dataID = 0;
      ChargingManagementExtendedSync_payload_buffer_activeChargingProfiles[payload_counter++] = 2 * 16 /* Wiretype = 2 =^ 32 Bit */ + ((tag_dataID>>8) & 0x0F) /* DataID High Part */ ;
      ChargingManagementExtendedSync_payload_buffer_activeChargingProfiles[payload_counter++] = tag_dataID & 0xFF /* DataID Low Part */ ;
      
      ChargingManagementExtendedSync_payload_buffer_activeChargingProfiles[payload_counter++] = ChargingManagementExtendedSync_array_activeChargingProfiles_elementId[j]>>24 & 0xFF;
      ChargingManagementExtendedSync_payload_buffer_activeChargingProfiles[payload_counter++] = ChargingManagementExtendedSync_array_activeChargingProfiles_elementId[j]>>16 & 0xFF;
      ChargingManagementExtendedSync_payload_buffer_activeChargingProfiles[payload_counter++] = ChargingManagementExtendedSync_array_activeChargingProfiles_elementId[j]>> 8 & 0xFF;
      ChargingManagementExtendedSync_payload_buffer_activeChargingProfiles[payload_counter++] = ChargingManagementExtendedSync_array_activeChargingProfiles_elementId[j]     & 0xFF;
    }
    
    
    // 1 isOwnCurrentUsed (boolean)
    if (ChargingManagementExtendedSync_array_activeChargingProfiles_isOwnCurrentUsed_available[j] == 1)
    {
      tag_dataID = 1;
      ChargingManagementExtendedSync_payload_buffer_activeChargingProfiles[payload_counter++] = 0 * 16 /* Wiretype = 0 =^ 8 Bit */ + ((tag_dataID>>8) & 0x0F) /* DataID High Part */ ;
      ChargingManagementExtendedSync_payload_buffer_activeChargingProfiles[payload_counter++] = tag_dataID & 0xFF /* DataID Low Part */ ;
      
      ChargingManagementExtendedSync_payload_buffer_activeChargingProfiles[payload_counter++] = ChargingManagementExtendedSync_array_activeChargingProfiles_isOwnCurrentUsed[j] & 0xFF;
    }
    
    
    // 2 isSmartChargingUsed (boolean)
    if (ChargingManagementExtendedSync_array_activeChargingProfiles_isSmartChargingUsed_available[j] == 1)
    {
      tag_dataID = 2;
      ChargingManagementExtendedSync_payload_buffer_activeChargingProfiles[payload_counter++] = 0 * 16 /* Wiretype = 0 =^ 8 Bit */ + ((tag_dataID>>8) & 0x0F) /* DataID High Part */ ;
      ChargingManagementExtendedSync_payload_buffer_activeChargingProfiles[payload_counter++] = tag_dataID & 0xFF /* DataID Low Part */ ;
      
      ChargingManagementExtendedSync_payload_buffer_activeChargingProfiles[payload_counter++] = ChargingManagementExtendedSync_array_activeChargingProfiles_isSmartChargingUsed[j] & 0xFF;
    }
    
    
    // 3 targetSoc (uint32)
    if (ChargingManagementExtendedSync_array_activeChargingProfiles_targetSoc_available[j] == 1)
    {
      tag_dataID = 3;
      ChargingManagementExtendedSync_payload_buffer_activeChargingProfiles[payload_counter++] = 2 * 16 /* Wiretype = 2 =^ 32 Bit */ + ((tag_dataID>>8) & 0x0F) /* DataID High Part */ ;
      ChargingManagementExtendedSync_payload_buffer_activeChargingProfiles[payload_counter++] = tag_dataID & 0xFF /* DataID Low Part */ ;
      
      ChargingManagementExtendedSync_payload_buffer_activeChargingProfiles[payload_counter++] = ChargingManagementExtendedSync_array_activeChargingProfiles_targetSoc[j]>>24 & 0xFF;
      ChargingManagementExtendedSync_payload_buffer_activeChargingProfiles[payload_counter++] = ChargingManagementExtendedSync_array_activeChargingProfiles_targetSoc[j]>>16 & 0xFF;
      ChargingManagementExtendedSync_payload_buffer_activeChargingProfiles[payload_counter++] = ChargingManagementExtendedSync_array_activeChargingProfiles_targetSoc[j]>> 8 & 0xFF;
      ChargingManagementExtendedSync_payload_buffer_activeChargingProfiles[payload_counter++] = ChargingManagementExtendedSync_array_activeChargingProfiles_targetSoc[j]     & 0xFF;
    }
    
    
    // 4 targetRange (uint32)
    if (ChargingManagementExtendedSync_array_activeChargingProfiles_targetRange_available[j] == 1)
    {
      tag_dataID = 4;
      ChargingManagementExtendedSync_payload_buffer_activeChargingProfiles[payload_counter++] = 2 * 16 /* Wiretype = 2 =^ 32 Bit */ + ((tag_dataID>>8) & 0x0F) /* DataID High Part */ ;
      ChargingManagementExtendedSync_payload_buffer_activeChargingProfiles[payload_counter++] = tag_dataID & 0xFF /* DataID Low Part */ ;
      
      ChargingManagementExtendedSync_payload_buffer_activeChargingProfiles[payload_counter++] = ChargingManagementExtendedSync_array_activeChargingProfiles_targetRange[j]>>24 & 0xFF;
      ChargingManagementExtendedSync_payload_buffer_activeChargingProfiles[payload_counter++] = ChargingManagementExtendedSync_array_activeChargingProfiles_targetRange[j]>>16 & 0xFF;
      ChargingManagementExtendedSync_payload_buffer_activeChargingProfiles[payload_counter++] = ChargingManagementExtendedSync_array_activeChargingProfiles_targetRange[j]>> 8 & 0xFF;
      ChargingManagementExtendedSync_payload_buffer_activeChargingProfiles[payload_counter++] = ChargingManagementExtendedSync_array_activeChargingProfiles_targetRange[j]     & 0xFF;
    }
    
    
    // 5 minSoc (uint32)
    if (ChargingManagementExtendedSync_array_activeChargingProfiles_minSoc_available[j] == 1)
    {
      tag_dataID = 5;
      ChargingManagementExtendedSync_payload_buffer_activeChargingProfiles[payload_counter++] = 2 * 16 /* Wiretype = 2 =^ 32 Bit */ + ((tag_dataID>>8) & 0x0F) /* DataID High Part */ ;
      ChargingManagementExtendedSync_payload_buffer_activeChargingProfiles[payload_counter++] = tag_dataID & 0xFF /* DataID Low Part */ ;
      
      ChargingManagementExtendedSync_payload_buffer_activeChargingProfiles[payload_counter++] = ChargingManagementExtendedSync_array_activeChargingProfiles_minSoc[j]>>24 & 0xFF;
      ChargingManagementExtendedSync_payload_buffer_activeChargingProfiles[payload_counter++] = ChargingManagementExtendedSync_array_activeChargingProfiles_minSoc[j]>>16 & 0xFF;
      ChargingManagementExtendedSync_payload_buffer_activeChargingProfiles[payload_counter++] = ChargingManagementExtendedSync_array_activeChargingProfiles_minSoc[j]>> 8 & 0xFF;
      ChargingManagementExtendedSync_payload_buffer_activeChargingProfiles[payload_counter++] = ChargingManagementExtendedSync_array_activeChargingProfiles_minSoc[j]     & 0xFF;
    }
    
    
    // 6 maxChargeCurrent (enum32)
    if (ChargingManagementExtendedSync_array_activeChargingProfiles_maxChargeCurrent_available[j] == 1)
    {
      tag_dataID = 6;
      ChargingManagementExtendedSync_payload_buffer_activeChargingProfiles[payload_counter++] = 2 * 16 /* Wiretype = 2 =^ 32 Bit */ + ((tag_dataID>>8) & 0x0F) /* DataID High Part */ ;
      ChargingManagementExtendedSync_payload_buffer_activeChargingProfiles[payload_counter++] = tag_dataID & 0xFF /* DataID Low Part */ ;
      
      ChargingManagementExtendedSync_payload_buffer_activeChargingProfiles[payload_counter++] = ChargingManagementExtendedSync_array_activeChargingProfiles_maxChargeCurrent[j]>>24 & 0xFF;
      ChargingManagementExtendedSync_payload_buffer_activeChargingProfiles[payload_counter++] = ChargingManagementExtendedSync_array_activeChargingProfiles_maxChargeCurrent[j]>>16 & 0xFF;
      ChargingManagementExtendedSync_payload_buffer_activeChargingProfiles[payload_counter++] = ChargingManagementExtendedSync_array_activeChargingProfiles_maxChargeCurrent[j]>> 8 & 0xFF;
      ChargingManagementExtendedSync_payload_buffer_activeChargingProfiles[payload_counter++] = ChargingManagementExtendedSync_array_activeChargingProfiles_maxChargeCurrent[j]     & 0xFF;
    }
    
    
    // 7 autounlockAc (enum32)
    if (ChargingManagementExtendedSync_array_activeChargingProfiles_autounlockAc_available[j] == 1)
    {
      tag_dataID = 7;
      ChargingManagementExtendedSync_payload_buffer_activeChargingProfiles[payload_counter++] = 2 * 16 /* Wiretype = 2 =^ 32 Bit */ + ((tag_dataID>>8) & 0x0F) /* DataID High Part */ ;
      ChargingManagementExtendedSync_payload_buffer_activeChargingProfiles[payload_counter++] = tag_dataID & 0xFF /* DataID Low Part */ ;
      
      ChargingManagementExtendedSync_payload_buffer_activeChargingProfiles[payload_counter++] = ChargingManagementExtendedSync_array_activeChargingProfiles_autounlockAc[j]>>24 & 0xFF;
      ChargingManagementExtendedSync_payload_buffer_activeChargingProfiles[payload_counter++] = ChargingManagementExtendedSync_array_activeChargingProfiles_autounlockAc[j]>>16 & 0xFF;
      ChargingManagementExtendedSync_payload_buffer_activeChargingProfiles[payload_counter++] = ChargingManagementExtendedSync_array_activeChargingProfiles_autounlockAc[j]>> 8 & 0xFF;
      ChargingManagementExtendedSync_payload_buffer_activeChargingProfiles[payload_counter++] = ChargingManagementExtendedSync_array_activeChargingProfiles_autounlockAc[j]     & 0xFF;
    }
    
    // 8 autounlockDc (enum32)
    if (ChargingManagementExtendedSync_array_activeChargingProfiles_autounlockDc_available[j] == 1)
    {
      tag_dataID = 8;
      ChargingManagementExtendedSync_payload_buffer_activeChargingProfiles[payload_counter++] = 2 * 16 /* Wiretype = 2 =^ 32 Bit */ + ((tag_dataID>>8) & 0x0F) /* DataID High Part */ ;
      ChargingManagementExtendedSync_payload_buffer_activeChargingProfiles[payload_counter++] = tag_dataID & 0xFF /* DataID Low Part */ ;
      
      ChargingManagementExtendedSync_payload_buffer_activeChargingProfiles[payload_counter++] = ChargingManagementExtendedSync_array_activeChargingProfiles_autounlockDc[j]>>24 & 0xFF;
      ChargingManagementExtendedSync_payload_buffer_activeChargingProfiles[payload_counter++] = ChargingManagementExtendedSync_array_activeChargingProfiles_autounlockDc[j]>>16 & 0xFF;
      ChargingManagementExtendedSync_payload_buffer_activeChargingProfiles[payload_counter++] = ChargingManagementExtendedSync_array_activeChargingProfiles_autounlockDc[j]>> 8 & 0xFF;
      ChargingManagementExtendedSync_payload_buffer_activeChargingProfiles[payload_counter++] = ChargingManagementExtendedSync_array_activeChargingProfiles_autounlockDc[j]     & 0xFF;
    }
    
    
    //Element Length
    element_length = payload_counter-start_pos;
    if (element_length >0) ChargingManagementExtendedSync_array_activeChargingProfiles_array_element_length[j] = element_length - 4;
    else                   ChargingManagementExtendedSync_array_activeChargingProfiles_array_element_length[j] = element_length;
    
    ChargingManagementExtendedSync_payload_buffer_activeChargingProfiles[start_pos++] = ChargingManagementExtendedSync_array_activeChargingProfiles_array_element_length[j]>>24 & 0xFF;
    ChargingManagementExtendedSync_payload_buffer_activeChargingProfiles[start_pos++] = ChargingManagementExtendedSync_array_activeChargingProfiles_array_element_length[j]>>16 & 0xFF;
    ChargingManagementExtendedSync_payload_buffer_activeChargingProfiles[start_pos++] = ChargingManagementExtendedSync_array_activeChargingProfiles_array_element_length[j]>> 8 & 0xFF;
    ChargingManagementExtendedSync_payload_buffer_activeChargingProfiles[start_pos++] = ChargingManagementExtendedSync_array_activeChargingProfiles_array_element_length[j]     & 0xFF;
    
    if (ChargingManagementExtendedSync_array_activeChargingProfiles_array_element_length[j] == 0) payload_counter = payload_counter+4;
  }
  
  // Struct Length
  ChargingManagementExtendedSync_array_activeChargingProfiles_struct_element_length = 4*@ChargingManagementExtendedSync_Notification_activeChargingProfiles_Element_TotalNum;

  for (k=0;k<@ChargingManagementExtendedSync_Notification_activeChargingProfiles_Element_TotalNum;k++)
    ChargingManagementExtendedSync_array_activeChargingProfiles_struct_element_length = ChargingManagementExtendedSync_array_activeChargingProfiles_struct_element_length + ChargingManagementExtendedSync_array_activeChargingProfiles_array_element_length[k];
  
  ChargingManagementExtendedSync_payload_buffer_activeChargingProfiles[0] = ChargingManagementExtendedSync_array_activeChargingProfiles_struct_element_length>>24 & 0xFF;
  ChargingManagementExtendedSync_payload_buffer_activeChargingProfiles[1] = ChargingManagementExtendedSync_array_activeChargingProfiles_struct_element_length>>16 & 0xFF;
  ChargingManagementExtendedSync_payload_buffer_activeChargingProfiles[2] = ChargingManagementExtendedSync_array_activeChargingProfiles_struct_element_length>> 8 & 0xFF;
  ChargingManagementExtendedSync_payload_buffer_activeChargingProfiles[3] = ChargingManagementExtendedSync_array_activeChargingProfiles_struct_element_length     & 0xFF;


  ChargingManagementExtendedSync_payload_length_activeChargingProfiles = ChargingManagementExtendedSync_array_activeChargingProfiles_struct_element_length+4;
  putvalue(ChargingManagementExtendedSync_Notification_activeChargingProfiles_Payload, ChargingManagementExtendedSync_payload_buffer_activeChargingProfiles, ChargingManagementExtendedSync_payload_length_activeChargingProfiles);
}

on envVar ChargingManagementExtendedSync_Notification_activeChargingProfiles_Element_TotalNum
{
  if (@this == 0) @this =  1;
  if (@this > 10) @this = 10;
  
  ChargingManagementExtendedSync_Notification_activeChargingProfiles();
  ChargingManagementExtendedSync_Notification_activeChargingProfiles_update();
}

on envVar ChargingManagementExtendedSync_Notification_activeChargingProfiles_Element
{
  ChargingManagementExtendedSync_Notification_activeChargingProfiles_update();
}

on envVar ChargingManagementExtendedSync_Notification_activeChargingProfiles_Element_Next
{
  if (@this == 1 && @ChargingManagementExtendedSync_Notification_activeChargingProfiles_Element < @ChargingManagementExtendedSync_Notification_activeChargingProfiles_Element_TotalNum - 1)
  {
    @ChargingManagementExtendedSync_Notification_activeChargingProfiles_Element = @ChargingManagementExtendedSync_Notification_activeChargingProfiles_Element + 1;
    ChargingManagementExtendedSync_Notification_activeChargingProfiles_update();
  }
}

on envVar ChargingManagementExtendedSync_Notification_activeChargingProfiles_Element_Previous
{
  if (@this == 1 && @ChargingManagementExtendedSync_Notification_activeChargingProfiles_Element > 0)
  {
    @ChargingManagementExtendedSync_Notification_activeChargingProfiles_Element = @ChargingManagementExtendedSync_Notification_activeChargingProfiles_Element - 1;
    ChargingManagementExtendedSync_Notification_activeChargingProfiles_update();
  }
}

ChargingManagementExtendedSync_Notification_activeChargingProfiles_update()
{
  @ChargingManagementExtendedSync_Notification_LengthIndicator_Element_activeChargingProfiles = ChargingManagementExtendedSync_array_activeChargingProfiles_array_element_length[@ChargingManagementExtendedSync_Notification_activeChargingProfiles_Element];
  @ChargingManagementExtendedSync_Notification_LengthIndicator_Struct_activeChargingProfiles  = ChargingManagementExtendedSync_array_activeChargingProfiles_struct_element_length;
  @ChargingManagementExtendedSync_Notification_Length_activeChargingProfiles                  = ChargingManagementExtendedSync_payload_length_activeChargingProfiles+8;
  
  @ChargingManagementExtendedSync_Notification_activeChargingProfiles_elementId           = ChargingManagementExtendedSync_array_activeChargingProfiles_elementId[@ChargingManagementExtendedSync_Notification_activeChargingProfiles_Element];
  @ChargingManagementExtendedSync_Notification_activeChargingProfiles_isOwnCurrentUsed    = ChargingManagementExtendedSync_array_activeChargingProfiles_isOwnCurrentUsed[@ChargingManagementExtendedSync_Notification_activeChargingProfiles_Element];
  @ChargingManagementExtendedSync_Notification_activeChargingProfiles_isSmartChargingUsed = ChargingManagementExtendedSync_array_activeChargingProfiles_isSmartChargingUsed[@ChargingManagementExtendedSync_Notification_activeChargingProfiles_Element];
  @ChargingManagementExtendedSync_Notification_activeChargingProfiles_targetSoc           = ChargingManagementExtendedSync_array_activeChargingProfiles_targetSoc[@ChargingManagementExtendedSync_Notification_activeChargingProfiles_Element];
  @ChargingManagementExtendedSync_Notification_activeChargingProfiles_targetRange         = ChargingManagementExtendedSync_array_activeChargingProfiles_targetRange[@ChargingManagementExtendedSync_Notification_activeChargingProfiles_Element];
  @ChargingManagementExtendedSync_Notification_activeChargingProfiles_minSoc              = ChargingManagementExtendedSync_array_activeChargingProfiles_minSoc[@ChargingManagementExtendedSync_Notification_activeChargingProfiles_Element];
  @ChargingManagementExtendedSync_Notification_activeChargingProfiles_maxChargeCurrent    = ChargingManagementExtendedSync_array_activeChargingProfiles_maxChargeCurrent[@ChargingManagementExtendedSync_Notification_activeChargingProfiles_Element];
  @ChargingManagementExtendedSync_Notification_activeChargingProfiles_autounlockAc        = ChargingManagementExtendedSync_array_activeChargingProfiles_autounlockAc[@ChargingManagementExtendedSync_Notification_activeChargingProfiles_Element];
  @ChargingManagementExtendedSync_Notification_activeChargingProfiles_autounlockDc        = ChargingManagementExtendedSync_array_activeChargingProfiles_autounlockDc[@ChargingManagementExtendedSync_Notification_activeChargingProfiles_Element];
  
  @ChargingManagementExtendedSync_Notification_activeChargingProfiles_elementId_available           = ChargingManagementExtendedSync_array_activeChargingProfiles_elementId_available[@ChargingManagementExtendedSync_Notification_activeChargingProfiles_Element];
  @ChargingManagementExtendedSync_Notification_activeChargingProfiles_isOwnCurrentUsed_available    = ChargingManagementExtendedSync_array_activeChargingProfiles_isOwnCurrentUsed_available[@ChargingManagementExtendedSync_Notification_activeChargingProfiles_Element];
  @ChargingManagementExtendedSync_Notification_activeChargingProfiles_isSmartChargingUsed_available = ChargingManagementExtendedSync_array_activeChargingProfiles_isSmartChargingUsed_available[@ChargingManagementExtendedSync_Notification_activeChargingProfiles_Element];
  @ChargingManagementExtendedSync_Notification_activeChargingProfiles_targetSoc_available           = ChargingManagementExtendedSync_array_activeChargingProfiles_targetSoc_available[@ChargingManagementExtendedSync_Notification_activeChargingProfiles_Element];
  @ChargingManagementExtendedSync_Notification_activeChargingProfiles_targetRange_available         = ChargingManagementExtendedSync_array_activeChargingProfiles_targetRange_available[@ChargingManagementExtendedSync_Notification_activeChargingProfiles_Element];
  @ChargingManagementExtendedSync_Notification_activeChargingProfiles_minSoc_available              = ChargingManagementExtendedSync_array_activeChargingProfiles_minSoc_available[@ChargingManagementExtendedSync_Notification_activeChargingProfiles_Element];
  @ChargingManagementExtendedSync_Notification_activeChargingProfiles_maxChargeCurrent_available    = ChargingManagementExtendedSync_array_activeChargingProfiles_maxChargeCurrent_available[@ChargingManagementExtendedSync_Notification_activeChargingProfiles_Element];
  @ChargingManagementExtendedSync_Notification_activeChargingProfiles_autounlockAc_available        = ChargingManagementExtendedSync_array_activeChargingProfiles_autounlockAc_available[@ChargingManagementExtendedSync_Notification_activeChargingProfiles_Element];
  @ChargingManagementExtendedSync_Notification_activeChargingProfiles_autounlockDc_available        = ChargingManagementExtendedSync_array_activeChargingProfiles_autounlockDc_available[@ChargingManagementExtendedSync_Notification_activeChargingProfiles_Element];
}







////////// nextChargingTimers Notification //////////

on envVar ChargingManagementExtendedSync_Notification_LengthIndicator_Struct_nextChargingTimers
{
  ChargingManagementExtendedSync_Notification_nextChargingTimers();
}
on envVar ChargingManagementExtendedSync_Notification_LengthIndicator_Element_nextChargingTimers
{
  ChargingManagementExtendedSync_Notification_nextChargingTimers();
}
on envVar ChargingManagementExtendedSync_Notification_nextChargingTimers_elementId
{
  ChargingManagementExtendedSync_array_nextChargingTimers_elementId[@ChargingManagementExtendedSync_Notification_nextChargingTimers_Element] = @this;
  ChargingManagementExtendedSync_Notification_nextChargingTimers();
}
on envVar ChargingManagementExtendedSync_Notification_nextChargingTimers_isActivated
{
  ChargingManagementExtendedSync_array_nextChargingTimers_isActivated[@ChargingManagementExtendedSync_Notification_nextChargingTimers_Element] = @this;
  ChargingManagementExtendedSync_Notification_nextChargingTimers();
}
on envVar ChargingManagementExtendedSync_Notification_nextChargingTimers_nextChargingTimerYear
{
  ChargingManagementExtendedSync_array_nextChargingTimers_nextChargingTimerYear[@ChargingManagementExtendedSync_Notification_nextChargingTimers_Element] = @this;
  ChargingManagementExtendedSync_Notification_nextChargingTimers();
}
on envVar ChargingManagementExtendedSync_Notification_nextChargingTimers_nextChargingTimerMonth
{
  ChargingManagementExtendedSync_array_nextChargingTimers_nextChargingTimerMonth[@ChargingManagementExtendedSync_Notification_nextChargingTimers_Element] = @this;
  ChargingManagementExtendedSync_Notification_nextChargingTimers();
}
on envVar ChargingManagementExtendedSync_Notification_nextChargingTimers_nextChargingTimerDay
{
  ChargingManagementExtendedSync_array_nextChargingTimers_nextChargingTimerDay[@ChargingManagementExtendedSync_Notification_nextChargingTimers_Element] = @this;
  ChargingManagementExtendedSync_Notification_nextChargingTimers();
}
on envVar ChargingManagementExtendedSync_Notification_nextChargingTimers_nextChargingTimerHour
{
  ChargingManagementExtendedSync_array_nextChargingTimers_nextChargingTimerHour[@ChargingManagementExtendedSync_Notification_nextChargingTimers_Element] = @this;
  ChargingManagementExtendedSync_Notification_nextChargingTimers();
}
on envVar ChargingManagementExtendedSync_Notification_nextChargingTimers_nextChargingTimerMinute
{
  ChargingManagementExtendedSync_array_nextChargingTimers_nextChargingTimerMinute[@ChargingManagementExtendedSync_Notification_nextChargingTimers_Element] = @this;
  ChargingManagementExtendedSync_Notification_nextChargingTimers();
}
on envVar ChargingManagementExtendedSync_Notification_nextChargingTimers_isClimatingNeeded
{
  ChargingManagementExtendedSync_array_nextChargingTimers_isClimatingNeeded[@ChargingManagementExtendedSync_Notification_nextChargingTimers_Element] = @this;
  ChargingManagementExtendedSync_Notification_nextChargingTimers();
}
on envVar ChargingManagementExtendedSync_Notification_nextChargingTimers_isChargingNeeded
{
  ChargingManagementExtendedSync_array_nextChargingTimers_isChargingNeeded[@ChargingManagementExtendedSync_Notification_nextChargingTimers_Element] = @this;
  ChargingManagementExtendedSync_Notification_nextChargingTimers();
}
on envVar ChargingManagementExtendedSync_Notification_nextChargingTimers_elementId_available
{
  ChargingManagementExtendedSync_array_nextChargingTimers_elementId_available[@ChargingManagementExtendedSync_Notification_nextChargingTimers_Element] = @this;
  ChargingManagementExtendedSync_Notification_nextChargingTimers();
}
on envVar ChargingManagementExtendedSync_Notification_nextChargingTimers_isActivated_available
{
  ChargingManagementExtendedSync_array_nextChargingTimers_isActivated_available[@ChargingManagementExtendedSync_Notification_nextChargingTimers_Element] = @this;
  ChargingManagementExtendedSync_Notification_nextChargingTimers();
}
on envVar ChargingManagementExtendedSync_Notification_nextChargingTimers_nextChargingTimerYear_available
{
  ChargingManagementExtendedSync_array_nextChargingTimers_nextChargingTimerYear_available[@ChargingManagementExtendedSync_Notification_nextChargingTimers_Element] = @this;
  ChargingManagementExtendedSync_Notification_nextChargingTimers();
}
on envVar ChargingManagementExtendedSync_Notification_nextChargingTimers_nextChargingTimerMonth_available
{
  ChargingManagementExtendedSync_array_nextChargingTimers_nextChargingTimerMonth_available[@ChargingManagementExtendedSync_Notification_nextChargingTimers_Element] = @this;
  ChargingManagementExtendedSync_Notification_nextChargingTimers();
}
on envVar ChargingManagementExtendedSync_Notification_nextChargingTimers_nextChargingTimerDay_available
{
  ChargingManagementExtendedSync_array_nextChargingTimers_nextChargingTimerDay_available[@ChargingManagementExtendedSync_Notification_nextChargingTimers_Element] = @this;
  ChargingManagementExtendedSync_Notification_nextChargingTimers();
}
on envVar ChargingManagementExtendedSync_Notification_nextChargingTimers_nextChargingTimerHour_available
{
  ChargingManagementExtendedSync_array_nextChargingTimers_nextChargingTimerHour_available[@ChargingManagementExtendedSync_Notification_nextChargingTimers_Element] = @this;
  ChargingManagementExtendedSync_Notification_nextChargingTimers();
}
on envVar ChargingManagementExtendedSync_Notification_nextChargingTimers_nextChargingTimerMinute_available
{
  ChargingManagementExtendedSync_array_nextChargingTimers_nextChargingTimerMinute_available[@ChargingManagementExtendedSync_Notification_nextChargingTimers_Element] = @this;
  ChargingManagementExtendedSync_Notification_nextChargingTimers();
}
on envVar ChargingManagementExtendedSync_Notification_nextChargingTimers_isClimatingNeeded_available
{
  ChargingManagementExtendedSync_array_nextChargingTimers_isClimatingNeeded_available[@ChargingManagementExtendedSync_Notification_nextChargingTimers_Element] = @this;
  ChargingManagementExtendedSync_Notification_nextChargingTimers();
}
on envVar ChargingManagementExtendedSync_Notification_nextChargingTimers_isChargingNeeded_available
{
  ChargingManagementExtendedSync_array_nextChargingTimers_isChargingNeeded_available[@ChargingManagementExtendedSync_Notification_nextChargingTimers_Element] = @this;
  ChargingManagementExtendedSync_Notification_nextChargingTimers();
}
on envVar ChargingManagementExtendedSync_Notification_nextChargingTimers_Payload
{
  ChargingManagementExtendedSync_Notification_nextChargingTimers_update();
}


ChargingManagementExtendedSync_Notification_nextChargingTimers()
{
  word payload_counter = 0;
  word start_pos       = 0;
  word element_length  = 0;
  
  // Length Indicator Struct - Platzhalter
  payload_counter = 0+4;
  start_pos = 0;
  
  for (j=0; j<@ChargingManagementExtendedSync_Notification_nextChargingTimers_Element_TotalNum; j++)
  {
    ChargingManagementExtendedSync_array_nextChargingTimers_available_functions[j] = ChargingManagementExtendedSync_array_nextChargingTimers_elementId_available[j]
                                                                                   + ChargingManagementExtendedSync_array_nextChargingTimers_isActivated_available[j]
                                                                                   + ChargingManagementExtendedSync_array_nextChargingTimers_nextChargingTimerYear_available[j]
                                                                                   + ChargingManagementExtendedSync_array_nextChargingTimers_nextChargingTimerMonth_available[j]
                                                                                   + ChargingManagementExtendedSync_array_nextChargingTimers_nextChargingTimerDay_available[j]
                                                                                   + ChargingManagementExtendedSync_array_nextChargingTimers_nextChargingTimerHour_available[j]
                                                                                   + ChargingManagementExtendedSync_array_nextChargingTimers_nextChargingTimerMinute_available[j]
                                                                                   + ChargingManagementExtendedSync_array_nextChargingTimers_isClimatingNeeded_available[j]
                                                                                   + ChargingManagementExtendedSync_array_nextChargingTimers_isChargingNeeded_available[j];
    
    // Length Indicator Element - Platzhalter
    if (ChargingManagementExtendedSync_array_nextChargingTimers_available_functions[j] > 0)
    {
      start_pos = payload_counter;
      payload_counter = payload_counter + 4;
    }
    else 
      start_pos = payload_counter;
    
    
    // 0 elementId (uint32)
    if (ChargingManagementExtendedSync_array_nextChargingTimers_elementId_available[j] == 1)
    {
      tag_dataID = 0;
      ChargingManagementExtendedSync_payload_buffer_nextChargingTimers[payload_counter++] = 2 * 16 /* Wiretype = 2 =^ 32 Bit */ + ((tag_dataID>>8) & 0x0F) /* DataID High Part */ ;
      ChargingManagementExtendedSync_payload_buffer_nextChargingTimers[payload_counter++] = tag_dataID & 0xFF /* DataID Low Part */ ;
      
      ChargingManagementExtendedSync_payload_buffer_nextChargingTimers[payload_counter++] = ChargingManagementExtendedSync_array_nextChargingTimers_elementId[j]>>24 & 0xFF;
      ChargingManagementExtendedSync_payload_buffer_nextChargingTimers[payload_counter++] = ChargingManagementExtendedSync_array_nextChargingTimers_elementId[j]>>16 & 0xFF;
      ChargingManagementExtendedSync_payload_buffer_nextChargingTimers[payload_counter++] = ChargingManagementExtendedSync_array_nextChargingTimers_elementId[j]>> 8 & 0xFF;
      ChargingManagementExtendedSync_payload_buffer_nextChargingTimers[payload_counter++] = ChargingManagementExtendedSync_array_nextChargingTimers_elementId[j]     & 0xFF;
    }
    
    
    // 1 isActivated (boolean)
    if (ChargingManagementExtendedSync_array_nextChargingTimers_isActivated_available[j] == 1)
    {
      tag_dataID = 1;
      ChargingManagementExtendedSync_payload_buffer_nextChargingTimers[payload_counter++] = 0 * 16 /* Wiretype = 0 =^ 8 Bit */ + ((tag_dataID>>8) & 0x0F) /* DataID High Part */ ;
      ChargingManagementExtendedSync_payload_buffer_nextChargingTimers[payload_counter++] = tag_dataID & 0xFF /* DataID Low Part */ ;
      
      ChargingManagementExtendedSync_payload_buffer_nextChargingTimers[payload_counter++] = ChargingManagementExtendedSync_array_nextChargingTimers_isActivated[j] & 0xFF;
    }
    
    
    // 2 nextChargingTimerYear (uint32)
    if (ChargingManagementExtendedSync_array_nextChargingTimers_nextChargingTimerYear_available[j] == 1)
    {
      tag_dataID = 2;
      ChargingManagementExtendedSync_payload_buffer_nextChargingTimers[payload_counter++] = 2 * 16 /* Wiretype = 2 =^ 32 Bit */ + ((tag_dataID>>8) & 0x0F) /* DataID High Part */ ;
      ChargingManagementExtendedSync_payload_buffer_nextChargingTimers[payload_counter++] = tag_dataID & 0xFF /* DataID Low Part */ ;
      
      ChargingManagementExtendedSync_payload_buffer_nextChargingTimers[payload_counter++] = ChargingManagementExtendedSync_array_nextChargingTimers_nextChargingTimerYear[j]>>24 & 0xFF;
      ChargingManagementExtendedSync_payload_buffer_nextChargingTimers[payload_counter++] = ChargingManagementExtendedSync_array_nextChargingTimers_nextChargingTimerYear[j]>>16 & 0xFF;
      ChargingManagementExtendedSync_payload_buffer_nextChargingTimers[payload_counter++] = ChargingManagementExtendedSync_array_nextChargingTimers_nextChargingTimerYear[j]>> 8 & 0xFF;
      ChargingManagementExtendedSync_payload_buffer_nextChargingTimers[payload_counter++] = ChargingManagementExtendedSync_array_nextChargingTimers_nextChargingTimerYear[j]     & 0xFF;
    }
    
    
    // 3 nextChargingTimerMonth (uint32)
    if (ChargingManagementExtendedSync_array_nextChargingTimers_nextChargingTimerMonth_available[j] == 1)
    {
      tag_dataID = 3;
      ChargingManagementExtendedSync_payload_buffer_nextChargingTimers[payload_counter++] = 2 * 16 /* Wiretype = 2 =^ 32 Bit */ + ((tag_dataID>>8) & 0x0F) /* DataID High Part */ ;
      ChargingManagementExtendedSync_payload_buffer_nextChargingTimers[payload_counter++] = tag_dataID & 0xFF /* DataID Low Part */ ;
      
      ChargingManagementExtendedSync_payload_buffer_nextChargingTimers[payload_counter++] = ChargingManagementExtendedSync_array_nextChargingTimers_nextChargingTimerMonth[j]>>24 & 0xFF;
      ChargingManagementExtendedSync_payload_buffer_nextChargingTimers[payload_counter++] = ChargingManagementExtendedSync_array_nextChargingTimers_nextChargingTimerMonth[j]>>16 & 0xFF;
      ChargingManagementExtendedSync_payload_buffer_nextChargingTimers[payload_counter++] = ChargingManagementExtendedSync_array_nextChargingTimers_nextChargingTimerMonth[j]>> 8 & 0xFF;
      ChargingManagementExtendedSync_payload_buffer_nextChargingTimers[payload_counter++] = ChargingManagementExtendedSync_array_nextChargingTimers_nextChargingTimerMonth[j]     & 0xFF;
    }
    
    
    // 4 nextChargingTimerDay (uint32)
    if (ChargingManagementExtendedSync_array_nextChargingTimers_nextChargingTimerDay_available[j] == 1)
    {
      tag_dataID = 4;
      ChargingManagementExtendedSync_payload_buffer_nextChargingTimers[payload_counter++] = 2 * 16 /* Wiretype = 2 =^ 32 Bit */ + ((tag_dataID>>8) & 0x0F) /* DataID High Part */ ;
      ChargingManagementExtendedSync_payload_buffer_nextChargingTimers[payload_counter++] = tag_dataID & 0xFF /* DataID Low Part */ ;
      
      ChargingManagementExtendedSync_payload_buffer_nextChargingTimers[payload_counter++] = ChargingManagementExtendedSync_array_nextChargingTimers_nextChargingTimerDay[j]>>24 & 0xFF;
      ChargingManagementExtendedSync_payload_buffer_nextChargingTimers[payload_counter++] = ChargingManagementExtendedSync_array_nextChargingTimers_nextChargingTimerDay[j]>>16 & 0xFF;
      ChargingManagementExtendedSync_payload_buffer_nextChargingTimers[payload_counter++] = ChargingManagementExtendedSync_array_nextChargingTimers_nextChargingTimerDay[j]>> 8 & 0xFF;
      ChargingManagementExtendedSync_payload_buffer_nextChargingTimers[payload_counter++] = ChargingManagementExtendedSync_array_nextChargingTimers_nextChargingTimerDay[j]     & 0xFF;
    }
    
    
    // 5 nextChargingTimerHour (uint32)
    if (ChargingManagementExtendedSync_array_nextChargingTimers_nextChargingTimerHour_available[j] == 1)
    {
      tag_dataID = 5;
      ChargingManagementExtendedSync_payload_buffer_nextChargingTimers[payload_counter++] = 2 * 16 /* Wiretype = 2 =^ 32 Bit */ + ((tag_dataID>>8) & 0x0F) /* DataID High Part */ ;
      ChargingManagementExtendedSync_payload_buffer_nextChargingTimers[payload_counter++] = tag_dataID & 0xFF /* DataID Low Part */ ;
      
      ChargingManagementExtendedSync_payload_buffer_nextChargingTimers[payload_counter++] = ChargingManagementExtendedSync_array_nextChargingTimers_nextChargingTimerHour[j]>>24 & 0xFF;
      ChargingManagementExtendedSync_payload_buffer_nextChargingTimers[payload_counter++] = ChargingManagementExtendedSync_array_nextChargingTimers_nextChargingTimerHour[j]>>16 & 0xFF;
      ChargingManagementExtendedSync_payload_buffer_nextChargingTimers[payload_counter++] = ChargingManagementExtendedSync_array_nextChargingTimers_nextChargingTimerHour[j]>> 8 & 0xFF;
      ChargingManagementExtendedSync_payload_buffer_nextChargingTimers[payload_counter++] = ChargingManagementExtendedSync_array_nextChargingTimers_nextChargingTimerHour[j]     & 0xFF;
    }
    
    
    // 6 nextChargingTimerMinute (uint32)
    if (ChargingManagementExtendedSync_array_nextChargingTimers_nextChargingTimerMinute_available[j] == 1)
    {
      tag_dataID = 6;
      ChargingManagementExtendedSync_payload_buffer_nextChargingTimers[payload_counter++] = 2 * 16 /* Wiretype = 2 =^ 32 Bit */ + ((tag_dataID>>8) & 0x0F) /* DataID High Part */ ;
      ChargingManagementExtendedSync_payload_buffer_nextChargingTimers[payload_counter++] = tag_dataID & 0xFF /* DataID Low Part */ ;
      
      ChargingManagementExtendedSync_payload_buffer_nextChargingTimers[payload_counter++] = ChargingManagementExtendedSync_array_nextChargingTimers_nextChargingTimerMinute[j]>>24 & 0xFF;
      ChargingManagementExtendedSync_payload_buffer_nextChargingTimers[payload_counter++] = ChargingManagementExtendedSync_array_nextChargingTimers_nextChargingTimerMinute[j]>>16 & 0xFF;
      ChargingManagementExtendedSync_payload_buffer_nextChargingTimers[payload_counter++] = ChargingManagementExtendedSync_array_nextChargingTimers_nextChargingTimerMinute[j]>> 8 & 0xFF;
      ChargingManagementExtendedSync_payload_buffer_nextChargingTimers[payload_counter++] = ChargingManagementExtendedSync_array_nextChargingTimers_nextChargingTimerMinute[j]     & 0xFF;
    }
    
    
    // 7 isClimatingNeeded (boolean)
    if (ChargingManagementExtendedSync_array_nextChargingTimers_isClimatingNeeded_available[j] == 1)
    {
      tag_dataID = 7;
      ChargingManagementExtendedSync_payload_buffer_nextChargingTimers[payload_counter++] = 0 * 16 /* Wiretype = 0 =^ 8 Bit */ + ((tag_dataID>>8) & 0x0F) /* DataID High Part */ ;
      ChargingManagementExtendedSync_payload_buffer_nextChargingTimers[payload_counter++] = tag_dataID & 0xFF /* DataID Low Part */ ;
      
      ChargingManagementExtendedSync_payload_buffer_nextChargingTimers[payload_counter++] = ChargingManagementExtendedSync_array_nextChargingTimers_isClimatingNeeded[j] & 0xFF;
    }
    
    // 8 isChargingNeeded (boolean)
    if (ChargingManagementExtendedSync_array_nextChargingTimers_isChargingNeeded_available[j] == 1)
    {
      tag_dataID = 8;
      ChargingManagementExtendedSync_payload_buffer_nextChargingTimers[payload_counter++] = 0 * 16 /* Wiretype = 0 =^ 8 Bit */ + ((tag_dataID>>8) & 0x0F) /* DataID High Part */ ;
      ChargingManagementExtendedSync_payload_buffer_nextChargingTimers[payload_counter++] = tag_dataID & 0xFF /* DataID Low Part */ ;
      
      ChargingManagementExtendedSync_payload_buffer_nextChargingTimers[payload_counter++] = ChargingManagementExtendedSync_array_nextChargingTimers_isChargingNeeded[j] & 0xFF;
    }
    
    
    //Element Length
    element_length = payload_counter-start_pos;
    if (element_length >0) ChargingManagementExtendedSync_array_nextChargingTimers_array_element_length[j] = element_length - 4;
    else                   ChargingManagementExtendedSync_array_nextChargingTimers_array_element_length[j] = element_length;
    
    ChargingManagementExtendedSync_payload_buffer_nextChargingTimers[start_pos++] = ChargingManagementExtendedSync_array_nextChargingTimers_array_element_length[j]>>24 & 0xFF;
    ChargingManagementExtendedSync_payload_buffer_nextChargingTimers[start_pos++] = ChargingManagementExtendedSync_array_nextChargingTimers_array_element_length[j]>>16 & 0xFF;
    ChargingManagementExtendedSync_payload_buffer_nextChargingTimers[start_pos++] = ChargingManagementExtendedSync_array_nextChargingTimers_array_element_length[j]>> 8 & 0xFF;
    ChargingManagementExtendedSync_payload_buffer_nextChargingTimers[start_pos++] = ChargingManagementExtendedSync_array_nextChargingTimers_array_element_length[j]     & 0xFF;
    
    if (ChargingManagementExtendedSync_array_nextChargingTimers_array_element_length[j] == 0) payload_counter = payload_counter+4;
  }
  
  // Struct Length
  ChargingManagementExtendedSync_array_nextChargingTimers_struct_element_length = 4*@ChargingManagementExtendedSync_Notification_nextChargingTimers_Element_TotalNum;

  for (k=0;k<@ChargingManagementExtendedSync_Notification_nextChargingTimers_Element_TotalNum;k++)
    ChargingManagementExtendedSync_array_nextChargingTimers_struct_element_length = ChargingManagementExtendedSync_array_nextChargingTimers_struct_element_length + ChargingManagementExtendedSync_array_nextChargingTimers_array_element_length[k];
  
  ChargingManagementExtendedSync_payload_buffer_nextChargingTimers[0] = ChargingManagementExtendedSync_array_nextChargingTimers_struct_element_length>>24 & 0xFF;
  ChargingManagementExtendedSync_payload_buffer_nextChargingTimers[1] = ChargingManagementExtendedSync_array_nextChargingTimers_struct_element_length>>16 & 0xFF;
  ChargingManagementExtendedSync_payload_buffer_nextChargingTimers[2] = ChargingManagementExtendedSync_array_nextChargingTimers_struct_element_length>> 8 & 0xFF;
  ChargingManagementExtendedSync_payload_buffer_nextChargingTimers[3] = ChargingManagementExtendedSync_array_nextChargingTimers_struct_element_length     & 0xFF;


  ChargingManagementExtendedSync_payload_length_nextChargingTimers = ChargingManagementExtendedSync_array_nextChargingTimers_struct_element_length+4;
  putvalue(ChargingManagementExtendedSync_Notification_nextChargingTimers_Payload, ChargingManagementExtendedSync_payload_buffer_nextChargingTimers, ChargingManagementExtendedSync_payload_length_nextChargingTimers);
}

on envVar ChargingManagementExtendedSync_Notification_nextChargingTimers_Element_TotalNum
{
  if (@this == 0) @this =  1;
  if (@this > 10) @this = 10;
  
  ChargingManagementExtendedSync_Notification_nextChargingTimers();
  ChargingManagementExtendedSync_Notification_nextChargingTimers_update();
}

on envVar ChargingManagementExtendedSync_Notification_nextChargingTimers_Element
{
  ChargingManagementExtendedSync_Notification_nextChargingTimers_update();
}

on envVar ChargingManagementExtendedSync_Notification_nextChargingTimers_Element_Next
{
  if (@this == 1 && @ChargingManagementExtendedSync_Notification_nextChargingTimers_Element < @ChargingManagementExtendedSync_Notification_nextChargingTimers_Element_TotalNum - 1)
  {
    @ChargingManagementExtendedSync_Notification_nextChargingTimers_Element = @ChargingManagementExtendedSync_Notification_nextChargingTimers_Element + 1;
    ChargingManagementExtendedSync_Notification_nextChargingTimers_update();
  }
}

on envVar ChargingManagementExtendedSync_Notification_nextChargingTimers_Element_Previous
{
  if (@this == 1 && @ChargingManagementExtendedSync_Notification_nextChargingTimers_Element > 0)
  {
    @ChargingManagementExtendedSync_Notification_nextChargingTimers_Element = @ChargingManagementExtendedSync_Notification_nextChargingTimers_Element - 1;
    ChargingManagementExtendedSync_Notification_nextChargingTimers_update();
  }
}
  
ChargingManagementExtendedSync_Notification_nextChargingTimers_update()
{
  @ChargingManagementExtendedSync_Notification_LengthIndicator_Element_nextChargingTimers = ChargingManagementExtendedSync_array_nextChargingTimers_array_element_length[@ChargingManagementExtendedSync_Notification_nextChargingTimers_Element];
  @ChargingManagementExtendedSync_Notification_LengthIndicator_Struct_nextChargingTimers  = ChargingManagementExtendedSync_array_nextChargingTimers_struct_element_length;
  @ChargingManagementExtendedSync_Notification_Length_nextChargingTimers                  = ChargingManagementExtendedSync_payload_length_nextChargingTimers+8;
  
  @ChargingManagementExtendedSync_Notification_nextChargingTimers_elementId               = ChargingManagementExtendedSync_array_nextChargingTimers_elementId[@ChargingManagementExtendedSync_Notification_nextChargingTimers_Element];
  @ChargingManagementExtendedSync_Notification_nextChargingTimers_isActivated	            = ChargingManagementExtendedSync_array_nextChargingTimers_isActivated[@ChargingManagementExtendedSync_Notification_nextChargingTimers_Element];
  @ChargingManagementExtendedSync_Notification_nextChargingTimers_nextChargingTimerYear	  = ChargingManagementExtendedSync_array_nextChargingTimers_nextChargingTimerYear[@ChargingManagementExtendedSync_Notification_nextChargingTimers_Element];
  @ChargingManagementExtendedSync_Notification_nextChargingTimers_nextChargingTimerMonth  = ChargingManagementExtendedSync_array_nextChargingTimers_nextChargingTimerMonth[@ChargingManagementExtendedSync_Notification_nextChargingTimers_Element];
  @ChargingManagementExtendedSync_Notification_nextChargingTimers_nextChargingTimerDay	  = ChargingManagementExtendedSync_array_nextChargingTimers_nextChargingTimerDay[@ChargingManagementExtendedSync_Notification_nextChargingTimers_Element];
  @ChargingManagementExtendedSync_Notification_nextChargingTimers_nextChargingTimerHour 	= ChargingManagementExtendedSync_array_nextChargingTimers_nextChargingTimerHour[@ChargingManagementExtendedSync_Notification_nextChargingTimers_Element];
  @ChargingManagementExtendedSync_Notification_nextChargingTimers_nextChargingTimerMinute	= ChargingManagementExtendedSync_array_nextChargingTimers_nextChargingTimerMinute[@ChargingManagementExtendedSync_Notification_nextChargingTimers_Element];
  @ChargingManagementExtendedSync_Notification_nextChargingTimers_isClimatingNeeded       = ChargingManagementExtendedSync_array_nextChargingTimers_isClimatingNeeded[@ChargingManagementExtendedSync_Notification_nextChargingTimers_Element];
  @ChargingManagementExtendedSync_Notification_nextChargingTimers_isChargingNeeded        = ChargingManagementExtendedSync_array_nextChargingTimers_isChargingNeeded[@ChargingManagementExtendedSync_Notification_nextChargingTimers_Element];
  
  @ChargingManagementExtendedSync_Notification_nextChargingTimers_elementId_available               = ChargingManagementExtendedSync_array_nextChargingTimers_elementId_available[@ChargingManagementExtendedSync_Notification_nextChargingTimers_Element];
  @ChargingManagementExtendedSync_Notification_nextChargingTimers_isActivated_available	            = ChargingManagementExtendedSync_array_nextChargingTimers_isActivated_available[@ChargingManagementExtendedSync_Notification_nextChargingTimers_Element];
  @ChargingManagementExtendedSync_Notification_nextChargingTimers_nextChargingTimerYear_available	  = ChargingManagementExtendedSync_array_nextChargingTimers_nextChargingTimerYear_available[@ChargingManagementExtendedSync_Notification_nextChargingTimers_Element];
  @ChargingManagementExtendedSync_Notification_nextChargingTimers_nextChargingTimerMonth_available  = ChargingManagementExtendedSync_array_nextChargingTimers_nextChargingTimerMonth_available[@ChargingManagementExtendedSync_Notification_nextChargingTimers_Element];
  @ChargingManagementExtendedSync_Notification_nextChargingTimers_nextChargingTimerDay_available	  = ChargingManagementExtendedSync_array_nextChargingTimers_nextChargingTimerDay_available[@ChargingManagementExtendedSync_Notification_nextChargingTimers_Element];
  @ChargingManagementExtendedSync_Notification_nextChargingTimers_nextChargingTimerHour_available 	= ChargingManagementExtendedSync_array_nextChargingTimers_nextChargingTimerHour_available[@ChargingManagementExtendedSync_Notification_nextChargingTimers_Element];
  @ChargingManagementExtendedSync_Notification_nextChargingTimers_nextChargingTimerMinute_available	= ChargingManagementExtendedSync_array_nextChargingTimers_nextChargingTimerMinute_available[@ChargingManagementExtendedSync_Notification_nextChargingTimers_Element];
  @ChargingManagementExtendedSync_Notification_nextChargingTimers_isClimatingNeeded_available       = ChargingManagementExtendedSync_array_nextChargingTimers_isClimatingNeeded_available[@ChargingManagementExtendedSync_Notification_nextChargingTimers_Element];
  @ChargingManagementExtendedSync_Notification_nextChargingTimers_isChargingNeeded_available        = ChargingManagementExtendedSync_array_nextChargingTimers_isChargingNeeded_available[@ChargingManagementExtendedSync_Notification_nextChargingTimers_Element];
}








////////// preferredChargingTimes Notification //////////

on envVar ChargingManagementExtendedSync_Notification_LengthIndicator_Struct_preferredChargingTimes
{
  ChargingManagementExtendedSync_Notification_preferredChargingTimes();
}
on envVar ChargingManagementExtendedSync_Notification_LengthIndicator_Element_preferredChargingTimes
{
  ChargingManagementExtendedSync_Notification_preferredChargingTimes();
}
on envVar ChargingManagementExtendedSync_Notification_preferredChargingTimes_elementId
{
  ChargingManagementExtendedSync_array_preferredChargingTimes_elementId[@ChargingManagementExtendedSync_Notification_preferredChargingTimes_Element] = @this;
  ChargingManagementExtendedSync_Notification_preferredChargingTimes();
}
on envVar ChargingManagementExtendedSync_Notification_preferredChargingTimes_isActivated
{
  ChargingManagementExtendedSync_array_preferredChargingTimes_isActivated[@ChargingManagementExtendedSync_Notification_preferredChargingTimes_Element] = @this;
  ChargingManagementExtendedSync_Notification_preferredChargingTimes();
}
on envVar ChargingManagementExtendedSync_Notification_preferredChargingTimes_startHour
{
  ChargingManagementExtendedSync_array_preferredChargingTimes_startHour[@ChargingManagementExtendedSync_Notification_preferredChargingTimes_Element] = @this;
  ChargingManagementExtendedSync_Notification_preferredChargingTimes();
}
on envVar ChargingManagementExtendedSync_Notification_preferredChargingTimes_startMinute
{
  ChargingManagementExtendedSync_array_preferredChargingTimes_startMinute[@ChargingManagementExtendedSync_Notification_preferredChargingTimes_Element] = @this;
  ChargingManagementExtendedSync_Notification_preferredChargingTimes();
}
on envVar ChargingManagementExtendedSync_Notification_preferredChargingTimes_endHour
{
  ChargingManagementExtendedSync_array_preferredChargingTimes_endHour[@ChargingManagementExtendedSync_Notification_preferredChargingTimes_Element] = @this;
  ChargingManagementExtendedSync_Notification_preferredChargingTimes();
}
on envVar ChargingManagementExtendedSync_Notification_preferredChargingTimes_endMinute
{
  ChargingManagementExtendedSync_array_preferredChargingTimes_endMinute[@ChargingManagementExtendedSync_Notification_preferredChargingTimes_Element] = @this;
  ChargingManagementExtendedSync_Notification_preferredChargingTimes();
}
on envVar ChargingManagementExtendedSync_Notification_preferredChargingTimes_elementId_available
{
  ChargingManagementExtendedSync_array_preferredChargingTimes_elementId_available[@ChargingManagementExtendedSync_Notification_preferredChargingTimes_Element] = @this;
  ChargingManagementExtendedSync_Notification_preferredChargingTimes();
}
on envVar ChargingManagementExtendedSync_Notification_preferredChargingTimes_isActivated_available
{
  ChargingManagementExtendedSync_array_preferredChargingTimes_isActivated_available[@ChargingManagementExtendedSync_Notification_preferredChargingTimes_Element] = @this;
  ChargingManagementExtendedSync_Notification_preferredChargingTimes();
}
on envVar ChargingManagementExtendedSync_Notification_preferredChargingTimes_startHour_available
{
  ChargingManagementExtendedSync_array_preferredChargingTimes_startHour_available[@ChargingManagementExtendedSync_Notification_preferredChargingTimes_Element] = @this;
  ChargingManagementExtendedSync_Notification_preferredChargingTimes();
}
on envVar ChargingManagementExtendedSync_Notification_preferredChargingTimes_startMinute_available
{
  ChargingManagementExtendedSync_array_preferredChargingTimes_startMinute_available[@ChargingManagementExtendedSync_Notification_preferredChargingTimes_Element] = @this;
  ChargingManagementExtendedSync_Notification_preferredChargingTimes();
}
on envVar ChargingManagementExtendedSync_Notification_preferredChargingTimes_endHour_available
{
  ChargingManagementExtendedSync_array_preferredChargingTimes_endHour_available[@ChargingManagementExtendedSync_Notification_preferredChargingTimes_Element] = @this;
  ChargingManagementExtendedSync_Notification_preferredChargingTimes();
}
on envVar ChargingManagementExtendedSync_Notification_preferredChargingTimes_endMinute_available
{
  ChargingManagementExtendedSync_array_preferredChargingTimes_endMinute_available[@ChargingManagementExtendedSync_Notification_preferredChargingTimes_Element] = @this;
  ChargingManagementExtendedSync_Notification_preferredChargingTimes();
}
on envVar ChargingManagementExtendedSync_Notification_preferredChargingTimes_Payload
{
  ChargingManagementExtendedSync_Notification_preferredChargingTimes_update();
}


ChargingManagementExtendedSync_Notification_preferredChargingTimes()
{
  word payload_counter = 0;
  word start_pos       = 0;
  word element_length  = 0;
  
  // Length Indicator Struct - Platzhalter
  payload_counter = 0+4;
  start_pos = 0;
  
  for (j=0; j<@ChargingManagementExtendedSync_Notification_preferredChargingTimes_Element_TotalNum; j++)
  {
    ChargingManagementExtendedSync_array_preferredChargingTimes_available_functions[j] = ChargingManagementExtendedSync_array_preferredChargingTimes_elementId_available[j]
                                                                                       + ChargingManagementExtendedSync_array_preferredChargingTimes_isActivated_available[j]
                                                                                       + ChargingManagementExtendedSync_array_preferredChargingTimes_startHour_available[j]
                                                                                       + ChargingManagementExtendedSync_array_preferredChargingTimes_startMinute_available[j]
                                                                                       + ChargingManagementExtendedSync_array_preferredChargingTimes_endHour_available[j]
                                                                                       + ChargingManagementExtendedSync_array_preferredChargingTimes_endMinute_available[j];
    
    // Length Indicator Element - Platzhalter
    if (ChargingManagementExtendedSync_array_preferredChargingTimes_available_functions[j] > 0)
    {
      start_pos = payload_counter;
      payload_counter = payload_counter + 4;
    }
    else 
      start_pos = payload_counter;
    
    
    // 0 elementId (uint32)
    if (ChargingManagementExtendedSync_array_preferredChargingTimes_elementId_available[j] == 1)
    {
      tag_dataID = 0;
      ChargingManagementExtendedSync_payload_buffer_preferredChargingTimes[payload_counter++] = 2 * 16 /* Wiretype = 2 =^ 32 Bit */ + ((tag_dataID>>8) & 0x0F) /* DataID High Part */ ;
      ChargingManagementExtendedSync_payload_buffer_preferredChargingTimes[payload_counter++] = tag_dataID & 0xFF /* DataID Low Part */ ;
      
      ChargingManagementExtendedSync_payload_buffer_preferredChargingTimes[payload_counter++] = ChargingManagementExtendedSync_array_preferredChargingTimes_elementId[j]>>24 & 0xFF;
      ChargingManagementExtendedSync_payload_buffer_preferredChargingTimes[payload_counter++] = ChargingManagementExtendedSync_array_preferredChargingTimes_elementId[j]>>16 & 0xFF;
      ChargingManagementExtendedSync_payload_buffer_preferredChargingTimes[payload_counter++] = ChargingManagementExtendedSync_array_preferredChargingTimes_elementId[j]>> 8 & 0xFF;
      ChargingManagementExtendedSync_payload_buffer_preferredChargingTimes[payload_counter++] = ChargingManagementExtendedSync_array_preferredChargingTimes_elementId[j]     & 0xFF;
    }
    
    // 1 isActivated (boolean)
    if (ChargingManagementExtendedSync_array_preferredChargingTimes_isActivated_available[j] == 1)
    {
      tag_dataID = 1;
      ChargingManagementExtendedSync_payload_buffer_preferredChargingTimes[payload_counter++] = 0 * 16 /* Wiretype = 0 =^ 8 Bit */ + ((tag_dataID>>8) & 0x0F) /* DataID High Part */ ;
      ChargingManagementExtendedSync_payload_buffer_preferredChargingTimes[payload_counter++] = tag_dataID & 0xFF /* DataID Low Part */ ;
      
      ChargingManagementExtendedSync_payload_buffer_preferredChargingTimes[payload_counter++] = ChargingManagementExtendedSync_array_preferredChargingTimes_isActivated[j] & 0xFF;
    }
    
    // 2 startHour (uint32)
    if (ChargingManagementExtendedSync_array_preferredChargingTimes_startHour_available[j] == 1)
    {
      tag_dataID = 2;
      ChargingManagementExtendedSync_payload_buffer_preferredChargingTimes[payload_counter++] = 2 * 16 /* Wiretype = 2 =^ 32 Bit */ + ((tag_dataID>>8) & 0x0F) /* DataID High Part */ ;
      ChargingManagementExtendedSync_payload_buffer_preferredChargingTimes[payload_counter++] = tag_dataID & 0xFF /* DataID Low Part */ ;
      
      ChargingManagementExtendedSync_payload_buffer_preferredChargingTimes[payload_counter++] = ChargingManagementExtendedSync_array_preferredChargingTimes_startHour[j]>>24 & 0xFF;
      ChargingManagementExtendedSync_payload_buffer_preferredChargingTimes[payload_counter++] = ChargingManagementExtendedSync_array_preferredChargingTimes_startHour[j]>>16 & 0xFF;
      ChargingManagementExtendedSync_payload_buffer_preferredChargingTimes[payload_counter++] = ChargingManagementExtendedSync_array_preferredChargingTimes_startHour[j]>> 8 & 0xFF;
      ChargingManagementExtendedSync_payload_buffer_preferredChargingTimes[payload_counter++] = ChargingManagementExtendedSync_array_preferredChargingTimes_startHour[j]     & 0xFF;
    }
    
    // 3 startMinute (uint32)
    if (ChargingManagementExtendedSync_array_preferredChargingTimes_startMinute_available[j] == 1)
    {
      tag_dataID = 3;
      ChargingManagementExtendedSync_payload_buffer_preferredChargingTimes[payload_counter++] = 2 * 16 /* Wiretype = 2 =^ 32 Bit */ + ((tag_dataID>>8) & 0x0F) /* DataID High Part */ ;
      ChargingManagementExtendedSync_payload_buffer_preferredChargingTimes[payload_counter++] = tag_dataID & 0xFF /* DataID Low Part */ ;
      
      ChargingManagementExtendedSync_payload_buffer_preferredChargingTimes[payload_counter++] = ChargingManagementExtendedSync_array_preferredChargingTimes_startMinute[j]>>24 & 0xFF;
      ChargingManagementExtendedSync_payload_buffer_preferredChargingTimes[payload_counter++] = ChargingManagementExtendedSync_array_preferredChargingTimes_startMinute[j]>>16 & 0xFF;
      ChargingManagementExtendedSync_payload_buffer_preferredChargingTimes[payload_counter++] = ChargingManagementExtendedSync_array_preferredChargingTimes_startMinute[j]>> 8 & 0xFF;
      ChargingManagementExtendedSync_payload_buffer_preferredChargingTimes[payload_counter++] = ChargingManagementExtendedSync_array_preferredChargingTimes_startMinute[j]     & 0xFF;
    }
    
    // 4 endHour (uint32)
    if (ChargingManagementExtendedSync_array_preferredChargingTimes_endHour_available[j] == 1)
    {
      tag_dataID = 4;
      ChargingManagementExtendedSync_payload_buffer_preferredChargingTimes[payload_counter++] = 2 * 16 /* Wiretype = 2 =^ 32 Bit */ + ((tag_dataID>>8) & 0x0F) /* DataID High Part */ ;
      ChargingManagementExtendedSync_payload_buffer_preferredChargingTimes[payload_counter++] = tag_dataID & 0xFF /* DataID Low Part */ ;
      
      ChargingManagementExtendedSync_payload_buffer_preferredChargingTimes[payload_counter++] = ChargingManagementExtendedSync_array_preferredChargingTimes_endHour[j]>>24 & 0xFF;
      ChargingManagementExtendedSync_payload_buffer_preferredChargingTimes[payload_counter++] = ChargingManagementExtendedSync_array_preferredChargingTimes_endHour[j]>>16 & 0xFF;
      ChargingManagementExtendedSync_payload_buffer_preferredChargingTimes[payload_counter++] = ChargingManagementExtendedSync_array_preferredChargingTimes_endHour[j]>> 8 & 0xFF;
      ChargingManagementExtendedSync_payload_buffer_preferredChargingTimes[payload_counter++] = ChargingManagementExtendedSync_array_preferredChargingTimes_endHour[j]     & 0xFF;
    }
    
    // 5 endMinute (uint32)
    if (ChargingManagementExtendedSync_array_preferredChargingTimes_endMinute_available[j] == 1)
    {
      tag_dataID = 5;
      ChargingManagementExtendedSync_payload_buffer_preferredChargingTimes[payload_counter++] = 2 * 16 /* Wiretype = 2 =^ 32 Bit */ + ((tag_dataID>>8) & 0x0F) /* DataID High Part */ ;
      ChargingManagementExtendedSync_payload_buffer_preferredChargingTimes[payload_counter++] = tag_dataID & 0xFF /* DataID Low Part */ ;
      
      ChargingManagementExtendedSync_payload_buffer_preferredChargingTimes[payload_counter++] = ChargingManagementExtendedSync_array_preferredChargingTimes_endMinute[j]>>24 & 0xFF;
      ChargingManagementExtendedSync_payload_buffer_preferredChargingTimes[payload_counter++] = ChargingManagementExtendedSync_array_preferredChargingTimes_endMinute[j]>>16 & 0xFF;
      ChargingManagementExtendedSync_payload_buffer_preferredChargingTimes[payload_counter++] = ChargingManagementExtendedSync_array_preferredChargingTimes_endMinute[j]>> 8 & 0xFF;
      ChargingManagementExtendedSync_payload_buffer_preferredChargingTimes[payload_counter++] = ChargingManagementExtendedSync_array_preferredChargingTimes_endMinute[j]     & 0xFF;
    }
    
    
    //Element Length
    element_length = payload_counter-start_pos;
    if (element_length >0) ChargingManagementExtendedSync_array_preferredChargingTimes_array_element_length[j] = element_length - 4;
    else                   ChargingManagementExtendedSync_array_preferredChargingTimes_array_element_length[j] = element_length;
    
    ChargingManagementExtendedSync_payload_buffer_preferredChargingTimes[start_pos++] = ChargingManagementExtendedSync_array_preferredChargingTimes_array_element_length[j]>>24 & 0xFF;
    ChargingManagementExtendedSync_payload_buffer_preferredChargingTimes[start_pos++] = ChargingManagementExtendedSync_array_preferredChargingTimes_array_element_length[j]>>16 & 0xFF;
    ChargingManagementExtendedSync_payload_buffer_preferredChargingTimes[start_pos++] = ChargingManagementExtendedSync_array_preferredChargingTimes_array_element_length[j]>> 8 & 0xFF;
    ChargingManagementExtendedSync_payload_buffer_preferredChargingTimes[start_pos++] = ChargingManagementExtendedSync_array_preferredChargingTimes_array_element_length[j]     & 0xFF;
    
    if (ChargingManagementExtendedSync_array_preferredChargingTimes_array_element_length[j] == 0) payload_counter = payload_counter+4;
  }
  
  // Struct Length
  ChargingManagementExtendedSync_array_preferredChargingTimes_struct_element_length = 4*@ChargingManagementExtendedSync_Notification_preferredChargingTimes_Element_TotalNum;

  for (k=0;k<@ChargingManagementExtendedSync_Notification_preferredChargingTimes_Element_TotalNum;k++)
    ChargingManagementExtendedSync_array_preferredChargingTimes_struct_element_length = ChargingManagementExtendedSync_array_preferredChargingTimes_struct_element_length + ChargingManagementExtendedSync_array_preferredChargingTimes_array_element_length[k];
  
  ChargingManagementExtendedSync_payload_buffer_preferredChargingTimes[0] = ChargingManagementExtendedSync_array_preferredChargingTimes_struct_element_length>>24 & 0xFF;
  ChargingManagementExtendedSync_payload_buffer_preferredChargingTimes[1] = ChargingManagementExtendedSync_array_preferredChargingTimes_struct_element_length>>16 & 0xFF;
  ChargingManagementExtendedSync_payload_buffer_preferredChargingTimes[2] = ChargingManagementExtendedSync_array_preferredChargingTimes_struct_element_length>> 8 & 0xFF;
  ChargingManagementExtendedSync_payload_buffer_preferredChargingTimes[3] = ChargingManagementExtendedSync_array_preferredChargingTimes_struct_element_length     & 0xFF;


  ChargingManagementExtendedSync_payload_length_preferredChargingTimes = ChargingManagementExtendedSync_array_preferredChargingTimes_struct_element_length+4;
  putvalue(ChargingManagementExtendedSync_Notification_preferredChargingTimes_Payload, ChargingManagementExtendedSync_payload_buffer_preferredChargingTimes, ChargingManagementExtendedSync_payload_length_preferredChargingTimes);
}

on envVar ChargingManagementExtendedSync_Notification_preferredChargingTimes_Element_TotalNum
{
  if (@this == 0) @this =  1;
  if (@this > 10) @this = 10;
  
  ChargingManagementExtendedSync_Notification_preferredChargingTimes();
  ChargingManagementExtendedSync_Notification_preferredChargingTimes_update();
}

on envVar ChargingManagementExtendedSync_Notification_preferredChargingTimes_Element
{
  ChargingManagementExtendedSync_Notification_preferredChargingTimes_update();
}

on envVar ChargingManagementExtendedSync_Notification_preferredChargingTimes_Element_Next
{
  if (@this == 1 && @ChargingManagementExtendedSync_Notification_preferredChargingTimes_Element < @ChargingManagementExtendedSync_Notification_preferredChargingTimes_Element_TotalNum - 1)
  {
    @ChargingManagementExtendedSync_Notification_preferredChargingTimes_Element = @ChargingManagementExtendedSync_Notification_preferredChargingTimes_Element + 1;
    ChargingManagementExtendedSync_Notification_preferredChargingTimes_update();
  }
}

on envVar ChargingManagementExtendedSync_Notification_preferredChargingTimes_Element_Previous
{
  if (@this == 1 && @ChargingManagementExtendedSync_Notification_preferredChargingTimes_Element > 0)
  {
    @ChargingManagementExtendedSync_Notification_preferredChargingTimes_Element = @ChargingManagementExtendedSync_Notification_preferredChargingTimes_Element - 1;
    ChargingManagementExtendedSync_Notification_preferredChargingTimes_update();
  }
}

ChargingManagementExtendedSync_Notification_preferredChargingTimes_update()
{
  @ChargingManagementExtendedSync_Notification_LengthIndicator_Element_preferredChargingTimes = ChargingManagementExtendedSync_array_preferredChargingTimes_array_element_length[@ChargingManagementExtendedSync_Notification_preferredChargingTimes_Element];
  @ChargingManagementExtendedSync_Notification_LengthIndicator_Struct_preferredChargingTimes  = ChargingManagementExtendedSync_array_preferredChargingTimes_struct_element_length;
  @ChargingManagementExtendedSync_Notification_Length_preferredChargingTimes                  = ChargingManagementExtendedSync_payload_length_preferredChargingTimes+8;
  
  @ChargingManagementExtendedSync_Notification_preferredChargingTimes_elementId   = ChargingManagementExtendedSync_array_preferredChargingTimes_elementId[@ChargingManagementExtendedSync_Notification_preferredChargingTimes_Element];
  @ChargingManagementExtendedSync_Notification_preferredChargingTimes_isActivated	= ChargingManagementExtendedSync_array_preferredChargingTimes_isActivated[@ChargingManagementExtendedSync_Notification_preferredChargingTimes_Element];
  @ChargingManagementExtendedSync_Notification_preferredChargingTimes_startHour   = ChargingManagementExtendedSync_array_preferredChargingTimes_startHour[@ChargingManagementExtendedSync_Notification_preferredChargingTimes_Element];
  @ChargingManagementExtendedSync_Notification_preferredChargingTimes_startMinute = ChargingManagementExtendedSync_array_preferredChargingTimes_startMinute[@ChargingManagementExtendedSync_Notification_preferredChargingTimes_Element];
  @ChargingManagementExtendedSync_Notification_preferredChargingTimes_endHour     = ChargingManagementExtendedSync_array_preferredChargingTimes_endHour[@ChargingManagementExtendedSync_Notification_preferredChargingTimes_Element];
  @ChargingManagementExtendedSync_Notification_preferredChargingTimes_endMinute   = ChargingManagementExtendedSync_array_preferredChargingTimes_endMinute[@ChargingManagementExtendedSync_Notification_preferredChargingTimes_Element];
  
  @ChargingManagementExtendedSync_Notification_preferredChargingTimes_elementId_available   = ChargingManagementExtendedSync_array_preferredChargingTimes_elementId_available[@ChargingManagementExtendedSync_Notification_preferredChargingTimes_Element];
  @ChargingManagementExtendedSync_Notification_preferredChargingTimes_isActivated_available	= ChargingManagementExtendedSync_array_preferredChargingTimes_isActivated_available[@ChargingManagementExtendedSync_Notification_preferredChargingTimes_Element];
  @ChargingManagementExtendedSync_Notification_preferredChargingTimes_startHour_available   = ChargingManagementExtendedSync_array_preferredChargingTimes_startHour_available[@ChargingManagementExtendedSync_Notification_preferredChargingTimes_Element];
  @ChargingManagementExtendedSync_Notification_preferredChargingTimes_startMinute_available = ChargingManagementExtendedSync_array_preferredChargingTimes_startMinute_available[@ChargingManagementExtendedSync_Notification_preferredChargingTimes_Element];
  @ChargingManagementExtendedSync_Notification_preferredChargingTimes_endHour_available     = ChargingManagementExtendedSync_array_preferredChargingTimes_endHour_available[@ChargingManagementExtendedSync_Notification_preferredChargingTimes_Element];
  @ChargingManagementExtendedSync_Notification_preferredChargingTimes_endMinute_available   = ChargingManagementExtendedSync_array_preferredChargingTimes_endMinute_available[@ChargingManagementExtendedSync_Notification_preferredChargingTimes_Element];
}








////////////////////////////////////////////////////////
////////////////// Service UnitMaster //////////////////
////////////////////////////////////////////////////////

on envVar ServiceDiscovery_Find_Service_UnitMaster
{
  if (@this == 1) Send_ServiceDiscovery_Find_Service_ICAS1Sys02();
}

on envVar UnitMaster_SetGet_units_Get
{
  if (@this == 1)
  {
    UDP_Segments_total = @UnitMaster_SetGet_Length_units/1404 + 1;
    UDP_Segments_left  = UDP_Segments_total;
    
    if (UDP_Segments_total > 1) seg_id_flag = 1;
    else                        seg_id_flag = 0;
    
    Send_Service_UnitMaster_SetGet (0x4010 & 0x0000FFFF);
  }
}
on envVar UnitMaster_SetGet_units_Set
{
  if (@this == 1)
  {
    UDP_Segments_total = @UnitMaster_SetGet_Length_units/1404 + 1;
    UDP_Segments_left  = UDP_Segments_total;
    
    if (UDP_Segments_total > 1) seg_id_flag = 1;
    else                        seg_id_flag = 0;
    
    Send_Service_UnitMaster_SetGet (0x4011 & 0x0000FFFF);
  }
}

on envVar UnitMaster_Subscribe_units
{
  if (get_subAck_flag == 0)
    Send_ServiceDiscovery_Subscribe_ICAS1Sys02 (0x600E, 0xC010, @this);
  
  UnitMaster_SubscribeStatus_units = @this;
}


Send_Service_UnitMaster_SetGet (word MethodID)
{
  ethernetPacket EthPaket;

  // Ethernet Packet - MAC Source address
  getvalue (ServiceDiscovery_EthernetPacket_MAC_Source_ICAS1Sys02, buffer_MAC);
  //EthPaket.source.ParseAddress ( buffer_MAC );
  EthPaket.source = ethGetMacAddressAsNumber (buffer_MAC);
  
  // Ethernet Packet - MAC Destination address
  getvalue (ServiceDiscovery_EthernetPacket_MAC_Destination, buffer_MAC);
  //EthPaket.destination.ParseAddress ( buffer_MAC );
  EthPaket.destination = ethGetMacAddressAsNumber (buffer_MAC);
  
  // Ethernet Packet - VLAN
  EthPaket.SetVlan (@ServiceDiscovery_EthernetPacket_VLAN_TPID, @ServiceDiscovery_EthernetPacket_VLAN_TCI);
  
  // Ethernet Packet - Type
  //EthPaket.ipv6.type = @EthernetPacket_Type;
  if (@ServiceDiscovery_EthernetPacket_Type == 0x86DD) EthPaket.ipv6.Init();
  
  
  // IPv6 Packet - Version
  EthPaket.ipv6.version = @ServiceDiscovery_IPv6Packet_Version;

  // IPv6 Packet - Traffic Class
  EthPaket.ipv6.class = @ServiceDiscovery_IPv6Packet_Traffic_Class;
  
  // IPv6 Packet - Flow Label
  EthPaket.ipv6.flow = @ServiceDiscovery_IPv6Packet_Flow_Label;
  
  // IPv6 Packet - Payload_Length
  EthPaket.ipv6.length = @ServiceDiscovery_IPv6Packet_Payload_Length;
  
  // IPv6 Packet - Next Header
  EthPaket.ipv6.next = @ServiceDiscovery_IPv6Packet_Next_Header;
  if (@ServiceDiscovery_IPv6Packet_Next_Header == 6) EthPaket.tcp.Init();
  if (@ServiceDiscovery_IPv6Packet_Next_Header == 17) EthPaket.udp.Init();
  
  // IPv6 Packet - Hop Limit
  EthPaket.ipv6.hopLimit = @ServiceDiscovery_IPv6Packet_Hop_Limit;

  // IPv6 Packet - IPv6 Destination address    // TODO: char array zu byte array
  buffer_ipv6[0]  = @ServiceDiscovery_IPv6Packet_IP_Destination_Unicast_01>>8 & 0xFF;
  buffer_ipv6[1]  = @ServiceDiscovery_IPv6Packet_IP_Destination_Unicast_01    & 0xFF;
  buffer_ipv6[2]  = @ServiceDiscovery_IPv6Packet_IP_Destination_Unicast_02>>8 & 0xFF;
  buffer_ipv6[3]  = @ServiceDiscovery_IPv6Packet_IP_Destination_Unicast_02    & 0xFF;
  buffer_ipv6[4]  = @ServiceDiscovery_IPv6Packet_IP_Destination_Unicast_03>>8 & 0xFF;
  buffer_ipv6[5]  = @ServiceDiscovery_IPv6Packet_IP_Destination_Unicast_03    & 0xFF;
  buffer_ipv6[6]  = @ServiceDiscovery_IPv6Packet_IP_Destination_Unicast_04>>8 & 0xFF;
  buffer_ipv6[7]  = @ServiceDiscovery_IPv6Packet_IP_Destination_Unicast_04    & 0xFF;
  buffer_ipv6[8]  = @ServiceDiscovery_IPv6Packet_IP_Destination_Unicast_05>>8 & 0xFF;
  buffer_ipv6[9]  = @ServiceDiscovery_IPv6Packet_IP_Destination_Unicast_05    & 0xFF;
  buffer_ipv6[10] = @ServiceDiscovery_IPv6Packet_IP_Destination_Unicast_06>>8 & 0xFF;
  buffer_ipv6[11] = @ServiceDiscovery_IPv6Packet_IP_Destination_Unicast_06    & 0xFF;
  buffer_ipv6[12] = @ServiceDiscovery_IPv6Packet_IP_Destination_Unicast_07>>8 & 0xFF;
  buffer_ipv6[13] = @ServiceDiscovery_IPv6Packet_IP_Destination_Unicast_07    & 0xFF;
  buffer_ipv6[14] = @ServiceDiscovery_IPv6Packet_IP_Destination_Unicast_08>>8 & 0xFF;
  buffer_ipv6[15] = @ServiceDiscovery_IPv6Packet_IP_Destination_Unicast_08    & 0xFF;
  EthPaket.ipv6.destination.SetData ( 0, buffer_ipv6, elcount(buffer_ipv6) );

  // IPv6 Packet - IPv6 Source address    // TODO: char array zu byte array
  buffer_ipv6[0]  = @ServiceDiscovery_IPv6Packet_IP_Source_ICAS1Sys02_01>>8 & 0xFF;
  buffer_ipv6[1]  = @ServiceDiscovery_IPv6Packet_IP_Source_ICAS1Sys02_01    & 0xFF;
  buffer_ipv6[2]  = @ServiceDiscovery_IPv6Packet_IP_Source_ICAS1Sys02_02>>8 & 0xFF;
  buffer_ipv6[3]  = @ServiceDiscovery_IPv6Packet_IP_Source_ICAS1Sys02_02    & 0xFF;
  buffer_ipv6[4]  = @ServiceDiscovery_IPv6Packet_IP_Source_ICAS1Sys02_03>>8 & 0xFF;
  buffer_ipv6[5]  = @ServiceDiscovery_IPv6Packet_IP_Source_ICAS1Sys02_03    & 0xFF;
  buffer_ipv6[6]  = @ServiceDiscovery_IPv6Packet_IP_Source_ICAS1Sys02_04>>8 & 0xFF;
  buffer_ipv6[7]  = @ServiceDiscovery_IPv6Packet_IP_Source_ICAS1Sys02_04    & 0xFF;
  buffer_ipv6[8]  = @ServiceDiscovery_IPv6Packet_IP_Source_ICAS1Sys02_05>>8 & 0xFF;
  buffer_ipv6[9]  = @ServiceDiscovery_IPv6Packet_IP_Source_ICAS1Sys02_05    & 0xFF;
  buffer_ipv6[10] = @ServiceDiscovery_IPv6Packet_IP_Source_ICAS1Sys02_06>>8 & 0xFF;
  buffer_ipv6[11] = @ServiceDiscovery_IPv6Packet_IP_Source_ICAS1Sys02_06    & 0xFF;
  buffer_ipv6[12] = @ServiceDiscovery_IPv6Packet_IP_Source_ICAS1Sys02_07>>8 & 0xFF;
  buffer_ipv6[13] = @ServiceDiscovery_IPv6Packet_IP_Source_ICAS1Sys02_07    & 0xFF;
  buffer_ipv6[14] = @ServiceDiscovery_IPv6Packet_IP_Source_ICAS1Sys02_08>>8 & 0xFF;
  buffer_ipv6[15] = @ServiceDiscovery_IPv6Packet_IP_Source_ICAS1Sys02_08    & 0xFF;
  EthPaket.ipv6.source.SetData ( 0, buffer_ipv6, elcount(buffer_ipv6) );

  
  // UDP Packet - Source Port
  EthPaket.udp.source = @UnitMaster_SetGet_Port_Source;
  
  // UDP Packet - Destination Port
  EthPaket.udp.destination = @UnitMaster_SetGet_Port_Destination;
  
  // UDP Packet - Length
  EthPaket.udp.length = @ServiceDiscovery_UDPPacket_Length;
  
  
  // SOME/IP Packet aus Rohdaten zusammenbauen (buffer array)
  i=0;
  
  // SOME/IP Packet - Message ID, Service ID [16 bit]
  buffer[i++] = @UnitMaster_SetGet_Message_ID_Service_ID>>8 & 0xFF;
  buffer[i++] = @UnitMaster_SetGet_Message_ID_Service_ID    & 0xFF;
  
  // SOME/IP Packet - Message ID, Message ID [16 bit]
  switch (MethodID)
  {
    case 0x4010: @UnitMaster_SetGet_Message_ID_Method_ID = @UnitMaster_SetGet_Message_ID_Method_ID_units_Get; break;
    case 0x4011: @UnitMaster_SetGet_Message_ID_Method_ID = @UnitMaster_SetGet_Message_ID_Method_ID_units_Set; break;
  }
  buffer[i++] = @UnitMaster_SetGet_Message_ID_Method_ID>>8 & 0xFF;
  buffer[i++] = @UnitMaster_SetGet_Message_ID_Method_ID    & 0xFF;
  
  // SOME/IP Packet - Length [32 bit]
  if (UDP_Segments_total == 1)
  {
    switch (MethodID)
    {
      case 0x4010: @UnitMaster_SetGet_Length = 8; break;
      case 0x4011: @UnitMaster_SetGet_Length = @UnitMaster_SetGet_Length_units; break;
    }
  }
  else
  {
    if (UDP_Segments_left > 1)
    {
      switch (MethodID)
      {
        case 0x4011: @UnitMaster_SetGet_Length = 1404; break;
      }
    }
    else
    {
      switch (MethodID)
      {
        case 0x4011: @UnitMaster_SetGet_Length = UnitMaster_payload_length_units - 1404*(UDP_Segments_total-UDP_Segments_left) + 24; break;
      }
    }
  }
  buffer[i++] = @UnitMaster_SetGet_Length>>24 & 0xFF;
  buffer[i++] = @UnitMaster_SetGet_Length>>16 & 0xFF;
  buffer[i++] = @UnitMaster_SetGet_Length>> 8 & 0xFF;
  buffer[i++] = @UnitMaster_SetGet_Length     & 0xFF;
  
  // SOME/IP Packet - Request ID, Client ID [16 bit]
  buffer[i++] = @UnitMaster_SetGet_Request_ID_Client_ID>>8 & 0xFF;
  buffer[i++] = @UnitMaster_SetGet_Request_ID_Client_ID    & 0xFF;
  
  // SOME/IP Packet - Request ID, Session ID) [16 bit]
  if ((UDP_Segments_total == 1) || (seg_id_flag == 1))
  {
    @ServiceDiscovery_SOMEIPPacket_Notification_Request_ID_Session_ID = @ServiceDiscovery_SOMEIPPacket_Notification_Request_ID_Session_ID + 1;
    if (@ServiceDiscovery_SOMEIPPacket_Notification_Request_ID_Session_ID == 0x10000) @ServiceDiscovery_SOMEIPPacket_Notification_Request_ID_Session_ID = 1;
    seg_id_flag = 0;
  }
  
  buffer[i++] = @ServiceDiscovery_SOMEIPPacket_Notification_Request_ID_Session_ID>>8 & 0xFF;
  buffer[i++] = @ServiceDiscovery_SOMEIPPacket_Notification_Request_ID_Session_ID    & 0xFF;
  
  // SOME/IP Packet - Protocol Version [8 bit]
  buffer[i++] = @UnitMaster_SetGet_Protocol_Version;
  
  // SOME/IP Packet - Interface Version [8 bit]
  buffer[i++] = @UnitMaster_SetGet_Interface_Version;
  
  // SOME/IP Packet - Message Type [8 bit]
  buffer[i++] = @UnitMaster_SetGet_Message_Type;
  
  // SOME/IP Packet - Return Code [8 bit]
  buffer[i++] = @UnitMaster_SetGet_Return_Code;
  
  
  if (UDP_Segments_total > 1)
  {
    if (UDP_Segments_left >= 0)
    { 
      // Message Type neu setzen
      buffer[i-2] = @UnitMaster_SetGet_Message_Type + 0x20;
      
      // Offset (16byte Schritte, 1392/16 = 87)
      @UnitMaster_SetGet_Offset = 87 * (UDP_Segments_total - UDP_Segments_left);
      
      // More Segments Flag
      if (UDP_Segments_left > 1) @UnitMaster_SetGet_More_Segments_Flag = 1;
      else                       @UnitMaster_SetGet_More_Segments_Flag = 0;
      
      buffer[i++] =   @UnitMaster_SetGet_Offset>>20 & 0xFF;
      buffer[i++] =   @UnitMaster_SetGet_Offset>>12 & 0xFF;
      buffer[i++] =   @UnitMaster_SetGet_Offset>>4  & 0xFF;
      buffer[i++] = ((@UnitMaster_SetGet_Offset<<4) & 0xF0) + (@UnitMaster_SetGet_More_Segments_Flag & 0x01);
    }
  }
  
  UDP_Segments_left--;
  
  ////// units setter //////
  if (MethodID == 0x4011)
  {
    if (UDP_Segments_total == 1)
    {
      for (j=0; j<UnitMaster_payload_length_units; j++)
        buffer[i++] = UnitMaster_payload_buffer_units[j];
    }
    else
    {
      if (UDP_Segments_left >= 1)
      {
        for (j=(UDP_Segments_total-UDP_Segments_left-1)*1392; j<(UDP_Segments_total-UDP_Segments_left)*1392; j++)
          buffer[i++] = UnitMaster_payload_buffer_units[j];
      }
      else
      {
        for (j=(UDP_Segments_total-(UDP_Segments_left+1))*1392; j<UnitMaster_payload_length_units; j++)
          buffer[i++] = UnitMaster_payload_buffer_units[j];
      }
    }
  }
    
  // Rohdaten in UDP Paket schreiben
  EthPaket.udp.SetData( 0, buffer, i );

  // calculate UDP and IPv6 checksum and send Ethernet packet
  EthPaket.CompletePacket();
  output( EthPaket );
  
  // prüfen ob alle Segemente gesendet wurden, sonst senden erneut aufrufen
  UnitMaster_Segmentation_Method_ID = MethodID;
  if (UDP_Segments_left>0)
    settimer(UnitMaster_Segmentation_delay, 50);
}

on timer UnitMaster_Segmentation_delay
{
  Send_Service_UnitMaster_SetGet (UnitMaster_Segmentation_Method_ID);
}






////////// units Setter //////////

on envVar UnitMaster_SetGet_LengthIndicator_Struct_units
{
  UnitMaster_SetGet_units();
}
on envVar UnitMaster_SetGet_LengthIndicator_Element_units
{
  UnitMaster_SetGet_units();
}
on envVar UnitMaster_SetGet_units_id
{
  getvalue(this, buffer_uuid);
  for (k=0;k<16;k++)
    UnitMaster_array_units_id[@UnitMaster_SetGet_units_Element][k] = buffer_uuid[k];
  UnitMaster_SetGet_units();
}
on envVar UnitMaster_SetGet_units_name
{
  for (k=0; k<100; k++)
    UnitMaster_array_units_name[@UnitMaster_SetGet_units_Element][k] = 0x00;
  
  getvalue (this, buffer_char);
  for (k=0; k<getvaluesize(UnitMaster_SetGet_units_name)-1; k++)
    UnitMaster_array_units_name[@UnitMaster_SetGet_units_Element][k] = buffer_char[k];
    
  UnitMaster_SetGet_units();
}
on envVar UnitMaster_SetGet_units_dateFormat
{
  UnitMaster_array_units_dateFormat[@UnitMaster_SetGet_units_Element] = @this;
  UnitMaster_SetGet_units();
}
on envVar UnitMaster_SetGet_units_dateFormatConfiguration
{
  UnitMaster_array_units_dateFormatConfiguration[@UnitMaster_SetGet_units_Element][@UnitMaster_SetGet_units_dateFormatConfiguration_Element] = @this;
  UnitMaster_SetGet_units();
}
on envVar UnitMaster_SetGet_units_distanceUnit
{
  UnitMaster_array_units_distanceUnit[@UnitMaster_SetGet_units_Element] = @this;
  UnitMaster_SetGet_units();
}
on envVar UnitMaster_SetGet_units_distanceUnitConfiguration
{
  UnitMaster_array_units_distanceUnitConfiguration[@UnitMaster_SetGet_units_Element][@UnitMaster_SetGet_units_distanceUnitConfiguration_Element] = @this;
  UnitMaster_SetGet_units();
}
on envVar UnitMaster_SetGet_units_pressureUnit
{
  UnitMaster_array_units_pressureUnit[@UnitMaster_SetGet_units_Element] = @this;
  UnitMaster_SetGet_units();
}
on envVar UnitMaster_SetGet_units_pressureUnitConfiguration
{
  UnitMaster_array_units_pressureUnitConfiguration[@UnitMaster_SetGet_units_Element][@UnitMaster_SetGet_units_pressureUnitConfiguration_Element] = @this;
  UnitMaster_SetGet_units();
}
on envVar UnitMaster_SetGet_units_restrictionReason
{
  UnitMaster_array_units_restrictionReason[@UnitMaster_SetGet_units_Element] = @this;
  UnitMaster_SetGet_units();
}
on envVar UnitMaster_SetGet_units_speedUnitTachometer
{
  UnitMaster_array_units_speedUnitTachometer[@UnitMaster_SetGet_units_Element] = @this;
  UnitMaster_SetGet_units();
}
on envVar UnitMaster_SetGet_units_speedUnit
{
  UnitMaster_array_units_speedUnit[@UnitMaster_SetGet_units_Element] = @this;
  UnitMaster_SetGet_units();
}
on envVar UnitMaster_SetGet_units_speedUnitConfiguration
{
  UnitMaster_array_units_speedUnitConfiguration[@UnitMaster_SetGet_units_Element][@UnitMaster_SetGet_units_speedUnitConfiguration_Element] = @this;
  UnitMaster_SetGet_units();
}
on envVar UnitMaster_SetGet_units_temperatureUnit
{
  UnitMaster_array_units_temperatureUnit[@UnitMaster_SetGet_units_Element] = @this;
  UnitMaster_SetGet_units();
}
on envVar UnitMaster_SetGet_units_temperatureUnitConfiguration
{
  UnitMaster_array_units_temperatureUnitConfiguration[@UnitMaster_SetGet_units_Element][@UnitMaster_SetGet_units_temperatureUnitConfiguration_Element] = @this;
  UnitMaster_SetGet_units();
}
on envVar UnitMaster_SetGet_units_timeFormat
{
  UnitMaster_array_units_timeFormat[@UnitMaster_SetGet_units_Element] = @this;
  UnitMaster_SetGet_units();
}
on envVar UnitMaster_SetGet_units_timeFormatConfiguration
{
  UnitMaster_array_units_timeFormatConfiguration[@UnitMaster_SetGet_units_Element][@UnitMaster_SetGet_units_timeFormatConfiguration_Element] = @this;
  UnitMaster_SetGet_units();
}
on envVar UnitMaster_SetGet_units_volumeUnit
{
  UnitMaster_array_units_volumeUnit[@UnitMaster_SetGet_units_Element] = @this;
  UnitMaster_SetGet_units();
}
on envVar UnitMaster_SetGet_units_volumeUnitConfiguration
{
  UnitMaster_array_units_volumeUnitConfiguration[@UnitMaster_SetGet_units_Element][@UnitMaster_SetGet_units_volumeUnitConfiguration_Element] = @this;
  UnitMaster_SetGet_units();
}
on envVar UnitMaster_SetGet_units_consumptionUnit
{
  UnitMaster_array_units_consumptionUnit[@UnitMaster_SetGet_units_Element] = @this;
  UnitMaster_SetGet_units();
}
on envVar UnitMaster_SetGet_units_consumptionUnitConfiguration
{
  UnitMaster_array_units_consumptionUnitConfiguration[@UnitMaster_SetGet_units_Element][@UnitMaster_SetGet_units_consumptionUnitConfiguration_Element] = @this;
  UnitMaster_SetGet_units();
}
on envVar UnitMaster_SetGet_units_consumptionUnitElectr
{
  UnitMaster_array_units_consumptionUnitElectr[@UnitMaster_SetGet_units_Element] = @this;
  UnitMaster_SetGet_units();
}
on envVar UnitMaster_SetGet_units_consumptionUnitElectrConfiguration
{
  UnitMaster_array_units_consumptionUnitElectrConfiguration[@UnitMaster_SetGet_units_Element][@UnitMaster_SetGet_units_consumptionUnitElectrConfiguration_Element] = @this;
  UnitMaster_SetGet_units();
}
on envVar UnitMaster_SetGet_units_consumptionUnitGas
{
  UnitMaster_array_units_consumptionUnitGas[@UnitMaster_SetGet_units_Element] = @this;
  UnitMaster_SetGet_units();
}
on envVar UnitMaster_SetGet_units_consumptionUnitGasConfiguration
{
  UnitMaster_array_units_consumptionUnitGasConfiguration[@UnitMaster_SetGet_units_Element][@UnitMaster_SetGet_units_consumptionUnitGasConfiguration_Element] = @this;
  UnitMaster_SetGet_units();
}
on envVar UnitMaster_SetGet_units_massUnit
{
  UnitMaster_array_units_massUnit[@UnitMaster_SetGet_units_Element] = @this;
  UnitMaster_SetGet_units();
}
on envVar UnitMaster_SetGet_units_massUnitConfiguration
{
  UnitMaster_array_units_massUnitConfiguration[@UnitMaster_SetGet_units_Element][@UnitMaster_SetGet_units_massUnitConfiguration_Element] = @this;
  UnitMaster_SetGet_units();
}
on envVar UnitMaster_SetGet_units_id_available
{
  UnitMaster_array_units_id_available[@UnitMaster_SetGet_units_Element] = @this;
  UnitMaster_SetGet_units();
}
on envVar UnitMaster_SetGet_units_name_available
{
  UnitMaster_array_units_name_available[@UnitMaster_SetGet_units_Element] = @this;
  UnitMaster_SetGet_units();
}
on envVar UnitMaster_SetGet_units_dateFormat_available
{
  UnitMaster_array_units_dateFormat_available[@UnitMaster_SetGet_units_Element] = @this;
  UnitMaster_SetGet_units();
}
on envVar UnitMaster_SetGet_units_dateFormatConfiguration_available
{
  UnitMaster_array_units_dateFormatConfiguration_available[@UnitMaster_SetGet_units_Element] = @this;
  UnitMaster_SetGet_units();
}
on envVar UnitMaster_SetGet_units_distanceUnit_available
{
  UnitMaster_array_units_distanceUnit_available[@UnitMaster_SetGet_units_Element] = @this;
  UnitMaster_SetGet_units();
}
on envVar UnitMaster_SetGet_units_distanceUnitConfiguration_available
{
  UnitMaster_array_units_distanceUnitConfiguration_available[@UnitMaster_SetGet_units_Element] = @this;
  UnitMaster_SetGet_units();
}
on envVar UnitMaster_SetGet_units_pressureUnit_available
{
  UnitMaster_array_units_pressureUnit_available[@UnitMaster_SetGet_units_Element] = @this;
  UnitMaster_SetGet_units();
}
on envVar UnitMaster_SetGet_units_pressureUnitConfiguration_available
{
  UnitMaster_array_units_pressureUnitConfiguration_available[@UnitMaster_SetGet_units_Element] = @this;
  UnitMaster_SetGet_units();
}
on envVar UnitMaster_SetGet_units_restrictionReason_available
{
  UnitMaster_array_units_restrictionReason_available[@UnitMaster_SetGet_units_Element] = @this;
  UnitMaster_SetGet_units();
}
on envVar UnitMaster_SetGet_units_speedUnitTachometer_available
{
  UnitMaster_array_units_speedUnitTachometer_available[@UnitMaster_SetGet_units_Element] = @this;
  UnitMaster_SetGet_units();
}
on envVar UnitMaster_SetGet_units_speedUnit_available
{
  UnitMaster_array_units_speedUnit_available[@UnitMaster_SetGet_units_Element] = @this;
  UnitMaster_SetGet_units();
}
on envVar UnitMaster_SetGet_units_speedUnitConfiguration_available
{
  UnitMaster_array_units_speedUnitConfiguration_available[@UnitMaster_SetGet_units_Element] = @this;
  UnitMaster_SetGet_units();
}
on envVar UnitMaster_SetGet_units_temperatureUnit_available
{
  UnitMaster_array_units_temperatureUnit_available[@UnitMaster_SetGet_units_Element] = @this;
  UnitMaster_SetGet_units();
}
on envVar UnitMaster_SetGet_units_temperatureUnitConfiguration_available
{
  UnitMaster_array_units_temperatureUnitConfiguration_available[@UnitMaster_SetGet_units_Element] = @this;
  UnitMaster_SetGet_units();
}
on envVar UnitMaster_SetGet_units_timeFormat_available
{
  UnitMaster_array_units_timeFormat_available[@UnitMaster_SetGet_units_Element] = @this;
  UnitMaster_SetGet_units();
}
on envVar UnitMaster_SetGet_units_timeFormatConfiguration_available
{
  UnitMaster_array_units_timeFormatConfiguration_available[@UnitMaster_SetGet_units_Element] = @this;
  UnitMaster_SetGet_units();
}
on envVar UnitMaster_SetGet_units_volumeUnit_available
{
  UnitMaster_array_units_volumeUnit_available[@UnitMaster_SetGet_units_Element] = @this;
  UnitMaster_SetGet_units();
}
on envVar UnitMaster_SetGet_units_volumeUnitConfiguration_available
{
  UnitMaster_array_units_volumeUnitConfiguration_available[@UnitMaster_SetGet_units_Element] = @this;
  UnitMaster_SetGet_units();
}
on envVar UnitMaster_SetGet_units_consumptionUnit_available
{
  UnitMaster_array_units_consumptionUnit_available[@UnitMaster_SetGet_units_Element] = @this;
  UnitMaster_SetGet_units();
}
on envVar UnitMaster_SetGet_units_consumptionUnitConfiguration_available
{
  UnitMaster_array_units_consumptionUnitConfiguration_available[@UnitMaster_SetGet_units_Element] = @this;
  UnitMaster_SetGet_units();
}
on envVar UnitMaster_SetGet_units_consumptionUnitElectr_available
{
  UnitMaster_array_units_consumptionUnitElectr_available[@UnitMaster_SetGet_units_Element] = @this;
  UnitMaster_SetGet_units();
}
on envVar UnitMaster_SetGet_units_consumptionUnitElectrConfiguration_available
{
  UnitMaster_array_units_consumptionUnitElectrConfiguration_available[@UnitMaster_SetGet_units_Element] = @this;
  UnitMaster_SetGet_units();
}
on envVar UnitMaster_SetGet_units_consumptionUnitGas_available
{
  UnitMaster_array_units_consumptionUnitGas_available[@UnitMaster_SetGet_units_Element] = @this;
  UnitMaster_SetGet_units();
}
on envVar UnitMaster_SetGet_units_consumptionUnitGasConfiguration_available
{
  UnitMaster_array_units_consumptionUnitGasConfiguration_available[@UnitMaster_SetGet_units_Element] = @this;
  UnitMaster_SetGet_units();
}
on envVar UnitMaster_SetGet_units_massUnit_available
{
  UnitMaster_array_units_massUnit_available[@UnitMaster_SetGet_units_Element] = @this;
  UnitMaster_SetGet_units();
}
on envVar UnitMaster_SetGet_units_massUnitConfiguration_available
{
  UnitMaster_array_units_massUnitConfiguration_available[@UnitMaster_SetGet_units_Element] = @this;
  UnitMaster_SetGet_units();
}
on envVar UnitMaster_SetGet_units_Payload
{
  UnitMaster_SetGet_units_update();
}


UnitMaster_SetGet_units()
{
  word payload_counter = 0;
  word start_pos       = 0;
  word element_length  = 0;
  
  // Length Indicator Struct - Platzhalter
  payload_counter = 0+4;
  start_pos = 0;
  
  for (j=0; j<@UnitMaster_SetGet_units_Element_TotalNum; j++)
  {
    UnitMaster_array_units_available_functions[j] = UnitMaster_array_units_id_available[j]
                                                  + UnitMaster_array_units_name_available[j]
                                                  + UnitMaster_array_units_dateFormat_available[j]
                                                  + UnitMaster_array_units_dateFormatConfiguration_available[j]
                                                  + UnitMaster_array_units_distanceUnit_available[j]
                                                  + UnitMaster_array_units_distanceUnitConfiguration_available[j]
                                                  + UnitMaster_array_units_pressureUnit_available[j]
                                                  + UnitMaster_array_units_pressureUnitConfiguration_available[j]
                                                  + UnitMaster_array_units_restrictionReason_available[j]
                                                  + UnitMaster_array_units_speedUnitTachometer_available[j]
                                                  + UnitMaster_array_units_speedUnit_available[j]
                                                  + UnitMaster_array_units_speedUnitConfiguration_available[j]
                                                  + UnitMaster_array_units_temperatureUnit_available[j]
                                                  + UnitMaster_array_units_temperatureUnitConfiguration_available[j]
                                                  + UnitMaster_array_units_timeFormat_available[j]
                                                  + UnitMaster_array_units_timeFormatConfiguration_available[j]
                                                  + UnitMaster_array_units_volumeUnit_available[j]
                                                  + UnitMaster_array_units_volumeUnitConfiguration_available[j]
                                                  + UnitMaster_array_units_consumptionUnit_available[j]
                                                  + UnitMaster_array_units_consumptionUnitConfiguration_available[j]
                                                  + UnitMaster_array_units_consumptionUnitElectr_available[j]
                                                  + UnitMaster_array_units_consumptionUnitElectrConfiguration_available[j]
                                                  + UnitMaster_array_units_consumptionUnitGas_available[j]
                                                  + UnitMaster_array_units_consumptionUnitGasConfiguration_available[j]
                                                  + UnitMaster_array_units_massUnit_available[j]
                                                  + UnitMaster_array_units_massUnitConfiguration_available[j];
    
    // Length Indicator Element - Platzhalter
    if (UnitMaster_array_units_available_functions[j] > 0)
    {
      start_pos = payload_counter;
      payload_counter = payload_counter + 4;
    }
    else 
      start_pos = payload_counter;
    
    
    // 0 id (uuid 16byte)
    if (UnitMaster_array_units_id_available[j] == 1)
    {
      tag_dataID = 0;
      UnitMaster_payload_buffer_units[payload_counter++] = 5 * 16 /* Wiretype = 5 =^ Array mit 1 Byte Länge */ + ((tag_dataID>>8) & 0x0F) /* DataID High Part */ ;
      UnitMaster_payload_buffer_units[payload_counter++] = tag_dataID & 0xFF /* DataID Low Part */ ;
      
      UnitMaster_payload_buffer_units[payload_counter++] = 16; // Array Length
      
      for (k=0; k<16; k++)
        UnitMaster_payload_buffer_units[payload_counter++] = UnitMaster_array_units_id[j][k] & 0xFF;
    }
    
    
    // 1 name (string)
    if (UnitMaster_array_units_name_available[j] == 1)
    {
      tag_dataID = 1;
      UnitMaster_payload_buffer_units[payload_counter++] = 5 * 16 /* Wiretype = 5 =^ Array mit 1 Byte Länge */ + ((tag_dataID>>8) & 0x0F) /* DataID High Part */ ;
      UnitMaster_payload_buffer_units[payload_counter++] = tag_dataID & 0xFF /* DataID Low Part */ ;
      
      UnitMaster_payload_buffer_units[payload_counter++] = strlen(UnitMaster_array_units_name[j]);  
      
      if (strlen(UnitMaster_array_units_name[j]) > 1)
      {
        for (k=0; k<strlen(UnitMaster_array_units_name[j]); k++)
          UnitMaster_payload_buffer_units[payload_counter++] = UnitMaster_array_units_name[j][k];
      }
    }
    
    
    // 2 dateFormat (enum32)
    if (UnitMaster_array_units_dateFormat_available[j] == 1)
    {
      tag_dataID = 2;
      UnitMaster_payload_buffer_units[payload_counter++] = 2 * 16 /* Wiretype = 2 =^ 32 Bit */ + ((tag_dataID>>8) & 0x0F) /* DataID High Part */ ;
      UnitMaster_payload_buffer_units[payload_counter++] = tag_dataID & 0xFF /* DataID Low Part */ ;
      
      UnitMaster_payload_buffer_units[payload_counter++] = UnitMaster_array_units_dateFormat[j]>>24 & 0xFF;
      UnitMaster_payload_buffer_units[payload_counter++] = UnitMaster_array_units_dateFormat[j]>>16 & 0xFF;
      UnitMaster_payload_buffer_units[payload_counter++] = UnitMaster_array_units_dateFormat[j]>> 8 & 0xFF;
      UnitMaster_payload_buffer_units[payload_counter++] = UnitMaster_array_units_dateFormat[j]     & 0xFF;
    }
    
    
    // 3 dateFormatConfiguration (enum32 array)
    if (UnitMaster_array_units_dateFormatConfiguration_available[j] == 1)
    {
      tag_dataID = 3;
      UnitMaster_payload_buffer_units[payload_counter++] = 5 * 16 /* Wiretype = 5 =^ Array mit 1 Byte Länge */ + ((tag_dataID>>8) & 0x0F) /* DataID High Part */ ;
      UnitMaster_payload_buffer_units[payload_counter++] = tag_dataID & 0xFF /* DataID Low Part */ ;
      
      // Array Length
      UnitMaster_array_units_dateFormatConfiguration_length = 4 * UnitMaster_array_units_dateFormatConfiguration_nr_of_elements[j];
      UnitMaster_payload_buffer_units[payload_counter++] = UnitMaster_array_units_dateFormatConfiguration_length     & 0xFF;
      
      if (UnitMaster_array_units_dateFormatConfiguration_length>0)
      {
        for (k=0; k<UnitMaster_array_units_dateFormatConfiguration_nr_of_elements[j]; k++)
        {
          UnitMaster_payload_buffer_units[payload_counter++] = UnitMaster_array_units_dateFormatConfiguration[j][k]>>24 & 0xFF;
          UnitMaster_payload_buffer_units[payload_counter++] = UnitMaster_array_units_dateFormatConfiguration[j][k]>>16 & 0xFF;
          UnitMaster_payload_buffer_units[payload_counter++] = UnitMaster_array_units_dateFormatConfiguration[j][k]>> 8 & 0xFF;
          UnitMaster_payload_buffer_units[payload_counter++] = UnitMaster_array_units_dateFormatConfiguration[j][k]     & 0xFF;
        }
      }
    }
    
    
    // 4 distanceUnit (enum32)
    if (UnitMaster_array_units_distanceUnit_available[j] == 1)
    {
      tag_dataID = 4;
      UnitMaster_payload_buffer_units[payload_counter++] = 2 * 16 /* Wiretype = 2 =^ 32 Bit */ + ((tag_dataID>>8) & 0x0F) /* DataID High Part */ ;
      UnitMaster_payload_buffer_units[payload_counter++] = tag_dataID & 0xFF /* DataID Low Part */ ;
      
      UnitMaster_payload_buffer_units[payload_counter++] = UnitMaster_array_units_distanceUnit[j]>>24 & 0xFF;
      UnitMaster_payload_buffer_units[payload_counter++] = UnitMaster_array_units_distanceUnit[j]>>16 & 0xFF;
      UnitMaster_payload_buffer_units[payload_counter++] = UnitMaster_array_units_distanceUnit[j]>> 8 & 0xFF;
      UnitMaster_payload_buffer_units[payload_counter++] = UnitMaster_array_units_distanceUnit[j]     & 0xFF;
    }
    
    
    // 5 distanceUnitConfiguration (enum32 array)
    if (UnitMaster_array_units_distanceUnitConfiguration_available[j] == 1)
    {
      tag_dataID = 5;
      UnitMaster_payload_buffer_units[payload_counter++] = 5 * 16 /* Wiretype = 5 =^ Array mit 1 Byte Länge */ + ((tag_dataID>>8) & 0x0F) /* DataID High Part */ ;
      UnitMaster_payload_buffer_units[payload_counter++] = tag_dataID & 0xFF /* DataID Low Part */ ;
      
      // Array Length
      UnitMaster_array_units_distanceUnitConfiguration_length = 4 * UnitMaster_array_units_distanceUnitConfiguration_nr_of_elements[j];
      UnitMaster_payload_buffer_units[payload_counter++] = UnitMaster_array_units_distanceUnitConfiguration_length     & 0xFF;
      
      if (UnitMaster_array_units_distanceUnitConfiguration_length>0)
      {
        for (k=0; k<UnitMaster_array_units_distanceUnitConfiguration_nr_of_elements[j]; k++)
        {
          UnitMaster_payload_buffer_units[payload_counter++] = UnitMaster_array_units_distanceUnitConfiguration[j][k]>>24 & 0xFF;
          UnitMaster_payload_buffer_units[payload_counter++] = UnitMaster_array_units_distanceUnitConfiguration[j][k]>>16 & 0xFF;
          UnitMaster_payload_buffer_units[payload_counter++] = UnitMaster_array_units_distanceUnitConfiguration[j][k]>> 8 & 0xFF;
          UnitMaster_payload_buffer_units[payload_counter++] = UnitMaster_array_units_distanceUnitConfiguration[j][k]     & 0xFF;
        }
      }
    }
    
    
    // 6 pressureUnit (enum32)
    if (UnitMaster_array_units_pressureUnit_available[j] == 1)
    {
      tag_dataID = 6;
      UnitMaster_payload_buffer_units[payload_counter++] = 2 * 16 /* Wiretype = 2 =^ 32 Bit */ + ((tag_dataID>>8) & 0x0F) /* DataID High Part */ ;
      UnitMaster_payload_buffer_units[payload_counter++] = tag_dataID & 0xFF /* DataID Low Part */ ;
      
      UnitMaster_payload_buffer_units[payload_counter++] = UnitMaster_array_units_pressureUnit[j]>>24 & 0xFF;
      UnitMaster_payload_buffer_units[payload_counter++] = UnitMaster_array_units_pressureUnit[j]>>16 & 0xFF;
      UnitMaster_payload_buffer_units[payload_counter++] = UnitMaster_array_units_pressureUnit[j]>> 8 & 0xFF;
      UnitMaster_payload_buffer_units[payload_counter++] = UnitMaster_array_units_pressureUnit[j]     & 0xFF;
    }
    
    
    // 7 pressureUnitConfiguration (enum32 array)
    if (UnitMaster_array_units_pressureUnitConfiguration_available[j] == 1)
    {
      tag_dataID = 7;
      UnitMaster_payload_buffer_units[payload_counter++] = 5 * 16 /* Wiretype = 5 =^ Array mit 1 Byte Länge */ + ((tag_dataID>>8) & 0x0F) /* DataID High Part */ ;
      UnitMaster_payload_buffer_units[payload_counter++] = tag_dataID & 0xFF /* DataID Low Part */ ;
      
      // Array Length
      UnitMaster_array_units_pressureUnitConfiguration_length = 4 * UnitMaster_array_units_pressureUnitConfiguration_nr_of_elements[j];
      UnitMaster_payload_buffer_units[payload_counter++] = UnitMaster_array_units_pressureUnitConfiguration_length     & 0xFF;
      
      if (UnitMaster_array_units_pressureUnitConfiguration_length>0)
      {
        for (k=0; k<UnitMaster_array_units_pressureUnitConfiguration_nr_of_elements[j]; k++)
        {
          UnitMaster_payload_buffer_units[payload_counter++] = UnitMaster_array_units_pressureUnitConfiguration[j][k]>>24 & 0xFF;
          UnitMaster_payload_buffer_units[payload_counter++] = UnitMaster_array_units_pressureUnitConfiguration[j][k]>>16 & 0xFF;
          UnitMaster_payload_buffer_units[payload_counter++] = UnitMaster_array_units_pressureUnitConfiguration[j][k]>> 8 & 0xFF;
          UnitMaster_payload_buffer_units[payload_counter++] = UnitMaster_array_units_pressureUnitConfiguration[j][k]     & 0xFF;
        }
      }
    }
    
    
    // 8 restrictionReason (enum32)
    if (UnitMaster_array_units_restrictionReason_available[j] == 1)
    {
      tag_dataID = 8;
      UnitMaster_payload_buffer_units[payload_counter++] = 2 * 16 /* Wiretype = 2 =^ 32 Bit */ + ((tag_dataID>>8) & 0x0F) /* DataID High Part */ ;
      UnitMaster_payload_buffer_units[payload_counter++] = tag_dataID & 0xFF /* DataID Low Part */ ;
      
      UnitMaster_payload_buffer_units[payload_counter++] = UnitMaster_array_units_restrictionReason[j]>>24 & 0xFF;
      UnitMaster_payload_buffer_units[payload_counter++] = UnitMaster_array_units_restrictionReason[j]>>16 & 0xFF;
      UnitMaster_payload_buffer_units[payload_counter++] = UnitMaster_array_units_restrictionReason[j]>> 8 & 0xFF;
      UnitMaster_payload_buffer_units[payload_counter++] = UnitMaster_array_units_restrictionReason[j]     & 0xFF;
    }
    
    
    // 9 speedUnitTachometer (enum32)
    if (UnitMaster_array_units_speedUnitTachometer_available[j] == 1)
    {
      tag_dataID = 9;
      UnitMaster_payload_buffer_units[payload_counter++] = 2 * 16 /* Wiretype = 2 =^ 32 Bit */ + ((tag_dataID>>8) & 0x0F) /* DataID High Part */ ;
      UnitMaster_payload_buffer_units[payload_counter++] = tag_dataID & 0xFF /* DataID Low Part */ ;
      
      UnitMaster_payload_buffer_units[payload_counter++] = UnitMaster_array_units_speedUnitTachometer[j]>>24 & 0xFF;
      UnitMaster_payload_buffer_units[payload_counter++] = UnitMaster_array_units_speedUnitTachometer[j]>>16 & 0xFF;
      UnitMaster_payload_buffer_units[payload_counter++] = UnitMaster_array_units_speedUnitTachometer[j]>> 8 & 0xFF;
      UnitMaster_payload_buffer_units[payload_counter++] = UnitMaster_array_units_speedUnitTachometer[j]     & 0xFF;
    }
    
    
    // 10 speedUnit (enum32)
    if (UnitMaster_array_units_speedUnit_available[j] == 1)
    {
      tag_dataID = 10;
      UnitMaster_payload_buffer_units[payload_counter++] = 2 * 16 /* Wiretype = 2 =^ 32 Bit */ + ((tag_dataID>>8) & 0x0F) /* DataID High Part */ ;
      UnitMaster_payload_buffer_units[payload_counter++] = tag_dataID & 0xFF /* DataID Low Part */ ;
      
      UnitMaster_payload_buffer_units[payload_counter++] = UnitMaster_array_units_speedUnit[j]>>24 & 0xFF;
      UnitMaster_payload_buffer_units[payload_counter++] = UnitMaster_array_units_speedUnit[j]>>16 & 0xFF;
      UnitMaster_payload_buffer_units[payload_counter++] = UnitMaster_array_units_speedUnit[j]>> 8 & 0xFF;
      UnitMaster_payload_buffer_units[payload_counter++] = UnitMaster_array_units_speedUnit[j]     & 0xFF;
    }
    
    // 11 speedUnitConfiguration (enum32 array)
    if (UnitMaster_array_units_speedUnitConfiguration_available[j] == 1)
    {
      tag_dataID = 11;
      UnitMaster_payload_buffer_units[payload_counter++] = 5 * 16 /* Wiretype = 5 =^ Array mit 1 Byte Länge */ + ((tag_dataID>>8) & 0x0F) /* DataID High Part */ ;
      UnitMaster_payload_buffer_units[payload_counter++] = tag_dataID & 0xFF /* DataID Low Part */ ;
      
      // Array Length
      UnitMaster_array_units_speedUnitConfiguration_length = 4 * UnitMaster_array_units_speedUnitConfiguration_nr_of_elements[j];
      UnitMaster_payload_buffer_units[payload_counter++] = UnitMaster_array_units_speedUnitConfiguration_length     & 0xFF;
      
      if (UnitMaster_array_units_speedUnitConfiguration_length>0)
      {
        for (k=0; k<UnitMaster_array_units_speedUnitConfiguration_nr_of_elements[j]; k++)
        {
          UnitMaster_payload_buffer_units[payload_counter++] = UnitMaster_array_units_speedUnitConfiguration[j][k]>>24 & 0xFF;
          UnitMaster_payload_buffer_units[payload_counter++] = UnitMaster_array_units_speedUnitConfiguration[j][k]>>16 & 0xFF;
          UnitMaster_payload_buffer_units[payload_counter++] = UnitMaster_array_units_speedUnitConfiguration[j][k]>> 8 & 0xFF;
          UnitMaster_payload_buffer_units[payload_counter++] = UnitMaster_array_units_speedUnitConfiguration[j][k]     & 0xFF;
        }
      }
    }
    
    // 12 temperatureUnit (enum32)
    if (UnitMaster_array_units_temperatureUnit_available[j] == 1)
    {
      tag_dataID = 12;
      UnitMaster_payload_buffer_units[payload_counter++] = 2 * 16 /* Wiretype = 2 =^ 32 Bit */ + ((tag_dataID>>8) & 0x0F) /* DataID High Part */ ;
      UnitMaster_payload_buffer_units[payload_counter++] = tag_dataID & 0xFF /* DataID Low Part */ ;
      
      UnitMaster_payload_buffer_units[payload_counter++] = UnitMaster_array_units_temperatureUnit[j]>>24 & 0xFF;
      UnitMaster_payload_buffer_units[payload_counter++] = UnitMaster_array_units_temperatureUnit[j]>>16 & 0xFF;
      UnitMaster_payload_buffer_units[payload_counter++] = UnitMaster_array_units_temperatureUnit[j]>> 8 & 0xFF;
      UnitMaster_payload_buffer_units[payload_counter++] = UnitMaster_array_units_temperatureUnit[j]     & 0xFF;
    }
    
    
    // 13 temperatureUnitConfiguration (enum32 array)
    if (UnitMaster_array_units_temperatureUnitConfiguration_available[j] == 1)
    {
      tag_dataID = 13;
      UnitMaster_payload_buffer_units[payload_counter++] = 5 * 16 /* Wiretype = 5 =^ Array mit 1 Byte Länge */ + ((tag_dataID>>8) & 0x0F) /* DataID High Part */ ;
      UnitMaster_payload_buffer_units[payload_counter++] = tag_dataID & 0xFF /* DataID Low Part */ ;
      
      // Array Length
      UnitMaster_array_units_temperatureUnitConfiguration_length = 4 * UnitMaster_array_units_temperatureUnitConfiguration_nr_of_elements[j];
      UnitMaster_payload_buffer_units[payload_counter++] = UnitMaster_array_units_temperatureUnitConfiguration_length     & 0xFF;
      
      if (UnitMaster_array_units_temperatureUnitConfiguration_length>0)
      {
        for (k=0; k<UnitMaster_array_units_temperatureUnitConfiguration_nr_of_elements[j]; k++)
        {
          UnitMaster_payload_buffer_units[payload_counter++] = UnitMaster_array_units_temperatureUnitConfiguration[j][k]>>24 & 0xFF;
          UnitMaster_payload_buffer_units[payload_counter++] = UnitMaster_array_units_temperatureUnitConfiguration[j][k]>>16 & 0xFF;
          UnitMaster_payload_buffer_units[payload_counter++] = UnitMaster_array_units_temperatureUnitConfiguration[j][k]>> 8 & 0xFF;
          UnitMaster_payload_buffer_units[payload_counter++] = UnitMaster_array_units_temperatureUnitConfiguration[j][k]     & 0xFF;
        }
      }
    }
    
    // 14 timeFormat (enum32)
    if (UnitMaster_array_units_timeFormat_available[j] == 1)
    {
      tag_dataID = 14;
      UnitMaster_payload_buffer_units[payload_counter++] = 2 * 16 /* Wiretype = 2 =^ 32 Bit */ + ((tag_dataID>>8) & 0x0F) /* DataID High Part */ ;
      UnitMaster_payload_buffer_units[payload_counter++] = tag_dataID & 0xFF /* DataID Low Part */ ;
      
      UnitMaster_payload_buffer_units[payload_counter++] = UnitMaster_array_units_timeFormat[j]>>24 & 0xFF;
      UnitMaster_payload_buffer_units[payload_counter++] = UnitMaster_array_units_timeFormat[j]>>16 & 0xFF;
      UnitMaster_payload_buffer_units[payload_counter++] = UnitMaster_array_units_timeFormat[j]>> 8 & 0xFF;
      UnitMaster_payload_buffer_units[payload_counter++] = UnitMaster_array_units_timeFormat[j]     & 0xFF;
    }
    
    
    // 15 timeFormatConfiguration (enum32 array)
    if (UnitMaster_array_units_timeFormatConfiguration_available[j] == 1)
    {
      tag_dataID = 15;
      UnitMaster_payload_buffer_units[payload_counter++] = 5 * 16 /* Wiretype = 5 =^ Array mit 1 Byte Länge */ + ((tag_dataID>>8) & 0x0F) /* DataID High Part */ ;
      UnitMaster_payload_buffer_units[payload_counter++] = tag_dataID & 0xFF /* DataID Low Part */ ;
      
      // Array Length
      UnitMaster_array_units_timeFormatConfiguration_length = 4 * UnitMaster_array_units_timeFormatConfiguration_nr_of_elements[j];
      UnitMaster_payload_buffer_units[payload_counter++] = UnitMaster_array_units_timeFormatConfiguration_length     & 0xFF;
      
      if (UnitMaster_array_units_timeFormatConfiguration_length>0)
      {
        for (k=0; k<UnitMaster_array_units_timeFormatConfiguration_nr_of_elements[j]; k++)
        {
          UnitMaster_payload_buffer_units[payload_counter++] = UnitMaster_array_units_timeFormatConfiguration[j][k]>>24 & 0xFF;
          UnitMaster_payload_buffer_units[payload_counter++] = UnitMaster_array_units_timeFormatConfiguration[j][k]>>16 & 0xFF;
          UnitMaster_payload_buffer_units[payload_counter++] = UnitMaster_array_units_timeFormatConfiguration[j][k]>> 8 & 0xFF;
          UnitMaster_payload_buffer_units[payload_counter++] = UnitMaster_array_units_timeFormatConfiguration[j][k]     & 0xFF;
        }
      }
    }
    
    
    // 16 volumeUnit (enum32)
    if (UnitMaster_array_units_volumeUnit_available[j] == 1)
    {
      tag_dataID = 16;
      UnitMaster_payload_buffer_units[payload_counter++] = 2 * 16 /* Wiretype = 2 =^ 32 Bit */ + ((tag_dataID>>8) & 0x0F) /* DataID High Part */ ;
      UnitMaster_payload_buffer_units[payload_counter++] = tag_dataID & 0xFF /* DataID Low Part */ ;
      
      UnitMaster_payload_buffer_units[payload_counter++] = UnitMaster_array_units_volumeUnit[j]>>24 & 0xFF;
      UnitMaster_payload_buffer_units[payload_counter++] = UnitMaster_array_units_volumeUnit[j]>>16 & 0xFF;
      UnitMaster_payload_buffer_units[payload_counter++] = UnitMaster_array_units_volumeUnit[j]>> 8 & 0xFF;
      UnitMaster_payload_buffer_units[payload_counter++] = UnitMaster_array_units_volumeUnit[j]     & 0xFF;
    }
    
    
    // 17 volumeUnitConfiguration (enum32 array)
    if (UnitMaster_array_units_volumeUnitConfiguration_available[j] == 1)
    {
      tag_dataID = 17;
      UnitMaster_payload_buffer_units[payload_counter++] = 5 * 16 /* Wiretype = 5 =^ Array mit 1 Byte Länge */ + ((tag_dataID>>8) & 0x0F) /* DataID High Part */ ;
      UnitMaster_payload_buffer_units[payload_counter++] = tag_dataID & 0xFF /* DataID Low Part */ ;
      
      // Array Length
      UnitMaster_array_units_volumeUnitConfiguration_length = 4 * UnitMaster_array_units_volumeUnitConfiguration_nr_of_elements[j];
      UnitMaster_payload_buffer_units[payload_counter++] = UnitMaster_array_units_volumeUnitConfiguration_length     & 0xFF;
      
      if (UnitMaster_array_units_volumeUnitConfiguration_length>0)
      {
        for (k=0; k<UnitMaster_array_units_volumeUnitConfiguration_nr_of_elements[j]; k++)
        {
          UnitMaster_payload_buffer_units[payload_counter++] = UnitMaster_array_units_volumeUnitConfiguration[j][k]>>24 & 0xFF;
          UnitMaster_payload_buffer_units[payload_counter++] = UnitMaster_array_units_volumeUnitConfiguration[j][k]>>16 & 0xFF;
          UnitMaster_payload_buffer_units[payload_counter++] = UnitMaster_array_units_volumeUnitConfiguration[j][k]>> 8 & 0xFF;
          UnitMaster_payload_buffer_units[payload_counter++] = UnitMaster_array_units_volumeUnitConfiguration[j][k]     & 0xFF;
        }
      }
    }
    
    
    // 18 consumptionUnit (enum32)
    if (UnitMaster_array_units_consumptionUnit_available[j] == 1)
    {
      tag_dataID = 18;
      UnitMaster_payload_buffer_units[payload_counter++] = 2 * 16 /* Wiretype = 2 =^ 32 Bit */ + ((tag_dataID>>8) & 0x0F) /* DataID High Part */ ;
      UnitMaster_payload_buffer_units[payload_counter++] = tag_dataID & 0xFF /* DataID Low Part */ ;
      
      UnitMaster_payload_buffer_units[payload_counter++] = UnitMaster_array_units_consumptionUnit[j]>>24 & 0xFF;
      UnitMaster_payload_buffer_units[payload_counter++] = UnitMaster_array_units_consumptionUnit[j]>>16 & 0xFF;
      UnitMaster_payload_buffer_units[payload_counter++] = UnitMaster_array_units_consumptionUnit[j]>> 8 & 0xFF;
      UnitMaster_payload_buffer_units[payload_counter++] = UnitMaster_array_units_consumptionUnit[j]     & 0xFF;
    }
    
    
    // 19 consumptionUnitConfiguration (enum32 array)
    if (UnitMaster_array_units_consumptionUnitConfiguration_available[j] == 1)
    {
      tag_dataID = 19;
      UnitMaster_payload_buffer_units[payload_counter++] = 5 * 16 /* Wiretype = 5 =^ Array mit 1 Byte Länge */ + ((tag_dataID>>8) & 0x0F) /* DataID High Part */ ;
      UnitMaster_payload_buffer_units[payload_counter++] = tag_dataID & 0xFF /* DataID Low Part */ ;
      
      // Array Length
      UnitMaster_array_units_consumptionUnitConfiguration_length = 4 * UnitMaster_array_units_consumptionUnitConfiguration_nr_of_elements[j];
      UnitMaster_payload_buffer_units[payload_counter++] = UnitMaster_array_units_consumptionUnitConfiguration_length     & 0xFF;
      
      if (UnitMaster_array_units_consumptionUnitConfiguration_length>0)
      {
        for (k=0; k<UnitMaster_array_units_consumptionUnitConfiguration_nr_of_elements[j]; k++)
        {
          UnitMaster_payload_buffer_units[payload_counter++] = UnitMaster_array_units_consumptionUnitConfiguration[j][k]>>24 & 0xFF;
          UnitMaster_payload_buffer_units[payload_counter++] = UnitMaster_array_units_consumptionUnitConfiguration[j][k]>>16 & 0xFF;
          UnitMaster_payload_buffer_units[payload_counter++] = UnitMaster_array_units_consumptionUnitConfiguration[j][k]>> 8 & 0xFF;
          UnitMaster_payload_buffer_units[payload_counter++] = UnitMaster_array_units_consumptionUnitConfiguration[j][k]     & 0xFF;
        }
      }
    }
    
    
    // 20 consumptionUnitElectr (enum32)
    if (UnitMaster_array_units_consumptionUnitElectr_available[j] == 1)
    {
      tag_dataID = 20;
      UnitMaster_payload_buffer_units[payload_counter++] = 2 * 16 /* Wiretype = 2 =^ 32 Bit */ + ((tag_dataID>>8) & 0x0F) /* DataID High Part */ ;
      UnitMaster_payload_buffer_units[payload_counter++] = tag_dataID & 0xFF /* DataID Low Part */ ;
      
      UnitMaster_payload_buffer_units[payload_counter++] = UnitMaster_array_units_consumptionUnitElectr[j]>>24 & 0xFF;
      UnitMaster_payload_buffer_units[payload_counter++] = UnitMaster_array_units_consumptionUnitElectr[j]>>16 & 0xFF;
      UnitMaster_payload_buffer_units[payload_counter++] = UnitMaster_array_units_consumptionUnitElectr[j]>> 8 & 0xFF;
      UnitMaster_payload_buffer_units[payload_counter++] = UnitMaster_array_units_consumptionUnitElectr[j]     & 0xFF;
    }
    
    
    // 21 consumptionUnitElectrConfiguration (enum32 array)
    if (UnitMaster_array_units_consumptionUnitElectrConfiguration_available[j] == 1)
    {
      tag_dataID = 21;
      UnitMaster_payload_buffer_units[payload_counter++] = 5 * 16 /* Wiretype = 5 =^ Array mit 1 Byte Länge */ + ((tag_dataID>>8) & 0x0F) /* DataID High Part */ ;
      UnitMaster_payload_buffer_units[payload_counter++] = tag_dataID & 0xFF /* DataID Low Part */ ;
      
      // Array Length
      UnitMaster_array_units_consumptionUnitElectrConfiguration_length = 4 * UnitMaster_array_units_consumptionUnitElectrConfiguration_nr_of_elements[j];
      UnitMaster_payload_buffer_units[payload_counter++] = UnitMaster_array_units_consumptionUnitElectrConfiguration_length     & 0xFF;
      
      if (UnitMaster_array_units_consumptionUnitElectrConfiguration_length>0)
      {
        for (k=0; k<UnitMaster_array_units_consumptionUnitElectrConfiguration_nr_of_elements[j]; k++)
        {
          UnitMaster_payload_buffer_units[payload_counter++] = UnitMaster_array_units_consumptionUnitElectrConfiguration[j][k]>>24 & 0xFF;
          UnitMaster_payload_buffer_units[payload_counter++] = UnitMaster_array_units_consumptionUnitElectrConfiguration[j][k]>>16 & 0xFF;
          UnitMaster_payload_buffer_units[payload_counter++] = UnitMaster_array_units_consumptionUnitElectrConfiguration[j][k]>> 8 & 0xFF;
          UnitMaster_payload_buffer_units[payload_counter++] = UnitMaster_array_units_consumptionUnitElectrConfiguration[j][k]     & 0xFF;
        }
      }
    }
    
    
    // 22 consumptionUnitGas (enum32)
    if (UnitMaster_array_units_consumptionUnitGas_available[j] == 1)
    {
      tag_dataID = 22;
      UnitMaster_payload_buffer_units[payload_counter++] = 2 * 16 /* Wiretype = 2 =^ 32 Bit */ + ((tag_dataID>>8) & 0x0F) /* DataID High Part */ ;
      UnitMaster_payload_buffer_units[payload_counter++] = tag_dataID & 0xFF /* DataID Low Part */ ;
      
      UnitMaster_payload_buffer_units[payload_counter++] = UnitMaster_array_units_consumptionUnitGas[j]>>24 & 0xFF;
      UnitMaster_payload_buffer_units[payload_counter++] = UnitMaster_array_units_consumptionUnitGas[j]>>16 & 0xFF;
      UnitMaster_payload_buffer_units[payload_counter++] = UnitMaster_array_units_consumptionUnitGas[j]>> 8 & 0xFF;
      UnitMaster_payload_buffer_units[payload_counter++] = UnitMaster_array_units_consumptionUnitGas[j]     & 0xFF;
    }
    
    
    // 23 consumptionUnitGasConfiguration (enum32 array)
    if (UnitMaster_array_units_consumptionUnitGasConfiguration_available[j] == 1)
    {
      tag_dataID = 23;
      UnitMaster_payload_buffer_units[payload_counter++] = 5 * 16 /* Wiretype = 5 =^ Array mit 1 Byte Länge */ + ((tag_dataID>>8) & 0x0F) /* DataID High Part */ ;
      UnitMaster_payload_buffer_units[payload_counter++] = tag_dataID & 0xFF /* DataID Low Part */ ;
      
      // Array Length
      UnitMaster_array_units_consumptionUnitGasConfiguration_length = 4 * UnitMaster_array_units_consumptionUnitGasConfiguration_nr_of_elements[j];
      UnitMaster_payload_buffer_units[payload_counter++] = UnitMaster_array_units_consumptionUnitGasConfiguration_length     & 0xFF;
      
      if (UnitMaster_array_units_consumptionUnitGasConfiguration_length>0)
      {
        for (k=0; k<UnitMaster_array_units_consumptionUnitGasConfiguration_nr_of_elements[j]; k++)
        {
          UnitMaster_payload_buffer_units[payload_counter++] = UnitMaster_array_units_consumptionUnitGasConfiguration[j][k]>>24 & 0xFF;
          UnitMaster_payload_buffer_units[payload_counter++] = UnitMaster_array_units_consumptionUnitGasConfiguration[j][k]>>16 & 0xFF;
          UnitMaster_payload_buffer_units[payload_counter++] = UnitMaster_array_units_consumptionUnitGasConfiguration[j][k]>> 8 & 0xFF;
          UnitMaster_payload_buffer_units[payload_counter++] = UnitMaster_array_units_consumptionUnitGasConfiguration[j][k]     & 0xFF;
        }
      }
    }
    
    
    // 24 massUnit (enum32)
    if (UnitMaster_array_units_massUnit_available[j] == 1)
    {
      tag_dataID = 24;
      UnitMaster_payload_buffer_units[payload_counter++] = 2 * 16 /* Wiretype = 2 =^ 32 Bit */ + ((tag_dataID>>8) & 0x0F) /* DataID High Part */ ;
      UnitMaster_payload_buffer_units[payload_counter++] = tag_dataID & 0xFF /* DataID Low Part */ ;
      
      UnitMaster_payload_buffer_units[payload_counter++] = UnitMaster_array_units_massUnit[j]>>24 & 0xFF;
      UnitMaster_payload_buffer_units[payload_counter++] = UnitMaster_array_units_massUnit[j]>>16 & 0xFF;
      UnitMaster_payload_buffer_units[payload_counter++] = UnitMaster_array_units_massUnit[j]>> 8 & 0xFF;
      UnitMaster_payload_buffer_units[payload_counter++] = UnitMaster_array_units_massUnit[j]     & 0xFF;
    }
    
    
    // 25 massUnitConfiguration (enum32 array)
    if (UnitMaster_array_units_massUnitConfiguration_available[j] == 1)
    {
      tag_dataID = 25;
      UnitMaster_payload_buffer_units[payload_counter++] = 5 * 16 /* Wiretype = 5 =^ Array mit 1 Byte Länge */ + ((tag_dataID>>8) & 0x0F) /* DataID High Part */ ;
      UnitMaster_payload_buffer_units[payload_counter++] = tag_dataID & 0xFF /* DataID Low Part */ ;
      
      // Array Length
      UnitMaster_array_units_massUnitConfiguration_length = 4 * UnitMaster_array_units_massUnitConfiguration_nr_of_elements[j];
      UnitMaster_payload_buffer_units[payload_counter++] = UnitMaster_array_units_massUnitConfiguration_length     & 0xFF;
      
      if (UnitMaster_array_units_massUnitConfiguration_length>0)
      {
        for (k=0; k<UnitMaster_array_units_massUnitConfiguration_nr_of_elements[j]; k++)
        {
          UnitMaster_payload_buffer_units[payload_counter++] = UnitMaster_array_units_massUnitConfiguration[j][k]>>24 & 0xFF;
          UnitMaster_payload_buffer_units[payload_counter++] = UnitMaster_array_units_massUnitConfiguration[j][k]>>16 & 0xFF;
          UnitMaster_payload_buffer_units[payload_counter++] = UnitMaster_array_units_massUnitConfiguration[j][k]>> 8 & 0xFF;
          UnitMaster_payload_buffer_units[payload_counter++] = UnitMaster_array_units_massUnitConfiguration[j][k]     & 0xFF;
        }
      }
    }
    
   
    //Element Length
    element_length = payload_counter-start_pos;
    if (element_length >0) UnitMaster_array_units_array_element_length[j] = element_length - 4;
    else                   UnitMaster_array_units_array_element_length[j] = element_length;
    
    UnitMaster_payload_buffer_units[start_pos++] = UnitMaster_array_units_array_element_length[j]>>24 & 0xFF;
    UnitMaster_payload_buffer_units[start_pos++] = UnitMaster_array_units_array_element_length[j]>>16 & 0xFF;
    UnitMaster_payload_buffer_units[start_pos++] = UnitMaster_array_units_array_element_length[j]>> 8 & 0xFF;
    UnitMaster_payload_buffer_units[start_pos++] = UnitMaster_array_units_array_element_length[j]     & 0xFF;
    
    if (UnitMaster_array_units_array_element_length[j] == 0) payload_counter = payload_counter+4;
  }
  
  // Struct Length
  UnitMaster_array_units_struct_element_length = 4*@UnitMaster_SetGet_units_Element_TotalNum;

  for (k=0;k<@UnitMaster_SetGet_units_Element_TotalNum;k++)
    UnitMaster_array_units_struct_element_length = UnitMaster_array_units_struct_element_length + UnitMaster_array_units_array_element_length[k];
  
  UnitMaster_payload_buffer_units[0] = UnitMaster_array_units_struct_element_length>>24 & 0xFF;
  UnitMaster_payload_buffer_units[1] = UnitMaster_array_units_struct_element_length>>16 & 0xFF;
  UnitMaster_payload_buffer_units[2] = UnitMaster_array_units_struct_element_length>> 8 & 0xFF;
  UnitMaster_payload_buffer_units[3] = UnitMaster_array_units_struct_element_length     & 0xFF;


  UnitMaster_payload_length_units = UnitMaster_array_units_struct_element_length+4;
  putvalue(UnitMaster_SetGet_units_Payload, UnitMaster_payload_buffer_units, UnitMaster_payload_length_units);
}

on envVar UnitMaster_SetGet_units_Element_TotalNum
{
  if (@this > 20) @this = 20;
  
  UnitMaster_SetGet_units();
  UnitMaster_SetGet_units_update();
}

on envVar UnitMaster_SetGet_units_Element
{
  UnitMaster_SetGet_units_update();
}

on envVar UnitMaster_SetGet_units_Element_Next
{
  if (@this == 1 && @UnitMaster_SetGet_units_Element < @UnitMaster_SetGet_units_Element_TotalNum - 1)
  {
    @UnitMaster_SetGet_units_Element = @UnitMaster_SetGet_units_Element + 1;
    UnitMaster_SetGet_units_update();
  }
}

on envVar UnitMaster_SetGet_units_Element_Previous
{
  if (@this == 1 && @UnitMaster_SetGet_units_Element > 0)
  {
    @UnitMaster_SetGet_units_Element = @UnitMaster_SetGet_units_Element - 1;
    UnitMaster_SetGet_units_update();
  }
}

on envVar UnitMaster_SetGet_units_dateFormatConfiguration_Element_TotalNum
{
  if (@this > 20) @this = 20;
  
  UnitMaster_array_units_dateFormatConfiguration_nr_of_elements[@UnitMaster_SetGet_units_Element] = @this;
  UnitMaster_SetGet_units();
  UnitMaster_SetGet_units_update();
}

on envVar UnitMaster_SetGet_units_dateFormatConfiguration_Element
{
  UnitMaster_SetGet_units_update();
}

on envVar UnitMaster_SetGet_units_dateFormatConfiguration_Element_Next
{
  if (@this == 1 && @UnitMaster_SetGet_units_dateFormatConfiguration_Element < @UnitMaster_SetGet_units_dateFormatConfiguration_Element_TotalNum - 1)
  {
    @UnitMaster_SetGet_units_dateFormatConfiguration_Element = @UnitMaster_SetGet_units_dateFormatConfiguration_Element + 1;
    
    @UnitMaster_SetGet_units_dateFormatConfiguration = UnitMaster_array_units_dateFormatConfiguration[@UnitMaster_SetGet_units_Element][@UnitMaster_SetGet_units_dateFormatConfiguration_Element];
  }
}

on envVar UnitMaster_SetGet_units_dateFormatConfiguration_Element_Previous
{
  if (@this == 1 && @UnitMaster_SetGet_units_dateFormatConfiguration_Element > 0)
  {
    @UnitMaster_SetGet_units_dateFormatConfiguration_Element = @UnitMaster_SetGet_units_dateFormatConfiguration_Element - 1;
    
    @UnitMaster_SetGet_units_dateFormatConfiguration = UnitMaster_array_units_dateFormatConfiguration[@UnitMaster_SetGet_units_Element][@UnitMaster_SetGet_units_dateFormatConfiguration_Element];
  }
}

on envVar UnitMaster_SetGet_units_distanceUnitConfiguration_Element_TotalNum
{
  if (@this > 20) @this = 20;
  
  UnitMaster_array_units_distanceUnitConfiguration_nr_of_elements[@UnitMaster_SetGet_units_Element] = @this;
  UnitMaster_SetGet_units();
  UnitMaster_SetGet_units_update();
}

on envVar UnitMaster_SetGet_units_distanceUnitConfiguration_Element
{
  UnitMaster_SetGet_units_update();
}

on envVar UnitMaster_SetGet_units_distanceUnitConfiguration_Element_Next
{
  if (@this == 1 && @UnitMaster_SetGet_units_distanceUnitConfiguration_Element < @UnitMaster_SetGet_units_distanceUnitConfiguration_Element_TotalNum - 1)
  {
    @UnitMaster_SetGet_units_distanceUnitConfiguration_Element = @UnitMaster_SetGet_units_distanceUnitConfiguration_Element + 1;
    
    @UnitMaster_SetGet_units_distanceUnitConfiguration = UnitMaster_array_units_distanceUnitConfiguration[@UnitMaster_SetGet_units_Element][@UnitMaster_SetGet_units_distanceUnitConfiguration_Element];
  }
}

on envVar UnitMaster_SetGet_units_distanceUnitConfiguration_Element_Previous
{
  if (@this == 1 && @UnitMaster_SetGet_units_distanceUnitConfiguration_Element > 0)
  {
    @UnitMaster_SetGet_units_distanceUnitConfiguration_Element = @UnitMaster_SetGet_units_distanceUnitConfiguration_Element - 1;
    
    @UnitMaster_SetGet_units_distanceUnitConfiguration = UnitMaster_array_units_distanceUnitConfiguration[@UnitMaster_SetGet_units_Element][@UnitMaster_SetGet_units_distanceUnitConfiguration_Element];
  }
}

on envVar UnitMaster_SetGet_units_pressureUnitConfiguration_Element_TotalNum
{
  if (@this > 20) @this = 20;
  
  UnitMaster_array_units_pressureUnitConfiguration_nr_of_elements[@UnitMaster_SetGet_units_Element] = @this;
  UnitMaster_SetGet_units();
  UnitMaster_SetGet_units_update();
}

on envVar UnitMaster_SetGet_units_pressureUnitConfiguration_Element
{
  UnitMaster_SetGet_units_update();
}

on envVar UnitMaster_SetGet_units_pressureUnitConfiguration_Element_Next
{
  if (@this == 1 && @UnitMaster_SetGet_units_pressureUnitConfiguration_Element < @UnitMaster_SetGet_units_pressureUnitConfiguration_Element_TotalNum - 1)
  {
    @UnitMaster_SetGet_units_pressureUnitConfiguration_Element = @UnitMaster_SetGet_units_pressureUnitConfiguration_Element + 1;
    
    @UnitMaster_SetGet_units_pressureUnitConfiguration = UnitMaster_array_units_pressureUnitConfiguration[@UnitMaster_SetGet_units_Element][@UnitMaster_SetGet_units_pressureUnitConfiguration_Element];
  }
}

on envVar UnitMaster_SetGet_units_pressureUnitConfiguration_Element_Previous
{
  if (@this == 1 && @UnitMaster_SetGet_units_pressureUnitConfiguration_Element > 0)
  {
    @UnitMaster_SetGet_units_pressureUnitConfiguration_Element = @UnitMaster_SetGet_units_pressureUnitConfiguration_Element - 1;
    
    @UnitMaster_SetGet_units_pressureUnitConfiguration = UnitMaster_array_units_pressureUnitConfiguration[@UnitMaster_SetGet_units_Element][@UnitMaster_SetGet_units_pressureUnitConfiguration_Element];
  }
}

on envVar UnitMaster_SetGet_units_speedUnitConfiguration_Element_TotalNum
{
  if (@this > 20) @this = 20;
  
  UnitMaster_array_units_speedUnitConfiguration_nr_of_elements[@UnitMaster_SetGet_units_Element] = @this;
  UnitMaster_SetGet_units();
  UnitMaster_SetGet_units_update();
}

on envVar UnitMaster_SetGet_units_speedUnitConfiguration_Element
{
  UnitMaster_SetGet_units_update();
}

on envVar UnitMaster_SetGet_units_speedUnitConfiguration_Element_Next
{
  if (@this == 1 && @UnitMaster_SetGet_units_speedUnitConfiguration_Element < @UnitMaster_SetGet_units_speedUnitConfiguration_Element_TotalNum - 1)
  {
    @UnitMaster_SetGet_units_speedUnitConfiguration_Element = @UnitMaster_SetGet_units_speedUnitConfiguration_Element + 1;
    
    @UnitMaster_SetGet_units_speedUnitConfiguration = UnitMaster_array_units_speedUnitConfiguration[@UnitMaster_SetGet_units_Element][@UnitMaster_SetGet_units_speedUnitConfiguration_Element];
  }
}

on envVar UnitMaster_SetGet_units_speedUnitConfiguration_Element_Previous
{
  if (@this == 1 && @UnitMaster_SetGet_units_speedUnitConfiguration_Element > 0)
  {
    @UnitMaster_SetGet_units_speedUnitConfiguration_Element = @UnitMaster_SetGet_units_speedUnitConfiguration_Element - 1;
    
    @UnitMaster_SetGet_units_speedUnitConfiguration = UnitMaster_array_units_speedUnitConfiguration[@UnitMaster_SetGet_units_Element][@UnitMaster_SetGet_units_speedUnitConfiguration_Element];
  }
}

on envVar UnitMaster_SetGet_units_temperatureUnitConfiguration_Element_TotalNum
{
  if (@this > 20) @this = 20;
  
  UnitMaster_array_units_temperatureUnitConfiguration_nr_of_elements[@UnitMaster_SetGet_units_Element] = @this;
  UnitMaster_SetGet_units();
  UnitMaster_SetGet_units_update();
}

on envVar UnitMaster_SetGet_units_temperatureUnitConfiguration_Element
{
  UnitMaster_SetGet_units_update();
}

on envVar UnitMaster_SetGet_units_temperatureUnitConfiguration_Element_Next
{
  if (@this == 1 && @UnitMaster_SetGet_units_temperatureUnitConfiguration_Element < @UnitMaster_SetGet_units_temperatureUnitConfiguration_Element_TotalNum - 1)
  {
    @UnitMaster_SetGet_units_temperatureUnitConfiguration_Element = @UnitMaster_SetGet_units_temperatureUnitConfiguration_Element + 1;
    
    @UnitMaster_SetGet_units_temperatureUnitConfiguration = UnitMaster_array_units_temperatureUnitConfiguration[@UnitMaster_SetGet_units_Element][@UnitMaster_SetGet_units_temperatureUnitConfiguration_Element];
  }
}

on envVar UnitMaster_SetGet_units_temperatureUnitConfiguration_Element_Previous
{
  if (@this == 1 && @UnitMaster_SetGet_units_temperatureUnitConfiguration_Element > 0)
  {
    @UnitMaster_SetGet_units_temperatureUnitConfiguration_Element = @UnitMaster_SetGet_units_temperatureUnitConfiguration_Element - 1;
    
    @UnitMaster_SetGet_units_temperatureUnitConfiguration = UnitMaster_array_units_temperatureUnitConfiguration[@UnitMaster_SetGet_units_Element][@UnitMaster_SetGet_units_temperatureUnitConfiguration_Element];
  }
}

on envVar UnitMaster_SetGet_units_timeFormatConfiguration_Element_TotalNum
{
  if (@this > 20) @this = 20;
  
  UnitMaster_array_units_temperatureUnitConfiguration_nr_of_elements[@UnitMaster_SetGet_units_Element] = @this;
  UnitMaster_SetGet_units();
  UnitMaster_SetGet_units_update();
}

on envVar UnitMaster_SetGet_units_timeFormatConfiguration_Element
{
  UnitMaster_SetGet_units_update();
}

on envVar UnitMaster_SetGet_units_timeFormatConfiguration_Element_Next
{
  if (@this == 1 && @UnitMaster_SetGet_units_timeFormatConfiguration_Element < @UnitMaster_SetGet_units_timeFormatConfiguration_Element_TotalNum - 1)
  {
    @UnitMaster_SetGet_units_timeFormatConfiguration_Element = @UnitMaster_SetGet_units_timeFormatConfiguration_Element + 1;
    
    @UnitMaster_SetGet_units_timeFormatConfiguration = UnitMaster_array_units_timeFormatConfiguration[@UnitMaster_SetGet_units_Element][@UnitMaster_SetGet_units_timeFormatConfiguration_Element];
  }
}

on envVar UnitMaster_SetGet_units_timeFormatConfiguration_Element_Previous
{
  if (@this == 1 && @UnitMaster_SetGet_units_timeFormatConfiguration_Element > 0)
  {
    @UnitMaster_SetGet_units_timeFormatConfiguration_Element = @UnitMaster_SetGet_units_timeFormatConfiguration_Element - 1;
    
    @UnitMaster_SetGet_units_timeFormatConfiguration = UnitMaster_array_units_timeFormatConfiguration[@UnitMaster_SetGet_units_Element][@UnitMaster_SetGet_units_timeFormatConfiguration_Element];
  }
}

on envVar UnitMaster_SetGet_units_volumeUnitConfiguration_Element_TotalNum
{
  if (@this > 20) @this = 20;
  
  UnitMaster_array_units_volumeUnitConfiguration_nr_of_elements[@UnitMaster_SetGet_units_Element] = @this;
  UnitMaster_SetGet_units();
  UnitMaster_SetGet_units_update();
}

on envVar UnitMaster_SetGet_units_volumeUnitConfiguration_Element
{
  UnitMaster_SetGet_units_update();
}

on envVar UnitMaster_SetGet_units_volumeUnitConfiguration_Element_Next
{
  if (@this == 1 && @UnitMaster_SetGet_units_volumeUnitConfiguration_Element < @UnitMaster_SetGet_units_volumeUnitConfiguration_Element_TotalNum - 1)
  {
    @UnitMaster_SetGet_units_volumeUnitConfiguration_Element = @UnitMaster_SetGet_units_volumeUnitConfiguration_Element + 1;
    
    @UnitMaster_SetGet_units_volumeUnitConfiguration = UnitMaster_array_units_volumeUnitConfiguration[@UnitMaster_SetGet_units_Element][@UnitMaster_SetGet_units_volumeUnitConfiguration_Element];
  }
}

on envVar UnitMaster_SetGet_units_volumeUnitConfiguration_Element_Previous
{
  if (@this == 1 && @UnitMaster_SetGet_units_volumeUnitConfiguration_Element > 0)
  {
    @UnitMaster_SetGet_units_volumeUnitConfiguration_Element = @UnitMaster_SetGet_units_volumeUnitConfiguration_Element - 1;
    
    @UnitMaster_SetGet_units_volumeUnitConfiguration = UnitMaster_array_units_volumeUnitConfiguration[@UnitMaster_SetGet_units_Element][@UnitMaster_SetGet_units_volumeUnitConfiguration_Element];
  }
}

on envVar UnitMaster_SetGet_units_consumptionUnitConfiguration_Element_TotalNum
{
  if (@this > 20) @this = 20;
  
  UnitMaster_array_units_consumptionUnitConfiguration_nr_of_elements[@UnitMaster_SetGet_units_Element] = @this;
  UnitMaster_SetGet_units();
  UnitMaster_SetGet_units_update();
}

on envVar UnitMaster_SetGet_units_consumptionUnitConfiguration_Element
{
  UnitMaster_SetGet_units_update();
}

on envVar UnitMaster_SetGet_units_consumptionUnitConfiguration_Element_Next
{
  if (@this == 1 && @UnitMaster_SetGet_units_consumptionUnitConfiguration_Element < @UnitMaster_SetGet_units_consumptionUnitConfiguration_Element_TotalNum - 1)
  {
    @UnitMaster_SetGet_units_consumptionUnitConfiguration_Element = @UnitMaster_SetGet_units_consumptionUnitConfiguration_Element + 1;
    
    @UnitMaster_SetGet_units_consumptionUnitConfiguration = UnitMaster_array_units_consumptionUnitConfiguration[@UnitMaster_SetGet_units_Element][@UnitMaster_SetGet_units_consumptionUnitConfiguration_Element];
  }
}

on envVar UnitMaster_SetGet_units_consumptionUnitConfiguration_Element_Previous
{
  if (@this == 1 && @UnitMaster_SetGet_units_consumptionUnitConfiguration_Element > 0)
  {
    @UnitMaster_SetGet_units_consumptionUnitConfiguration_Element = @UnitMaster_SetGet_units_consumptionUnitConfiguration_Element - 1;
    
    @UnitMaster_SetGet_units_consumptionUnitConfiguration = UnitMaster_array_units_consumptionUnitConfiguration[@UnitMaster_SetGet_units_Element][@UnitMaster_SetGet_units_consumptionUnitConfiguration_Element];
  }
}

on envVar UnitMaster_SetGet_units_consumptionUnitElectrConfiguration_Element_TotalNum
{
  if (@this > 20) @this = 20;
  
  UnitMaster_array_units_consumptionUnitElectrConfiguration_nr_of_elements[@UnitMaster_SetGet_units_Element] = @this;
  UnitMaster_SetGet_units();
  UnitMaster_SetGet_units_update();
}

on envVar UnitMaster_SetGet_units_consumptionUnitElectrConfiguration_Element
{
  UnitMaster_SetGet_units_update();
}

on envVar UnitMaster_SetGet_units_consumptionUnitElectrConfiguration_Element_Next
{
  if (@this == 1 && @UnitMaster_SetGet_units_consumptionUnitElectrConfiguration_Element < @UnitMaster_SetGet_units_consumptionUnitElectrConfiguration_Element_TotalNum - 1)
  {
    @UnitMaster_SetGet_units_consumptionUnitElectrConfiguration_Element = @UnitMaster_SetGet_units_consumptionUnitElectrConfiguration_Element + 1;
    
    @UnitMaster_SetGet_units_consumptionUnitElectrConfiguration = UnitMaster_array_units_consumptionUnitElectrConfiguration[@UnitMaster_SetGet_units_Element][@UnitMaster_SetGet_units_consumptionUnitElectrConfiguration_Element];
  }
}

on envVar UnitMaster_SetGet_units_consumptionUnitElectrConfiguration_Element_Previous
{
  if (@this == 1 && @UnitMaster_SetGet_units_consumptionUnitElectrConfiguration_Element > 0)
  {
    @UnitMaster_SetGet_units_consumptionUnitElectrConfiguration_Element = @UnitMaster_SetGet_units_consumptionUnitElectrConfiguration_Element - 1;
    
    @UnitMaster_SetGet_units_consumptionUnitElectrConfiguration = UnitMaster_array_units_consumptionUnitElectrConfiguration[@UnitMaster_SetGet_units_Element][@UnitMaster_SetGet_units_consumptionUnitElectrConfiguration_Element];
  }
}

on envVar UnitMaster_SetGet_units_consumptionUnitGasConfiguration_Element_TotalNum
{
  if (@this > 20) @this = 20;
  
  UnitMaster_array_units_consumptionUnitGasConfiguration_nr_of_elements[@UnitMaster_SetGet_units_Element] = @this;
  UnitMaster_SetGet_units();
  UnitMaster_SetGet_units_update();
}

on envVar UnitMaster_SetGet_units_consumptionUnitGasConfiguration_Element
{
  UnitMaster_SetGet_units_update();
}

on envVar UnitMaster_SetGet_units_consumptionUnitGasConfiguration_Element_Next
{
  if (@this == 1 && @UnitMaster_SetGet_units_consumptionUnitGasConfiguration_Element < @UnitMaster_SetGet_units_consumptionUnitGasConfiguration_Element_TotalNum - 1)
  {
    @UnitMaster_SetGet_units_consumptionUnitGasConfiguration_Element = @UnitMaster_SetGet_units_consumptionUnitGasConfiguration_Element + 1;
    
    @UnitMaster_SetGet_units_consumptionUnitGasConfiguration = UnitMaster_array_units_consumptionUnitGasConfiguration[@UnitMaster_SetGet_units_Element][@UnitMaster_SetGet_units_consumptionUnitGasConfiguration_Element];
  }
}

on envVar UnitMaster_SetGet_units_consumptionUnitGasConfiguration_Element_Previous
{
  if (@this == 1 && @UnitMaster_SetGet_units_consumptionUnitGasConfiguration_Element > 0)
  {
    @UnitMaster_SetGet_units_consumptionUnitGasConfiguration_Element = @UnitMaster_SetGet_units_consumptionUnitGasConfiguration_Element - 1;
    
    @UnitMaster_SetGet_units_consumptionUnitGasConfiguration = UnitMaster_array_units_consumptionUnitGasConfiguration[@UnitMaster_SetGet_units_Element][@UnitMaster_SetGet_units_consumptionUnitGasConfiguration_Element];
  }
}

on envVar UnitMaster_SetGet_units_massUnitConfiguration_Element_TotalNum
{
  if (@this > 20) @this = 20;
  
  UnitMaster_array_units_massUnitConfiguration_nr_of_elements[@UnitMaster_SetGet_units_Element] = @this;
  UnitMaster_SetGet_units();
  UnitMaster_SetGet_units_update();
}

on envVar UnitMaster_SetGet_units_massUnitConfiguration_Element
{
  UnitMaster_SetGet_units_update();
}

on envVar UnitMaster_SetGet_units_massUnitConfiguration_Element_Next
{
  if (@this == 1 && @UnitMaster_SetGet_units_massUnitConfiguration_Element < @UnitMaster_SetGet_units_massUnitConfiguration_Element_TotalNum - 1)
  {
    @UnitMaster_SetGet_units_massUnitConfiguration_Element = @UnitMaster_SetGet_units_massUnitConfiguration_Element + 1;
    
    @UnitMaster_SetGet_units_massUnitConfiguration = UnitMaster_array_units_massUnitConfiguration[@UnitMaster_SetGet_units_Element][@UnitMaster_SetGet_units_massUnitConfiguration_Element];
  }
}

on envVar UnitMaster_SetGet_units_massUnitConfiguration_Element_Previous
{
  if (@this == 1 && @UnitMaster_SetGet_units_massUnitConfiguration_Element > 0)
  {
    @UnitMaster_SetGet_units_massUnitConfiguration_Element = @UnitMaster_SetGet_units_massUnitConfiguration_Element - 1;
    
    @UnitMaster_SetGet_units_massUnitConfiguration = UnitMaster_array_units_massUnitConfiguration[@UnitMaster_SetGet_units_Element][@UnitMaster_SetGet_units_massUnitConfiguration_Element];
  }
}

UnitMaster_SetGet_units_update()
{
  @UnitMaster_SetGet_LengthIndicator_Element_units = UnitMaster_array_units_array_element_length[@UnitMaster_SetGet_units_Element];
  @UnitMaster_SetGet_LengthIndicator_Struct_units  = UnitMaster_array_units_struct_element_length;
  @UnitMaster_SetGet_Length_units                  = UnitMaster_payload_length_units+8;
  
  @UnitMaster_SetGet_units_dateFormat                         = UnitMaster_array_units_dateFormat[@UnitMaster_SetGet_units_Element];
  @UnitMaster_SetGet_units_dateFormatConfiguration            = UnitMaster_array_units_dateFormatConfiguration[@UnitMaster_SetGet_units_Element][@UnitMaster_SetGet_units_dateFormatConfiguration_Element];
  @UnitMaster_SetGet_units_distanceUnit                       = UnitMaster_array_units_distanceUnit[@UnitMaster_SetGet_units_Element];
  @UnitMaster_SetGet_units_distanceUnitConfiguration          = UnitMaster_array_units_distanceUnitConfiguration[@UnitMaster_SetGet_units_Element][@UnitMaster_SetGet_units_distanceUnitConfiguration_Element];
  @UnitMaster_SetGet_units_pressureUnit                       = UnitMaster_array_units_pressureUnit[@UnitMaster_SetGet_units_Element];
  @UnitMaster_SetGet_units_pressureUnitConfiguration          = UnitMaster_array_units_pressureUnitConfiguration[@UnitMaster_SetGet_units_Element][@UnitMaster_SetGet_units_pressureUnitConfiguration_Element];
  @UnitMaster_SetGet_units_restrictionReason                  = UnitMaster_array_units_restrictionReason[@UnitMaster_SetGet_units_Element];
  @UnitMaster_SetGet_units_speedUnitTachometer                = UnitMaster_array_units_speedUnitTachometer[@UnitMaster_SetGet_units_Element];
  @UnitMaster_SetGet_units_speedUnit                          = UnitMaster_array_units_speedUnit[@UnitMaster_SetGet_units_Element];
  @UnitMaster_SetGet_units_speedUnitConfiguration             = UnitMaster_array_units_speedUnitConfiguration[@UnitMaster_SetGet_units_Element][@UnitMaster_SetGet_units_speedUnitConfiguration_Element];
  @UnitMaster_SetGet_units_temperatureUnit                    = UnitMaster_array_units_temperatureUnit[@UnitMaster_SetGet_units_Element];
  @UnitMaster_SetGet_units_temperatureUnitConfiguration       = UnitMaster_array_units_temperatureUnitConfiguration[@UnitMaster_SetGet_units_Element][@UnitMaster_SetGet_units_temperatureUnitConfiguration_Element];
  @UnitMaster_SetGet_units_timeFormat                         = UnitMaster_array_units_timeFormat[@UnitMaster_SetGet_units_Element];
  @UnitMaster_SetGet_units_timeFormatConfiguration            = UnitMaster_array_units_timeFormatConfiguration[@UnitMaster_SetGet_units_Element][@UnitMaster_SetGet_units_timeFormatConfiguration_Element];
  @UnitMaster_SetGet_units_volumeUnit                         = UnitMaster_array_units_volumeUnit[@UnitMaster_SetGet_units_Element];
  @UnitMaster_SetGet_units_volumeUnitConfiguration            = UnitMaster_array_units_volumeUnitConfiguration[@UnitMaster_SetGet_units_Element][@UnitMaster_SetGet_units_volumeUnitConfiguration_Element];
  @UnitMaster_SetGet_units_consumptionUnit                    = UnitMaster_array_units_consumptionUnit[@UnitMaster_SetGet_units_Element];
  @UnitMaster_SetGet_units_consumptionUnitConfiguration       = UnitMaster_array_units_consumptionUnitConfiguration[@UnitMaster_SetGet_units_Element][@UnitMaster_SetGet_units_consumptionUnitConfiguration_Element];
  @UnitMaster_SetGet_units_consumptionUnitElectr              = UnitMaster_array_units_consumptionUnitElectr[@UnitMaster_SetGet_units_Element];
  @UnitMaster_SetGet_units_consumptionUnitElectrConfiguration = UnitMaster_array_units_consumptionUnitElectrConfiguration[@UnitMaster_SetGet_units_Element][@UnitMaster_SetGet_units_consumptionUnitElectrConfiguration_Element];
  @UnitMaster_SetGet_units_consumptionUnitGas                 = UnitMaster_array_units_consumptionUnitGas[@UnitMaster_SetGet_units_Element];
  @UnitMaster_SetGet_units_consumptionUnitGasConfiguration    = UnitMaster_array_units_consumptionUnitGasConfiguration[@UnitMaster_SetGet_units_Element][@UnitMaster_SetGet_units_consumptionUnitGasConfiguration_Element];
  @UnitMaster_SetGet_units_massUnit                           = UnitMaster_array_units_massUnit[@UnitMaster_SetGet_units_Element];
  @UnitMaster_SetGet_units_massUnitConfiguration              = UnitMaster_array_units_massUnitConfiguration[@UnitMaster_SetGet_units_Element][@UnitMaster_SetGet_units_massUnitConfiguration_Element];
  
  @UnitMaster_SetGet_units_dateFormatConfiguration_Element_TotalNum            = UnitMaster_array_units_dateFormatConfiguration_nr_of_elements[@UnitMaster_SetGet_units_Element];
  @UnitMaster_SetGet_units_distanceUnitConfiguration_Element_TotalNum          = UnitMaster_array_units_distanceUnitConfiguration_nr_of_elements[@UnitMaster_SetGet_units_Element];
  @UnitMaster_SetGet_units_pressureUnitConfiguration_Element_TotalNum          = UnitMaster_array_units_pressureUnitConfiguration_nr_of_elements[@UnitMaster_SetGet_units_Element];
  @UnitMaster_SetGet_units_speedUnitConfiguration_Element_TotalNum             = UnitMaster_array_units_speedUnitConfiguration_nr_of_elements[@UnitMaster_SetGet_units_Element];
  @UnitMaster_SetGet_units_temperatureUnitConfiguration_Element_TotalNum       = UnitMaster_array_units_temperatureUnitConfiguration_nr_of_elements[@UnitMaster_SetGet_units_Element];
  @UnitMaster_SetGet_units_timeFormatConfiguration_Element_TotalNum            = UnitMaster_array_units_timeFormatConfiguration_nr_of_elements[@UnitMaster_SetGet_units_Element];
  @UnitMaster_SetGet_units_volumeUnitConfiguration_Element_TotalNum            = UnitMaster_array_units_volumeUnitConfiguration_nr_of_elements[@UnitMaster_SetGet_units_Element];
  @UnitMaster_SetGet_units_consumptionUnitConfiguration_Element_TotalNum       = UnitMaster_array_units_consumptionUnitConfiguration_nr_of_elements[@UnitMaster_SetGet_units_Element];
  @UnitMaster_SetGet_units_consumptionUnitElectrConfiguration_Element_TotalNum = UnitMaster_array_units_consumptionUnitElectrConfiguration_nr_of_elements[@UnitMaster_SetGet_units_Element];
  @UnitMaster_SetGet_units_consumptionUnitGasConfiguration_Element_TotalNum    = UnitMaster_array_units_consumptionUnitGasConfiguration_nr_of_elements[@UnitMaster_SetGet_units_Element];
  @UnitMaster_SetGet_units_massUnitConfiguration_Element_TotalNum              = UnitMaster_array_units_massUnitConfiguration_nr_of_elements[@UnitMaster_SetGet_units_Element];
  
  putValue (UnitMaster_SetGet_units_id, UnitMaster_array_units_id[@UnitMaster_SetGet_units_Element]);
  putValue (UnitMaster_SetGet_units_name, UnitMaster_array_units_name[@UnitMaster_SetGet_units_Element]);
  
  @UnitMaster_SetGet_units_id_available                                 = UnitMaster_array_units_id_available[@UnitMaster_SetGet_units_Element];
  @UnitMaster_SetGet_units_name_available                               = UnitMaster_array_units_name_available[@UnitMaster_SetGet_units_Element];
  @UnitMaster_SetGet_units_dateFormat_available                         = UnitMaster_array_units_dateFormat_available[@UnitMaster_SetGet_units_Element];
  @UnitMaster_SetGet_units_dateFormatConfiguration_available            = UnitMaster_array_units_dateFormatConfiguration_available[@UnitMaster_SetGet_units_Element];
  @UnitMaster_SetGet_units_distanceUnit_available                       = UnitMaster_array_units_distanceUnit_available[@UnitMaster_SetGet_units_Element];
  @UnitMaster_SetGet_units_distanceUnitConfiguration_available          = UnitMaster_array_units_distanceUnitConfiguration_available[@UnitMaster_SetGet_units_Element];
  @UnitMaster_SetGet_units_pressureUnit_available                       = UnitMaster_array_units_pressureUnit_available[@UnitMaster_SetGet_units_Element];
  @UnitMaster_SetGet_units_pressureUnitConfiguration_available          = UnitMaster_array_units_pressureUnitConfiguration_available[@UnitMaster_SetGet_units_Element];
  @UnitMaster_SetGet_units_restrictionReason_available                  = UnitMaster_array_units_restrictionReason_available[@UnitMaster_SetGet_units_Element];
  @UnitMaster_SetGet_units_speedUnitTachometer_available                = UnitMaster_array_units_speedUnitTachometer_available[@UnitMaster_SetGet_units_Element];
  @UnitMaster_SetGet_units_speedUnit_available                          = UnitMaster_array_units_speedUnit_available[@UnitMaster_SetGet_units_Element];
  @UnitMaster_SetGet_units_speedUnitConfiguration_available             = UnitMaster_array_units_speedUnitConfiguration_available[@UnitMaster_SetGet_units_Element];
  @UnitMaster_SetGet_units_temperatureUnit_available                    = UnitMaster_array_units_temperatureUnit_available[@UnitMaster_SetGet_units_Element];
  @UnitMaster_SetGet_units_temperatureUnitConfiguration_available       = UnitMaster_array_units_temperatureUnitConfiguration_available[@UnitMaster_SetGet_units_Element];
  @UnitMaster_SetGet_units_timeFormat_available                         = UnitMaster_array_units_timeFormat_available[@UnitMaster_SetGet_units_Element];
  @UnitMaster_SetGet_units_timeFormatConfiguration_available            = UnitMaster_array_units_timeFormatConfiguration_available[@UnitMaster_SetGet_units_Element];
  @UnitMaster_SetGet_units_volumeUnit_available                         = UnitMaster_array_units_volumeUnit_available[@UnitMaster_SetGet_units_Element];
  @UnitMaster_SetGet_units_volumeUnitConfiguration_available            = UnitMaster_array_units_volumeUnitConfiguration_available[@UnitMaster_SetGet_units_Element];
  @UnitMaster_SetGet_units_consumptionUnit_available                    = UnitMaster_array_units_consumptionUnit_available[@UnitMaster_SetGet_units_Element];
  @UnitMaster_SetGet_units_consumptionUnitConfiguration_available       = UnitMaster_array_units_consumptionUnitConfiguration_available[@UnitMaster_SetGet_units_Element];
  @UnitMaster_SetGet_units_consumptionUnitElectr_available              = UnitMaster_array_units_consumptionUnitElectr_available[@UnitMaster_SetGet_units_Element];
  @UnitMaster_SetGet_units_consumptionUnitElectrConfiguration_available = UnitMaster_array_units_consumptionUnitElectrConfiguration_available[@UnitMaster_SetGet_units_Element];
  @UnitMaster_SetGet_units_consumptionUnitGas_available                 = UnitMaster_array_units_consumptionUnitGas_available[@UnitMaster_SetGet_units_Element];
  @UnitMaster_SetGet_units_consumptionUnitGasConfiguration_available    = UnitMaster_array_units_consumptionUnitGasConfiguration_available[@UnitMaster_SetGet_units_Element];
  @UnitMaster_SetGet_units_massUnit_available                           = UnitMaster_array_units_massUnit_available[@UnitMaster_SetGet_units_Element];
  @UnitMaster_SetGet_units_massUnitConfiguration_available              = UnitMaster_array_units_massUnitConfiguration_available[@UnitMaster_SetGet_units_Element]; 
}


UnitMaster_units_Notification()
{
  word data_length;
  word data_length_element_sum;
  word data_length_element[10];
  byte wiretype;
  byte data_id;
  word start_pos;
  
  payload_rx_counter = 0;
  data_length_element_sum = 0;
  UnitMaster_units_data_length_element_num = 0;
  UnitMaster_units_available_reset();
  
  // Gesamtlaenge
  data_length = ((someip_payload_buffer[payload_rx_counter++]&0x000000FF)*16777216
              +  (someip_payload_buffer[payload_rx_counter++]&0x000000FF)*65536
              +  (someip_payload_buffer[payload_rx_counter++]&0x000000FF)*256
              +  (someip_payload_buffer[payload_rx_counter++]&0x000000FF));
  
  // pruefen ob noch Elemente vorhanden sind
  while (data_length_element_sum < data_length)
  {
    // Laenge Element
    data_length_element[UnitMaster_units_data_length_element_num] = ((someip_payload_buffer[payload_rx_counter++]&0x000000FF)*16777216
                                                                  +  (someip_payload_buffer[payload_rx_counter++]&0x000000FF)*65536
                                                                  +  (someip_payload_buffer[payload_rx_counter++]&0x000000FF)*256
                                                                  +  (someip_payload_buffer[payload_rx_counter++]&0x000000FF));
    
    start_pos = payload_rx_counter;
    
    while (payload_rx_counter < data_length_element[UnitMaster_units_data_length_element_num] + start_pos)
    {
      // wiretype & data_id pruefen
      wiretype = (someip_payload_buffer[payload_rx_counter++]>>4) & 0x0F;
      data_id = someip_payload_buffer[payload_rx_counter++];
      
      switch (data_id)
      {
        case 0:  UnitMaster_Notification_units_id(); break;
        case 1:  UnitMaster_Notification_units_name(); break;
        case 2:  UnitMaster_Notification_units_dateFormat(); break;
        case 3:  UnitMaster_Notification_units_dateFormatConfiguration(wiretype); break;
        case 4:  UnitMaster_Notification_units_distanceUnit(); break;
        case 5:  UnitMaster_Notification_units_distanceUnitConfiguration(wiretype); break;
        case 6:  UnitMaster_Notification_units_pressureUnit(); break;
        case 7:  UnitMaster_Notification_units_pressureUnitConfiguration(wiretype); break;
        case 8:  UnitMaster_Notification_units_restrictionReason(); break;
        case 9:  UnitMaster_Notification_units_speedUnitTachometer(); break;
        case 10: UnitMaster_Notification_units_speedUnit(); break;
        case 11: UnitMaster_Notification_units_speedUnitConfiguration(wiretype); break;
        case 12: UnitMaster_Notification_units_temperatureUnit(); break;
        case 13: UnitMaster_Notification_units_temperatureUnitConfiguration(wiretype); break;
        case 14: UnitMaster_Notification_units_timeFormat(); break;
        case 15: UnitMaster_Notification_units_timeFormatConfiguration(wiretype); break;
        case 16: UnitMaster_Notification_units_volumeUnit(); break;
        case 17: UnitMaster_Notification_units_volumeUnitConfiguration(wiretype); break;
        case 18: UnitMaster_Notification_units_consumptionUnit(); break;
        case 19: UnitMaster_Notification_units_consumptionUnitConfiguration(wiretype); break;
        case 20: UnitMaster_Notification_units_consumptionUnitElectr(); break;
        case 21: UnitMaster_Notification_units_consumptionUnitElectrConfiguration(wiretype); break;
        case 22: UnitMaster_Notification_units_consumptionUnitGas(); break;
        case 23: UnitMaster_Notification_units_consumptionUnitGasConfiguration(wiretype); break;
        case 24: UnitMaster_Notification_units_massUnit(); break;
        case 25: UnitMaster_Notification_units_massUnitConfiguration(wiretype); break;
      }
    }
    data_length_element_sum = data_length_element_sum + data_length_element[UnitMaster_units_data_length_element_num] + 4;
    
    if (data_length_element_sum < data_length)
      UnitMaster_units_data_length_element_num++;
  }
  @UnitMaster_SetGet_units_Element_TotalNum = UnitMaster_units_data_length_element_num+1;
}

UnitMaster_units_available_reset()
{
  for (k=0; k<10; k++)
  {
    UnitMaster_array_units_id_available[k]                                       = 0;
    UnitMaster_array_units_name_available[k]                                     = 0;
    UnitMaster_array_units_dateFormat_available[k]                               = 0;
    UnitMaster_array_units_dateFormatConfiguration_available[k]                  = 0;
    UnitMaster_array_units_distanceUnit_available[k]                             = 0;
    UnitMaster_array_units_distanceUnitConfiguration_available[k]                = 0;
    UnitMaster_array_units_pressureUnit_available[k]                             = 0;
    UnitMaster_array_units_pressureUnitConfiguration_available[k]                = 0;
    UnitMaster_array_units_restrictionReason_available[k]                        = 0;
    UnitMaster_array_units_speedUnitTachometer_available[k]                      = 0;
    UnitMaster_array_units_speedUnit_available[k]                                = 0;
    UnitMaster_array_units_speedUnitConfiguration_available[k]                   = 0;
    UnitMaster_array_units_temperatureUnit_available[k]                          = 0;
    UnitMaster_array_units_temperatureUnitConfiguration_available[k]             = 0;
    UnitMaster_array_units_timeFormat_available[k]                               = 0;
    UnitMaster_array_units_timeFormatConfiguration_available[k]                  = 0;
    UnitMaster_array_units_volumeUnit_available[k]                               = 0;
    UnitMaster_array_units_volumeUnitConfiguration_available[k]                  = 0;
    UnitMaster_array_units_consumptionUnit_available[k]                          = 0;
    UnitMaster_array_units_consumptionUnitConfiguration_available[k]             = 0;
    UnitMaster_array_units_consumptionUnitElectr_available[k]                    = 0;
    UnitMaster_array_units_consumptionUnitElectrConfiguration_available[k]       = 0;
    UnitMaster_array_units_consumptionUnitGas_available[k]                       = 0;
    UnitMaster_array_units_consumptionUnitGasConfiguration_available[k]          = 0;
    UnitMaster_array_units_massUnit_available[k]                                 = 0;
    UnitMaster_array_units_massUnitConfiguration_available[k]                    = 0;
  }
}


UnitMaster_Notification_units_id()
{
  byte length;
  
  length = someip_payload_buffer[payload_rx_counter++];
  
  for (k=0; k<length; k++)
  {
    UnitMaster_array_units_id[UnitMaster_units_data_length_element_num][k] = someip_payload_buffer[payload_rx_counter++];
  }
  
  UnitMaster_array_units_id_available[UnitMaster_units_data_length_element_num] = 1;
  UnitMaster_SetGet_units_update();
}
UnitMaster_Notification_units_name()
{
  byte length;
  
  length = someip_payload_buffer[payload_rx_counter++];
  
  for (k=0; k<length; k++)
    UnitMaster_array_units_name[UnitMaster_units_data_length_element_num][k] = someip_payload_buffer[payload_rx_counter++];
  
  UnitMaster_array_units_id_available[UnitMaster_units_data_length_element_num] = 1;
  UnitMaster_SetGet_units_update();
}
UnitMaster_Notification_units_dateFormat()
{
  UnitMaster_array_units_dateFormat[UnitMaster_units_data_length_element_num] = ((someip_payload_buffer[payload_rx_counter++]&0x000000FF)*16777216
                                                                              +  (someip_payload_buffer[payload_rx_counter++]&0x000000FF)*65536
                                                                              +  (someip_payload_buffer[payload_rx_counter++]&0x000000FF)*256
                                                                              +  (someip_payload_buffer[payload_rx_counter++]&0x000000FF));
  
  UnitMaster_array_units_dateFormat_available[UnitMaster_units_data_length_element_num] = 1;
  UnitMaster_SetGet_units_update();
}
UnitMaster_Notification_units_dateFormatConfiguration(byte wiretype)
{
  dword length;
  byte  elements;
  
  if (wiretype==5) // 1 Byte Laenge
  {
    length = someip_payload_buffer[payload_rx_counter++]&0x000000FF;
  }
  if (wiretype==6) // 2 Byte Laenge
  {
    length = ((someip_payload_buffer[payload_rx_counter++]&0x000000FF)*256
           +  (someip_payload_buffer[payload_rx_counter++]&0x000000FF));
  }
  if (wiretype==7) // 4 Byte Laenge
  {
    length = ((someip_payload_buffer[payload_rx_counter++]&0x000000FF)*16777216
           +  (someip_payload_buffer[payload_rx_counter++]&0x000000FF)*65536
           +  (someip_payload_buffer[payload_rx_counter++]&0x000000FF)*256
           +  (someip_payload_buffer[payload_rx_counter++]&0x000000FF));
  }
  
  elements = length/4;
  
  for (k=0;k<elements;k++)
  {
    UnitMaster_array_units_dateFormatConfiguration[UnitMaster_units_data_length_element_num][k] = ((someip_payload_buffer[payload_rx_counter++]&0x000000FF)*16777216
                                                                                                +  (someip_payload_buffer[payload_rx_counter++]&0x000000FF)*65536
                                                                                                +  (someip_payload_buffer[payload_rx_counter++]&0x000000FF)*256
                                                                                                +  (someip_payload_buffer[payload_rx_counter++]&0x000000FF));
  }
  UnitMaster_array_units_dateFormatConfiguration_nr_of_elements[UnitMaster_units_data_length_element_num] = elements;
  UnitMaster_array_units_dateFormatConfiguration_available[UnitMaster_units_data_length_element_num] = 1;
  UnitMaster_SetGet_units_update();
}
UnitMaster_Notification_units_distanceUnit()
{
  UnitMaster_array_units_distanceUnit[UnitMaster_units_data_length_element_num] = ((someip_payload_buffer[payload_rx_counter++]&0x000000FF)*16777216
                                                                                +  (someip_payload_buffer[payload_rx_counter++]&0x000000FF)*65536
                                                                                +  (someip_payload_buffer[payload_rx_counter++]&0x000000FF)*256
                                                                                +  (someip_payload_buffer[payload_rx_counter++]&0x000000FF));
  
  UnitMaster_array_units_distanceUnit_available[UnitMaster_units_data_length_element_num] = 1;
  UnitMaster_SetGet_units_update();
}
UnitMaster_Notification_units_distanceUnitConfiguration(byte wiretype)
{
  dword length;
  byte  elements;
  
  if (wiretype==5) // 1 Byte Laenge
  {
    length = someip_payload_buffer[payload_rx_counter++]&0x000000FF;
  }
  if (wiretype==6) // 2 Byte Laenge
  {
    length = ((someip_payload_buffer[payload_rx_counter++]&0x000000FF)*256
           +  (someip_payload_buffer[payload_rx_counter++]&0x000000FF));
  }
  if (wiretype==7) // 4 Byte Laenge
  {
    length = ((someip_payload_buffer[payload_rx_counter++]&0x000000FF)*16777216
           +  (someip_payload_buffer[payload_rx_counter++]&0x000000FF)*65536
           +  (someip_payload_buffer[payload_rx_counter++]&0x000000FF)*256
           +  (someip_payload_buffer[payload_rx_counter++]&0x000000FF));
  }
  
  elements = length/4;
  
  for (k=0;k<elements;k++)
  {
    UnitMaster_array_units_distanceUnitConfiguration[UnitMaster_units_data_length_element_num][k] = ((someip_payload_buffer[payload_rx_counter++]&0x000000FF)*16777216
                                                                                                  +  (someip_payload_buffer[payload_rx_counter++]&0x000000FF)*65536
                                                                                                  +  (someip_payload_buffer[payload_rx_counter++]&0x000000FF)*256
                                                                                                  +  (someip_payload_buffer[payload_rx_counter++]&0x000000FF));
  }
  UnitMaster_array_units_distanceUnitConfiguration_nr_of_elements[UnitMaster_units_data_length_element_num] = elements;
  UnitMaster_array_units_distanceUnitConfiguration_available[UnitMaster_units_data_length_element_num] = 1;
  UnitMaster_SetGet_units_update();
}
UnitMaster_Notification_units_pressureUnit()
{
  UnitMaster_array_units_pressureUnit[UnitMaster_units_data_length_element_num] = ((someip_payload_buffer[payload_rx_counter++]&0x000000FF)*16777216
                                                                                +  (someip_payload_buffer[payload_rx_counter++]&0x000000FF)*65536
                                                                                +  (someip_payload_buffer[payload_rx_counter++]&0x000000FF)*256
                                                                                +  (someip_payload_buffer[payload_rx_counter++]&0x000000FF));
  
  UnitMaster_array_units_pressureUnit_available[UnitMaster_units_data_length_element_num] = 1;
  UnitMaster_SetGet_units_update();
}
UnitMaster_Notification_units_pressureUnitConfiguration(byte wiretype)
{
  dword length;
  byte  elements;
  
  if (wiretype==5) // 1 Byte Laenge
  {
    length = someip_payload_buffer[payload_rx_counter++]&0x000000FF;
  }
  if (wiretype==6) // 2 Byte Laenge
  {
    length = ((someip_payload_buffer[payload_rx_counter++]&0x000000FF)*256
           +  (someip_payload_buffer[payload_rx_counter++]&0x000000FF));
  }
  if (wiretype==7) // 4 Byte Laenge
  {
    length = ((someip_payload_buffer[payload_rx_counter++]&0x000000FF)*16777216
           +  (someip_payload_buffer[payload_rx_counter++]&0x000000FF)*65536
           +  (someip_payload_buffer[payload_rx_counter++]&0x000000FF)*256
           +  (someip_payload_buffer[payload_rx_counter++]&0x000000FF));
  }
  
  elements = length/4;
  
  for (k=0;k<elements;k++)
  {
    UnitMaster_array_units_pressureUnitConfiguration[UnitMaster_units_data_length_element_num][k] = ((someip_payload_buffer[payload_rx_counter++]&0x000000FF)*16777216
                                                                                                  +  (someip_payload_buffer[payload_rx_counter++]&0x000000FF)*65536
                                                                                                  +  (someip_payload_buffer[payload_rx_counter++]&0x000000FF)*256
                                                                                                  +  (someip_payload_buffer[payload_rx_counter++]&0x000000FF));
  }
  UnitMaster_array_units_pressureUnitConfiguration_nr_of_elements[UnitMaster_units_data_length_element_num] = elements;
  UnitMaster_array_units_pressureUnitConfiguration_available[UnitMaster_units_data_length_element_num] = 1;
  UnitMaster_SetGet_units_update();
}
UnitMaster_Notification_units_restrictionReason()
{
  UnitMaster_array_units_restrictionReason [UnitMaster_units_data_length_element_num] = ((someip_payload_buffer[payload_rx_counter++]&0x000000FF)*16777216
                                                                                      +  (someip_payload_buffer[payload_rx_counter++]&0x000000FF)*65536
                                                                                      +  (someip_payload_buffer[payload_rx_counter++]&0x000000FF)*256
                                                                                      +  (someip_payload_buffer[payload_rx_counter++]&0x000000FF));
  
  UnitMaster_array_units_restrictionReason_available[UnitMaster_units_data_length_element_num] = 1;
  UnitMaster_SetGet_units_update();
}
UnitMaster_Notification_units_speedUnitTachometer()
{
  UnitMaster_array_units_speedUnitTachometer[UnitMaster_units_data_length_element_num] = ((someip_payload_buffer[payload_rx_counter++]&0x000000FF)*16777216
                                                                                       +  (someip_payload_buffer[payload_rx_counter++]&0x000000FF)*65536
                                                                                       +  (someip_payload_buffer[payload_rx_counter++]&0x000000FF)*256
                                                                                       +  (someip_payload_buffer[payload_rx_counter++]&0x000000FF));
  
  UnitMaster_array_units_speedUnitTachometer_available[UnitMaster_units_data_length_element_num] = 1;
  UnitMaster_SetGet_units_update();
}
UnitMaster_Notification_units_speedUnit()
{
  UnitMaster_array_units_speedUnit[UnitMaster_units_data_length_element_num] = ((someip_payload_buffer[payload_rx_counter++]&0x000000FF)*16777216
                                                                             +  (someip_payload_buffer[payload_rx_counter++]&0x000000FF)*65536
                                                                             +  (someip_payload_buffer[payload_rx_counter++]&0x000000FF)*256
                                                                             +  (someip_payload_buffer[payload_rx_counter++]&0x000000FF));
  
  UnitMaster_array_units_speedUnit_available[UnitMaster_units_data_length_element_num] = 1;
  UnitMaster_SetGet_units_update();
}
UnitMaster_Notification_units_speedUnitConfiguration(byte wiretype)
{
  dword length;
  byte  elements;
  
  if (wiretype==5) // 1 Byte Laenge
  {
    length = someip_payload_buffer[payload_rx_counter++]&0x000000FF;
  }
  if (wiretype==6) // 2 Byte Laenge
  {
    length = ((someip_payload_buffer[payload_rx_counter++]&0x000000FF)*256
           +  (someip_payload_buffer[payload_rx_counter++]&0x000000FF));
  }
  if (wiretype==7) // 4 Byte Laenge
  {
    length = ((someip_payload_buffer[payload_rx_counter++]&0x000000FF)*16777216
           +  (someip_payload_buffer[payload_rx_counter++]&0x000000FF)*65536
           +  (someip_payload_buffer[payload_rx_counter++]&0x000000FF)*256
           +  (someip_payload_buffer[payload_rx_counter++]&0x000000FF));
  }
  
  elements = length/4;
  
  for (k=0;k<elements;k++)
  {
    UnitMaster_array_units_speedUnitConfiguration[UnitMaster_units_data_length_element_num][k] = ((someip_payload_buffer[payload_rx_counter++]&0x000000FF)*16777216
                                                                                               +  (someip_payload_buffer[payload_rx_counter++]&0x000000FF)*65536
                                                                                               +  (someip_payload_buffer[payload_rx_counter++]&0x000000FF)*256
                                                                                               +  (someip_payload_buffer[payload_rx_counter++]&0x000000FF));
  }
  UnitMaster_array_units_speedUnitConfiguration_nr_of_elements[UnitMaster_units_data_length_element_num] = elements;
  UnitMaster_array_units_speedUnitConfiguration_available[UnitMaster_units_data_length_element_num] = 1;
  UnitMaster_SetGet_units_update();
}
UnitMaster_Notification_units_temperatureUnit()
{
  UnitMaster_array_units_temperatureUnit[UnitMaster_units_data_length_element_num] = ((someip_payload_buffer[payload_rx_counter++]&0x000000FF)*16777216
                                                                                   +  (someip_payload_buffer[payload_rx_counter++]&0x000000FF)*65536
                                                                                   +  (someip_payload_buffer[payload_rx_counter++]&0x000000FF)*256
                                                                                   +  (someip_payload_buffer[payload_rx_counter++]&0x000000FF));
  
  UnitMaster_array_units_temperatureUnit_available[UnitMaster_units_data_length_element_num] = 1;
  UnitMaster_SetGet_units_update();
}
UnitMaster_Notification_units_temperatureUnitConfiguration(byte wiretype)
{
  dword length;
  byte  elements;
  
  if (wiretype==5) // 1 Byte Laenge
  {
    length = someip_payload_buffer[payload_rx_counter++]&0x000000FF;
  }
  if (wiretype==6) // 2 Byte Laenge
  {
    length = ((someip_payload_buffer[payload_rx_counter++]&0x000000FF)*256
           +  (someip_payload_buffer[payload_rx_counter++]&0x000000FF));
  }
  if (wiretype==7) // 4 Byte Laenge
  {
    length = ((someip_payload_buffer[payload_rx_counter++]&0x000000FF)*16777216
           +  (someip_payload_buffer[payload_rx_counter++]&0x000000FF)*65536
           +  (someip_payload_buffer[payload_rx_counter++]&0x000000FF)*256
           +  (someip_payload_buffer[payload_rx_counter++]&0x000000FF));
  }
  
  elements = length/4;
  
  for (k=0;k<elements;k++)
  {
    UnitMaster_array_units_temperatureUnitConfiguration[UnitMaster_units_data_length_element_num][k] = ((someip_payload_buffer[payload_rx_counter++]&0x000000FF)*16777216
                                                                                                     +  (someip_payload_buffer[payload_rx_counter++]&0x000000FF)*65536
                                                                                                     +  (someip_payload_buffer[payload_rx_counter++]&0x000000FF)*256
                                                                                                     +  (someip_payload_buffer[payload_rx_counter++]&0x000000FF));
  }
  UnitMaster_array_units_temperatureUnitConfiguration_nr_of_elements[UnitMaster_units_data_length_element_num] = elements;
  UnitMaster_array_units_temperatureUnitConfiguration_available[UnitMaster_units_data_length_element_num] = 1;
  UnitMaster_SetGet_units_update();
}
UnitMaster_Notification_units_timeFormat()
{
  UnitMaster_array_units_timeFormat[UnitMaster_units_data_length_element_num] = ((someip_payload_buffer[payload_rx_counter++]&0x000000FF)*16777216
                                                                              +  (someip_payload_buffer[payload_rx_counter++]&0x000000FF)*65536
                                                                              +  (someip_payload_buffer[payload_rx_counter++]&0x000000FF)*256
                                                                              +  (someip_payload_buffer[payload_rx_counter++]&0x000000FF));
  
  UnitMaster_array_units_timeFormat_available[UnitMaster_units_data_length_element_num] = 1;
  UnitMaster_SetGet_units_update();
}
UnitMaster_Notification_units_timeFormatConfiguration(byte wiretype)
{
  dword length;
  byte  elements;
  
  if (wiretype==5) // 1 Byte Laenge
  {
    length = someip_payload_buffer[payload_rx_counter++]&0x000000FF;
  }
  if (wiretype==6) // 2 Byte Laenge
  {
    length = ((someip_payload_buffer[payload_rx_counter++]&0x000000FF)*256
           +  (someip_payload_buffer[payload_rx_counter++]&0x000000FF));
  }
  if (wiretype==7) // 4 Byte Laenge
  {
    length = ((someip_payload_buffer[payload_rx_counter++]&0x000000FF)*16777216
           +  (someip_payload_buffer[payload_rx_counter++]&0x000000FF)*65536
           +  (someip_payload_buffer[payload_rx_counter++]&0x000000FF)*256
           +  (someip_payload_buffer[payload_rx_counter++]&0x000000FF));
  }
  
  elements = length/4;
  
  for (k=0;k<elements;k++)
  {
    UnitMaster_array_units_timeFormatConfiguration[UnitMaster_units_data_length_element_num][k] = ((someip_payload_buffer[payload_rx_counter++]&0x000000FF)*16777216
                                                                                                +  (someip_payload_buffer[payload_rx_counter++]&0x000000FF)*65536
                                                                                                +  (someip_payload_buffer[payload_rx_counter++]&0x000000FF)*256
                                                                                                +  (someip_payload_buffer[payload_rx_counter++]&0x000000FF));
  }
  UnitMaster_array_units_timeFormatConfiguration_nr_of_elements[UnitMaster_units_data_length_element_num] = elements;
  UnitMaster_array_units_timeFormatConfiguration_available[UnitMaster_units_data_length_element_num] = 1;
  UnitMaster_SetGet_units_update();
}
UnitMaster_Notification_units_volumeUnit()
{
  UnitMaster_array_units_volumeUnit[UnitMaster_units_data_length_element_num] = ((someip_payload_buffer[payload_rx_counter++]&0x000000FF)*16777216
                                                                              +  (someip_payload_buffer[payload_rx_counter++]&0x000000FF)*65536
                                                                              +  (someip_payload_buffer[payload_rx_counter++]&0x000000FF)*256
                                                                              +  (someip_payload_buffer[payload_rx_counter++]&0x000000FF));
  
  UnitMaster_array_units_volumeUnit_available[UnitMaster_units_data_length_element_num] = 1;
  UnitMaster_SetGet_units_update();
}
UnitMaster_Notification_units_volumeUnitConfiguration(byte wiretype)
{
  dword length;
  byte  elements;
  
  if (wiretype==5) // 1 Byte Laenge
  {
    length = someip_payload_buffer[payload_rx_counter++]&0x000000FF;
  }
  if (wiretype==6) // 2 Byte Laenge
  {
    length = ((someip_payload_buffer[payload_rx_counter++]&0x000000FF)*256
           +  (someip_payload_buffer[payload_rx_counter++]&0x000000FF));
  }
  if (wiretype==7) // 4 Byte Laenge
  {
    length = ((someip_payload_buffer[payload_rx_counter++]&0x000000FF)*16777216
           +  (someip_payload_buffer[payload_rx_counter++]&0x000000FF)*65536
           +  (someip_payload_buffer[payload_rx_counter++]&0x000000FF)*256
           +  (someip_payload_buffer[payload_rx_counter++]&0x000000FF));
  }
  
  elements = length/4;
  
  for (k=0;k<elements;k++)
  {
    UnitMaster_array_units_volumeUnitConfiguration[UnitMaster_units_data_length_element_num][k] = ((someip_payload_buffer[payload_rx_counter++]&0x000000FF)*16777216
                                                                                                +  (someip_payload_buffer[payload_rx_counter++]&0x000000FF)*65536
                                                                                                +  (someip_payload_buffer[payload_rx_counter++]&0x000000FF)*256
                                                                                                +  (someip_payload_buffer[payload_rx_counter++]&0x000000FF));
  }
  UnitMaster_array_units_volumeUnitConfiguration_nr_of_elements[UnitMaster_units_data_length_element_num] = elements;
  UnitMaster_array_units_volumeUnitConfiguration_available[UnitMaster_units_data_length_element_num] = 1;
  UnitMaster_SetGet_units_update();
}
UnitMaster_Notification_units_consumptionUnit()
{
  UnitMaster_array_units_consumptionUnit[UnitMaster_units_data_length_element_num] = ((someip_payload_buffer[payload_rx_counter++]&0x000000FF)*16777216
                                                                                   +  (someip_payload_buffer[payload_rx_counter++]&0x000000FF)*65536
                                                                                   +  (someip_payload_buffer[payload_rx_counter++]&0x000000FF)*256
                                                                                   +  (someip_payload_buffer[payload_rx_counter++]&0x000000FF));
  
  UnitMaster_array_units_consumptionUnit_available[UnitMaster_units_data_length_element_num] = 1;
  UnitMaster_SetGet_units_update();
}
UnitMaster_Notification_units_consumptionUnitConfiguration(byte wiretype)
{
  dword length;
  byte  elements;
  
  if (wiretype==5) // 1 Byte Laenge
  {
    length = someip_payload_buffer[payload_rx_counter++]&0x000000FF;
  }
  if (wiretype==6) // 2 Byte Laenge
  {
    length = ((someip_payload_buffer[payload_rx_counter++]&0x000000FF)*256
           +  (someip_payload_buffer[payload_rx_counter++]&0x000000FF));
  }
  if (wiretype==7) // 4 Byte Laenge
  {
    length = ((someip_payload_buffer[payload_rx_counter++]&0x000000FF)*16777216
           +  (someip_payload_buffer[payload_rx_counter++]&0x000000FF)*65536
           +  (someip_payload_buffer[payload_rx_counter++]&0x000000FF)*256
           +  (someip_payload_buffer[payload_rx_counter++]&0x000000FF));
  }
  
  elements = length/4;
  
  for (k=0;k<elements;k++)
  {
    UnitMaster_array_units_consumptionUnitConfiguration[UnitMaster_units_data_length_element_num][k] = ((someip_payload_buffer[payload_rx_counter++]&0x000000FF)*16777216
                                                                                                     +  (someip_payload_buffer[payload_rx_counter++]&0x000000FF)*65536
                                                                                                     +  (someip_payload_buffer[payload_rx_counter++]&0x000000FF)*256
                                                                                                     +  (someip_payload_buffer[payload_rx_counter++]&0x000000FF));
  }
  UnitMaster_array_units_consumptionUnitConfiguration_nr_of_elements[UnitMaster_units_data_length_element_num] = elements;
  UnitMaster_array_units_consumptionUnitConfiguration_available[UnitMaster_units_data_length_element_num] = 1;
  UnitMaster_SetGet_units_update();
}
UnitMaster_Notification_units_consumptionUnitElectr()
{
  UnitMaster_array_units_consumptionUnitElectr[UnitMaster_units_data_length_element_num] = ((someip_payload_buffer[payload_rx_counter++]&0x000000FF)*16777216
                                                                                         +  (someip_payload_buffer[payload_rx_counter++]&0x000000FF)*65536
                                                                                         +  (someip_payload_buffer[payload_rx_counter++]&0x000000FF)*256
                                                                                         +  (someip_payload_buffer[payload_rx_counter++]&0x000000FF));
  
  UnitMaster_array_units_consumptionUnitElectr_available[UnitMaster_units_data_length_element_num] = 1;
  UnitMaster_SetGet_units_update();
}
UnitMaster_Notification_units_consumptionUnitElectrConfiguration(byte wiretype)
{
  dword length;
  byte  elements;
  
  if (wiretype==5) // 1 Byte Laenge
  {
    length = someip_payload_buffer[payload_rx_counter++]&0x000000FF;
  }
  if (wiretype==6) // 2 Byte Laenge
  {
    length = ((someip_payload_buffer[payload_rx_counter++]&0x000000FF)*256
           +  (someip_payload_buffer[payload_rx_counter++]&0x000000FF));
  }
  if (wiretype==7) // 4 Byte Laenge
  {
    length = ((someip_payload_buffer[payload_rx_counter++]&0x000000FF)*16777216
           +  (someip_payload_buffer[payload_rx_counter++]&0x000000FF)*65536
           +  (someip_payload_buffer[payload_rx_counter++]&0x000000FF)*256
           +  (someip_payload_buffer[payload_rx_counter++]&0x000000FF));
  }
  
  elements = length/4;
  
  for (k=0;k<elements;k++)
  {
    UnitMaster_array_units_consumptionUnitElectrConfiguration[UnitMaster_units_data_length_element_num][k] = ((someip_payload_buffer[payload_rx_counter++]&0x000000FF)*16777216
                                                                                                           +  (someip_payload_buffer[payload_rx_counter++]&0x000000FF)*65536
                                                                                                           +  (someip_payload_buffer[payload_rx_counter++]&0x000000FF)*256
                                                                                                           +  (someip_payload_buffer[payload_rx_counter++]&0x000000FF));
  }
  UnitMaster_array_units_consumptionUnitElectrConfiguration_nr_of_elements[UnitMaster_units_data_length_element_num] = elements;
  UnitMaster_array_units_consumptionUnitElectrConfiguration_available[UnitMaster_units_data_length_element_num] = 1;
  UnitMaster_SetGet_units_update();
}
UnitMaster_Notification_units_consumptionUnitGas()
{
  UnitMaster_array_units_consumptionUnitGas[UnitMaster_units_data_length_element_num] = ((someip_payload_buffer[payload_rx_counter++]&0x000000FF)*16777216
                                                                                      +  (someip_payload_buffer[payload_rx_counter++]&0x000000FF)*65536
                                                                                      +  (someip_payload_buffer[payload_rx_counter++]&0x000000FF)*256
                                                                                      +  (someip_payload_buffer[payload_rx_counter++]&0x000000FF));
  
  UnitMaster_array_units_consumptionUnitGas_available[UnitMaster_units_data_length_element_num] = 1;
  UnitMaster_SetGet_units_update();
}
UnitMaster_Notification_units_consumptionUnitGasConfiguration(byte wiretype)
{
  dword length;
  byte  elements;
  
  if (wiretype==5) // 1 Byte Laenge
  {
    length = someip_payload_buffer[payload_rx_counter++]&0x000000FF;
  }
  if (wiretype==6) // 2 Byte Laenge
  {
    length = ((someip_payload_buffer[payload_rx_counter++]&0x000000FF)*256
           +  (someip_payload_buffer[payload_rx_counter++]&0x000000FF));
  }
  if (wiretype==7) // 4 Byte Laenge
  {
    length = ((someip_payload_buffer[payload_rx_counter++]&0x000000FF)*16777216
           +  (someip_payload_buffer[payload_rx_counter++]&0x000000FF)*65536
           +  (someip_payload_buffer[payload_rx_counter++]&0x000000FF)*256
           +  (someip_payload_buffer[payload_rx_counter++]&0x000000FF));
  }
  
  elements = length/4;
  
  for (k=0;k<elements;k++)
  {
    UnitMaster_array_units_consumptionUnitGasConfiguration[UnitMaster_units_data_length_element_num][k] = ((someip_payload_buffer[payload_rx_counter++]&0x000000FF)*16777216
                                                                                                        +  (someip_payload_buffer[payload_rx_counter++]&0x000000FF)*65536
                                                                                                        +  (someip_payload_buffer[payload_rx_counter++]&0x000000FF)*256
                                                                                                        +  (someip_payload_buffer[payload_rx_counter++]&0x000000FF));
  }
  UnitMaster_array_units_consumptionUnitGasConfiguration_nr_of_elements[UnitMaster_units_data_length_element_num] = elements;
  UnitMaster_array_units_consumptionUnitGasConfiguration_available[UnitMaster_units_data_length_element_num] = 1;
  UnitMaster_SetGet_units_update();
}
UnitMaster_Notification_units_massUnit()
{
  UnitMaster_array_units_massUnit[UnitMaster_units_data_length_element_num] = ((someip_payload_buffer[payload_rx_counter++]&0x000000FF)*16777216
                                                                            +  (someip_payload_buffer[payload_rx_counter++]&0x000000FF)*65536
                                                                            +  (someip_payload_buffer[payload_rx_counter++]&0x000000FF)*256
                                                                            +  (someip_payload_buffer[payload_rx_counter++]&0x000000FF));
  
  UnitMaster_array_units_massUnit_available[UnitMaster_units_data_length_element_num] = 1;
  UnitMaster_SetGet_units_update();
}
UnitMaster_Notification_units_massUnitConfiguration(byte wiretype)
{
  dword length;
  byte  elements;
  
  if (wiretype==5) // 1 Byte Laenge
  {
    length = someip_payload_buffer[payload_rx_counter++]&0x000000FF;
  }
  if (wiretype==6) // 2 Byte Laenge
  {
    length = ((someip_payload_buffer[payload_rx_counter++]&0x000000FF)*256
           +  (someip_payload_buffer[payload_rx_counter++]&0x000000FF));
  }
  if (wiretype==7) // 4 Byte Laenge
  {
    length = ((someip_payload_buffer[payload_rx_counter++]&0x000000FF)*16777216
           +  (someip_payload_buffer[payload_rx_counter++]&0x000000FF)*65536
           +  (someip_payload_buffer[payload_rx_counter++]&0x000000FF)*256
           +  (someip_payload_buffer[payload_rx_counter++]&0x000000FF));
  }
  
  elements = length/4;
  
  for (k=0;k<elements;k++)
  {
    UnitMaster_array_units_massUnitConfiguration[UnitMaster_units_data_length_element_num][k] = ((someip_payload_buffer[payload_rx_counter++]&0x000000FF)*16777216
                                                                                              +  (someip_payload_buffer[payload_rx_counter++]&0x000000FF)*65536
                                                                                              +  (someip_payload_buffer[payload_rx_counter++]&0x000000FF)*256
                                                                                              +  (someip_payload_buffer[payload_rx_counter++]&0x000000FF));
  }
  UnitMaster_array_units_massUnitConfiguration_nr_of_elements[UnitMaster_units_data_length_element_num] = elements;
  UnitMaster_array_units_massUnitConfiguration_available[UnitMaster_units_data_length_element_num] = 1;
  UnitMaster_SetGet_units_update();
}









//////////////////////////////////////////////////////////
////////////////// Service DisplaySpeed //////////////////
//////////////////////////////////////////////////////////

on envVar ServiceDiscovery_Find_Service_DisplaySpeed
{
  if (@this == 1) Send_ServiceDiscovery_Find_Service_ICAS1Sys02();
}

on envVar DisplaySpeed_SetGet_speeds_Get
{
  if (@this == 1)
  {
    UDP_Segments_total = @DisplaySpeed_SetGet_Length_speeds/1404 + 1;
    UDP_Segments_left  = UDP_Segments_total;
    
    if (UDP_Segments_total > 1) seg_id_flag = 1;
    else                        seg_id_flag = 0;
    
    Send_Service_DisplaySpeed_SetGet (0x4010 & 0x0000FFFF);
  }
}
on envVar DisplaySpeed_SetGet_speedWarnings_Get
{
  if (@this == 1)
  {
    UDP_Segments_total = @DisplaySpeed_SetGet_Length_speedWarnings/1404 + 1;
    UDP_Segments_left  = UDP_Segments_total;
    
    if (UDP_Segments_total > 1) seg_id_flag = 1;
    else                        seg_id_flag = 0;
    
    Send_Service_DisplaySpeed_SetGet (0x4020 & 0x0000FFFF);
  }
}
on envVar DisplaySpeed_SetGet_speedWarnings_Set
{
  if (@this == 1)
  {
    UDP_Segments_total = @DisplaySpeed_SetGet_Length_speedWarnings/1404 + 1;
    UDP_Segments_left  = UDP_Segments_total;
    
    if (UDP_Segments_total > 1) seg_id_flag = 1;
    else                        seg_id_flag = 0;
    
    Send_Service_DisplaySpeed_SetGet (0x4021 & 0x0000FFFF);
  }
}
on envVar DisplaySpeed_SetGet_speedBlockings_Get
{
  if (@this == 1)
  {
    UDP_Segments_total = @DisplaySpeed_SetGet_Length_speedBlockings/1404 + 1;
    UDP_Segments_left  = UDP_Segments_total;
    
    if (UDP_Segments_total > 1) seg_id_flag = 1;
    else                        seg_id_flag = 0;
    
    Send_Service_DisplaySpeed_SetGet (0x4030 & 0x0000FFFF);
  }
}
on envVar DisplaySpeed_Subscribe_speeds
{
  if (get_subAck_flag == 0)
    Send_ServiceDiscovery_Subscribe_ICAS1Sys02 (0x6021, 0xC010, @this);
  
  DisplaySpeed_SubscribeStatus_speeds = @this;
}
on envVar DisplaySpeed_Subscribe_speedWarnings
{
  if (get_subAck_flag == 0)
    Send_ServiceDiscovery_Subscribe_ICAS1Sys02 (0x6021, 0xC020, @this);
  
  DisplaySpeed_SubscribeStatus_speedWarnings = @this;
}
on envVar DisplaySpeed_Subscribe_speedBlockings
{
  if (get_subAck_flag == 0)
    Send_ServiceDiscovery_Subscribe_ICAS1Sys02 (0x6021, 0xC030, @this);
  
  DisplaySpeed_SubscribeStatus_speedBlockings = @this;
}


Send_Service_DisplaySpeed_SetGet (word MethodID)
{
  ethernetPacket EthPaket;

  // Ethernet Packet - MAC Source address
  getvalue (ServiceDiscovery_EthernetPacket_MAC_Source_ICAS1Sys02, buffer_MAC);
  //EthPaket.source.ParseAddress ( buffer_MAC );
  EthPaket.source = ethGetMacAddressAsNumber (buffer_MAC);
  
  // Ethernet Packet - MAC Destination address
  getvalue (ServiceDiscovery_EthernetPacket_MAC_Destination, buffer_MAC);
  //EthPaket.destination.ParseAddress ( buffer_MAC );
  EthPaket.destination = ethGetMacAddressAsNumber (buffer_MAC);
  
  // Ethernet Packet - VLAN
  EthPaket.SetVlan (@ServiceDiscovery_EthernetPacket_VLAN_TPID, @ServiceDiscovery_EthernetPacket_VLAN_TCI);
  
  // Ethernet Packet - Type
  //EthPaket.ipv6.type = @EthernetPacket_Type;
  if (@ServiceDiscovery_EthernetPacket_Type == 0x86DD) EthPaket.ipv6.Init();
  
  
  // IPv6 Packet - Version
  EthPaket.ipv6.version = @ServiceDiscovery_IPv6Packet_Version;

  // IPv6 Packet - Traffic Class
  EthPaket.ipv6.class = @ServiceDiscovery_IPv6Packet_Traffic_Class;
  
  // IPv6 Packet - Flow Label
  EthPaket.ipv6.flow = @ServiceDiscovery_IPv6Packet_Flow_Label;
  
  // IPv6 Packet - Payload_Length
  EthPaket.ipv6.length = @ServiceDiscovery_IPv6Packet_Payload_Length;
  
  // IPv6 Packet - Next Header
  EthPaket.ipv6.next = @ServiceDiscovery_IPv6Packet_Next_Header;
  if (@ServiceDiscovery_IPv6Packet_Next_Header == 6) EthPaket.tcp.Init();
  if (@ServiceDiscovery_IPv6Packet_Next_Header == 17) EthPaket.udp.Init();
  
  // IPv6 Packet - Hop Limit
  EthPaket.ipv6.hopLimit = @ServiceDiscovery_IPv6Packet_Hop_Limit;

  // IPv6 Packet - IPv6 Destination address    // TODO: char array zu byte array
  buffer_ipv6[0]  = @ServiceDiscovery_IPv6Packet_IP_Destination_Unicast_01>>8 & 0xFF;
  buffer_ipv6[1]  = @ServiceDiscovery_IPv6Packet_IP_Destination_Unicast_01    & 0xFF;
  buffer_ipv6[2]  = @ServiceDiscovery_IPv6Packet_IP_Destination_Unicast_02>>8 & 0xFF;
  buffer_ipv6[3]  = @ServiceDiscovery_IPv6Packet_IP_Destination_Unicast_02    & 0xFF;
  buffer_ipv6[4]  = @ServiceDiscovery_IPv6Packet_IP_Destination_Unicast_03>>8 & 0xFF;
  buffer_ipv6[5]  = @ServiceDiscovery_IPv6Packet_IP_Destination_Unicast_03    & 0xFF;
  buffer_ipv6[6]  = @ServiceDiscovery_IPv6Packet_IP_Destination_Unicast_04>>8 & 0xFF;
  buffer_ipv6[7]  = @ServiceDiscovery_IPv6Packet_IP_Destination_Unicast_04    & 0xFF;
  buffer_ipv6[8]  = @ServiceDiscovery_IPv6Packet_IP_Destination_Unicast_05>>8 & 0xFF;
  buffer_ipv6[9]  = @ServiceDiscovery_IPv6Packet_IP_Destination_Unicast_05    & 0xFF;
  buffer_ipv6[10] = @ServiceDiscovery_IPv6Packet_IP_Destination_Unicast_06>>8 & 0xFF;
  buffer_ipv6[11] = @ServiceDiscovery_IPv6Packet_IP_Destination_Unicast_06    & 0xFF;
  buffer_ipv6[12] = @ServiceDiscovery_IPv6Packet_IP_Destination_Unicast_07>>8 & 0xFF;
  buffer_ipv6[13] = @ServiceDiscovery_IPv6Packet_IP_Destination_Unicast_07    & 0xFF;
  buffer_ipv6[14] = @ServiceDiscovery_IPv6Packet_IP_Destination_Unicast_08>>8 & 0xFF;
  buffer_ipv6[15] = @ServiceDiscovery_IPv6Packet_IP_Destination_Unicast_08    & 0xFF;
  EthPaket.ipv6.destination.SetData ( 0, buffer_ipv6, elcount(buffer_ipv6) );

  // IPv6 Packet - IPv6 Source address    // TODO: char array zu byte array
  buffer_ipv6[0]  = @ServiceDiscovery_IPv6Packet_IP_Source_ICAS1Sys02_01>>8 & 0xFF;
  buffer_ipv6[1]  = @ServiceDiscovery_IPv6Packet_IP_Source_ICAS1Sys02_01    & 0xFF;
  buffer_ipv6[2]  = @ServiceDiscovery_IPv6Packet_IP_Source_ICAS1Sys02_02>>8 & 0xFF;
  buffer_ipv6[3]  = @ServiceDiscovery_IPv6Packet_IP_Source_ICAS1Sys02_02    & 0xFF;
  buffer_ipv6[4]  = @ServiceDiscovery_IPv6Packet_IP_Source_ICAS1Sys02_03>>8 & 0xFF;
  buffer_ipv6[5]  = @ServiceDiscovery_IPv6Packet_IP_Source_ICAS1Sys02_03    & 0xFF;
  buffer_ipv6[6]  = @ServiceDiscovery_IPv6Packet_IP_Source_ICAS1Sys02_04>>8 & 0xFF;
  buffer_ipv6[7]  = @ServiceDiscovery_IPv6Packet_IP_Source_ICAS1Sys02_04    & 0xFF;
  buffer_ipv6[8]  = @ServiceDiscovery_IPv6Packet_IP_Source_ICAS1Sys02_05>>8 & 0xFF;
  buffer_ipv6[9]  = @ServiceDiscovery_IPv6Packet_IP_Source_ICAS1Sys02_05    & 0xFF;
  buffer_ipv6[10] = @ServiceDiscovery_IPv6Packet_IP_Source_ICAS1Sys02_06>>8 & 0xFF;
  buffer_ipv6[11] = @ServiceDiscovery_IPv6Packet_IP_Source_ICAS1Sys02_06    & 0xFF;
  buffer_ipv6[12] = @ServiceDiscovery_IPv6Packet_IP_Source_ICAS1Sys02_07>>8 & 0xFF;
  buffer_ipv6[13] = @ServiceDiscovery_IPv6Packet_IP_Source_ICAS1Sys02_07    & 0xFF;
  buffer_ipv6[14] = @ServiceDiscovery_IPv6Packet_IP_Source_ICAS1Sys02_08>>8 & 0xFF;
  buffer_ipv6[15] = @ServiceDiscovery_IPv6Packet_IP_Source_ICAS1Sys02_08    & 0xFF;
  EthPaket.ipv6.source.SetData ( 0, buffer_ipv6, elcount(buffer_ipv6) );

  
  // UDP Packet - Source Port
  EthPaket.udp.source = @DisplaySpeed_SetGet_Port_Source;
  
  // UDP Packet - Destination Port
  EthPaket.udp.destination = @DisplaySpeed_SetGet_Port_Destination;
  
  // UDP Packet - Length
  EthPaket.udp.length = @ServiceDiscovery_UDPPacket_Length;
  
  
  // SOME/IP Packet aus Rohdaten zusammenbauen (buffer array)
  i=0;
  
  // SOME/IP Packet - Message ID, Service ID [16 bit]
  buffer[i++] = @DisplaySpeed_SetGet_Message_ID_Service_ID>>8 & 0xFF;
  buffer[i++] = @DisplaySpeed_SetGet_Message_ID_Service_ID    & 0xFF;
  
  // SOME/IP Packet - Message ID, Message ID [16 bit]
  switch (MethodID)
  {
    case 0x4010: @DisplaySpeed_SetGet_Message_ID_Method_ID = @DisplaySpeed_SetGet_Message_ID_Method_ID_speeds_Get; break;
    case 0x4020: @DisplaySpeed_SetGet_Message_ID_Method_ID = @DisplaySpeed_SetGet_Message_ID_Method_ID_speedWarnings_Get; break;
    case 0x4021: @DisplaySpeed_SetGet_Message_ID_Method_ID = @DisplaySpeed_SetGet_Message_ID_Method_ID_speedWarnings_Set; break;
    case 0x4030: @DisplaySpeed_SetGet_Message_ID_Method_ID = @DisplaySpeed_SetGet_Message_ID_Method_ID_speedBlockings_Get; break;
  }
  buffer[i++] = @DisplaySpeed_SetGet_Message_ID_Method_ID>>8 & 0xFF;
  buffer[i++] = @DisplaySpeed_SetGet_Message_ID_Method_ID    & 0xFF;
  
  // SOME/IP Packet - Length [32 bit]
  if (UDP_Segments_total == 1)
  {
    switch (MethodID)
    {
      case 0x4010: @DisplaySpeed_SetGet_Length = 8; break;
      case 0x4020: @DisplaySpeed_SetGet_Length = 8; break;
      case 0x4021: @DisplaySpeed_SetGet_Length = @DisplaySpeed_SetGet_Length_speedWarnings; break;
      case 0x4030: @DisplaySpeed_SetGet_Length = 8; break;
    }
  }
  else
  {
    if (UDP_Segments_left > 1)
    {
      switch (MethodID)
      {
        case 0x4021: @DisplaySpeed_SetGet_Length = 1404; break;
      }
    }
    else
    {
      switch (MethodID)
      {
        case 0x4021: @DisplaySpeed_SetGet_Length = DisplaySpeed_payload_length_speedWarnings - 1404*(UDP_Segments_total-UDP_Segments_left) + 24; break;
      }
    }
  }
  buffer[i++] = @DisplaySpeed_SetGet_Length>>24 & 0xFF;
  buffer[i++] = @DisplaySpeed_SetGet_Length>>16 & 0xFF;
  buffer[i++] = @DisplaySpeed_SetGet_Length>> 8 & 0xFF;
  buffer[i++] = @DisplaySpeed_SetGet_Length     & 0xFF;
  
  // SOME/IP Packet - Request ID, Client ID [16 bit]
  buffer[i++] = @DisplaySpeed_SetGet_Request_ID_Client_ID>>8 & 0xFF;
  buffer[i++] = @DisplaySpeed_SetGet_Request_ID_Client_ID    & 0xFF;
  
  // SOME/IP Packet - Request ID, Session ID) [16 bit]
  if ((UDP_Segments_total == 1) || (seg_id_flag == 1))
  {
    @ServiceDiscovery_SOMEIPPacket_Notification_Request_ID_Session_ID = @ServiceDiscovery_SOMEIPPacket_Notification_Request_ID_Session_ID + 1;
    if (@ServiceDiscovery_SOMEIPPacket_Notification_Request_ID_Session_ID == 0x10000) @ServiceDiscovery_SOMEIPPacket_Notification_Request_ID_Session_ID = 1;
    seg_id_flag = 0;
  }
  
  buffer[i++] = @ServiceDiscovery_SOMEIPPacket_Notification_Request_ID_Session_ID>>8 & 0xFF;
  buffer[i++] = @ServiceDiscovery_SOMEIPPacket_Notification_Request_ID_Session_ID    & 0xFF;
  
  // SOME/IP Packet - Protocol Version [8 bit]
  buffer[i++] = @DisplaySpeed_SetGet_Protocol_Version;
  
  // SOME/IP Packet - Interface Version [8 bit]
  buffer[i++] = @DisplaySpeed_SetGet_Interface_Version;
  
  // SOME/IP Packet - Message Type [8 bit]
  buffer[i++] = @DisplaySpeed_SetGet_Message_Type;
  
  // SOME/IP Packet - Return Code [8 bit]
  buffer[i++] = @DisplaySpeed_SetGet_Return_Code;
  
  
  if (UDP_Segments_total > 1)
  {
    if (UDP_Segments_left >= 0)
    { 
      // Message Type neu setzen
      buffer[i-2] = @DisplaySpeed_SetGet_Message_Type + 0x20;
      
      // Offset (16byte Schritte, 1392/16 = 87)
      @DisplaySpeed_SetGet_Offset = 87 * (UDP_Segments_total - UDP_Segments_left);
      
      // More Segments Flag
      if (UDP_Segments_left > 1) @DisplaySpeed_SetGet_More_Segments_Flag = 1;
      else                       @DisplaySpeed_SetGet_More_Segments_Flag = 0;
      
      buffer[i++] =   @DisplaySpeed_SetGet_Offset>>20 & 0xFF;
      buffer[i++] =   @DisplaySpeed_SetGet_Offset>>12 & 0xFF;
      buffer[i++] =   @DisplaySpeed_SetGet_Offset>>4  & 0xFF;
      buffer[i++] = ((@DisplaySpeed_SetGet_Offset<<4) & 0xF0) + (@DisplaySpeed_SetGet_More_Segments_Flag & 0x01);
    }
  }
  
  UDP_Segments_left--;
  
  ////// speedWarnings setter //////
  if (MethodID == 0x4021)
  {
    if (UDP_Segments_total == 1)
    {
      for (j=0; j<DisplaySpeed_payload_length_speedWarnings; j++)
        buffer[i++] = DisplaySpeed_payload_buffer_speedWarnings[j];
    }
    else
    {
      if (UDP_Segments_left >= 1)
      {
        for (j=(UDP_Segments_total-UDP_Segments_left-1)*1392; j<(UDP_Segments_total-UDP_Segments_left)*1392; j++)
          buffer[i++] = DisplaySpeed_payload_buffer_speedWarnings[j];
      }
      else
      {
        for (j=(UDP_Segments_total-(UDP_Segments_left+1))*1392; j<DisplaySpeed_payload_length_speedWarnings; j++)
          buffer[i++] = DisplaySpeed_payload_buffer_speedWarnings[j];
      }
    }
  }
    
  // Rohdaten in UDP Paket schreiben
  EthPaket.udp.SetData( 0, buffer, i );

  // calculate UDP and IPv6 checksum and send Ethernet packet
  EthPaket.CompletePacket();
  output( EthPaket );
  
  // prüfen ob alle Segemente gesendet wurden, sonst senden erneut aufrufen
  DisplaySpeed_Segmentation_Method_ID = MethodID;
  if (UDP_Segments_left>0)
    settimer(DisplaySpeed_Segmentation_delay, 50);
}

on timer DisplaySpeed_Segmentation_delay
{
  Send_Service_DisplaySpeed_SetGet (DisplaySpeed_Segmentation_Method_ID);
}



////////// speeds //////////

on envVar DisplaySpeed_SetGet_LengthIndicator_Struct_speeds
{
  DisplaySpeed_SetGet_speeds();
}
on envVar DisplaySpeed_SetGet_LengthIndicator_Element_speeds
{
  DisplaySpeed_SetGet_speeds();
}
on envVar DisplaySpeed_SetGet_speeds_type
{
  DisplaySpeed_array_speeds_type[@DisplaySpeed_SetGet_speeds_Element] = @this;
  DisplaySpeed_SetGet_speeds();
}
on envVar DisplaySpeed_SetGet_speeds_currentValue
{
  DisplaySpeed_array_speeds_currentValue[@DisplaySpeed_SetGet_speeds_Element] = @this;
  DisplaySpeed_SetGet_speeds();
}
on envVar DisplaySpeed_SetGet_speeds_restrictionReason
{
  DisplaySpeed_array_speeds_restrictionReason[@DisplaySpeed_SetGet_speeds_Element] = @this;
  DisplaySpeed_SetGet_speeds();
}
on envVar DisplaySpeed_SetGet_speeds_unit
{
  DisplaySpeed_array_speeds_unit[@DisplaySpeed_SetGet_speeds_Element] = @this;
  DisplaySpeed_SetGet_speeds();
}
on envVar DisplaySpeed_SetGet_speeds_isDisplayActivated
{
  DisplaySpeed_array_speeds_isDisplayActivated[@DisplaySpeed_SetGet_speeds_Element] = @this;
  DisplaySpeed_SetGet_speeds();
}
on envVar DisplaySpeed_SetGet_speeds_maxValue
{
  DisplaySpeed_array_speeds_maxValue[@DisplaySpeed_SetGet_speeds_Element] = @this;
  DisplaySpeed_SetGet_speeds();
}
on envVar DisplaySpeed_SetGet_speeds_minValue
{
  DisplaySpeed_array_speeds_minValue[@DisplaySpeed_SetGet_speeds_Element] = @this;
  DisplaySpeed_SetGet_speeds();
}
on envVar DisplaySpeed_SetGet_speeds_resolution
{
  DisplaySpeed_array_speeds_resolution[@DisplaySpeed_SetGet_speeds_Element] = @this;
  DisplaySpeed_SetGet_speeds();
}
on envVar DisplaySpeed_SetGet_speeds_type_available
{
  DisplaySpeed_array_speeds_type_available[@DisplaySpeed_SetGet_speeds_Element] = @this;
  DisplaySpeed_SetGet_speeds();
}
on envVar DisplaySpeed_SetGet_speeds_currentValue_available
{
  DisplaySpeed_array_speeds_currentValue_available[@DisplaySpeed_SetGet_speeds_Element] = @this;
  DisplaySpeed_SetGet_speeds();
}
on envVar DisplaySpeed_SetGet_speeds_restrictionReason_available
{
  DisplaySpeed_array_speeds_restrictionReason_available[@DisplaySpeed_SetGet_speeds_Element] = @this;
  DisplaySpeed_SetGet_speeds();
}
on envVar DisplaySpeed_SetGet_speeds_unit_available
{
  DisplaySpeed_array_speeds_unit_available[@DisplaySpeed_SetGet_speeds_Element] = @this;
  DisplaySpeed_SetGet_speeds();
}
on envVar DisplaySpeed_SetGet_speeds_isDisplayActivated_available
{
  DisplaySpeed_array_speeds_isDisplayActivated_available[@DisplaySpeed_SetGet_speeds_Element] = @this;
  DisplaySpeed_SetGet_speeds();
}
on envVar DisplaySpeed_SetGet_speeds_maxValue_available
{
  DisplaySpeed_array_speeds_maxValue_available[@DisplaySpeed_SetGet_speeds_Element] = @this;
  DisplaySpeed_SetGet_speeds();
}
on envVar DisplaySpeed_SetGet_speeds_minValue_available
{
  DisplaySpeed_array_speeds_minValue_available[@DisplaySpeed_SetGet_speeds_Element] = @this;
  DisplaySpeed_SetGet_speeds();
}
on envVar DisplaySpeed_SetGet_speeds_resolution_available
{
  DisplaySpeed_array_speeds_resolution_available[@DisplaySpeed_SetGet_speeds_Element] = @this;
  DisplaySpeed_SetGet_speeds();
}
on envVar DisplaySpeed_SetGet_speeds_Payload
{
  DisplaySpeed_SetGet_speeds_update();
}


DisplaySpeed_SetGet_speeds()
{
  word payload_counter = 0;
  word start_pos       = 0;
  word element_length  = 0;
  
  // Length Indicator Struct - Platzhalter
  payload_counter = 0+4;
  start_pos = 0;
  
  for (j=0; j<@DisplaySpeed_SetGet_speeds_Element_TotalNum; j++)
  {
    DisplaySpeed_array_speeds_available_functions[j] = DisplaySpeed_array_speeds_type_available[j]
                                                            + DisplaySpeed_array_speeds_currentValue_available[j]
                                                            + DisplaySpeed_array_speeds_restrictionReason_available[j]
                                                            + DisplaySpeed_array_speeds_unit_available[j]
																	                          + DisplaySpeed_array_speeds_isDisplayActivated_available[j]
																	                          + DisplaySpeed_array_speeds_maxValue_available[j]
															                              + DisplaySpeed_array_speeds_minValue_available[j]
                                                            + DisplaySpeed_array_speeds_resolution_available[j];
    
    // Length Indicator Element - Platzhalter
    if (DisplaySpeed_array_speeds_available_functions[j] > 0)
    {
      start_pos = payload_counter;
      payload_counter = payload_counter + 4;
    }
    else 
      start_pos = payload_counter;
    
    
    // 0 type (enum32)
    if (DisplaySpeed_array_speeds_type_available[j] == 1)
    {
      tag_dataID = 0;
      DisplaySpeed_payload_buffer_speeds[payload_counter++] = 2 * 16 /* Wiretype = 2  =^ 32 Bit */ + ((tag_dataID>>8) & 0x0F) /* DataID High Part */ ;
      DisplaySpeed_payload_buffer_speeds[payload_counter++] = tag_dataID & 0xFF /* DataID Low Part */ ;
      
      DisplaySpeed_payload_buffer_speeds[payload_counter++] = DisplaySpeed_array_speeds_type[j]>>24 & 0xFF;
      DisplaySpeed_payload_buffer_speeds[payload_counter++] = DisplaySpeed_array_speeds_type[j]>>16 & 0xFF;
      DisplaySpeed_payload_buffer_speeds[payload_counter++] = DisplaySpeed_array_speeds_type[j]>> 8 & 0xFF;
      DisplaySpeed_payload_buffer_speeds[payload_counter++] = DisplaySpeed_array_speeds_type[j]     & 0xFF;
    }
    
    
    // 1 currentValue (float32)
    if (DisplaySpeed_array_speeds_currentValue_available[j] == 1)
    {
      tag_dataID = 1;
      DisplaySpeed_payload_buffer_speeds[payload_counter++] = 2 * 16 /* Wiretype = 2  =^ 32 Bit */ + ((tag_dataID>>8) & 0x0F) /* DataID High Part */ ;
      DisplaySpeed_payload_buffer_speeds[payload_counter++] = tag_dataID & 0xFF /* DataID Low Part */ ;
      
      temp_converttodword = interpretAsDword (DisplaySpeed_array_speeds_currentValue[j]);
      DisplaySpeed_payload_buffer_speeds[payload_counter++] = temp_converttodword>>24 & 0xFF;
      DisplaySpeed_payload_buffer_speeds[payload_counter++] = temp_converttodword>>16 & 0xFF;
      DisplaySpeed_payload_buffer_speeds[payload_counter++] = temp_converttodword>> 8 & 0xFF;
      DisplaySpeed_payload_buffer_speeds[payload_counter++] = temp_converttodword     & 0xFF;
    }
    
    
    // 2 restrictionReason (enum32)
    if (DisplaySpeed_array_speeds_restrictionReason_available[j] == 1)
    {
      tag_dataID = 2;
      DisplaySpeed_payload_buffer_speeds[payload_counter++] = 2 * 16 /* Wiretype = 2  =^ 32 Bit */ + ((tag_dataID>>8) & 0x0F) /* DataID High Part */ ;
      DisplaySpeed_payload_buffer_speeds[payload_counter++] = tag_dataID & 0xFF /* DataID Low Part */ ;
      
      DisplaySpeed_payload_buffer_speeds[payload_counter++] = DisplaySpeed_array_speeds_restrictionReason[j]>>24 & 0xFF;
      DisplaySpeed_payload_buffer_speeds[payload_counter++] = DisplaySpeed_array_speeds_restrictionReason[j]>>16 & 0xFF;
      DisplaySpeed_payload_buffer_speeds[payload_counter++] = DisplaySpeed_array_speeds_restrictionReason[j]>> 8 & 0xFF;
      DisplaySpeed_payload_buffer_speeds[payload_counter++] = DisplaySpeed_array_speeds_restrictionReason[j]     & 0xFF;
    }
    
    
    // 3 unit (enum32)
    if (DisplaySpeed_array_speeds_unit_available[j] == 1)
    {
      tag_dataID = 3;
      DisplaySpeed_payload_buffer_speeds[payload_counter++] = 2 * 16 /* Wiretype = 2  =^ 32 Bit */ + ((tag_dataID>>8) & 0x0F) /* DataID High Part */ ;
      DisplaySpeed_payload_buffer_speeds[payload_counter++] = tag_dataID & 0xFF /* DataID Low Part */ ;
      
      DisplaySpeed_payload_buffer_speeds[payload_counter++] = DisplaySpeed_array_speeds_unit[j]>>24 & 0xFF;
      DisplaySpeed_payload_buffer_speeds[payload_counter++] = DisplaySpeed_array_speeds_unit[j]>>16 & 0xFF;
      DisplaySpeed_payload_buffer_speeds[payload_counter++] = DisplaySpeed_array_speeds_unit[j]>> 8 & 0xFF;
      DisplaySpeed_payload_buffer_speeds[payload_counter++] = DisplaySpeed_array_speeds_unit[j]     & 0xFF;
    }
    
    
    // 4 isDisplayActivated (enum32)
    if (DisplaySpeed_array_speeds_isDisplayActivated_available[j] == 1)
    {
      tag_dataID = 4;
      DisplaySpeed_payload_buffer_speeds[payload_counter++] = 0 * 16 /* Wiretype = 0  =^ 8 Bit */ + ((tag_dataID>>8) & 0x0F) /* DataID High Part */ ;
      DisplaySpeed_payload_buffer_speeds[payload_counter++] = tag_dataID & 0xFF /* DataID Low Part */ ;
      
      DisplaySpeed_payload_buffer_speeds[payload_counter++] = DisplaySpeed_array_speeds_isDisplayActivated[j] & 0xFF;
    }
    
    
    // 5 maxValue (uint32)
    if (DisplaySpeed_array_speeds_maxValue_available[j] == 1)
    {
      tag_dataID = 5;
      DisplaySpeed_payload_buffer_speeds[payload_counter++] = 2 * 16 /* Wiretype = 2  =^ 32 Bit */ + ((tag_dataID>>8) & 0x0F) /* DataID High Part */ ;
      DisplaySpeed_payload_buffer_speeds[payload_counter++] = tag_dataID & 0xFF /* DataID Low Part */ ;
      
      DisplaySpeed_payload_buffer_speeds[payload_counter++] = DisplaySpeed_array_speeds_maxValue[j]>>24 & 0xFF;
      DisplaySpeed_payload_buffer_speeds[payload_counter++] = DisplaySpeed_array_speeds_maxValue[j]>>16 & 0xFF;
      DisplaySpeed_payload_buffer_speeds[payload_counter++] = DisplaySpeed_array_speeds_maxValue[j]>> 8 & 0xFF;
      DisplaySpeed_payload_buffer_speeds[payload_counter++] = DisplaySpeed_array_speeds_maxValue[j]     & 0xFF;
    }
    
    
    // 6 minValue (uint32)
    if (DisplaySpeed_array_speeds_minValue_available[j] == 1)
    {
      tag_dataID = 6;
      DisplaySpeed_payload_buffer_speeds[payload_counter++] = 2 * 16 /* Wiretype = 2  =^ 32 Bit */ + ((tag_dataID>>8) & 0x0F) /* DataID High Part */ ;
      DisplaySpeed_payload_buffer_speeds[payload_counter++] = tag_dataID & 0xFF /* DataID Low Part */ ;
      
      DisplaySpeed_payload_buffer_speeds[payload_counter++] = DisplaySpeed_array_speeds_minValue[j]>>24 & 0xFF;
      DisplaySpeed_payload_buffer_speeds[payload_counter++] = DisplaySpeed_array_speeds_minValue[j]>>16 & 0xFF;
      DisplaySpeed_payload_buffer_speeds[payload_counter++] = DisplaySpeed_array_speeds_minValue[j]>> 8 & 0xFF;
      DisplaySpeed_payload_buffer_speeds[payload_counter++] = DisplaySpeed_array_speeds_minValue[j]     & 0xFF;
    }
    
    
    // 7 resolution (float32)
    if (DisplaySpeed_array_speeds_resolution_available[j] == 1)
    {
      tag_dataID = 7;
      DisplaySpeed_payload_buffer_speeds[payload_counter++] = 2 * 16 /* Wiretype = 2  =^ 32 Bit */ + ((tag_dataID>>8) & 0x0F) /* DataID High Part */ ;
      DisplaySpeed_payload_buffer_speeds[payload_counter++] = tag_dataID & 0xFF /* DataID Low Part */ ;
      
      temp_converttodword = interpretAsDword (DisplaySpeed_array_speeds_resolution[j]);
      DisplaySpeed_payload_buffer_speeds[payload_counter++] = temp_converttodword>>24 & 0xFF;
      DisplaySpeed_payload_buffer_speeds[payload_counter++] = temp_converttodword>>16 & 0xFF;
      DisplaySpeed_payload_buffer_speeds[payload_counter++] = temp_converttodword>> 8 & 0xFF;
      DisplaySpeed_payload_buffer_speeds[payload_counter++] = temp_converttodword     & 0xFF;
    }
    
    
    //Element Length
    element_length = payload_counter-start_pos;
    if (element_length >0) DisplaySpeed_array_speeds_array_element_length[j] = element_length - 4;
    else                   DisplaySpeed_array_speeds_array_element_length[j] = element_length;
    
    DisplaySpeed_payload_buffer_speeds[start_pos++] = DisplaySpeed_array_speeds_array_element_length[j]>>24 & 0xFF;
    DisplaySpeed_payload_buffer_speeds[start_pos++] = DisplaySpeed_array_speeds_array_element_length[j]>>16 & 0xFF;
    DisplaySpeed_payload_buffer_speeds[start_pos++] = DisplaySpeed_array_speeds_array_element_length[j]>> 8 & 0xFF;
    DisplaySpeed_payload_buffer_speeds[start_pos++] = DisplaySpeed_array_speeds_array_element_length[j]     & 0xFF;
    
    if (DisplaySpeed_array_speeds_array_element_length[j] == 0) payload_counter = payload_counter+4;
  }
  
  // Struct Length
  DisplaySpeed_array_speeds_struct_element_length = 4*@DisplaySpeed_SetGet_speeds_Element_TotalNum;

  for (k=0;k<@DisplaySpeed_SetGet_speeds_Element_TotalNum;k++)
    DisplaySpeed_array_speeds_struct_element_length = DisplaySpeed_array_speeds_struct_element_length + DisplaySpeed_array_speeds_array_element_length[k];
  
  DisplaySpeed_payload_buffer_speeds[0] = DisplaySpeed_array_speeds_struct_element_length>>24 & 0xFF;
  DisplaySpeed_payload_buffer_speeds[1] = DisplaySpeed_array_speeds_struct_element_length>>16 & 0xFF;
  DisplaySpeed_payload_buffer_speeds[2] = DisplaySpeed_array_speeds_struct_element_length>> 8 & 0xFF;
  DisplaySpeed_payload_buffer_speeds[3] = DisplaySpeed_array_speeds_struct_element_length     & 0xFF;


  DisplaySpeed_payload_length_speeds = DisplaySpeed_array_speeds_struct_element_length+4;
  putvalue(DisplaySpeed_SetGet_speeds_Payload, DisplaySpeed_payload_buffer_speeds, DisplaySpeed_payload_length_speeds);
}

on envVar DisplaySpeed_SetGet_speeds_Element_TotalNum
{
  if (@this == 0) @this =  1;
  if (@this > 10) @this = 10;
  
  DisplaySpeed_SetGet_speeds();
  DisplaySpeed_SetGet_speeds_update();
}

on envVar DisplaySpeed_SetGet_speeds_Element
{
  DisplaySpeed_SetGet_speeds_update();
}

on envVar DisplaySpeed_SetGet_speeds_Element_Next
{
  if (@this == 1 && @DisplaySpeed_SetGet_speeds_Element < @DisplaySpeed_SetGet_speeds_Element_TotalNum - 1)
  {
    @DisplaySpeed_SetGet_speeds_Element = @DisplaySpeed_SetGet_speeds_Element + 1;
    DisplaySpeed_SetGet_speeds_update();
  }
}

on envVar DisplaySpeed_SetGet_speeds_Element_Previous
{
  if (@this == 1 && @DisplaySpeed_SetGet_speeds_Element > 0)
  {
    @DisplaySpeed_SetGet_speeds_Element = @DisplaySpeed_SetGet_speeds_Element - 1;
    DisplaySpeed_SetGet_speeds_update();
  }
}

DisplaySpeed_SetGet_speeds_update()
{
  @DisplaySpeed_SetGet_LengthIndicator_Element_speeds = DisplaySpeed_array_speeds_array_element_length[@DisplaySpeed_SetGet_speeds_Element];
  @DisplaySpeed_SetGet_LengthIndicator_Struct_speeds  = DisplaySpeed_array_speeds_struct_element_length;
  @DisplaySpeed_SetGet_Length_speeds                  = DisplaySpeed_payload_length_speeds+8;
  
  @DisplaySpeed_SetGet_speeds_type               = DisplaySpeed_array_speeds_type[@DisplaySpeed_SetGet_speeds_Element];
  @DisplaySpeed_SetGet_speeds_currentValue       = DisplaySpeed_array_speeds_currentValue[@DisplaySpeed_SetGet_speeds_Element];
  @DisplaySpeed_SetGet_speeds_restrictionReason  = DisplaySpeed_array_speeds_restrictionReason[@DisplaySpeed_SetGet_speeds_Element];
  @DisplaySpeed_SetGet_speeds_unit               = DisplaySpeed_array_speeds_unit[@DisplaySpeed_SetGet_speeds_Element];
  @DisplaySpeed_SetGet_speeds_isDisplayActivated = DisplaySpeed_array_speeds_isDisplayActivated[@DisplaySpeed_SetGet_speeds_Element];
  @DisplaySpeed_SetGet_speeds_maxValue           = DisplaySpeed_array_speeds_maxValue[@DisplaySpeed_SetGet_speeds_Element];
  @DisplaySpeed_SetGet_speeds_minValue           = DisplaySpeed_array_speeds_minValue[@DisplaySpeed_SetGet_speeds_Element];
  @DisplaySpeed_SetGet_speeds_resolution         = DisplaySpeed_array_speeds_resolution[@DisplaySpeed_SetGet_speeds_Element];
  
  @DisplaySpeed_SetGet_speeds_type_available               = DisplaySpeed_array_speeds_type_available[@DisplaySpeed_SetGet_speeds_Element];
  @DisplaySpeed_SetGet_speeds_currentValue_available       = DisplaySpeed_array_speeds_currentValue_available[@DisplaySpeed_SetGet_speeds_Element];
  @DisplaySpeed_SetGet_speeds_restrictionReason_available  = DisplaySpeed_array_speeds_restrictionReason_available[@DisplaySpeed_SetGet_speeds_Element];
  @DisplaySpeed_SetGet_speeds_unit_available               = DisplaySpeed_array_speeds_unit_available[@DisplaySpeed_SetGet_speeds_Element];
  @DisplaySpeed_SetGet_speeds_isDisplayActivated_available = DisplaySpeed_array_speeds_isDisplayActivated_available[@DisplaySpeed_SetGet_speeds_Element];
  @DisplaySpeed_SetGet_speeds_maxValue_available           = DisplaySpeed_array_speeds_maxValue_available[@DisplaySpeed_SetGet_speeds_Element];
  @DisplaySpeed_SetGet_speeds_minValue_available           = DisplaySpeed_array_speeds_minValue_available[@DisplaySpeed_SetGet_speeds_Element];
  @DisplaySpeed_SetGet_speeds_resolution_available         = DisplaySpeed_array_speeds_resolution_available[@DisplaySpeed_SetGet_speeds_Element];
}


DisplaySpeed_speeds_Notification()
{
  word data_length;
  word data_length_element_sum;
  word data_length_element[10];
  byte wiretype;
  byte data_id;
  word start_pos;
  
  payload_rx_counter = 0;
  data_length_element_sum = 0;
  DisplaySpeed_speeds_data_length_element_num = 0;
  DisplaySpeed_speeds_available_reset();
  
  // Gesamtlaenge
  data_length = ((someip_payload_buffer[payload_rx_counter++]&0x000000FF)*16777216
              +  (someip_payload_buffer[payload_rx_counter++]&0x000000FF)*65536
              +  (someip_payload_buffer[payload_rx_counter++]&0x000000FF)*256
              +  (someip_payload_buffer[payload_rx_counter++]&0x000000FF));
  
  // pruefen ob noch Elemente vorhanden sind
  while (data_length_element_sum < data_length)
  {
    // Laenge Element
    data_length_element[DisplaySpeed_speeds_data_length_element_num] = ((someip_payload_buffer[payload_rx_counter++]&0x000000FF)*16777216
                                                                     +  (someip_payload_buffer[payload_rx_counter++]&0x000000FF)*65536
                                                                     +  (someip_payload_buffer[payload_rx_counter++]&0x000000FF)*256
                                                                     +  (someip_payload_buffer[payload_rx_counter++]&0x000000FF));
   
    start_pos = payload_rx_counter;
    
    while (payload_rx_counter < data_length_element[DisplaySpeed_speeds_data_length_element_num] + start_pos)
    {
      // wiretype & data_id pruefen
      wiretype = (someip_payload_buffer[payload_rx_counter++]>>4) & 0x0F;
      data_id = someip_payload_buffer[payload_rx_counter++];
      
      switch (data_id)
      {
        case 0:  DisplaySpeed_Notification_speeds_type(); break;
        case 1:  DisplaySpeed_Notification_speeds_currentValue(); break;
        case 2:  DisplaySpeed_Notification_speeds_restrictionReason(); break;
        case 3:  DisplaySpeed_Notification_speeds_unit(); break;
        case 4:  DisplaySpeed_Notification_speeds_isDisplayActivated(); break;
        case 5:  DisplaySpeed_Notification_speeds_maxValue(); break;
        case 6:  DisplaySpeed_Notification_speeds_minValue(); break;
        case 7:  DisplaySpeed_Notification_speeds_resolution(); break;
      }
    }
    data_length_element_sum = data_length_element_sum + data_length_element[DisplaySpeed_speeds_data_length_element_num] + 4;
    
    if (data_length_element_sum < data_length)
      DisplaySpeed_speeds_data_length_element_num++;
  }
  @DisplaySpeed_SetGet_speeds_Element_TotalNum = DisplaySpeed_speeds_data_length_element_num+1;
}

DisplaySpeed_speeds_available_reset()
{
  for (k=0; k<10; k++)
  {
    DisplaySpeed_array_speeds_type_available[k]               = 0;
    DisplaySpeed_array_speeds_currentValue_available[k]       = 0;
    DisplaySpeed_array_speeds_restrictionReason_available[k]  = 0;
    DisplaySpeed_array_speeds_unit_available[k]               = 0;
    DisplaySpeed_array_speeds_isDisplayActivated_available[k] = 0;
    DisplaySpeed_array_speeds_maxValue_available[k]           = 0;
    DisplaySpeed_array_speeds_minValue_available[k]           = 0;
    DisplaySpeed_array_speeds_resolution_available[k]         = 0;
  }
}


DisplaySpeed_Notification_speeds_type()
{
  DisplaySpeed_array_speeds_type[DisplaySpeed_speeds_data_length_element_num] = ((someip_payload_buffer[payload_rx_counter++]&0x000000FF)*16777216
                                                                              +  (someip_payload_buffer[payload_rx_counter++]&0x000000FF)*65536
                                                                              +  (someip_payload_buffer[payload_rx_counter++]&0x000000FF)*256
                                                                              +  (someip_payload_buffer[payload_rx_counter++]&0x000000FF));
  
  DisplaySpeed_array_speeds_type_available[DisplaySpeed_speeds_data_length_element_num] = 1;
  DisplaySpeed_SetGet_speeds_update();
}
DisplaySpeed_Notification_speeds_currentValue()
{
  dword temp_converttofloat;
  
  temp_converttofloat = ((someip_payload_buffer[payload_rx_counter++]&0x000000FF)*16777216
                      +  (someip_payload_buffer[payload_rx_counter++]&0x000000FF)*65536
                      +  (someip_payload_buffer[payload_rx_counter++]&0x000000FF)*256
                      +  (someip_payload_buffer[payload_rx_counter++]&0x000000FF));
  
  DisplaySpeed_array_speeds_currentValue[DisplaySpeed_speeds_data_length_element_num] = interpretAsFloat (temp_converttofloat);
  
  DisplaySpeed_array_speeds_currentValue_available[DisplaySpeed_speeds_data_length_element_num] = 1;
  DisplaySpeed_SetGet_speeds_update();
}
DisplaySpeed_Notification_speeds_restrictionReason()
{
  DisplaySpeed_array_speeds_restrictionReason[DisplaySpeed_speeds_data_length_element_num] = ((someip_payload_buffer[payload_rx_counter++]&0x000000FF)*16777216
                                                                                           +  (someip_payload_buffer[payload_rx_counter++]&0x000000FF)*65536
                                                                                           +  (someip_payload_buffer[payload_rx_counter++]&0x000000FF)*256
                                                                                           +  (someip_payload_buffer[payload_rx_counter++]&0x000000FF));
  
  DisplaySpeed_array_speeds_restrictionReason_available[DisplaySpeed_speeds_data_length_element_num] = 1;
  DisplaySpeed_SetGet_speeds_update();
}
DisplaySpeed_Notification_speeds_unit()
{
  DisplaySpeed_array_speeds_unit[DisplaySpeed_speeds_data_length_element_num] = ((someip_payload_buffer[payload_rx_counter++]&0x000000FF)*16777216
                                                                              +  (someip_payload_buffer[payload_rx_counter++]&0x000000FF)*65536
                                                                              +  (someip_payload_buffer[payload_rx_counter++]&0x000000FF)*256
                                                                              +  (someip_payload_buffer[payload_rx_counter++]&0x000000FF));
  
  DisplaySpeed_array_speeds_unit_available[DisplaySpeed_speeds_data_length_element_num] = 1;
  DisplaySpeed_SetGet_speeds_update();
}
DisplaySpeed_Notification_speeds_isDisplayActivated()
{
  DisplaySpeed_array_speeds_isDisplayActivated[DisplaySpeed_speeds_data_length_element_num] = (someip_payload_buffer[payload_rx_counter++]&0x000000FF);
  
  DisplaySpeed_array_speeds_isDisplayActivated_available[DisplaySpeed_speeds_data_length_element_num] = 1;
  DisplaySpeed_SetGet_speeds_update();
}
DisplaySpeed_Notification_speeds_maxValue()
{
  DisplaySpeed_array_speeds_maxValue[DisplaySpeed_speeds_data_length_element_num] = ((someip_payload_buffer[payload_rx_counter++]&0x000000FF)*16777216
                                                                                  +  (someip_payload_buffer[payload_rx_counter++]&0x000000FF)*65536
                                                                                  +  (someip_payload_buffer[payload_rx_counter++]&0x000000FF)*256
                                                                                  +  (someip_payload_buffer[payload_rx_counter++]&0x000000FF));
  
  DisplaySpeed_array_speeds_maxValue_available[DisplaySpeed_speeds_data_length_element_num] = 1;
  DisplaySpeed_SetGet_speeds_update();
}
DisplaySpeed_Notification_speeds_minValue()
{
  DisplaySpeed_array_speeds_minValue[DisplaySpeed_speeds_data_length_element_num] = ((someip_payload_buffer[payload_rx_counter++]&0x000000FF)*16777216
                                                                                  +  (someip_payload_buffer[payload_rx_counter++]&0x000000FF)*65536
                                                                                  +  (someip_payload_buffer[payload_rx_counter++]&0x000000FF)*256
                                                                                  +  (someip_payload_buffer[payload_rx_counter++]&0x000000FF));
  
  DisplaySpeed_array_speeds_minValue_available[DisplaySpeed_speeds_data_length_element_num] = 1;
  DisplaySpeed_SetGet_speeds_update();
}
DisplaySpeed_Notification_speeds_resolution()
{
  dword temp_converttofloat;
  
  temp_converttofloat = ((someip_payload_buffer[payload_rx_counter++]&0x000000FF)*16777216
                      +  (someip_payload_buffer[payload_rx_counter++]&0x000000FF)*65536
                      +  (someip_payload_buffer[payload_rx_counter++]&0x000000FF)*256
                      +  (someip_payload_buffer[payload_rx_counter++]&0x000000FF));
  
  DisplaySpeed_array_speeds_resolution[DisplaySpeed_speeds_data_length_element_num] = interpretAsFloat (temp_converttofloat);
  
  DisplaySpeed_array_speeds_resolution_available[DisplaySpeed_speeds_data_length_element_num] = 1;
  DisplaySpeed_SetGet_speeds_update();
}



////////// speedWarnings Setter //////////

on envVar DisplaySpeed_SetGet_LengthIndicator_Struct_speedWarnings
{
  DisplaySpeed_SetGet_speedWarnings();
}
on envVar DisplaySpeed_SetGet_LengthIndicator_Element_speedWarnings
{
  DisplaySpeed_SetGet_speedWarnings();
}
on envVar DisplaySpeed_SetGet_speedWarnings_type
{
  DisplaySpeed_array_speedWarnings_type[@DisplaySpeed_SetGet_speedWarnings_Element] = @this;
  DisplaySpeed_SetGet_speedWarnings();
}
on envVar DisplaySpeed_SetGet_speedWarnings_isActivated
{
  DisplaySpeed_array_speedWarnings_isActivated[@DisplaySpeed_SetGet_speedWarnings_Element] = @this;
  DisplaySpeed_SetGet_speedWarnings();
}
on envVar DisplaySpeed_SetGet_speedWarnings_threshold
{
  DisplaySpeed_array_speedWarnings_threshold[@DisplaySpeed_SetGet_speedWarnings_Element] = @this;
  DisplaySpeed_SetGet_speedWarnings();
}
on envVar DisplaySpeed_SetGet_speedWarnings_unit
{
  DisplaySpeed_array_speedWarnings_unit[@DisplaySpeed_SetGet_speedWarnings_Element] = @this;
  DisplaySpeed_SetGet_speedWarnings();
}
on envVar DisplaySpeed_SetGet_speedWarnings_restrictionReason
{
  DisplaySpeed_array_speedWarnings_restrictionReason[@DisplaySpeed_SetGet_speedWarnings_Element] = @this;
  DisplaySpeed_SetGet_speedWarnings();
}
on envVar DisplaySpeed_SetGet_speedWarnings_maxValue
{
  DisplaySpeed_array_speedWarnings_maxValue[@DisplaySpeed_SetGet_speedWarnings_Element] = @this;
  DisplaySpeed_SetGet_speedWarnings();
}
on envVar DisplaySpeed_SetGet_speedWarnings_minValue
{
  DisplaySpeed_array_speedWarnings_minValue[@DisplaySpeed_SetGet_speedWarnings_Element] = @this;
  DisplaySpeed_SetGet_speedWarnings();
}
on envVar DisplaySpeed_SetGet_speedWarnings_resolution
{
  DisplaySpeed_array_speedWarnings_resolution[@DisplaySpeed_SetGet_speedWarnings_Element] = @this;
  DisplaySpeed_SetGet_speedWarnings();
}
on envVar DisplaySpeed_SetGet_speedWarnings_type_available
{
  DisplaySpeed_array_speedWarnings_type_available[@DisplaySpeed_SetGet_speedWarnings_Element] = @this;
  DisplaySpeed_SetGet_speedWarnings();
}
on envVar DisplaySpeed_SetGet_speedWarnings_isActivated_available
{
  DisplaySpeed_array_speedWarnings_isActivated_available[@DisplaySpeed_SetGet_speedWarnings_Element] = @this;
  DisplaySpeed_SetGet_speedWarnings();
}
on envVar DisplaySpeed_SetGet_speedWarnings_threshold_available
{
  DisplaySpeed_array_speedWarnings_threshold_available[@DisplaySpeed_SetGet_speedWarnings_Element] = @this;
  DisplaySpeed_SetGet_speedWarnings();
}
on envVar DisplaySpeed_SetGet_speedWarnings_unit_available
{
  DisplaySpeed_array_speedWarnings_unit_available[@DisplaySpeed_SetGet_speedWarnings_Element] = @this;
  DisplaySpeed_SetGet_speedWarnings();
}
on envVar DisplaySpeed_SetGet_speedWarnings_restrictionReason_available
{
  DisplaySpeed_array_speedWarnings_restrictionReason_available[@DisplaySpeed_SetGet_speedWarnings_Element] = @this;
  DisplaySpeed_SetGet_speedWarnings();
}
on envVar DisplaySpeed_SetGet_speedWarnings_maxValue_available
{
  DisplaySpeed_array_speedWarnings_maxValue_available[@DisplaySpeed_SetGet_speedWarnings_Element] = @this;
  DisplaySpeed_SetGet_speedWarnings();
}
on envVar DisplaySpeed_SetGet_speedWarnings_minValue_available
{
  DisplaySpeed_array_speedWarnings_minValue_available[@DisplaySpeed_SetGet_speedWarnings_Element] = @this;
  DisplaySpeed_SetGet_speedWarnings();
}
on envVar DisplaySpeed_SetGet_speedWarnings_resolution_available
{
  DisplaySpeed_array_speedWarnings_resolution_available[@DisplaySpeed_SetGet_speedWarnings_Element] = @this;
  DisplaySpeed_SetGet_speedWarnings();
}
on envVar DisplaySpeed_SetGet_speedWarnings_Payload
{
  DisplaySpeed_SetGet_speedWarnings_update();
}


DisplaySpeed_SetGet_speedWarnings()
{
  word payload_counter = 0;
  word start_pos       = 0;
  word element_length  = 0;
  
  // Length Indicator Struct - Platzhalter
  payload_counter = 0+4;
  start_pos = 0;
  
  for (j=0; j<@DisplaySpeed_SetGet_speedWarnings_Element_TotalNum; j++)
  {
    DisplaySpeed_array_speedWarnings_available_functions[j] = DisplaySpeed_array_speedWarnings_type_available[j]
                                                            + DisplaySpeed_array_speedWarnings_isActivated_available[j]
                                                            + DisplaySpeed_array_speedWarnings_threshold_available[j]
                                                            + DisplaySpeed_array_speedWarnings_unit_available[j]
																	                          + DisplaySpeed_array_speedWarnings_restrictionReason_available[j]
																	                          + DisplaySpeed_array_speedWarnings_maxValue_available[j]
															                              + DisplaySpeed_array_speedWarnings_minValue_available[j]
                                                            + DisplaySpeed_array_speedWarnings_resolution_available[j];
    
    // Length Indicator Element - Platzhalter
    if (DisplaySpeed_array_speedWarnings_available_functions[j] > 0)
    {
      start_pos = payload_counter;
      payload_counter = payload_counter + 4;
    }
    else 
      start_pos = payload_counter;
    
    
    // 0 type (enum32)
    if (DisplaySpeed_array_speedWarnings_type_available[j] == 1)
    {
      tag_dataID = 0;
      DisplaySpeed_payload_buffer_speedWarnings[payload_counter++] = 2 * 16 /* Wiretype = 2  =^ 32 Bit */ + ((tag_dataID>>8) & 0x0F) /* DataID High Part */ ;
      DisplaySpeed_payload_buffer_speedWarnings[payload_counter++] = tag_dataID & 0xFF /* DataID Low Part */ ;
      
      DisplaySpeed_payload_buffer_speedWarnings[payload_counter++] = DisplaySpeed_array_speedWarnings_type[j]>>24 & 0xFF;
      DisplaySpeed_payload_buffer_speedWarnings[payload_counter++] = DisplaySpeed_array_speedWarnings_type[j]>>16 & 0xFF;
      DisplaySpeed_payload_buffer_speedWarnings[payload_counter++] = DisplaySpeed_array_speedWarnings_type[j]>> 8 & 0xFF;
      DisplaySpeed_payload_buffer_speedWarnings[payload_counter++] = DisplaySpeed_array_speedWarnings_type[j]     & 0xFF;
    }
    
    // 1 isActivated (boolean)
    if (DisplaySpeed_array_speedWarnings_isActivated_available[j] == 1)
    {
      tag_dataID = 1;
      DisplaySpeed_payload_buffer_speedWarnings[payload_counter++] = 0 * 16 /* Wiretype = 0  =^ 8 Bit */ + ((tag_dataID>>8) & 0x0F) /* DataID High Part */ ;
      DisplaySpeed_payload_buffer_speedWarnings[payload_counter++] = tag_dataID & 0xFF /* DataID Low Part */ ;
      
      DisplaySpeed_payload_buffer_speedWarnings[payload_counter++] = DisplaySpeed_array_speedWarnings_isActivated[j] & 0xFF;
    }
    
    
    // 2 threshold (uint32)
    if (DisplaySpeed_array_speedWarnings_threshold_available[j] == 1)
    {
      tag_dataID = 2;
      DisplaySpeed_payload_buffer_speedWarnings[payload_counter++] = 2 * 16 /* Wiretype = 2  =^ 32 Bit */ + ((tag_dataID>>8) & 0x0F) /* DataID High Part */ ;
      DisplaySpeed_payload_buffer_speedWarnings[payload_counter++] = tag_dataID & 0xFF /* DataID Low Part */ ;
      
      DisplaySpeed_payload_buffer_speedWarnings[payload_counter++] = DisplaySpeed_array_speedWarnings_threshold[j]>>24 & 0xFF;
      DisplaySpeed_payload_buffer_speedWarnings[payload_counter++] = DisplaySpeed_array_speedWarnings_threshold[j]>>16 & 0xFF;
      DisplaySpeed_payload_buffer_speedWarnings[payload_counter++] = DisplaySpeed_array_speedWarnings_threshold[j]>> 8 & 0xFF;
      DisplaySpeed_payload_buffer_speedWarnings[payload_counter++] = DisplaySpeed_array_speedWarnings_threshold[j]     & 0xFF;
    }
    
    
    // 3 unit (enum32)
    if (DisplaySpeed_array_speedWarnings_unit_available[j] == 1)
    {
      tag_dataID = 3;
      DisplaySpeed_payload_buffer_speedWarnings[payload_counter++] = 2 * 16 /* Wiretype = 2  =^ 32 Bit */ + ((tag_dataID>>8) & 0x0F) /* DataID High Part */ ;
      DisplaySpeed_payload_buffer_speedWarnings[payload_counter++] = tag_dataID & 0xFF /* DataID Low Part */ ;
      
      DisplaySpeed_payload_buffer_speedWarnings[payload_counter++] = DisplaySpeed_array_speedWarnings_unit[j]>>24 & 0xFF;
      DisplaySpeed_payload_buffer_speedWarnings[payload_counter++] = DisplaySpeed_array_speedWarnings_unit[j]>>16 & 0xFF;
      DisplaySpeed_payload_buffer_speedWarnings[payload_counter++] = DisplaySpeed_array_speedWarnings_unit[j]>> 8 & 0xFF;
      DisplaySpeed_payload_buffer_speedWarnings[payload_counter++] = DisplaySpeed_array_speedWarnings_unit[j]     & 0xFF;
    }
    
    
    // 4 restrictionReason (enum32)
    if (DisplaySpeed_array_speedWarnings_restrictionReason_available[j] == 1)
    {
      tag_dataID = 4;
      DisplaySpeed_payload_buffer_speedWarnings[payload_counter++] = 2 * 16 /* Wiretype = 2  =^ 32 Bit */ + ((tag_dataID>>8) & 0x0F) /* DataID High Part */ ;
      DisplaySpeed_payload_buffer_speedWarnings[payload_counter++] = tag_dataID & 0xFF /* DataID Low Part */ ;
      
      DisplaySpeed_payload_buffer_speedWarnings[payload_counter++] = DisplaySpeed_array_speedWarnings_restrictionReason[j]>>24 & 0xFF;
      DisplaySpeed_payload_buffer_speedWarnings[payload_counter++] = DisplaySpeed_array_speedWarnings_restrictionReason[j]>>16 & 0xFF;
      DisplaySpeed_payload_buffer_speedWarnings[payload_counter++] = DisplaySpeed_array_speedWarnings_restrictionReason[j]>> 8 & 0xFF;
      DisplaySpeed_payload_buffer_speedWarnings[payload_counter++] = DisplaySpeed_array_speedWarnings_restrictionReason[j]     & 0xFF;
    }
    
    // 5 maxValue (uint32)
    if (DisplaySpeed_array_speedWarnings_maxValue_available[j] == 1)
    {
      tag_dataID = 5;
      DisplaySpeed_payload_buffer_speedWarnings[payload_counter++] = 2 * 16 /* Wiretype = 2  =^ 32 Bit */ + ((tag_dataID>>8) & 0x0F) /* DataID High Part */ ;
      DisplaySpeed_payload_buffer_speedWarnings[payload_counter++] = tag_dataID & 0xFF /* DataID Low Part */ ;
      
      DisplaySpeed_payload_buffer_speedWarnings[payload_counter++] = DisplaySpeed_array_speedWarnings_maxValue[j]>>24 & 0xFF;
      DisplaySpeed_payload_buffer_speedWarnings[payload_counter++] = DisplaySpeed_array_speedWarnings_maxValue[j]>>16 & 0xFF;
      DisplaySpeed_payload_buffer_speedWarnings[payload_counter++] = DisplaySpeed_array_speedWarnings_maxValue[j]>> 8 & 0xFF;
      DisplaySpeed_payload_buffer_speedWarnings[payload_counter++] = DisplaySpeed_array_speedWarnings_maxValue[j]     & 0xFF;
    }
    
    
    // 6 minValue (uint32)
    if (DisplaySpeed_array_speedWarnings_minValue_available[j] == 1)
    {
      tag_dataID = 6;
      DisplaySpeed_payload_buffer_speedWarnings[payload_counter++] = 2 * 16 /* Wiretype = 2  =^ 32 Bit */ + ((tag_dataID>>8) & 0x0F) /* DataID High Part */ ;
      DisplaySpeed_payload_buffer_speedWarnings[payload_counter++] = tag_dataID & 0xFF /* DataID Low Part */ ;
      
      DisplaySpeed_payload_buffer_speedWarnings[payload_counter++] = DisplaySpeed_array_speedWarnings_minValue[j]>>24 & 0xFF;
      DisplaySpeed_payload_buffer_speedWarnings[payload_counter++] = DisplaySpeed_array_speedWarnings_minValue[j]>>16 & 0xFF;
      DisplaySpeed_payload_buffer_speedWarnings[payload_counter++] = DisplaySpeed_array_speedWarnings_minValue[j]>> 8 & 0xFF;
      DisplaySpeed_payload_buffer_speedWarnings[payload_counter++] = DisplaySpeed_array_speedWarnings_minValue[j]     & 0xFF;
    }
    
    
    // 7 resolution (uint32)
    if (DisplaySpeed_array_speedWarnings_resolution_available[j] == 1)
    {
      tag_dataID = 7;
      DisplaySpeed_payload_buffer_speedWarnings[payload_counter++] = 2 * 16 /* Wiretype = 2  =^ 32 Bit */ + ((tag_dataID>>8) & 0x0F) /* DataID High Part */ ;
      DisplaySpeed_payload_buffer_speedWarnings[payload_counter++] = tag_dataID & 0xFF /* DataID Low Part */ ;
      
      DisplaySpeed_payload_buffer_speedWarnings[payload_counter++] = DisplaySpeed_array_speedWarnings_resolution[j]>>24 & 0xFF;
      DisplaySpeed_payload_buffer_speedWarnings[payload_counter++] = DisplaySpeed_array_speedWarnings_resolution[j]>>16 & 0xFF;
      DisplaySpeed_payload_buffer_speedWarnings[payload_counter++] = DisplaySpeed_array_speedWarnings_resolution[j]>> 8 & 0xFF;
      DisplaySpeed_payload_buffer_speedWarnings[payload_counter++] = DisplaySpeed_array_speedWarnings_resolution[j]     & 0xFF;
    }
    
    
    //Element Length
    element_length = payload_counter-start_pos;
    if (element_length >0) DisplaySpeed_array_speedWarnings_array_element_length[j] = element_length - 4;
    else                   DisplaySpeed_array_speedWarnings_array_element_length[j] = element_length;
    
    DisplaySpeed_payload_buffer_speedWarnings[start_pos++] = DisplaySpeed_array_speedWarnings_array_element_length[j]>>24 & 0xFF;
    DisplaySpeed_payload_buffer_speedWarnings[start_pos++] = DisplaySpeed_array_speedWarnings_array_element_length[j]>>16 & 0xFF;
    DisplaySpeed_payload_buffer_speedWarnings[start_pos++] = DisplaySpeed_array_speedWarnings_array_element_length[j]>> 8 & 0xFF;
    DisplaySpeed_payload_buffer_speedWarnings[start_pos++] = DisplaySpeed_array_speedWarnings_array_element_length[j]     & 0xFF;
    
    if (DisplaySpeed_array_speedWarnings_array_element_length[j] == 0) payload_counter = payload_counter+4;
  }
  
  // Struct Length
  DisplaySpeed_array_speedWarnings_struct_element_length = 4*@DisplaySpeed_SetGet_speedWarnings_Element_TotalNum;

  for (k=0;k<@DisplaySpeed_SetGet_speedWarnings_Element_TotalNum;k++)
    DisplaySpeed_array_speedWarnings_struct_element_length = DisplaySpeed_array_speedWarnings_struct_element_length + DisplaySpeed_array_speedWarnings_array_element_length[k];
  
  DisplaySpeed_payload_buffer_speedWarnings[0] = DisplaySpeed_array_speedWarnings_struct_element_length>>24 & 0xFF;
  DisplaySpeed_payload_buffer_speedWarnings[1] = DisplaySpeed_array_speedWarnings_struct_element_length>>16 & 0xFF;
  DisplaySpeed_payload_buffer_speedWarnings[2] = DisplaySpeed_array_speedWarnings_struct_element_length>> 8 & 0xFF;
  DisplaySpeed_payload_buffer_speedWarnings[3] = DisplaySpeed_array_speedWarnings_struct_element_length     & 0xFF;


  DisplaySpeed_payload_length_speedWarnings = DisplaySpeed_array_speedWarnings_struct_element_length+4;
  putvalue(DisplaySpeed_SetGet_speedWarnings_Payload, DisplaySpeed_payload_buffer_speedWarnings, DisplaySpeed_payload_length_speedWarnings);
}

on envVar DisplaySpeed_SetGet_speedWarnings_Element_TotalNum
{
  if (@this == 0) @this =  1;
  if (@this > 10) @this = 10;
  
  DisplaySpeed_SetGet_speedWarnings();
  DisplaySpeed_SetGet_speedWarnings_update();
}

on envVar DisplaySpeed_SetGet_speedWarnings_Element
{
  DisplaySpeed_SetGet_speedWarnings_update();
}

on envVar DisplaySpeed_SetGet_speedWarnings_Element_Next
{
  if (@this == 1 && @DisplaySpeed_SetGet_speedWarnings_Element < @DisplaySpeed_SetGet_speedWarnings_Element_TotalNum - 1)
  {
    @DisplaySpeed_SetGet_speedWarnings_Element = @DisplaySpeed_SetGet_speedWarnings_Element + 1;
    DisplaySpeed_SetGet_speedWarnings_update();
  }
}

on envVar DisplaySpeed_SetGet_speedWarnings_Element_Previous
{
  if (@this == 1 && @DisplaySpeed_SetGet_speedWarnings_Element > 0)
  {
    @DisplaySpeed_SetGet_speedWarnings_Element = @DisplaySpeed_SetGet_speedWarnings_Element - 1;
    DisplaySpeed_SetGet_speedWarnings_update();
  }
}
DisplaySpeed_SetGet_speedWarnings_update()
{
  @DisplaySpeed_SetGet_LengthIndicator_Element_speedWarnings = DisplaySpeed_array_speedWarnings_array_element_length[@DisplaySpeed_SetGet_speedWarnings_Element];
  @DisplaySpeed_SetGet_LengthIndicator_Struct_speedWarnings  = DisplaySpeed_array_speedWarnings_struct_element_length;
  @DisplaySpeed_SetGet_Length_speedWarnings                  = DisplaySpeed_payload_length_speedWarnings+8;
  
  @DisplaySpeed_SetGet_speedWarnings_type              = DisplaySpeed_array_speedWarnings_type[@DisplaySpeed_SetGet_speedWarnings_Element];
  @DisplaySpeed_SetGet_speedWarnings_isActivated       = DisplaySpeed_array_speedWarnings_isActivated[@DisplaySpeed_SetGet_speedWarnings_Element];
  @DisplaySpeed_SetGet_speedWarnings_threshold         = DisplaySpeed_array_speedWarnings_threshold[@DisplaySpeed_SetGet_speedWarnings_Element];
  @DisplaySpeed_SetGet_speedWarnings_unit              = DisplaySpeed_array_speedWarnings_unit[@DisplaySpeed_SetGet_speedWarnings_Element];
  @DisplaySpeed_SetGet_speedWarnings_restrictionReason = DisplaySpeed_array_speedWarnings_restrictionReason[@DisplaySpeed_SetGet_speedWarnings_Element];
  @DisplaySpeed_SetGet_speedWarnings_maxValue          = DisplaySpeed_array_speedWarnings_maxValue[@DisplaySpeed_SetGet_speedWarnings_Element];
  @DisplaySpeed_SetGet_speedWarnings_minValue          = DisplaySpeed_array_speedWarnings_minValue[@DisplaySpeed_SetGet_speedWarnings_Element];
  @DisplaySpeed_SetGet_speedWarnings_resolution        = DisplaySpeed_array_speedWarnings_resolution[@DisplaySpeed_SetGet_speedWarnings_Element];
  
  @DisplaySpeed_SetGet_speedWarnings_type_available              = DisplaySpeed_array_speedWarnings_type_available[@DisplaySpeed_SetGet_speedWarnings_Element];
  @DisplaySpeed_SetGet_speedWarnings_isActivated_available       = DisplaySpeed_array_speedWarnings_isActivated_available[@DisplaySpeed_SetGet_speedWarnings_Element];
  @DisplaySpeed_SetGet_speedWarnings_threshold_available         = DisplaySpeed_array_speedWarnings_threshold_available[@DisplaySpeed_SetGet_speedWarnings_Element];
  @DisplaySpeed_SetGet_speedWarnings_unit_available              = DisplaySpeed_array_speedWarnings_unit_available[@DisplaySpeed_SetGet_speedWarnings_Element];
  @DisplaySpeed_SetGet_speedWarnings_restrictionReason_available = DisplaySpeed_array_speedWarnings_restrictionReason_available[@DisplaySpeed_SetGet_speedWarnings_Element];
  @DisplaySpeed_SetGet_speedWarnings_maxValue_available          = DisplaySpeed_array_speedWarnings_maxValue_available[@DisplaySpeed_SetGet_speedWarnings_Element];
  @DisplaySpeed_SetGet_speedWarnings_minValue_available          = DisplaySpeed_array_speedWarnings_minValue_available[@DisplaySpeed_SetGet_speedWarnings_Element];
  @DisplaySpeed_SetGet_speedWarnings_resolution_available        = DisplaySpeed_array_speedWarnings_resolution_available[@DisplaySpeed_SetGet_speedWarnings_Element];
}

DisplaySpeed_speedWarnings_Notification()
{
  word data_length;
  word data_length_element_sum;
  word data_length_element[10];
  byte wiretype;
  byte data_id;
  word start_pos;
  
  payload_rx_counter = 0;
  data_length_element_sum = 0;
  DisplaySpeed_speedWarnings_data_length_element_num = 0;
  DisplaySpeed_speedWarnings_available_reset();
  
  // Gesamtlaenge
  data_length = ((someip_payload_buffer[payload_rx_counter++]&0x000000FF)*16777216
              +  (someip_payload_buffer[payload_rx_counter++]&0x000000FF)*65536
              +  (someip_payload_buffer[payload_rx_counter++]&0x000000FF)*256
              +  (someip_payload_buffer[payload_rx_counter++]&0x000000FF));
  
  // pruefen ob noch Elemente vorhanden sind
  while (data_length_element_sum < data_length)
  {
    // Laenge Element
    data_length_element[DisplaySpeed_speedWarnings_data_length_element_num] = ((someip_payload_buffer[payload_rx_counter++]&0x000000FF)*16777216
                                                                            +  (someip_payload_buffer[payload_rx_counter++]&0x000000FF)*65536
                                                                            +  (someip_payload_buffer[payload_rx_counter++]&0x000000FF)*256
                                                                            +  (someip_payload_buffer[payload_rx_counter++]&0x000000FF));
   
    start_pos = payload_rx_counter;
    
    while (payload_rx_counter < data_length_element[DisplaySpeed_speedWarnings_data_length_element_num] + start_pos)
    {
      // wiretype & data_id pruefen
      wiretype = (someip_payload_buffer[payload_rx_counter++]>>4) & 0x0F;
      data_id = someip_payload_buffer[payload_rx_counter++];
      
      switch (data_id)
      {
        case 0:  DisplaySpeed_Notification_speedWarnings_type(); break;
        case 1:  DisplaySpeed_Notification_speedWarnings_isActivated(); break;
        case 2:  DisplaySpeed_Notification_speedWarnings_threshold(); break;
        case 3:  DisplaySpeed_Notification_speedWarnings_unit(); break;
        case 4:  DisplaySpeed_Notification_speedWarnings_restrictionReason(); break;
        case 5:  DisplaySpeed_Notification_speedWarnings_maxValue(); break;
        case 6:  DisplaySpeed_Notification_speedWarnings_minValue(); break;
        case 7:  DisplaySpeed_Notification_speedWarnings_resolution(); break;
      }
    }
    data_length_element_sum = data_length_element_sum + data_length_element[DisplaySpeed_speedWarnings_data_length_element_num] + 4;
    
    if (data_length_element_sum < data_length)
      DisplaySpeed_speedWarnings_data_length_element_num++;
  }
  @DisplaySpeed_SetGet_speedWarnings_Element_TotalNum = DisplaySpeed_speedWarnings_data_length_element_num+1;
}

DisplaySpeed_speedWarnings_available_reset()
{
  for (k=0; k<10; k++)
  {
    DisplaySpeed_array_speedWarnings_type_available[k]                           = 0;
    DisplaySpeed_array_speedWarnings_isActivated_available[k]                    = 0;
    DisplaySpeed_array_speedWarnings_threshold_available[k]                      = 0;
    DisplaySpeed_array_speedWarnings_unit_available[k]                           = 0;
    DisplaySpeed_array_speedWarnings_restrictionReason_available[k]              = 0;
    DisplaySpeed_array_speedWarnings_maxValue_available[k]                       = 0;
    DisplaySpeed_array_speedWarnings_minValue_available[k]                       = 0;
    DisplaySpeed_array_speedWarnings_resolution_available[k]                     = 0;
    DisplaySpeed_array_speedBlockings_type_available[k]                          = 0;
    DisplaySpeed_array_speedBlockings_isActivated_available[k]                   = 0;
    DisplaySpeed_array_speedBlockings_isCodedStrict_available[k]                 = 0;
    DisplaySpeed_array_speedBlockings_threshold_available[k]                     = 0;
    DisplaySpeed_array_speedBlockings_unit_available[k]                          = 0;
    DisplaySpeed_array_speedBlockings_restrictionReason_available[k]             = 0;
  }
}

DisplaySpeed_Notification_speedWarnings_type()
{
  DisplaySpeed_array_speedWarnings_type[DisplaySpeed_speedWarnings_data_length_element_num] = ((someip_payload_buffer[payload_rx_counter++]&0x000000FF)*16777216
                                                                                            +  (someip_payload_buffer[payload_rx_counter++]&0x000000FF)*65536
                                                                                            +  (someip_payload_buffer[payload_rx_counter++]&0x000000FF)*256
                                                                                            +  (someip_payload_buffer[payload_rx_counter++]&0x000000FF));
  
  DisplaySpeed_array_speedWarnings_type_available[DisplaySpeed_speedWarnings_data_length_element_num] = 1;
  DisplaySpeed_SetGet_speedWarnings_update();
}
DisplaySpeed_Notification_speedWarnings_isActivated()
{
  DisplaySpeed_array_speedWarnings_isActivated[DisplaySpeed_speedWarnings_data_length_element_num] = (someip_payload_buffer[payload_rx_counter++]&0x000000FF);
  
  DisplaySpeed_array_speedWarnings_isActivated_available[DisplaySpeed_speedWarnings_data_length_element_num] = 1;
  DisplaySpeed_SetGet_speedWarnings_update();
}
DisplaySpeed_Notification_speedWarnings_threshold()
{
  DisplaySpeed_array_speedWarnings_threshold[DisplaySpeed_speedWarnings_data_length_element_num] = ((someip_payload_buffer[payload_rx_counter++]&0x000000FF)*16777216
                                                                                                 +  (someip_payload_buffer[payload_rx_counter++]&0x000000FF)*65536
                                                                                                 +  (someip_payload_buffer[payload_rx_counter++]&0x000000FF)*256
                                                                                                 +  (someip_payload_buffer[payload_rx_counter++]&0x000000FF));
  
  DisplaySpeed_array_speedWarnings_threshold_available[DisplaySpeed_speedWarnings_data_length_element_num] = 1;
  DisplaySpeed_SetGet_speedWarnings_update();
}
DisplaySpeed_Notification_speedWarnings_unit()
{
  DisplaySpeed_array_speedWarnings_unit[DisplaySpeed_speedWarnings_data_length_element_num] = ((someip_payload_buffer[payload_rx_counter++]&0x000000FF)*16777216
                                                                                            +  (someip_payload_buffer[payload_rx_counter++]&0x000000FF)*65536
                                                                                            +  (someip_payload_buffer[payload_rx_counter++]&0x000000FF)*256
                                                                                            +  (someip_payload_buffer[payload_rx_counter++]&0x000000FF));
  
  DisplaySpeed_array_speedWarnings_unit_available[DisplaySpeed_speedWarnings_data_length_element_num] = 1;
  DisplaySpeed_SetGet_speedWarnings_update();
}
DisplaySpeed_Notification_speedWarnings_restrictionReason()
{
  DisplaySpeed_array_speedWarnings_restrictionReason[DisplaySpeed_speedWarnings_data_length_element_num] = ((someip_payload_buffer[payload_rx_counter++]&0x000000FF)*16777216
                                                                                                         +  (someip_payload_buffer[payload_rx_counter++]&0x000000FF)*65536
                                                                                                         +  (someip_payload_buffer[payload_rx_counter++]&0x000000FF)*256
                                                                                                         +  (someip_payload_buffer[payload_rx_counter++]&0x000000FF));
  
  DisplaySpeed_array_speedWarnings_restrictionReason_available[DisplaySpeed_speedWarnings_data_length_element_num] = 1;
  DisplaySpeed_SetGet_speedWarnings_update();
}
DisplaySpeed_Notification_speedWarnings_maxValue()
{
  DisplaySpeed_array_speedWarnings_maxValue[DisplaySpeed_speedWarnings_data_length_element_num] = ((someip_payload_buffer[payload_rx_counter++]&0x000000FF)*16777216
                                                                                                +  (someip_payload_buffer[payload_rx_counter++]&0x000000FF)*65536
                                                                                                +  (someip_payload_buffer[payload_rx_counter++]&0x000000FF)*256
                                                                                                +  (someip_payload_buffer[payload_rx_counter++]&0x000000FF));
  
  DisplaySpeed_array_speedWarnings_maxValue_available[DisplaySpeed_speedWarnings_data_length_element_num] = 1;
  DisplaySpeed_SetGet_speedWarnings_update();
}
DisplaySpeed_Notification_speedWarnings_minValue()
{
  DisplaySpeed_array_speedWarnings_minValue[DisplaySpeed_speedWarnings_data_length_element_num] = ((someip_payload_buffer[payload_rx_counter++]&0x000000FF)*16777216
                                                                                                +  (someip_payload_buffer[payload_rx_counter++]&0x000000FF)*65536
                                                                                                +  (someip_payload_buffer[payload_rx_counter++]&0x000000FF)*256
                                                                                                +  (someip_payload_buffer[payload_rx_counter++]&0x000000FF));
  
  DisplaySpeed_array_speedWarnings_minValue_available[DisplaySpeed_speedWarnings_data_length_element_num] = 1;
  DisplaySpeed_SetGet_speedWarnings_update();
}
DisplaySpeed_Notification_speedWarnings_resolution()
{
  DisplaySpeed_array_speedWarnings_resolution[DisplaySpeed_speedWarnings_data_length_element_num] = ((someip_payload_buffer[payload_rx_counter++]&0x000000FF)*16777216
                                                                                                  +  (someip_payload_buffer[payload_rx_counter++]&0x000000FF)*65536
                                                                                                  +  (someip_payload_buffer[payload_rx_counter++]&0x000000FF)*256
                                                                                                  +  (someip_payload_buffer[payload_rx_counter++]&0x000000FF));
  
  DisplaySpeed_array_speedWarnings_resolution_available[DisplaySpeed_speedWarnings_data_length_element_num] = 1;
  DisplaySpeed_SetGet_speedWarnings_update();
}





////////// speedBlockings //////////

on envVar DisplaySpeed_SetGet_LengthIndicator_Struct_speedBlockings
{
  DisplaySpeed_SetGet_speedBlockings();
}
on envVar DisplaySpeed_SetGet_LengthIndicator_Element_speedBlockings
{
  DisplaySpeed_SetGet_speedBlockings();
}
on envVar DisplaySpeed_SetGet_speedBlockings_type
{
  DisplaySpeed_array_speedBlockings_type[@DisplaySpeed_SetGet_speedBlockings_Element] = @this;
  DisplaySpeed_SetGet_speedBlockings();
}
on envVar DisplaySpeed_SetGet_speedBlockings_isActivated
{
  DisplaySpeed_array_speedBlockings_isActivated[@DisplaySpeed_SetGet_speedBlockings_Element] = @this;
  DisplaySpeed_SetGet_speedBlockings();
}
on envVar DisplaySpeed_SetGet_speedBlockings_isCodedStrict
{
  DisplaySpeed_array_speedBlockings_isCodedStrict[@DisplaySpeed_SetGet_speedBlockings_Element] = @this;
  DisplaySpeed_SetGet_speedBlockings();
}
on envVar DisplaySpeed_SetGet_speedBlockings_threshold
{
  DisplaySpeed_array_speedBlockings_threshold[@DisplaySpeed_SetGet_speedBlockings_Element] = @this;
  DisplaySpeed_SetGet_speedBlockings();
}
on envVar DisplaySpeed_SetGet_speedBlockings_unit
{
  DisplaySpeed_array_speedBlockings_unit[@DisplaySpeed_SetGet_speedBlockings_Element] = @this;
  DisplaySpeed_SetGet_speedBlockings();
}
on envVar DisplaySpeed_SetGet_speedBlockings_restrictionReason
{
  DisplaySpeed_array_speedBlockings_restrictionReason[@DisplaySpeed_SetGet_speedBlockings_Element] = @this;
  DisplaySpeed_SetGet_speedBlockings();
}
on envVar DisplaySpeed_SetGet_speedBlockings_type_available
{
  DisplaySpeed_array_speedBlockings_type_available[@DisplaySpeed_SetGet_speedBlockings_Element] = @this;
  DisplaySpeed_SetGet_speedBlockings();
}
on envVar DisplaySpeed_SetGet_speedBlockings_isActivated_available
{
  DisplaySpeed_array_speedBlockings_isActivated_available[@DisplaySpeed_SetGet_speedBlockings_Element] = @this;
  DisplaySpeed_SetGet_speedBlockings();
}
on envVar DisplaySpeed_SetGet_speedBlockings_isCodedStrict_available
{
  DisplaySpeed_array_speedBlockings_isCodedStrict_available[@DisplaySpeed_SetGet_speedBlockings_Element] = @this;
  DisplaySpeed_SetGet_speedBlockings();
}
on envVar DisplaySpeed_SetGet_speedBlockings_threshold_available
{
  DisplaySpeed_array_speedBlockings_threshold_available[@DisplaySpeed_SetGet_speedBlockings_Element] = @this;
  DisplaySpeed_SetGet_speedBlockings();
}
on envVar DisplaySpeed_SetGet_speedBlockings_unit_available
{
  DisplaySpeed_array_speedBlockings_unit_available[@DisplaySpeed_SetGet_speedBlockings_Element] = @this;
  DisplaySpeed_SetGet_speedBlockings();
}
on envVar DisplaySpeed_SetGet_speedBlockings_restrictionReason_available
{
  DisplaySpeed_array_speedBlockings_restrictionReason_available[@DisplaySpeed_SetGet_speedBlockings_Element] = @this;
  DisplaySpeed_SetGet_speedBlockings();
}
on envVar DisplaySpeed_SetGet_speedBlockings_Payload
{
  DisplaySpeed_SetGet_speedBlockings_update();
}


DisplaySpeed_SetGet_speedBlockings()
{
  word payload_counter = 0;
  word start_pos       = 0;
  word element_length  = 0;
  
  // Length Indicator Struct - Platzhalter
  payload_counter = 0+4;
  start_pos = 0;
  
  for (j=0; j<@DisplaySpeed_SetGet_speedBlockings_Element_TotalNum; j++)
  {
    DisplaySpeed_array_speedBlockings_available_functions[j] = DisplaySpeed_array_speedBlockings_type_available[j]
                                                             + DisplaySpeed_array_speedBlockings_isActivated_available[j]
                                                             + DisplaySpeed_array_speedBlockings_isCodedStrict_available[j]
                                                             + DisplaySpeed_array_speedBlockings_threshold_available[j]
																	                           + DisplaySpeed_array_speedBlockings_unit_available[j]
                                                             + DisplaySpeed_array_speedBlockings_restrictionReason_available[j];
    
    // Length Indicator Element - Platzhalter
    if (DisplaySpeed_array_speedBlockings_available_functions[j] > 0)
    {
      start_pos = payload_counter;
      payload_counter = payload_counter + 4;
    }
    else 
      start_pos = payload_counter;
    
    
    // 0 type (enum32)
    if (DisplaySpeed_array_speedBlockings_type_available[j] == 1)
    {
      tag_dataID = 0;
      DisplaySpeed_payload_buffer_speedBlockings[payload_counter++] = 2 * 16 /* Wiretype = 2  =^ 32 Bit */ + ((tag_dataID>>8) & 0x0F) /* DataID High Part */ ;
      DisplaySpeed_payload_buffer_speedBlockings[payload_counter++] = tag_dataID & 0xFF /* DataID Low Part */ ;
      
      DisplaySpeed_payload_buffer_speedBlockings[payload_counter++] = DisplaySpeed_array_speedBlockings_type[j]>>24 & 0xFF;
      DisplaySpeed_payload_buffer_speedBlockings[payload_counter++] = DisplaySpeed_array_speedBlockings_type[j]>>16 & 0xFF;
      DisplaySpeed_payload_buffer_speedBlockings[payload_counter++] = DisplaySpeed_array_speedBlockings_type[j]>> 8 & 0xFF;
      DisplaySpeed_payload_buffer_speedBlockings[payload_counter++] = DisplaySpeed_array_speedBlockings_type[j]     & 0xFF;
    }
    
    
    // 1 isActivated (boolean)
    if (DisplaySpeed_array_speedBlockings_isActivated_available[j] == 1)
    {
      tag_dataID = 1;
      DisplaySpeed_payload_buffer_speedBlockings[payload_counter++] = 0 * 16 /* Wiretype = 0  =^ 8 Bit */ + ((tag_dataID>>8) & 0x0F) /* DataID High Part */ ;
      DisplaySpeed_payload_buffer_speedBlockings[payload_counter++] = tag_dataID & 0xFF /* DataID Low Part */ ;
      
      DisplaySpeed_payload_buffer_speedBlockings[payload_counter++] = DisplaySpeed_array_speedBlockings_isActivated[j] & 0xFF;
    }
    
    
    // 2 isCodedStrict (boolean)
    if (DisplaySpeed_array_speedBlockings_restrictionReason_available[j] == 1)
    {
      tag_dataID = 2;
      DisplaySpeed_payload_buffer_speedBlockings[payload_counter++] = 0 * 16 /* Wiretype = 0  =^ 8 Bit */ + ((tag_dataID>>8) & 0x0F) /* DataID High Part */ ;
      DisplaySpeed_payload_buffer_speedBlockings[payload_counter++] = tag_dataID & 0xFF /* DataID Low Part */ ;
      
      DisplaySpeed_payload_buffer_speedBlockings[payload_counter++] = DisplaySpeed_array_speedBlockings_isCodedStrict[j] & 0xFF;
    }
    
    
    // 3 threshold (uint32)
    if (DisplaySpeed_array_speedBlockings_threshold_available[j] == 1)
    {
      tag_dataID = 3;
      DisplaySpeed_payload_buffer_speedBlockings[payload_counter++] = 2 * 16 /* Wiretype = 2  =^ 32 Bit */ + ((tag_dataID>>8) & 0x0F) /* DataID High Part */ ;
      DisplaySpeed_payload_buffer_speedBlockings[payload_counter++] = tag_dataID & 0xFF /* DataID Low Part */ ;
      
      DisplaySpeed_payload_buffer_speedBlockings[payload_counter++] = DisplaySpeed_array_speedBlockings_threshold[j]>>24 & 0xFF;
      DisplaySpeed_payload_buffer_speedBlockings[payload_counter++] = DisplaySpeed_array_speedBlockings_threshold[j]>>16 & 0xFF;
      DisplaySpeed_payload_buffer_speedBlockings[payload_counter++] = DisplaySpeed_array_speedBlockings_threshold[j]>> 8 & 0xFF;
      DisplaySpeed_payload_buffer_speedBlockings[payload_counter++] = DisplaySpeed_array_speedBlockings_threshold[j]     & 0xFF;
    }
    
    
    // 4 unit (enum32)
    if (DisplaySpeed_array_speedBlockings_unit_available[j] == 1)
    {
      tag_dataID = 4;
      DisplaySpeed_payload_buffer_speedBlockings[payload_counter++] = 2 * 16 /* Wiretype = 2  =^ 32 Bit */ + ((tag_dataID>>8) & 0x0F) /* DataID High Part */ ;
      DisplaySpeed_payload_buffer_speedBlockings[payload_counter++] = tag_dataID & 0xFF /* DataID Low Part */ ;
      
      DisplaySpeed_payload_buffer_speedBlockings[payload_counter++] = DisplaySpeed_array_speedBlockings_unit[j]>>24 & 0xFF;
      DisplaySpeed_payload_buffer_speedBlockings[payload_counter++] = DisplaySpeed_array_speedBlockings_unit[j]>>16 & 0xFF;
      DisplaySpeed_payload_buffer_speedBlockings[payload_counter++] = DisplaySpeed_array_speedBlockings_unit[j]>> 8 & 0xFF;
      DisplaySpeed_payload_buffer_speedBlockings[payload_counter++] = DisplaySpeed_array_speedBlockings_unit[j]     & 0xFF;
    }
    
    
    // 5 restrictionReason (enum)
    if (DisplaySpeed_array_speedBlockings_restrictionReason_available[j] == 1)
    {
      tag_dataID = 5;
      DisplaySpeed_payload_buffer_speedBlockings[payload_counter++] = 2 * 16 /* Wiretype = 2  =^ 32 Bit */ + ((tag_dataID>>8) & 0x0F) /* DataID High Part */ ;
      DisplaySpeed_payload_buffer_speedBlockings[payload_counter++] = tag_dataID & 0xFF /* DataID Low Part */ ;
      
      DisplaySpeed_payload_buffer_speedBlockings[payload_counter++] = DisplaySpeed_array_speedBlockings_restrictionReason[j]>>24 & 0xFF;
      DisplaySpeed_payload_buffer_speedBlockings[payload_counter++] = DisplaySpeed_array_speedBlockings_restrictionReason[j]>>16 & 0xFF;
      DisplaySpeed_payload_buffer_speedBlockings[payload_counter++] = DisplaySpeed_array_speedBlockings_restrictionReason[j]>> 8 & 0xFF;
      DisplaySpeed_payload_buffer_speedBlockings[payload_counter++] = DisplaySpeed_array_speedBlockings_restrictionReason[j]     & 0xFF;
    }
    
    
    //Element Length
    element_length = payload_counter-start_pos;
    if (element_length >0) DisplaySpeed_array_speedBlockings_array_element_length[j] = element_length - 4;
    else                   DisplaySpeed_array_speedBlockings_array_element_length[j] = element_length;
    
    DisplaySpeed_payload_buffer_speedBlockings[start_pos++] = DisplaySpeed_array_speedBlockings_array_element_length[j]>>24 & 0xFF;
    DisplaySpeed_payload_buffer_speedBlockings[start_pos++] = DisplaySpeed_array_speedBlockings_array_element_length[j]>>16 & 0xFF;
    DisplaySpeed_payload_buffer_speedBlockings[start_pos++] = DisplaySpeed_array_speedBlockings_array_element_length[j]>> 8 & 0xFF;
    DisplaySpeed_payload_buffer_speedBlockings[start_pos++] = DisplaySpeed_array_speedBlockings_array_element_length[j]     & 0xFF;
    
    if (DisplaySpeed_array_speedBlockings_array_element_length[j] == 0) payload_counter = payload_counter+4;
  }
  
  // Struct Length
  DisplaySpeed_array_speedBlockings_struct_element_length = 4*@DisplaySpeed_SetGet_speedBlockings_Element_TotalNum;

  for (k=0;k<@DisplaySpeed_SetGet_speedBlockings_Element_TotalNum;k++)
    DisplaySpeed_array_speedBlockings_struct_element_length = DisplaySpeed_array_speedBlockings_struct_element_length + DisplaySpeed_array_speedBlockings_array_element_length[k];
  
  DisplaySpeed_payload_buffer_speedBlockings[0] = DisplaySpeed_array_speedBlockings_struct_element_length>>24 & 0xFF;
  DisplaySpeed_payload_buffer_speedBlockings[1] = DisplaySpeed_array_speedBlockings_struct_element_length>>16 & 0xFF;
  DisplaySpeed_payload_buffer_speedBlockings[2] = DisplaySpeed_array_speedBlockings_struct_element_length>> 8 & 0xFF;
  DisplaySpeed_payload_buffer_speedBlockings[3] = DisplaySpeed_array_speedBlockings_struct_element_length     & 0xFF;


  DisplaySpeed_payload_length_speedBlockings = DisplaySpeed_array_speedBlockings_struct_element_length+4;
  putvalue(DisplaySpeed_SetGet_speedBlockings_Payload, DisplaySpeed_payload_buffer_speedBlockings, DisplaySpeed_payload_length_speedBlockings);
}

on envVar DisplaySpeed_SetGet_speedBlockings_Element_TotalNum
{
  if (@this == 0) @this =  1;
  if (@this > 10) @this = 10;
  
  DisplaySpeed_SetGet_speedBlockings();
  DisplaySpeed_SetGet_speedBlockings_update();
}

on envVar DisplaySpeed_SetGet_speedBlockings_Element
{
  DisplaySpeed_SetGet_speedBlockings_update();
}

on envVar DisplaySpeed_SetGet_speedBlockings_Element_Next
{
  if (@this == 1 && @DisplaySpeed_SetGet_speedBlockings_Element < @DisplaySpeed_SetGet_speedBlockings_Element_TotalNum - 1)
  {
    @DisplaySpeed_SetGet_speedBlockings_Element = @DisplaySpeed_SetGet_speedBlockings_Element + 1;
    DisplaySpeed_SetGet_speedBlockings_update();
  }
}

on envVar DisplaySpeed_SetGet_speedBlockings_Element_Previous
{
  if (@this == 1 && @DisplaySpeed_SetGet_speedBlockings_Element > 0)
  {
    @DisplaySpeed_SetGet_speedBlockings_Element = @DisplaySpeed_SetGet_speedBlockings_Element - 1;
    DisplaySpeed_SetGet_speedBlockings_update();
  }
}

DisplaySpeed_SetGet_speedBlockings_update()
{
  @DisplaySpeed_SetGet_LengthIndicator_Element_speedBlockings = DisplaySpeed_array_speedBlockings_array_element_length[@DisplaySpeed_SetGet_speedBlockings_Element];
  @DisplaySpeed_SetGet_LengthIndicator_Struct_speedBlockings  = DisplaySpeed_array_speedBlockings_struct_element_length;
  @DisplaySpeed_SetGet_Length_speedBlockings                  = DisplaySpeed_payload_length_speedBlockings+8;
  
  @DisplaySpeed_SetGet_speedBlockings_type              = DisplaySpeed_array_speedBlockings_type[@DisplaySpeed_SetGet_speedBlockings_Element];
  @DisplaySpeed_SetGet_speedBlockings_isActivated       = DisplaySpeed_array_speedBlockings_isActivated[@DisplaySpeed_SetGet_speedBlockings_Element];
  @DisplaySpeed_SetGet_speedBlockings_isCodedStrict     = DisplaySpeed_array_speedBlockings_isCodedStrict[@DisplaySpeed_SetGet_speedBlockings_Element];
  @DisplaySpeed_SetGet_speedBlockings_threshold         = DisplaySpeed_array_speedBlockings_threshold[@DisplaySpeed_SetGet_speedBlockings_Element];
  @DisplaySpeed_SetGet_speedBlockings_unit              = DisplaySpeed_array_speedBlockings_unit[@DisplaySpeed_SetGet_speedBlockings_Element];
  @DisplaySpeed_SetGet_speedBlockings_restrictionReason = DisplaySpeed_array_speedBlockings_restrictionReason[@DisplaySpeed_SetGet_speedBlockings_Element];
  
  @DisplaySpeed_SetGet_speedBlockings_type_available              = DisplaySpeed_array_speedBlockings_type_available[@DisplaySpeed_SetGet_speedBlockings_Element];
  @DisplaySpeed_SetGet_speedBlockings_isActivated_available       = DisplaySpeed_array_speedBlockings_isActivated_available[@DisplaySpeed_SetGet_speedBlockings_Element];
  @DisplaySpeed_SetGet_speedBlockings_isCodedStrict_available     = DisplaySpeed_array_speedBlockings_isCodedStrict_available[@DisplaySpeed_SetGet_speedBlockings_Element];
  @DisplaySpeed_SetGet_speedBlockings_threshold_available         = DisplaySpeed_array_speedBlockings_threshold_available[@DisplaySpeed_SetGet_speedBlockings_Element];
  @DisplaySpeed_SetGet_speedBlockings_unit_available              = DisplaySpeed_array_speedBlockings_unit_available[@DisplaySpeed_SetGet_speedBlockings_Element];
  @DisplaySpeed_SetGet_speedBlockings_restrictionReason_available = DisplaySpeed_array_speedBlockings_restrictionReason_available[@DisplaySpeed_SetGet_speedBlockings_Element];
}


DisplaySpeed_speedBlockings_Notification()
{
  word data_length;
  word data_length_element_sum;
  word data_length_element[10];
  byte wiretype;
  byte data_id;
  word start_pos;
  
  payload_rx_counter = 0;
  data_length_element_sum = 0;
  DisplaySpeed_speedBlockings_data_length_element_num = 0;
  DisplaySpeed_speedBlockings_available_reset();
  
  // Gesamtlaenge
  data_length = ((someip_payload_buffer[payload_rx_counter++]&0x000000FF)*16777216
              +  (someip_payload_buffer[payload_rx_counter++]&0x000000FF)*65536
              +  (someip_payload_buffer[payload_rx_counter++]&0x000000FF)*256
              +  (someip_payload_buffer[payload_rx_counter++]&0x000000FF));
  
  // pruefen ob noch Elemente vorhanden sind
  while (data_length_element_sum < data_length)
  {
    // Laenge Element
    data_length_element[DisplaySpeed_speedBlockings_data_length_element_num] = ((someip_payload_buffer[payload_rx_counter++]&0x000000FF)*16777216
                                                                     +  (someip_payload_buffer[payload_rx_counter++]&0x000000FF)*65536
                                                                     +  (someip_payload_buffer[payload_rx_counter++]&0x000000FF)*256
                                                                     +  (someip_payload_buffer[payload_rx_counter++]&0x000000FF));
   
    start_pos = payload_rx_counter;
    
    while (payload_rx_counter < data_length_element[DisplaySpeed_speedBlockings_data_length_element_num] + start_pos)
    {
      // wiretype & data_id pruefen
      wiretype = (someip_payload_buffer[payload_rx_counter++]>>4) & 0x0F;
      data_id = someip_payload_buffer[payload_rx_counter++];
      
      switch (data_id)
      {
        case 0:  DisplaySpeed_Notification_speedBlockings_type(); break;
        case 1:  DisplaySpeed_Notification_speedBlockings_isActivated(); break;
        case 2:  DisplaySpeed_Notification_speedBlockings_isCodedStrict(); break;
        case 3:  DisplaySpeed_Notification_speedBlockings_threshold(); break;
        case 4:  DisplaySpeed_Notification_speedBlockings_unit(); break;
        case 5:  DisplaySpeed_Notification_speedBlockings_restrictionReason(); break;
      }
    }
    data_length_element_sum = data_length_element_sum + data_length_element[DisplaySpeed_speedBlockings_data_length_element_num] + 4;
    
    if (data_length_element_sum < data_length)
      DisplaySpeed_speedBlockings_data_length_element_num++;
  }
  @DisplaySpeed_SetGet_speedBlockings_Element_TotalNum = DisplaySpeed_speedBlockings_data_length_element_num+1;
}

DisplaySpeed_speedBlockings_available_reset()
{
  for (k=0; k<10; k++)
  {
    DisplaySpeed_array_speedBlockings_type_available[k]                          = 0;
    DisplaySpeed_array_speedBlockings_isActivated_available[k]                   = 0;
    DisplaySpeed_array_speedBlockings_isCodedStrict_available[k]                 = 0;
    DisplaySpeed_array_speedBlockings_threshold_available[k]                     = 0;
    DisplaySpeed_array_speedBlockings_unit_available[k]                          = 0;
    DisplaySpeed_array_speedBlockings_restrictionReason_available[k]             = 0;
  }
}


DisplaySpeed_Notification_speedBlockings_type()
{
  DisplaySpeed_array_speedBlockings_type[DisplaySpeed_speedBlockings_data_length_element_num] = ((someip_payload_buffer[payload_rx_counter++]&0x000000FF)*16777216
                                                                                              +  (someip_payload_buffer[payload_rx_counter++]&0x000000FF)*65536
                                                                                              +  (someip_payload_buffer[payload_rx_counter++]&0x000000FF)*256
                                                                                              +  (someip_payload_buffer[payload_rx_counter++]&0x000000FF));
  
  DisplaySpeed_array_speedBlockings_type_available[DisplaySpeed_speedBlockings_data_length_element_num] = 1;
  DisplaySpeed_SetGet_speedBlockings_update();
}
DisplaySpeed_Notification_speedBlockings_isActivated()
{
  DisplaySpeed_array_speedBlockings_isActivated[DisplaySpeed_speedBlockings_data_length_element_num] = (someip_payload_buffer[payload_rx_counter++]&0x000000FF);
  
  DisplaySpeed_array_speedBlockings_isActivated_available[DisplaySpeed_speedBlockings_data_length_element_num] = 1;
  DisplaySpeed_SetGet_speedBlockings_update();
}
DisplaySpeed_Notification_speedBlockings_isCodedStrict()
{
  DisplaySpeed_array_speedBlockings_isCodedStrict[DisplaySpeed_speedBlockings_data_length_element_num] = (someip_payload_buffer[payload_rx_counter++]&0x000000FF);
  
  DisplaySpeed_array_speedBlockings_isCodedStrict_available[DisplaySpeed_speedBlockings_data_length_element_num] = 1;
  DisplaySpeed_SetGet_speedBlockings_update();
}
DisplaySpeed_Notification_speedBlockings_threshold()
{
  DisplaySpeed_array_speedBlockings_threshold[DisplaySpeed_speedBlockings_data_length_element_num] = ((someip_payload_buffer[payload_rx_counter++]&0x000000FF)*16777216
                                                                                                   +  (someip_payload_buffer[payload_rx_counter++]&0x000000FF)*65536
                                                                                                   +  (someip_payload_buffer[payload_rx_counter++]&0x000000FF)*256
                                                                                                   +  (someip_payload_buffer[payload_rx_counter++]&0x000000FF));
  
  DisplaySpeed_array_speedBlockings_threshold_available[DisplaySpeed_speedBlockings_data_length_element_num] = 1;
  DisplaySpeed_SetGet_speedBlockings_update();
}
DisplaySpeed_Notification_speedBlockings_unit()
{
  DisplaySpeed_array_speedBlockings_unit[DisplaySpeed_speedBlockings_data_length_element_num] = ((someip_payload_buffer[payload_rx_counter++]&0x000000FF)*16777216
                                                                                              +  (someip_payload_buffer[payload_rx_counter++]&0x000000FF)*65536
                                                                                              +  (someip_payload_buffer[payload_rx_counter++]&0x000000FF)*256
                                                                                              +  (someip_payload_buffer[payload_rx_counter++]&0x000000FF));
  
  DisplaySpeed_array_speedBlockings_unit_available[DisplaySpeed_speedBlockings_data_length_element_num] = 1;
  DisplaySpeed_SetGet_speedBlockings_update();
}
DisplaySpeed_Notification_speedBlockings_restrictionReason()
{
  DisplaySpeed_array_speedBlockings_restrictionReason[DisplaySpeed_speedBlockings_data_length_element_num] = ((someip_payload_buffer[payload_rx_counter++]&0x000000FF)*16777216
                                                                                                           +  (someip_payload_buffer[payload_rx_counter++]&0x000000FF)*65536
                                                                                                           +  (someip_payload_buffer[payload_rx_counter++]&0x000000FF)*256
                                                                                                           +  (someip_payload_buffer[payload_rx_counter++]&0x000000FF));
  
  DisplaySpeed_array_speedBlockings_restrictionReason_available[DisplaySpeed_speedBlockings_data_length_element_num] = 1;
  DisplaySpeed_SetGet_speedBlockings_update();
}







//////////////////////////////////////////////////////////
////////////////// Service Temperature ///////////////////
//////////////////////////////////////////////////////////

on envVar ServiceDiscovery_Find_Service_Temperature
{
  if (@this == 1) Send_ServiceDiscovery_Find_Service_ICAS1Sys02();
}

on envVar Temperature_SetGet_temperatures_Get
{
  if (@this == 1)
  {
    UDP_Segments_total = @Temperature_SetGet_Length_temperatures/1404 + 1;
    UDP_Segments_left  = UDP_Segments_total;
    
    if (UDP_Segments_total > 1) seg_id_flag = 1;
    else                        seg_id_flag = 0;
    
    Send_Service_Temperature_SetGet (0x4010 & 0x0000FFFF);
  }
}
on envVar Temperature_SetGet_temperatureWarnings_Get
{
  if (@this == 1)
  {
    UDP_Segments_total = @Temperature_SetGet_Length_temperatureWarnings/1404 + 1;
    UDP_Segments_left  = UDP_Segments_total;
    
    if (UDP_Segments_total > 1) seg_id_flag = 1;
    else                        seg_id_flag = 0;
    
    Send_Service_Temperature_SetGet (0x4020 & 0x0000FFFF);
  }
}

on envVar Temperature_Subscribe_temperatures
{
  if (get_subAck_flag == 0)
    Send_ServiceDiscovery_Subscribe_ICAS1Sys02 (0x6034, 0xC010, @this);
  
  Temperature_SubscribeStatus_temperatures = @this;
}

on envVar Temperature_Subscribe_temperatureWarnings
{
  if (get_subAck_flag == 0)
    Send_ServiceDiscovery_Subscribe_ICAS1Sys02 (0x6034, 0xC020, @this);
  
  Temperature_SubscribeStatus_temperatureWarnings = @this;
}


Send_Service_Temperature_SetGet (word MethodID)
{
  ethernetPacket EthPaket;

  // Ethernet Packet - MAC Source address
  getvalue (ServiceDiscovery_EthernetPacket_MAC_Source_ICAS1Sys02, buffer_MAC);
  //EthPaket.source.ParseAddress ( buffer_MAC );
  EthPaket.source = ethGetMacAddressAsNumber (buffer_MAC);
  
  // Ethernet Packet - MAC Destination address
  getvalue (ServiceDiscovery_EthernetPacket_MAC_Destination, buffer_MAC);
  //EthPaket.destination.ParseAddress ( buffer_MAC );
  EthPaket.destination = ethGetMacAddressAsNumber (buffer_MAC);
  
  // Ethernet Packet - VLAN
  EthPaket.SetVlan (@ServiceDiscovery_EthernetPacket_VLAN_TPID, @ServiceDiscovery_EthernetPacket_VLAN_TCI);
  
  // Ethernet Packet - Type
  //EthPaket.ipv6.type = @EthernetPacket_Type;
  if (@ServiceDiscovery_EthernetPacket_Type == 0x86DD) EthPaket.ipv6.Init();
  
  
  // IPv6 Packet - Version
  EthPaket.ipv6.version = @ServiceDiscovery_IPv6Packet_Version;

  // IPv6 Packet - Traffic Class
  EthPaket.ipv6.class = @ServiceDiscovery_IPv6Packet_Traffic_Class;
  
  // IPv6 Packet - Flow Label
  EthPaket.ipv6.flow = @ServiceDiscovery_IPv6Packet_Flow_Label;
  
  // IPv6 Packet - Payload_Length
  EthPaket.ipv6.length = @ServiceDiscovery_IPv6Packet_Payload_Length;
  
  // IPv6 Packet - Next Header
  EthPaket.ipv6.next = @ServiceDiscovery_IPv6Packet_Next_Header;
  if (@ServiceDiscovery_IPv6Packet_Next_Header == 6) EthPaket.tcp.Init();
  if (@ServiceDiscovery_IPv6Packet_Next_Header == 17) EthPaket.udp.Init();
  
  // IPv6 Packet - Hop Limit
  EthPaket.ipv6.hopLimit = @ServiceDiscovery_IPv6Packet_Hop_Limit;

  // IPv6 Packet - IPv6 Destination address    // TODO: char array zu byte array
  buffer_ipv6[0]  = @ServiceDiscovery_IPv6Packet_IP_Destination_Unicast_01>>8 & 0xFF;
  buffer_ipv6[1]  = @ServiceDiscovery_IPv6Packet_IP_Destination_Unicast_01    & 0xFF;
  buffer_ipv6[2]  = @ServiceDiscovery_IPv6Packet_IP_Destination_Unicast_02>>8 & 0xFF;
  buffer_ipv6[3]  = @ServiceDiscovery_IPv6Packet_IP_Destination_Unicast_02    & 0xFF;
  buffer_ipv6[4]  = @ServiceDiscovery_IPv6Packet_IP_Destination_Unicast_03>>8 & 0xFF;
  buffer_ipv6[5]  = @ServiceDiscovery_IPv6Packet_IP_Destination_Unicast_03    & 0xFF;
  buffer_ipv6[6]  = @ServiceDiscovery_IPv6Packet_IP_Destination_Unicast_04>>8 & 0xFF;
  buffer_ipv6[7]  = @ServiceDiscovery_IPv6Packet_IP_Destination_Unicast_04    & 0xFF;
  buffer_ipv6[8]  = @ServiceDiscovery_IPv6Packet_IP_Destination_Unicast_05>>8 & 0xFF;
  buffer_ipv6[9]  = @ServiceDiscovery_IPv6Packet_IP_Destination_Unicast_05    & 0xFF;
  buffer_ipv6[10] = @ServiceDiscovery_IPv6Packet_IP_Destination_Unicast_06>>8 & 0xFF;
  buffer_ipv6[11] = @ServiceDiscovery_IPv6Packet_IP_Destination_Unicast_06    & 0xFF;
  buffer_ipv6[12] = @ServiceDiscovery_IPv6Packet_IP_Destination_Unicast_07>>8 & 0xFF;
  buffer_ipv6[13] = @ServiceDiscovery_IPv6Packet_IP_Destination_Unicast_07    & 0xFF;
  buffer_ipv6[14] = @ServiceDiscovery_IPv6Packet_IP_Destination_Unicast_08>>8 & 0xFF;
  buffer_ipv6[15] = @ServiceDiscovery_IPv6Packet_IP_Destination_Unicast_08    & 0xFF;
  EthPaket.ipv6.destination.SetData ( 0, buffer_ipv6, elcount(buffer_ipv6) );

  // IPv6 Packet - IPv6 Source address    // TODO: char array zu byte array
  buffer_ipv6[0]  = @ServiceDiscovery_IPv6Packet_IP_Source_ICAS1Sys02_01>>8 & 0xFF;
  buffer_ipv6[1]  = @ServiceDiscovery_IPv6Packet_IP_Source_ICAS1Sys02_01    & 0xFF;
  buffer_ipv6[2]  = @ServiceDiscovery_IPv6Packet_IP_Source_ICAS1Sys02_02>>8 & 0xFF;
  buffer_ipv6[3]  = @ServiceDiscovery_IPv6Packet_IP_Source_ICAS1Sys02_02    & 0xFF;
  buffer_ipv6[4]  = @ServiceDiscovery_IPv6Packet_IP_Source_ICAS1Sys02_03>>8 & 0xFF;
  buffer_ipv6[5]  = @ServiceDiscovery_IPv6Packet_IP_Source_ICAS1Sys02_03    & 0xFF;
  buffer_ipv6[6]  = @ServiceDiscovery_IPv6Packet_IP_Source_ICAS1Sys02_04>>8 & 0xFF;
  buffer_ipv6[7]  = @ServiceDiscovery_IPv6Packet_IP_Source_ICAS1Sys02_04    & 0xFF;
  buffer_ipv6[8]  = @ServiceDiscovery_IPv6Packet_IP_Source_ICAS1Sys02_05>>8 & 0xFF;
  buffer_ipv6[9]  = @ServiceDiscovery_IPv6Packet_IP_Source_ICAS1Sys02_05    & 0xFF;
  buffer_ipv6[10] = @ServiceDiscovery_IPv6Packet_IP_Source_ICAS1Sys02_06>>8 & 0xFF;
  buffer_ipv6[11] = @ServiceDiscovery_IPv6Packet_IP_Source_ICAS1Sys02_06    & 0xFF;
  buffer_ipv6[12] = @ServiceDiscovery_IPv6Packet_IP_Source_ICAS1Sys02_07>>8 & 0xFF;
  buffer_ipv6[13] = @ServiceDiscovery_IPv6Packet_IP_Source_ICAS1Sys02_07    & 0xFF;
  buffer_ipv6[14] = @ServiceDiscovery_IPv6Packet_IP_Source_ICAS1Sys02_08>>8 & 0xFF;
  buffer_ipv6[15] = @ServiceDiscovery_IPv6Packet_IP_Source_ICAS1Sys02_08    & 0xFF;
  EthPaket.ipv6.source.SetData ( 0, buffer_ipv6, elcount(buffer_ipv6) );

  
  // UDP Packet - Source Port
  EthPaket.udp.source = @Temperature_SetGet_Port_Source;
  
  // UDP Packet - Destination Port
  EthPaket.udp.destination = @Temperature_SetGet_Port_Destination;
  
  // UDP Packet - Length
  EthPaket.udp.length = @ServiceDiscovery_UDPPacket_Length;
  
  
  // SOME/IP Packet aus Rohdaten zusammenbauen (buffer array)
  i=0;
  
  // SOME/IP Packet - Message ID, Service ID [16 bit]
  buffer[i++] = @Temperature_SetGet_Message_ID_Service_ID>>8 & 0xFF;
  buffer[i++] = @Temperature_SetGet_Message_ID_Service_ID    & 0xFF;
  
  // SOME/IP Packet - Message ID, Message ID [16 bit]
  switch (MethodID)
  {
    case 0x4010: @Temperature_SetGet_Message_ID_Method_ID = @Temperature_SetGet_Message_ID_Method_ID_temperatures_Get; break;
    case 0x4020: @Temperature_SetGet_Message_ID_Method_ID = @Temperature_SetGet_Message_ID_Method_ID_temperatureWarnings_Get; break;
  }
  buffer[i++] = @Temperature_SetGet_Message_ID_Method_ID>>8 & 0xFF;
  buffer[i++] = @Temperature_SetGet_Message_ID_Method_ID    & 0xFF;
  
  // SOME/IP Packet - Length [32 bit]
  if (UDP_Segments_total == 1)
  {
    switch (MethodID)
    {
      case 0x4010: @Temperature_SetGet_Length = 8; break;
      case 0x4020: @Temperature_SetGet_Length = 8; break;
    }
  }
  else
  {
    if (UDP_Segments_left > 1)
    {
      switch (MethodID)
      {
        
      }
    }
    else
    {
      switch (MethodID)
      {
        
      }
    }
  }
  buffer[i++] = @Temperature_SetGet_Length>>24 & 0xFF;
  buffer[i++] = @Temperature_SetGet_Length>>16 & 0xFF;
  buffer[i++] = @Temperature_SetGet_Length>> 8 & 0xFF;
  buffer[i++] = @Temperature_SetGet_Length     & 0xFF;
  
  // SOME/IP Packet - Request ID, Client ID [16 bit]
  buffer[i++] = @Temperature_SetGet_Request_ID_Client_ID>>8 & 0xFF;
  buffer[i++] = @Temperature_SetGet_Request_ID_Client_ID    & 0xFF;
  
  // SOME/IP Packet - Request ID, Session ID) [16 bit]
  if ((UDP_Segments_total == 1) || (seg_id_flag == 1))
  {
    @ServiceDiscovery_SOMEIPPacket_Notification_Request_ID_Session_ID = @ServiceDiscovery_SOMEIPPacket_Notification_Request_ID_Session_ID + 1;
    if (@ServiceDiscovery_SOMEIPPacket_Notification_Request_ID_Session_ID == 0x10000) @ServiceDiscovery_SOMEIPPacket_Notification_Request_ID_Session_ID = 1;
    seg_id_flag = 0;
  }
  
  buffer[i++] = @ServiceDiscovery_SOMEIPPacket_Notification_Request_ID_Session_ID>>8 & 0xFF;
  buffer[i++] = @ServiceDiscovery_SOMEIPPacket_Notification_Request_ID_Session_ID    & 0xFF;
  
  // SOME/IP Packet - Protocol Version [8 bit]
  buffer[i++] = @Temperature_SetGet_Protocol_Version;
  
  // SOME/IP Packet - Interface Version [8 bit]
  buffer[i++] = @Temperature_SetGet_Interface_Version;
  
  // SOME/IP Packet - Message Type [8 bit]
  buffer[i++] = @Temperature_SetGet_Message_Type;
  
  // SOME/IP Packet - Return Code [8 bit]
  buffer[i++] = @Temperature_SetGet_Return_Code;
  
  
  if (UDP_Segments_total > 1)
  {
    if (UDP_Segments_left >= 0)
    { 
      // Message Type neu setzen
      buffer[i-2] = @Temperature_SetGet_Message_Type + 0x20;
      
      // Offset (16byte Schritte, 1392/16 = 87)
      @Temperature_SetGet_Offset = 87 * (UDP_Segments_total - UDP_Segments_left);
      
      // More Segments Flag
      if (UDP_Segments_left > 1) @Temperature_SetGet_More_Segments_Flag = 1;
      else                       @Temperature_SetGet_More_Segments_Flag = 0;
      
      buffer[i++] =   @Temperature_SetGet_Offset>>20 & 0xFF;
      buffer[i++] =   @Temperature_SetGet_Offset>>12 & 0xFF;
      buffer[i++] =   @Temperature_SetGet_Offset>>4  & 0xFF;
      buffer[i++] = ((@Temperature_SetGet_Offset<<4) & 0xF0) + (@Temperature_SetGet_More_Segments_Flag & 0x01);
    }
  }
  
  UDP_Segments_left--;
    
  // Rohdaten in UDP Paket schreiben
  EthPaket.udp.SetData( 0, buffer, i );

  // calculate UDP and IPv6 checksum and send Ethernet packet
  EthPaket.CompletePacket();
  output( EthPaket );
  
  // prüfen ob alle Segemente gesendet wurden, sonst senden erneut aufrufen
  Temperature_Segmentation_Method_ID = MethodID;
  if (UDP_Segments_left>0)
    settimer(Temperature_Segmentation_delay, 50);
}

on timer Temperature_Segmentation_delay
{
  Send_Service_Temperature_SetGet (Temperature_Segmentation_Method_ID);
}






////////// temperatures //////////

on envVar Temperature_SetGet_LengthIndicator_Struct_temperatures
{
  Temperature_SetGet_temperatures();
}
on envVar Temperature_SetGet_LengthIndicator_Element_temperatures
{
  Temperature_SetGet_temperatures();
}
on envVar Temperature_SetGet_temperatures_type
{
  Temperature_array_temperatures_type[@Temperature_SetGet_temperatures_Element] = @this;
  Temperature_SetGet_temperatures();
}
on envVar Temperature_SetGet_temperatures_currentValue
{
  Temperature_array_temperatures_currentValue[@Temperature_SetGet_temperatures_Element] = @this;
  Temperature_SetGet_temperatures();
}
on envVar Temperature_SetGet_temperatures_restrictionReason
{
  Temperature_array_temperatures_restrictionReason[@Temperature_SetGet_temperatures_Element] = @this;
  Temperature_SetGet_temperatures();
}
on envVar Temperature_SetGet_temperatures_unit
{
  Temperature_array_temperatures_unit[@Temperature_SetGet_temperatures_Element] = @this;
  Temperature_SetGet_temperatures();
}
on envVar Temperature_SetGet_temperatures_minValue
{
  Temperature_array_temperatures_minValue[@Temperature_SetGet_temperatures_Element] = @this;
  Temperature_SetGet_temperatures();
}
on envVar Temperature_SetGet_temperatures_maxValue
{
  Temperature_array_temperatures_maxValue[@Temperature_SetGet_temperatures_Element] = @this;
  Temperature_SetGet_temperatures();
}
on envVar Temperature_SetGet_temperatures_resolution
{
  Temperature_array_temperatures_resolution[@Temperature_SetGet_temperatures_Element] = @this;
  Temperature_SetGet_temperatures();
}
on envVar Temperature_SetGet_temperatures_isValueInvalid
{
  Temperature_array_temperatures_isValueInvalid[@Temperature_SetGet_temperatures_Element] = @this;
  Temperature_SetGet_temperatures();
}
on envVar Temperature_SetGet_temperatures_type_available
{
  Temperature_array_temperatures_type_available[@Temperature_SetGet_temperatures_Element] = @this;
  Temperature_SetGet_temperatures();
}
on envVar Temperature_SetGet_temperatures_currentValue_available
{
  Temperature_array_temperatures_currentValue_available[@Temperature_SetGet_temperatures_Element] = @this;
  Temperature_SetGet_temperatures();
}
on envVar Temperature_SetGet_temperatures_restrictionReason_available
{
  Temperature_array_temperatures_restrictionReason_available[@Temperature_SetGet_temperatures_Element] = @this;
  Temperature_SetGet_temperatures();
}
on envVar Temperature_SetGet_temperatures_unit_available
{
  Temperature_array_temperatures_unit_available[@Temperature_SetGet_temperatures_Element] = @this;
  Temperature_SetGet_temperatures();
}
on envVar Temperature_SetGet_temperatures_minValue_available
{
  Temperature_array_temperatures_minValue_available[@Temperature_SetGet_temperatures_Element] = @this;
  Temperature_SetGet_temperatures();
}
on envVar Temperature_SetGet_temperatures_maxValue_available
{
  Temperature_array_temperatures_maxValue_available[@Temperature_SetGet_temperatures_Element] = @this;
  Temperature_SetGet_temperatures();
}
on envVar Temperature_SetGet_temperatures_resolution_available
{
  Temperature_array_temperatures_resolution_available[@Temperature_SetGet_temperatures_Element] = @this;
  Temperature_SetGet_temperatures();
}
on envVar Temperature_SetGet_temperatures_isValueInvalid_available
{
  Temperature_array_temperatures_isValueInvalid_available[@Temperature_SetGet_temperatures_Element] = @this;
  Temperature_SetGet_temperatures();
}
on envVar Temperature_SetGet_temperatures_Payload
{
  Temperature_SetGet_temperatures_update();
}


Temperature_SetGet_temperatures()
{
  word payload_counter = 0;
  word start_pos       = 0;
  word element_length  = 0;
  
  // Length Indicator Struct - Platzhalter
  payload_counter = 0+4;
  start_pos = 0;
  
  for (j=0; j<@Temperature_SetGet_temperatures_Element_TotalNum; j++)
  {
    Temperature_array_temperatures_available_functions[j] = Temperature_array_temperatures_type_available[j]
                                                          + Temperature_array_temperatures_currentValue_available[j]
                                                          + Temperature_array_temperatures_restrictionReason_available[j]
                                                          + Temperature_array_temperatures_unit_available[j]
																                          + Temperature_array_temperatures_minValue_available[j]
    																                      + Temperature_array_temperatures_maxValue_available[j]
    																                      + Temperature_array_temperatures_resolution_available[j]
                                                          + Temperature_array_temperatures_isValueInvalid_available[j];
    
    // Length Indicator Element - Platzhalter
    if (Temperature_array_temperatures_available_functions[j] > 0)
    {
      start_pos = payload_counter;
      payload_counter = payload_counter + 4;
    }
    else 
      start_pos = payload_counter;
    
    
    // 0 type (enum32)
    if (Temperature_array_temperatures_type_available[j] == 1)
    {
      tag_dataID = 0;
      Temperature_payload_buffer_temperatures[payload_counter++] = 2 * 16 /* Wiretype = 2  =^ 32 Bit */ + ((tag_dataID>>8) & 0x0F) /* DataID High Part */ ;
      Temperature_payload_buffer_temperatures[payload_counter++] = tag_dataID & 0xFF /* DataID Low Part */ ;
      
      Temperature_payload_buffer_temperatures[payload_counter++] = Temperature_array_temperatures_type[j]>>24 & 0xFF;
      Temperature_payload_buffer_temperatures[payload_counter++] = Temperature_array_temperatures_type[j]>>16 & 0xFF;
      Temperature_payload_buffer_temperatures[payload_counter++] = Temperature_array_temperatures_type[j]>> 8 & 0xFF;
      Temperature_payload_buffer_temperatures[payload_counter++] = Temperature_array_temperatures_type[j]     & 0xFF;
    }
    
    
    // 1 curentValue (float32)
    if (Temperature_array_temperatures_currentValue_available[j] == 1)
    {
      tag_dataID = 1;
      Temperature_payload_buffer_temperatures[payload_counter++] = 2 * 16 /* Wiretype = 2  =^ 32 Bit */ + ((tag_dataID>>8) & 0x0F) /* DataID High Part */ ;
      Temperature_payload_buffer_temperatures[payload_counter++] = tag_dataID & 0xFF /* DataID Low Part */ ;
      
      temp_converttodword = interpretAsDword (Temperature_array_temperatures_currentValue[j]);
      Temperature_payload_buffer_temperatures[payload_counter++] = temp_converttodword>>24 & 0xFF;
      Temperature_payload_buffer_temperatures[payload_counter++] = temp_converttodword>>16 & 0xFF;
      Temperature_payload_buffer_temperatures[payload_counter++] = temp_converttodword>> 8 & 0xFF;
      Temperature_payload_buffer_temperatures[payload_counter++] = temp_converttodword     & 0xFF;
    }
    
    
    // 2 restrictionReason (enum32)
    if (Temperature_array_temperatures_restrictionReason_available[j] == 1)
    {
      tag_dataID = 2;
      Temperature_payload_buffer_temperatures[payload_counter++] = 2 * 16 /* Wiretype = 2  =^ 32 Bit */ + ((tag_dataID>>8) & 0x0F) /* DataID High Part */ ;
      Temperature_payload_buffer_temperatures[payload_counter++] = tag_dataID & 0xFF /* DataID Low Part */ ;
      
      Temperature_payload_buffer_temperatures[payload_counter++] = Temperature_array_temperatures_restrictionReason[j]>>24 & 0xFF;
      Temperature_payload_buffer_temperatures[payload_counter++] = Temperature_array_temperatures_restrictionReason[j]>>16 & 0xFF;
      Temperature_payload_buffer_temperatures[payload_counter++] = Temperature_array_temperatures_restrictionReason[j]>> 8 & 0xFF;
      Temperature_payload_buffer_temperatures[payload_counter++] = Temperature_array_temperatures_restrictionReason[j]     & 0xFF;
    }
    
    
    // 3 unit (enum32)
    if (Temperature_array_temperatures_unit_available[j] == 1)
    {
      tag_dataID = 3;
      Temperature_payload_buffer_temperatures[payload_counter++] = 2 * 16 /* Wiretype = 2  =^ 32 Bit */ + ((tag_dataID>>8) & 0x0F) /* DataID High Part */ ;
      Temperature_payload_buffer_temperatures[payload_counter++] = tag_dataID & 0xFF /* DataID Low Part */ ;
      
      Temperature_payload_buffer_temperatures[payload_counter++] = Temperature_array_temperatures_unit[j]>>24 & 0xFF;
      Temperature_payload_buffer_temperatures[payload_counter++] = Temperature_array_temperatures_unit[j]>>16 & 0xFF;
      Temperature_payload_buffer_temperatures[payload_counter++] = Temperature_array_temperatures_unit[j]>> 8 & 0xFF;
      Temperature_payload_buffer_temperatures[payload_counter++] = Temperature_array_temperatures_unit[j]     & 0xFF;
    }
    
    
    // 4 minValue (float32)
    if (Temperature_array_temperatures_minValue_available[j] == 1)
    {
      tag_dataID = 4;
      Temperature_payload_buffer_temperatures[payload_counter++] = 2 * 16 /* Wiretype = 2  =^ 32 Bit */ + ((tag_dataID>>8) & 0x0F) /* DataID High Part */ ;
      Temperature_payload_buffer_temperatures[payload_counter++] = tag_dataID & 0xFF /* DataID Low Part */ ;
      
      temp_converttodword = interpretAsDword (Temperature_array_temperatures_minValue[j]);
      Temperature_payload_buffer_temperatures[payload_counter++] = temp_converttodword>>24 & 0xFF;
      Temperature_payload_buffer_temperatures[payload_counter++] = temp_converttodword>>16 & 0xFF;
      Temperature_payload_buffer_temperatures[payload_counter++] = temp_converttodword>> 8 & 0xFF;
      Temperature_payload_buffer_temperatures[payload_counter++] = temp_converttodword     & 0xFF;
    }
    
    
    // 5 maxValue (float32)
    if (Temperature_array_temperatures_maxValue_available[j] == 1)
    {
      tag_dataID = 5;
      Temperature_payload_buffer_temperatures[payload_counter++] = 2 * 16 /* Wiretype = 2  =^ 32 Bit */ + ((tag_dataID>>8) & 0x0F) /* DataID High Part */ ;
      Temperature_payload_buffer_temperatures[payload_counter++] = tag_dataID & 0xFF /* DataID Low Part */ ;
      
      temp_converttodword = interpretAsDword (Temperature_array_temperatures_maxValue[j]);
      Temperature_payload_buffer_temperatures[payload_counter++] = temp_converttodword>>24 & 0xFF;
      Temperature_payload_buffer_temperatures[payload_counter++] = temp_converttodword>>16 & 0xFF;
      Temperature_payload_buffer_temperatures[payload_counter++] = temp_converttodword>> 8 & 0xFF;
      Temperature_payload_buffer_temperatures[payload_counter++] = temp_converttodword     & 0xFF;
    }
    
    
    // 6 resolution (float32)
    if (Temperature_array_temperatures_resolution_available[j] == 1)
    {
      tag_dataID = 6;
      Temperature_payload_buffer_temperatures[payload_counter++] = 2 * 16 /* Wiretype = 2  =^ 32 Bit */ + ((tag_dataID>>8) & 0x0F) /* DataID High Part */ ;
      Temperature_payload_buffer_temperatures[payload_counter++] = tag_dataID & 0xFF /* DataID Low Part */ ;
      
      temp_converttodword = interpretAsDword (Temperature_array_temperatures_resolution[j]);
      Temperature_payload_buffer_temperatures[payload_counter++] = temp_converttodword>>24 & 0xFF;
      Temperature_payload_buffer_temperatures[payload_counter++] = temp_converttodword>>16 & 0xFF;
      Temperature_payload_buffer_temperatures[payload_counter++] = temp_converttodword>> 8 & 0xFF;
      Temperature_payload_buffer_temperatures[payload_counter++] = temp_converttodword     & 0xFF;
    }
    
    
    // 7 isCodedStrict (boolean)
    if (Temperature_array_temperatures_isValueInvalid_available[j] == 1)
    {
      tag_dataID = 7;
      Temperature_payload_buffer_temperatures[payload_counter++] = 0 * 16 /* Wiretype = 0  =^ 8 Bit */ + ((tag_dataID>>8) & 0x0F) /* DataID High Part */ ;
      Temperature_payload_buffer_temperatures[payload_counter++] = tag_dataID & 0xFF /* DataID Low Part */ ;
      
      Temperature_payload_buffer_temperatures[payload_counter++] = Temperature_array_temperatures_isValueInvalid[j] & 0xFF;
    }
    
    
    //Element Length
    element_length = payload_counter-start_pos;
    if (element_length >0) Temperature_array_temperatures_array_element_length[j] = element_length - 4;
    else                   Temperature_array_temperatures_array_element_length[j] = element_length;
    
    Temperature_payload_buffer_temperatures[start_pos++] = Temperature_array_temperatures_array_element_length[j]>>24 & 0xFF;
    Temperature_payload_buffer_temperatures[start_pos++] = Temperature_array_temperatures_array_element_length[j]>>16 & 0xFF;
    Temperature_payload_buffer_temperatures[start_pos++] = Temperature_array_temperatures_array_element_length[j]>> 8 & 0xFF;
    Temperature_payload_buffer_temperatures[start_pos++] = Temperature_array_temperatures_array_element_length[j]     & 0xFF;
    
    if (Temperature_array_temperatures_array_element_length[j] == 0) payload_counter = payload_counter+4;
  }
  
  // Struct Length
  Temperature_array_temperatures_struct_element_length = 4*@Temperature_SetGet_temperatures_Element_TotalNum;

  for (k=0;k<@Temperature_SetGet_temperatures_Element_TotalNum;k++)
    Temperature_array_temperatures_struct_element_length = Temperature_array_temperatures_struct_element_length + Temperature_array_temperatures_array_element_length[k];
  
  Temperature_payload_buffer_temperatures[0] = Temperature_array_temperatures_struct_element_length>>24 & 0xFF;
  Temperature_payload_buffer_temperatures[1] = Temperature_array_temperatures_struct_element_length>>16 & 0xFF;
  Temperature_payload_buffer_temperatures[2] = Temperature_array_temperatures_struct_element_length>> 8 & 0xFF;
  Temperature_payload_buffer_temperatures[3] = Temperature_array_temperatures_struct_element_length     & 0xFF;


  Temperature_payload_length_temperatures = Temperature_array_temperatures_struct_element_length+4;
  putvalue(Temperature_SetGet_temperatures_Payload, Temperature_payload_buffer_temperatures, Temperature_payload_length_temperatures);
}

on envVar Temperature_SetGet_temperatures_Element_TotalNum
{
  if (@this == 0) @this =  1;
  if (@this > 10) @this = 10;
  
  Temperature_SetGet_temperatures();
  Temperature_SetGet_temperatures_update();
}

on envVar Temperature_SetGet_temperatures_Element
{
  Temperature_SetGet_temperatures_update();
}

on envVar Temperature_SetGet_temperatures_Element_Next
{
  if (@this == 1 && @Temperature_SetGet_temperatures_Element < @Temperature_SetGet_temperatures_Element_TotalNum - 1)
  {
    @Temperature_SetGet_temperatures_Element = @Temperature_SetGet_temperatures_Element + 1;
    Temperature_SetGet_temperatures_update();
  }
}

on envVar Temperature_SetGet_temperatures_Element_Previous
{
  if (@this == 1 && @Temperature_SetGet_temperatures_Element > 0)
  {
    @Temperature_SetGet_temperatures_Element = @Temperature_SetGet_temperatures_Element - 1;
    Temperature_SetGet_temperatures_update();
  }
}

Temperature_SetGet_temperatures_update()
{
  @Temperature_SetGet_LengthIndicator_Element_temperatures = Temperature_array_temperatures_array_element_length[@Temperature_SetGet_temperatures_Element];
  @Temperature_SetGet_LengthIndicator_Struct_temperatures  = Temperature_array_temperatures_struct_element_length;
  @Temperature_SetGet_Length_temperatures                  = Temperature_payload_length_temperatures+8;
  
  @Temperature_SetGet_temperatures_type              = Temperature_array_temperatures_type[@Temperature_SetGet_temperatures_Element];
  @Temperature_SetGet_temperatures_currentValue      = Temperature_array_temperatures_currentValue[@Temperature_SetGet_temperatures_Element];
  @Temperature_SetGet_temperatures_restrictionReason = Temperature_array_temperatures_restrictionReason[@Temperature_SetGet_temperatures_Element];
  @Temperature_SetGet_temperatures_unit              = Temperature_array_temperatures_unit[@Temperature_SetGet_temperatures_Element];
  @Temperature_SetGet_temperatures_minValue          = Temperature_array_temperatures_minValue[@Temperature_SetGet_temperatures_Element];
  @Temperature_SetGet_temperatures_maxValue          = Temperature_array_temperatures_maxValue[@Temperature_SetGet_temperatures_Element];
  @Temperature_SetGet_temperatures_resolution        = Temperature_array_temperatures_resolution[@Temperature_SetGet_temperatures_Element];
  @Temperature_SetGet_temperatures_isValueInvalid    = Temperature_array_temperatures_isValueInvalid[@Temperature_SetGet_temperatures_Element];
  
  @Temperature_SetGet_temperatures_type_available              = Temperature_array_temperatures_type_available[@Temperature_SetGet_temperatures_Element];
  @Temperature_SetGet_temperatures_currentValue_available      = Temperature_array_temperatures_currentValue_available[@Temperature_SetGet_temperatures_Element];
  @Temperature_SetGet_temperatures_restrictionReason_available = Temperature_array_temperatures_restrictionReason_available[@Temperature_SetGet_temperatures_Element];
  @Temperature_SetGet_temperatures_unit_available              = Temperature_array_temperatures_unit_available[@Temperature_SetGet_temperatures_Element];
  @Temperature_SetGet_temperatures_minValue_available          = Temperature_array_temperatures_minValue_available[@Temperature_SetGet_temperatures_Element];
  @Temperature_SetGet_temperatures_maxValue_available          = Temperature_array_temperatures_maxValue_available[@Temperature_SetGet_temperatures_Element];
  @Temperature_SetGet_temperatures_resolution_available        = Temperature_array_temperatures_resolution_available[@Temperature_SetGet_temperatures_Element];
  @Temperature_SetGet_temperatures_isValueInvalid_available    = Temperature_array_temperatures_isValueInvalid_available[@Temperature_SetGet_temperatures_Element];
}


Temperature_temperatures_Notification()
{
  word data_length;
  word data_length_element_sum;
  word data_length_element[10];
  byte wiretype;
  byte data_id;
  word start_pos;
  
  payload_rx_counter = 0;
  data_length_element_sum = 0;
  Temperature_temperatures_data_length_element_num = 0;
  Temperature_temperatures_available_reset();
  
  // Gesamtlaenge
  data_length = ((someip_payload_buffer[payload_rx_counter++]&0x000000FF)*16777216
              +  (someip_payload_buffer[payload_rx_counter++]&0x000000FF)*65536
              +  (someip_payload_buffer[payload_rx_counter++]&0x000000FF)*256
              +  (someip_payload_buffer[payload_rx_counter++]&0x000000FF));
  
  // pruefen ob noch Elemente vorhanden sind
  while (data_length_element_sum < data_length)
  {
    // Laenge Element
    data_length_element[Temperature_temperatures_data_length_element_num] = ((someip_payload_buffer[payload_rx_counter++]&0x000000FF)*16777216
                                                                          +  (someip_payload_buffer[payload_rx_counter++]&0x000000FF)*65536
                                                                          +  (someip_payload_buffer[payload_rx_counter++]&0x000000FF)*256
                                                                          +  (someip_payload_buffer[payload_rx_counter++]&0x000000FF));
   
    start_pos = payload_rx_counter;
    
    while (payload_rx_counter < data_length_element[Temperature_temperatures_data_length_element_num] + start_pos)
    {
      // wiretype & data_id pruefen
      wiretype = (someip_payload_buffer[payload_rx_counter++]>>4) & 0x0F;
      data_id = someip_payload_buffer[payload_rx_counter++];
      
      switch (data_id)
      {
        case 0:  Temperature_Notification_temperatures_type(); break;
        case 1:  Temperature_Notification_temperatures_currentValue(); break;
        case 2:  Temperature_Notification_temperatures_restrictionReason(); break;
        case 3:  Temperature_Notification_temperatures_unit(); break;
        case 4:  Temperature_Notification_temperatures_minValue(); break;
        case 5:  Temperature_Notification_temperatures_maxValue(); break;
        case 6:  Temperature_Notification_temperatures_resolution(); break;
        case 7:  Temperature_Notification_temperatures_isValueInvalid(); break;
      }
    }
    data_length_element_sum = data_length_element_sum + data_length_element[Temperature_temperatures_data_length_element_num] + 4;
    
    if (data_length_element_sum < data_length)
      Temperature_temperatures_data_length_element_num++;
  }
  @Temperature_SetGet_temperatures_Element_TotalNum = Temperature_temperatures_data_length_element_num+1;
}

Temperature_temperatures_available_reset()
{
  for (k=0; k<10; k++)
  {
    Temperature_array_temperatures_type_available[k]                              = 0;
    Temperature_array_temperatures_currentValue_available[k]                      = 0;
    Temperature_array_temperatures_restrictionReason_available[k]                 = 0;
    Temperature_array_temperatures_unit_available[k]                              = 0;
    Temperature_array_temperatures_minValue_available[k]                          = 0;
    Temperature_array_temperatures_maxValue_available[k]                          = 0;
    Temperature_array_temperatures_resolution_available[k]                        = 0;
    Temperature_array_temperatures_isValueInvalid_available[k]                    = 0;
    Temperature_array_temperatureWarnings_type_available[k]                       = 0;
    Temperature_array_temperatureWarnings_temperature_available[k]                = 0;
    Temperature_array_temperatureWarnings_isToBeNotified_available[k]             = 0;
  }
}


Temperature_Notification_temperatures_type()
{
  Temperature_array_temperatures_type[Temperature_temperatures_data_length_element_num] = ((someip_payload_buffer[payload_rx_counter++]&0x000000FF)*16777216
                                                                                        +  (someip_payload_buffer[payload_rx_counter++]&0x000000FF)*65536
                                                                                        +  (someip_payload_buffer[payload_rx_counter++]&0x000000FF)*256
                                                                                        +  (someip_payload_buffer[payload_rx_counter++]&0x000000FF));
  
  Temperature_array_temperatures_type_available[Temperature_temperatures_data_length_element_num] = 1;
  Temperature_SetGet_temperatures_update();
}
Temperature_Notification_temperatures_currentValue()
{
  dword temp_converttofloat;
  
  temp_converttofloat = ((someip_payload_buffer[payload_rx_counter++]&0x000000FF)*16777216
                      +  (someip_payload_buffer[payload_rx_counter++]&0x000000FF)*65536
                      +  (someip_payload_buffer[payload_rx_counter++]&0x000000FF)*256
                      +  (someip_payload_buffer[payload_rx_counter++]&0x000000FF));
  
  Temperature_array_temperatures_currentValue[Temperature_temperatures_data_length_element_num] = interpretAsFloat (temp_converttofloat);
  
  Temperature_array_temperatures_currentValue_available[Temperature_temperatures_data_length_element_num] = 1;
  Temperature_SetGet_temperatures_update();
}
Temperature_Notification_temperatures_restrictionReason()
{
  Temperature_array_temperatures_restrictionReason[Temperature_temperatures_data_length_element_num] = ((someip_payload_buffer[payload_rx_counter++]&0x000000FF)*16777216
                                                                                                     +  (someip_payload_buffer[payload_rx_counter++]&0x000000FF)*65536
                                                                                                     +  (someip_payload_buffer[payload_rx_counter++]&0x000000FF)*256
                                                                                                     +  (someip_payload_buffer[payload_rx_counter++]&0x000000FF));
  
  Temperature_array_temperatures_restrictionReason_available[Temperature_temperatures_data_length_element_num] = 1;
  Temperature_SetGet_temperatures_update();
}
Temperature_Notification_temperatures_unit()
{
  Temperature_array_temperatures_unit[Temperature_temperatures_data_length_element_num] = ((someip_payload_buffer[payload_rx_counter++]&0x000000FF)*16777216
                                                                                        +  (someip_payload_buffer[payload_rx_counter++]&0x000000FF)*65536
                                                                                        +  (someip_payload_buffer[payload_rx_counter++]&0x000000FF)*256
                                                                                        +  (someip_payload_buffer[payload_rx_counter++]&0x000000FF));
  
  Temperature_array_temperatures_unit_available[Temperature_temperatures_data_length_element_num] = 1;
  Temperature_SetGet_temperatures_update();
}
Temperature_Notification_temperatures_minValue()
{
  dword temp_converttofloat;
  
  temp_converttofloat = ((someip_payload_buffer[payload_rx_counter++]&0x000000FF)*16777216
                      +  (someip_payload_buffer[payload_rx_counter++]&0x000000FF)*65536
                      +  (someip_payload_buffer[payload_rx_counter++]&0x000000FF)*256
                      +  (someip_payload_buffer[payload_rx_counter++]&0x000000FF));
  
  Temperature_array_temperatures_minValue[Temperature_temperatures_data_length_element_num] = interpretAsFloat (temp_converttofloat);
  
  Temperature_array_temperatures_minValue_available[Temperature_temperatures_data_length_element_num] = 1;
  Temperature_SetGet_temperatures_update();
}
Temperature_Notification_temperatures_maxValue()
{
  dword temp_converttofloat;
  
  temp_converttofloat = ((someip_payload_buffer[payload_rx_counter++]&0x000000FF)*16777216
                      +  (someip_payload_buffer[payload_rx_counter++]&0x000000FF)*65536
                      +  (someip_payload_buffer[payload_rx_counter++]&0x000000FF)*256
                      +  (someip_payload_buffer[payload_rx_counter++]&0x000000FF));
  
  Temperature_array_temperatures_maxValue[Temperature_temperatures_data_length_element_num] = interpretAsFloat (temp_converttofloat);
  
  Temperature_array_temperatures_maxValue_available[Temperature_temperatures_data_length_element_num] = 1;
  Temperature_SetGet_temperatures_update();
}
Temperature_Notification_temperatures_resolution()
{
  dword temp_converttofloat;
  
  temp_converttofloat = ((someip_payload_buffer[payload_rx_counter++]&0x000000FF)*16777216
                      +  (someip_payload_buffer[payload_rx_counter++]&0x000000FF)*65536
                      +  (someip_payload_buffer[payload_rx_counter++]&0x000000FF)*256
                      +  (someip_payload_buffer[payload_rx_counter++]&0x000000FF));
  
  Temperature_array_temperatures_resolution[Temperature_temperatures_data_length_element_num] = interpretAsFloat (temp_converttofloat);
  
  Temperature_array_temperatures_resolution_available[Temperature_temperatures_data_length_element_num] = 1;
  Temperature_SetGet_temperatures_update();
}
Temperature_Notification_temperatures_isValueInvalid()
{
  Temperature_array_temperatures_isValueInvalid[Temperature_temperatures_data_length_element_num] = (someip_payload_buffer[payload_rx_counter++]&0x000000FF);
  
  Temperature_array_temperatures_isValueInvalid_available[Temperature_temperatures_data_length_element_num] = 1;
  Temperature_SetGet_temperatures_update();
}








////////// temperatureWarnings //////////

on envVar Temperature_SetGet_LengthIndicator_Struct_temperatureWarnings
{
  Temperature_SetGet_temperatureWarnings();
}
on envVar Temperature_SetGet_LengthIndicator_Element_temperatureWarnings
{
  Temperature_SetGet_temperatureWarnings();
}
on envVar Temperature_SetGet_temperatureWarnings_type
{
  Temperature_array_temperatureWarnings_type[@Temperature_SetGet_temperatureWarnings_Element] = @this;
  Temperature_SetGet_temperatureWarnings();
}
on envVar Temperature_SetGet_temperatureWarnings_temperature_serviceId
{
  Temperature_array_temperatureWarnings_temperature_serviceId[@Temperature_SetGet_temperatureWarnings_Element] = @this;
  Temperature_SetGet_temperatureWarnings();
}
on envVar Temperature_SetGet_temperatureWarnings_temperature_serviceInstanceId
{
  Temperature_array_temperatureWarnings_temperature_serviceInstanceId[@Temperature_SetGet_temperatureWarnings_Element] = @this;
  Temperature_SetGet_temperatureWarnings();
}
on envVar Temperature_SetGet_temperatureWarnings_temperature_resourceId
{
  Temperature_array_temperatureWarnings_temperature_resourceId[@Temperature_SetGet_temperatureWarnings_Element] = @this;
  Temperature_SetGet_temperatureWarnings();
}
on envVar Temperature_SetGet_temperatureWarnings_temperature_elementId
{
  getvalue(this, buffer_uuid);
  for (k=0;k<16;k++)
    Temperature_array_temperatureWarnings_temperature_elementId[@Temperature_SetGet_temperatureWarnings_Element][k] = buffer_uuid[k];
  Temperature_SetGet_temperatureWarnings();
}
on envVar Temperature_SetGet_temperatureWarnings_type_available
{
  Temperature_array_temperatureWarnings_type_available[@Temperature_SetGet_temperatureWarnings_Element] = @this;
  Temperature_SetGet_temperatureWarnings();
}
on envVar Temperature_SetGet_temperatureWarnings_temperature_available
{
  Temperature_array_temperatureWarnings_temperature_available[@Temperature_SetGet_temperatureWarnings_Element] = @this;
  Temperature_SetGet_temperatureWarnings();
}
on envVar Temperature_SetGet_temperatureWarnings_isToBeNotified_available
{
  Temperature_array_temperatureWarnings_isToBeNotified_available[@Temperature_SetGet_temperatureWarnings_Element] = @this;
  Temperature_SetGet_temperatureWarnings();
}
on envVar Temperature_SetGet_temperatureWarnings_Payload
{
  Temperature_SetGet_temperatureWarnings_update();
}


Temperature_SetGet_temperatureWarnings()
{
  word payload_counter = 0;
  word start_pos       = 0;
  word element_length  = 0;
  
  // Length Indicator Struct - Platzhalter
  payload_counter = 0+4;
  start_pos = 0;
  
  for (j=0; j<@Temperature_SetGet_temperatureWarnings_Element_TotalNum; j++)
  {
    Temperature_array_temperatureWarnings_available_functions[j] = Temperature_array_temperatureWarnings_type_available[j]
                                                                 + Temperature_array_temperatureWarnings_temperature_available[j]
                                                                 + Temperature_array_temperatureWarnings_isToBeNotified_available[j];
    
    // Length Indicator Element - Platzhalter
    if (Temperature_array_temperatureWarnings_available_functions[j] > 0)
    {
      start_pos = payload_counter;
      payload_counter = payload_counter + 4;
    }
    else 
      start_pos = payload_counter;
    
    
    // 0 type (enum32)
    if (Temperature_array_temperatureWarnings_type_available[j] == 1)
    {
      tag_dataID = 0;
      Temperature_payload_buffer_temperatureWarnings[payload_counter++] = 2 * 16 /* Wiretype = 2  =^ 32 Bit */ + ((tag_dataID>>8) & 0x0F) /* DataID High Part */ ;
      Temperature_payload_buffer_temperatureWarnings[payload_counter++] = tag_dataID & 0xFF /* DataID Low Part */ ;
      
      Temperature_payload_buffer_temperatureWarnings[payload_counter++] = Temperature_array_temperatureWarnings_type[j]>>24 & 0xFF;
      Temperature_payload_buffer_temperatureWarnings[payload_counter++] = Temperature_array_temperatureWarnings_type[j]>>16 & 0xFF;
      Temperature_payload_buffer_temperatureWarnings[payload_counter++] = Temperature_array_temperatureWarnings_type[j]>> 8 & 0xFF;
      Temperature_payload_buffer_temperatureWarnings[payload_counter++] = Temperature_array_temperatureWarnings_type[j]     & 0xFF;
    }
    
    
    // 1 temperature (ref#Temperature.temperatures.temperatureObject)
    if (Temperature_array_temperatureWarnings_temperature_available[j] == 1)
    {
      tag_dataID = 1;
      Temperature_payload_buffer_temperatureWarnings[payload_counter++] = 5 * 16 /* Wiretype = 5  =^ Array mit 1 Byte Länge */ + ((tag_dataID>>8) & 0x0F) /* DataID High Part */ ;
      Temperature_payload_buffer_temperatureWarnings[payload_counter++] = tag_dataID & 0xFF /* DataID Low Part */ ;
      
      Temperature_payload_buffer_temperatureWarnings[payload_counter++] = 22; // Array Length
      
      // Service ID
      Temperature_payload_buffer_temperatureWarnings[payload_counter++] = Temperature_array_temperatureWarnings_temperature_serviceId[j]>> 8 & 0xFF;
      Temperature_payload_buffer_temperatureWarnings[payload_counter++] = Temperature_array_temperatureWarnings_temperature_serviceId[j]     & 0xFF;
      
      // Service Instance ID
      Temperature_payload_buffer_temperatureWarnings[payload_counter++] = Temperature_array_temperatureWarnings_temperature_serviceInstanceId[j]>> 8 & 0xFF;
      Temperature_payload_buffer_temperatureWarnings[payload_counter++] = Temperature_array_temperatureWarnings_temperature_serviceInstanceId[j]     & 0xFF;
      
      // Resource ID
      Temperature_payload_buffer_temperatureWarnings[payload_counter++] = Temperature_array_temperatureWarnings_temperature_resourceId[j]>> 8 & 0xFF;
      Temperature_payload_buffer_temperatureWarnings[payload_counter++] = Temperature_array_temperatureWarnings_temperature_resourceId[j]     & 0xFF;
      
      // Element ID
      for (k=0; k<16; k++)
        Temperature_payload_buffer_temperatureWarnings[payload_counter++] = Temperature_array_temperatureWarnings_temperature_elementId[j][k] & 0xFF;
    }
    
    
    // 2 isCodedStrict (boolean)
    if (Temperature_array_temperatureWarnings_isToBeNotified_available[j] == 1)
    {
      tag_dataID =2;
      Temperature_payload_buffer_temperatureWarnings[payload_counter++] = 0 * 16 /* Wiretype = 0  =^ 8 Bit */ + ((tag_dataID>>8) & 0x0F) /* DataID High Part */ ;
      Temperature_payload_buffer_temperatureWarnings[payload_counter++] = tag_dataID & 0xFF /* DataID Low Part */ ;
      
      Temperature_payload_buffer_temperatureWarnings[payload_counter++] = Temperature_array_temperatureWarnings_isToBeNotified[j] & 0xFF;
    }
    
    
    //Element Length
    element_length = payload_counter-start_pos;
    if (element_length >0) Temperature_array_temperatureWarnings_array_element_length[j] = element_length - 4;
    else                   Temperature_array_temperatureWarnings_array_element_length[j] = element_length;
    
    Temperature_payload_buffer_temperatureWarnings[start_pos++] = Temperature_array_temperatureWarnings_array_element_length[j]>>24 & 0xFF;
    Temperature_payload_buffer_temperatureWarnings[start_pos++] = Temperature_array_temperatureWarnings_array_element_length[j]>>16 & 0xFF;
    Temperature_payload_buffer_temperatureWarnings[start_pos++] = Temperature_array_temperatureWarnings_array_element_length[j]>> 8 & 0xFF;
    Temperature_payload_buffer_temperatureWarnings[start_pos++] = Temperature_array_temperatureWarnings_array_element_length[j]     & 0xFF;
    
    if (Temperature_array_temperatureWarnings_array_element_length[j] == 0) payload_counter = payload_counter+4;
  }
  
  // Struct Length
  Temperature_array_temperatureWarnings_struct_element_length = 4*@Temperature_SetGet_temperatureWarnings_Element_TotalNum;

  for (k=0;k<@Temperature_SetGet_temperatureWarnings_Element_TotalNum;k++)
    Temperature_array_temperatureWarnings_struct_element_length = Temperature_array_temperatureWarnings_struct_element_length + Temperature_array_temperatureWarnings_array_element_length[k];
  
  Temperature_payload_buffer_temperatureWarnings[0] = Temperature_array_temperatureWarnings_struct_element_length>>24 & 0xFF;
  Temperature_payload_buffer_temperatureWarnings[1] = Temperature_array_temperatureWarnings_struct_element_length>>16 & 0xFF;
  Temperature_payload_buffer_temperatureWarnings[2] = Temperature_array_temperatureWarnings_struct_element_length>> 8 & 0xFF;
  Temperature_payload_buffer_temperatureWarnings[3] = Temperature_array_temperatureWarnings_struct_element_length     & 0xFF;


  Temperature_payload_length_temperatureWarnings = Temperature_array_temperatureWarnings_struct_element_length+4;
  putvalue(Temperature_SetGet_temperatureWarnings_Payload, Temperature_payload_buffer_temperatureWarnings, Temperature_payload_length_temperatureWarnings);
}

on envVar Temperature_SetGet_temperatureWarnings_Element_TotalNum
{
  if (@this == 0) @this =  1;
  if (@this > 10) @this = 10;
  
  Temperature_SetGet_temperatureWarnings();
  Temperature_SetGet_temperatureWarnings_update();
}

on envVar Temperature_SetGet_temperatureWarnings_Element
{
  Temperature_SetGet_temperatureWarnings_update();
}

on envVar Temperature_SetGet_temperatureWarnings_Element_Next
{
  if (@this == 1 && @Temperature_SetGet_temperatureWarnings_Element < @Temperature_SetGet_temperatureWarnings_Element_TotalNum - 1)
  {
    @Temperature_SetGet_temperatureWarnings_Element = @Temperature_SetGet_temperatureWarnings_Element + 1;
    Temperature_SetGet_temperatureWarnings_update();
  }
}

on envVar Temperature_SetGet_temperatureWarnings_Element_Previous
{
  if (@this == 1 && @Temperature_SetGet_temperatureWarnings_Element > 0)
  {
    @Temperature_SetGet_temperatureWarnings_Element = @Temperature_SetGet_temperatureWarnings_Element - 1;
    Temperature_SetGet_temperatureWarnings_update();
  }
}

Temperature_SetGet_temperatureWarnings_update()
{
  @Temperature_SetGet_LengthIndicator_Element_temperatureWarnings = Temperature_array_temperatureWarnings_array_element_length[@Temperature_SetGet_temperatureWarnings_Element];
  @Temperature_SetGet_LengthIndicator_Struct_temperatureWarnings  = Temperature_array_temperatureWarnings_struct_element_length;
  @Temperature_SetGet_Length_temperatureWarnings                  = Temperature_payload_length_temperatureWarnings+8;
  
  @Temperature_SetGet_temperatureWarnings_type                          = Temperature_array_temperatureWarnings_type[@Temperature_SetGet_temperatureWarnings_Element];
  @Temperature_SetGet_temperatureWarnings_temperature_serviceId         = Temperature_array_temperatureWarnings_temperature_serviceId[@ChargingManagementCore_Notification_immediateActions_Element];
  @Temperature_SetGet_temperatureWarnings_temperature_serviceInstanceId = Temperature_array_temperatureWarnings_temperature_serviceInstanceId[@ChargingManagementCore_Notification_immediateActions_Element];
  @Temperature_SetGet_temperatureWarnings_temperature_resourceId        = Temperature_array_temperatureWarnings_temperature_resourceId[@ChargingManagementCore_Notification_immediateActions_Element];
  @Temperature_SetGet_temperatureWarnings_isToBeNotified                = Temperature_array_temperatureWarnings_isToBeNotified[@Temperature_SetGet_temperatureWarnings_Element];
  
  putValue (Temperature_SetGet_temperatureWarnings_temperature_elementId, Temperature_array_temperatureWarnings_temperature_elementId[@ChargingManagementCore_Notification_immediateActions_Element]);
  
  @Temperature_SetGet_temperatureWarnings_type_available           = Temperature_array_temperatureWarnings_type_available[@Temperature_SetGet_temperatureWarnings_Element];
  @Temperature_SetGet_temperatureWarnings_temperature_available    = Temperature_array_temperatureWarnings_temperature_available[@Temperature_SetGet_temperatureWarnings_Element];
  @Temperature_SetGet_temperatureWarnings_isToBeNotified_available = Temperature_array_temperatureWarnings_isToBeNotified_available[@Temperature_SetGet_temperatureWarnings_Element];
}


Temperature_temperatureWarnings_Notification()
{
  word data_length;
  word data_length_element_sum;
  word data_length_element[10];
  byte wiretype;
  byte data_id;
  word start_pos;
  
  payload_rx_counter = 0;
  data_length_element_sum = 0;
  Temperature_temperatureWarnings_data_length_element_num = 0;
  Temperature_temperatureWarnings_available_reset();
  
  // Gesamtlaenge
  data_length = ((someip_payload_buffer[payload_rx_counter++]&0x000000FF)*16777216
              +  (someip_payload_buffer[payload_rx_counter++]&0x000000FF)*65536
              +  (someip_payload_buffer[payload_rx_counter++]&0x000000FF)*256
              +  (someip_payload_buffer[payload_rx_counter++]&0x000000FF));
  
  // pruefen ob noch Elemente vorhanden sind
  while (data_length_element_sum < data_length)
  {
    // Laenge Element
    data_length_element[Temperature_temperatureWarnings_data_length_element_num] = ((someip_payload_buffer[payload_rx_counter++]&0x000000FF)*16777216
                                                                                 +  (someip_payload_buffer[payload_rx_counter++]&0x000000FF)*65536
                                                                                 +  (someip_payload_buffer[payload_rx_counter++]&0x000000FF)*256
                                                                                 +  (someip_payload_buffer[payload_rx_counter++]&0x000000FF));
   
    start_pos = payload_rx_counter;
    
    while (payload_rx_counter < data_length_element[Temperature_temperatureWarnings_data_length_element_num] + start_pos)
    {
      // wiretype & data_id pruefen
      wiretype = (someip_payload_buffer[payload_rx_counter++]>>4) & 0x0F;
      data_id = someip_payload_buffer[payload_rx_counter++];
      
      switch (data_id)
      {
        case 0:  Temperature_Notification_temperatureWarnings_type(); break;
        case 1:  Temperature_Notification_temperatureWarnings_temperature(); break;
        case 2:  Temperature_Notification_temperatureWarnings_isToBeNotified(); break;
      }
    }
    data_length_element_sum = data_length_element_sum + data_length_element[Temperature_temperatureWarnings_data_length_element_num] + 4;
    
    if (data_length_element_sum < data_length)
      Temperature_temperatureWarnings_data_length_element_num++;
  }
  @Temperature_SetGet_temperatureWarnings_Element_TotalNum = Temperature_temperatureWarnings_data_length_element_num+1;
}

Temperature_temperatureWarnings_available_reset()
{
  for (k=0; k<10; k++)
  {
    Temperature_array_temperatureWarnings_type_available[k]           = 0;
    Temperature_array_temperatureWarnings_temperature_available[k]    = 0;
    Temperature_array_temperatureWarnings_isToBeNotified_available[k] = 0;
  }
}


Temperature_Notification_temperatureWarnings_type()
{
  Temperature_array_temperatureWarnings_type[Temperature_temperatureWarnings_data_length_element_num] = ((someip_payload_buffer[payload_rx_counter++]&0x000000FF)*16777216
                                                                                                      +  (someip_payload_buffer[payload_rx_counter++]&0x000000FF)*65536
                                                                                                      +  (someip_payload_buffer[payload_rx_counter++]&0x000000FF)*256
                                                                                                      +  (someip_payload_buffer[payload_rx_counter++]&0x000000FF));
  
  Temperature_array_temperatureWarnings_type_available[Temperature_temperatureWarnings_data_length_element_num] = 1;
  Temperature_SetGet_temperatureWarnings_update();
}
Temperature_Notification_temperatureWarnings_temperature()
{
  dword temp_converttofloat;
  byte length;
  
  payload_rx_counter++; // Laenge ueberspringen
  
  Temperature_array_temperatureWarnings_temperature_serviceId[Temperature_temperatureWarnings_data_length_element_num] = ((someip_payload_buffer[payload_rx_counter++]&0x000000FF)*256
                                                                                                                       +  (someip_payload_buffer[payload_rx_counter++]&0x000000FF));
  
  Temperature_array_temperatureWarnings_temperature_serviceInstanceId[Temperature_temperatureWarnings_data_length_element_num] = ((someip_payload_buffer[payload_rx_counter++]&0x000000FF)*256
                                                                                                                               +  (someip_payload_buffer[payload_rx_counter++]&0x000000FF));
  
  Temperature_array_temperatureWarnings_temperature_resourceId[Temperature_temperatureWarnings_data_length_element_num] = ((someip_payload_buffer[payload_rx_counter++]&0x000000FF)*256
                                                                                                                        +  (someip_payload_buffer[payload_rx_counter++]&0x000000FF));
  for (k=0; k<16; k++)
  {
    Temperature_array_temperatureWarnings_temperature_elementId[Temperature_temperatureWarnings_data_length_element_num][k] = someip_payload_buffer[payload_rx_counter++];
  }
  
  Temperature_array_temperatureWarnings_temperature_available[Temperature_temperatureWarnings_data_length_element_num] = 1;
  Temperature_SetGet_temperatureWarnings_update();
}
Temperature_Notification_temperatureWarnings_isToBeNotified()
{
  Temperature_array_temperatureWarnings_isToBeNotified[Temperature_temperatureWarnings_data_length_element_num] = (someip_payload_buffer[payload_rx_counter++]&0x000000FF);
  
  Temperature_array_temperatureWarnings_isToBeNotified_available[Temperature_temperatureWarnings_data_length_element_num] = 1;
  Temperature_SetGet_temperatureWarnings_update();
}







///////////////////////////////////////////////////////////////
////////////////// Service DrivingStatistics //////////////////
///////////////////////////////////////////////////////////////

on envVar ServiceDiscovery_Find_Service_DrivingStatistics
{
  if (@this == 1) Send_ServiceDiscovery_Find_Service_ICAS1Sys02();
}

on envVar DrivingStatistics_SetGet_speeds_Get
{
  if (@this == 1)
  {
    UDP_Segments_total = @DrivingStatistics_SetGet_Length_speeds/1404 + 1;
    UDP_Segments_left  = UDP_Segments_total;
    
    if (UDP_Segments_total > 1) seg_id_flag = 1;
    else                        seg_id_flag = 0;
    
    Send_Service_DrivingStatistics_SetGet (0x4010 & 0x0000FFFF);
  }
}
on envVar DrivingStatistics_SetGet_speeds_Set
{
  if (@this == 1)
  {
    UDP_Segments_total = @DrivingStatistics_SetGet_Length_speeds/1404 + 1;
    UDP_Segments_left  = UDP_Segments_total;
    
    if (UDP_Segments_total > 1) seg_id_flag = 1;
    else                        seg_id_flag = 0;
    
    Send_Service_DrivingStatistics_SetGet (0x4011 & 0x0000FFFF);
  }
}
on envVar DrivingStatistics_SetGet_distances_Get
{
  if (@this == 1)
  {
    UDP_Segments_total = @DrivingStatistics_SetGet_Length_distances/1404 + 1;
    UDP_Segments_left  = UDP_Segments_total;
    
    if (UDP_Segments_total > 1) seg_id_flag = 1;
    else                        seg_id_flag = 0;
    
    Send_Service_DrivingStatistics_SetGet (0x4020 & 0x0000FFFF);
  }
}
on envVar DrivingStatistics_SetGet_distances_Set
{
  if (@this == 1)
  {
    UDP_Segments_total = @DrivingStatistics_SetGet_Length_distances/1404 + 1;
    UDP_Segments_left  = UDP_Segments_total;
    
    if (UDP_Segments_total > 1) seg_id_flag = 1;
    else                        seg_id_flag = 0;
    
    Send_Service_DrivingStatistics_SetGet (0x4021 & 0x0000FFFF);
  }
}
on envVar DrivingStatistics_SetGet_durations_Get
{
  if (@this == 1)
  {
    UDP_Segments_total = @DrivingStatistics_SetGet_Length_durations/1404 + 1;
    UDP_Segments_left  = UDP_Segments_total;
    
    if (UDP_Segments_total > 1) seg_id_flag = 1;
    else                        seg_id_flag = 0;
    
    Send_Service_DrivingStatistics_SetGet (0x4030 & 0x0000FFFF);
  }
}
on envVar DrivingStatistics_SetGet_durations_Set
{
  if (@this == 1)
  {
    UDP_Segments_total = @DrivingStatistics_SetGet_Length_durations/1404 + 1;
    UDP_Segments_left  = UDP_Segments_total;
    
    if (UDP_Segments_total > 1) seg_id_flag = 1;
    else                        seg_id_flag = 0;
    
    Send_Service_DrivingStatistics_SetGet (0x4031 & 0x0000FFFF);
  }
}

on envVar DrivingStatistics_Subscribe_speeds
{
  if (get_subAck_flag == 0)
    Send_ServiceDiscovery_Subscribe_ICAS1Sys02 (0x6035, 0xC010, @this);
  
  DrivingStatistics_SubscribeStatus_speeds = @this;
}

on envVar DrivingStatistics_Subscribe_distances
{
  if (get_subAck_flag == 0)
    Send_ServiceDiscovery_Subscribe_ICAS1Sys02 (0x6035, 0xC020, @this);
  
  DrivingStatistics_SubscribeStatus_distances = @this;
}

on envVar DrivingStatistics_Subscribe_durations
{
  if (get_subAck_flag == 0)
    Send_ServiceDiscovery_Subscribe_ICAS1Sys02 (0x6035, 0xC030, @this);
  
  DrivingStatistics_SubscribeStatus_durations = @this;
}


Send_Service_DrivingStatistics_SetGet (word MethodID)
{
  ethernetPacket EthPaket;

  // Ethernet Packet - MAC Source address
  getvalue (ServiceDiscovery_EthernetPacket_MAC_Source_ICAS1Sys02, buffer_MAC);
  //EthPaket.source.ParseAddress ( buffer_MAC );
  EthPaket.source = ethGetMacAddressAsNumber (buffer_MAC);
  
  // Ethernet Packet - MAC Destination address
  getvalue (ServiceDiscovery_EthernetPacket_MAC_Destination, buffer_MAC);
  //EthPaket.destination.ParseAddress ( buffer_MAC );
  EthPaket.destination = ethGetMacAddressAsNumber (buffer_MAC);
  
  // Ethernet Packet - VLAN
  EthPaket.SetVlan (@ServiceDiscovery_EthernetPacket_VLAN_TPID, @ServiceDiscovery_EthernetPacket_VLAN_TCI);
  
  // Ethernet Packet - Type
  //EthPaket.ipv6.type = @EthernetPacket_Type;
  if (@ServiceDiscovery_EthernetPacket_Type == 0x86DD) EthPaket.ipv6.Init();
  
  
  // IPv6 Packet - Version
  EthPaket.ipv6.version = @ServiceDiscovery_IPv6Packet_Version;

  // IPv6 Packet - Traffic Class
  EthPaket.ipv6.class = @ServiceDiscovery_IPv6Packet_Traffic_Class;
  
  // IPv6 Packet - Flow Label
  EthPaket.ipv6.flow = @ServiceDiscovery_IPv6Packet_Flow_Label;
  
  // IPv6 Packet - Payload_Length
  EthPaket.ipv6.length = @ServiceDiscovery_IPv6Packet_Payload_Length;
  
  // IPv6 Packet - Next Header
  EthPaket.ipv6.next = @ServiceDiscovery_IPv6Packet_Next_Header;
  if (@ServiceDiscovery_IPv6Packet_Next_Header == 6) EthPaket.tcp.Init();
  if (@ServiceDiscovery_IPv6Packet_Next_Header == 17) EthPaket.udp.Init();
  
  // IPv6 Packet - Hop Limit
  EthPaket.ipv6.hopLimit = @ServiceDiscovery_IPv6Packet_Hop_Limit;

  // IPv6 Packet - IPv6 Destination address    // TODO: char array zu byte array
  buffer_ipv6[0]  = @ServiceDiscovery_IPv6Packet_IP_Destination_Unicast_01>>8 & 0xFF;
  buffer_ipv6[1]  = @ServiceDiscovery_IPv6Packet_IP_Destination_Unicast_01    & 0xFF;
  buffer_ipv6[2]  = @ServiceDiscovery_IPv6Packet_IP_Destination_Unicast_02>>8 & 0xFF;
  buffer_ipv6[3]  = @ServiceDiscovery_IPv6Packet_IP_Destination_Unicast_02    & 0xFF;
  buffer_ipv6[4]  = @ServiceDiscovery_IPv6Packet_IP_Destination_Unicast_03>>8 & 0xFF;
  buffer_ipv6[5]  = @ServiceDiscovery_IPv6Packet_IP_Destination_Unicast_03    & 0xFF;
  buffer_ipv6[6]  = @ServiceDiscovery_IPv6Packet_IP_Destination_Unicast_04>>8 & 0xFF;
  buffer_ipv6[7]  = @ServiceDiscovery_IPv6Packet_IP_Destination_Unicast_04    & 0xFF;
  buffer_ipv6[8]  = @ServiceDiscovery_IPv6Packet_IP_Destination_Unicast_05>>8 & 0xFF;
  buffer_ipv6[9]  = @ServiceDiscovery_IPv6Packet_IP_Destination_Unicast_05    & 0xFF;
  buffer_ipv6[10] = @ServiceDiscovery_IPv6Packet_IP_Destination_Unicast_06>>8 & 0xFF;
  buffer_ipv6[11] = @ServiceDiscovery_IPv6Packet_IP_Destination_Unicast_06    & 0xFF;
  buffer_ipv6[12] = @ServiceDiscovery_IPv6Packet_IP_Destination_Unicast_07>>8 & 0xFF;
  buffer_ipv6[13] = @ServiceDiscovery_IPv6Packet_IP_Destination_Unicast_07    & 0xFF;
  buffer_ipv6[14] = @ServiceDiscovery_IPv6Packet_IP_Destination_Unicast_08>>8 & 0xFF;
  buffer_ipv6[15] = @ServiceDiscovery_IPv6Packet_IP_Destination_Unicast_08    & 0xFF;
  EthPaket.ipv6.destination.SetData ( 0, buffer_ipv6, elcount(buffer_ipv6) );

  // IPv6 Packet - IPv6 Source address    // TODO: char array zu byte array
  buffer_ipv6[0]  = @ServiceDiscovery_IPv6Packet_IP_Source_ICAS1Sys02_01>>8 & 0xFF;
  buffer_ipv6[1]  = @ServiceDiscovery_IPv6Packet_IP_Source_ICAS1Sys02_01    & 0xFF;
  buffer_ipv6[2]  = @ServiceDiscovery_IPv6Packet_IP_Source_ICAS1Sys02_02>>8 & 0xFF;
  buffer_ipv6[3]  = @ServiceDiscovery_IPv6Packet_IP_Source_ICAS1Sys02_02    & 0xFF;
  buffer_ipv6[4]  = @ServiceDiscovery_IPv6Packet_IP_Source_ICAS1Sys02_03>>8 & 0xFF;
  buffer_ipv6[5]  = @ServiceDiscovery_IPv6Packet_IP_Source_ICAS1Sys02_03    & 0xFF;
  buffer_ipv6[6]  = @ServiceDiscovery_IPv6Packet_IP_Source_ICAS1Sys02_04>>8 & 0xFF;
  buffer_ipv6[7]  = @ServiceDiscovery_IPv6Packet_IP_Source_ICAS1Sys02_04    & 0xFF;
  buffer_ipv6[8]  = @ServiceDiscovery_IPv6Packet_IP_Source_ICAS1Sys02_05>>8 & 0xFF;
  buffer_ipv6[9]  = @ServiceDiscovery_IPv6Packet_IP_Source_ICAS1Sys02_05    & 0xFF;
  buffer_ipv6[10] = @ServiceDiscovery_IPv6Packet_IP_Source_ICAS1Sys02_06>>8 & 0xFF;
  buffer_ipv6[11] = @ServiceDiscovery_IPv6Packet_IP_Source_ICAS1Sys02_06    & 0xFF;
  buffer_ipv6[12] = @ServiceDiscovery_IPv6Packet_IP_Source_ICAS1Sys02_07>>8 & 0xFF;
  buffer_ipv6[13] = @ServiceDiscovery_IPv6Packet_IP_Source_ICAS1Sys02_07    & 0xFF;
  buffer_ipv6[14] = @ServiceDiscovery_IPv6Packet_IP_Source_ICAS1Sys02_08>>8 & 0xFF;
  buffer_ipv6[15] = @ServiceDiscovery_IPv6Packet_IP_Source_ICAS1Sys02_08    & 0xFF;
  EthPaket.ipv6.source.SetData ( 0, buffer_ipv6, elcount(buffer_ipv6) );

  
  // UDP Packet - Source Port
  EthPaket.udp.source = @DrivingStatistics_SetGet_Port_Source;
  
  // UDP Packet - Destination Port
  EthPaket.udp.destination = @DrivingStatistics_SetGet_Port_Destination;
  
  // UDP Packet - Length
  EthPaket.udp.length = @ServiceDiscovery_UDPPacket_Length;
  
  
  // SOME/IP Packet aus Rohdaten zusammenbauen (buffer array)
  i=0;
  
  // SOME/IP Packet - Message ID, Service ID [16 bit]
  buffer[i++] = @DrivingStatistics_SetGet_Message_ID_Service_ID>>8 & 0xFF;
  buffer[i++] = @DrivingStatistics_SetGet_Message_ID_Service_ID    & 0xFF;
  
  // SOME/IP Packet - Message ID, Message ID [16 bit]
  switch (MethodID)
  {
    case 0x4010: @DrivingStatistics_SetGet_Message_ID_Method_ID = @DrivingStatistics_SetGet_Message_ID_Method_ID_speeds_Get; break;
    case 0x4011: @DrivingStatistics_SetGet_Message_ID_Method_ID = @DrivingStatistics_SetGet_Message_ID_Method_ID_speeds_Set; break;
    case 0x4020: @DrivingStatistics_SetGet_Message_ID_Method_ID = @DrivingStatistics_SetGet_Message_ID_Method_ID_distances_Get; break;
    case 0x4021: @DrivingStatistics_SetGet_Message_ID_Method_ID = @DrivingStatistics_SetGet_Message_ID_Method_ID_distances_Set; break;
    case 0x4030: @DrivingStatistics_SetGet_Message_ID_Method_ID = @DrivingStatistics_SetGet_Message_ID_Method_ID_durations_Get; break;
    case 0x4031: @DrivingStatistics_SetGet_Message_ID_Method_ID = @DrivingStatistics_SetGet_Message_ID_Method_ID_durations_Set; break;
  }
  buffer[i++] = @DrivingStatistics_SetGet_Message_ID_Method_ID>>8 & 0xFF;
  buffer[i++] = @DrivingStatistics_SetGet_Message_ID_Method_ID    & 0xFF;
  
  // SOME/IP Packet - Length [32 bit]
  if (UDP_Segments_total == 1)
  {
    switch (MethodID)
    {
      case 0x4010: @DrivingStatistics_SetGet_Length = 8; break;
      case 0x4011: @DrivingStatistics_SetGet_Length = @DrivingStatistics_SetGet_Length_speeds; break;
      case 0x4020: @DrivingStatistics_SetGet_Length = 8; break;
      case 0x4021: @DrivingStatistics_SetGet_Length = @DrivingStatistics_SetGet_Length_distances; break;
      case 0x4030: @DrivingStatistics_SetGet_Length = 8; break;
      case 0x4031: @DrivingStatistics_SetGet_Length = @DrivingStatistics_SetGet_Length_durations; break;
    }
  }
  else
  {
    if (UDP_Segments_left > 1)
    {
      switch (MethodID)
      {
        case 0x4021: @DrivingStatistics_SetGet_Length = 1404; break;
      }
    }
    else
    {
      switch (MethodID)
      {
        case 0x4011: @DrivingStatistics_SetGet_Length = DrivingStatistics_payload_length_speeds    - 1404*(UDP_Segments_total-UDP_Segments_left) + 24; break;
        case 0x4021: @DrivingStatistics_SetGet_Length = DrivingStatistics_payload_length_distances - 1404*(UDP_Segments_total-UDP_Segments_left) + 24; break;
        case 0x4031: @DrivingStatistics_SetGet_Length = DrivingStatistics_payload_length_durations - 1404*(UDP_Segments_total-UDP_Segments_left) + 24; break;
      }
    }
  }
  buffer[i++] = @DrivingStatistics_SetGet_Length>>24 & 0xFF;
  buffer[i++] = @DrivingStatistics_SetGet_Length>>16 & 0xFF;
  buffer[i++] = @DrivingStatistics_SetGet_Length>> 8 & 0xFF;
  buffer[i++] = @DrivingStatistics_SetGet_Length     & 0xFF;
  
  // SOME/IP Packet - Request ID, Client ID [16 bit]
  buffer[i++] = @DrivingStatistics_SetGet_Request_ID_Client_ID>>8 & 0xFF;
  buffer[i++] = @DrivingStatistics_SetGet_Request_ID_Client_ID    & 0xFF;
  
  // SOME/IP Packet - Request ID, Session ID) [16 bit]
  if ((UDP_Segments_total == 1) || (seg_id_flag == 1))
  {
    @ServiceDiscovery_SOMEIPPacket_Notification_Request_ID_Session_ID = @ServiceDiscovery_SOMEIPPacket_Notification_Request_ID_Session_ID + 1;
    if (@ServiceDiscovery_SOMEIPPacket_Notification_Request_ID_Session_ID == 0x10000) @ServiceDiscovery_SOMEIPPacket_Notification_Request_ID_Session_ID = 1;
    seg_id_flag = 0;
  }
  
  buffer[i++] = @ServiceDiscovery_SOMEIPPacket_Notification_Request_ID_Session_ID>>8 & 0xFF;
  buffer[i++] = @ServiceDiscovery_SOMEIPPacket_Notification_Request_ID_Session_ID    & 0xFF;
  
  // SOME/IP Packet - Protocol Version [8 bit]
  buffer[i++] = @DrivingStatistics_SetGet_Protocol_Version;
  
  // SOME/IP Packet - Interface Version [8 bit]
  buffer[i++] = @DrivingStatistics_SetGet_Interface_Version;
  
  // SOME/IP Packet - Message Type [8 bit]
  buffer[i++] = @DrivingStatistics_SetGet_Message_Type;
  
  // SOME/IP Packet - Return Code [8 bit]
  buffer[i++] = @DrivingStatistics_SetGet_Return_Code;
  
  
  if (UDP_Segments_total > 1)
  {
    if (UDP_Segments_left >= 0)
    { 
      // Message Type neu setzen
      buffer[i-2] = @DrivingStatistics_SetGet_Message_Type + 0x20;
      
      // Offset (16byte Schritte, 1392/16 = 87)
      @DrivingStatistics_SetGet_Offset = 87 * (UDP_Segments_total - UDP_Segments_left);
      
      // More Segments Flag
      if (UDP_Segments_left > 1) @DrivingStatistics_SetGet_More_Segments_Flag = 1;
      else                       @DrivingStatistics_SetGet_More_Segments_Flag = 0;
      
      buffer[i++] =   @DrivingStatistics_SetGet_Offset>>20 & 0xFF;
      buffer[i++] =   @DrivingStatistics_SetGet_Offset>>12 & 0xFF;
      buffer[i++] =   @DrivingStatistics_SetGet_Offset>>4  & 0xFF;
      buffer[i++] = ((@DrivingStatistics_SetGet_Offset<<4) & 0xF0) + (@DrivingStatistics_SetGet_More_Segments_Flag & 0x01);
    }
  }
  
  UDP_Segments_left--;
  
  ////// speeds setter //////
  if (MethodID == 0x4011)
  {
    if (UDP_Segments_total == 1)
    {
      for (j=0; j<DrivingStatistics_payload_length_speeds; j++)
        buffer[i++] = DrivingStatistics_payload_buffer_speeds[j];
    }
    else
    {
      if (UDP_Segments_left >= 1)
      {
        for (j=(UDP_Segments_total-UDP_Segments_left-1)*1392; j<(UDP_Segments_total-UDP_Segments_left)*1392; j++)
          buffer[i++] = DrivingStatistics_payload_buffer_speeds[j];
      }
      else
      {
        for (j=(UDP_Segments_total-(UDP_Segments_left+1))*1392; j<DrivingStatistics_payload_length_speeds; j++)
          buffer[i++] = DrivingStatistics_payload_buffer_speeds[j];
      }
    }
  }
  
  ////// distances setter //////
  if (MethodID == 0x4021)
  {
    if (UDP_Segments_total == 1)
    {
      for (j=0; j<DrivingStatistics_payload_length_distances; j++)
        buffer[i++] = DrivingStatistics_payload_buffer_distances[j];
    }
    else
    {
      if (UDP_Segments_left >= 1)
      {
        for (j=(UDP_Segments_total-UDP_Segments_left-1)*1392; j<(UDP_Segments_total-UDP_Segments_left)*1392; j++)
          buffer[i++] = DrivingStatistics_payload_buffer_distances[j];
      }
      else
      {
        for (j=(UDP_Segments_total-(UDP_Segments_left+1))*1392; j<DrivingStatistics_payload_length_distances; j++)
          buffer[i++] = DrivingStatistics_payload_buffer_distances[j];
      }
    }
  }
  
  ////// durations setter //////
  if (MethodID == 0x4031)
  {
    if (UDP_Segments_total == 1)
    {
      for (j=0; j<DrivingStatistics_payload_length_durations; j++)
        buffer[i++] = DrivingStatistics_payload_buffer_durations[j];
    }
    else
    {
      if (UDP_Segments_left >= 1)
      {
        for (j=(UDP_Segments_total-UDP_Segments_left-1)*1392; j<(UDP_Segments_total-UDP_Segments_left)*1392; j++)
          buffer[i++] = DrivingStatistics_payload_buffer_durations[j];
      }
      else
      {
        for (j=(UDP_Segments_total-(UDP_Segments_left+1))*1392; j<DrivingStatistics_payload_length_durations; j++)
          buffer[i++] = DrivingStatistics_payload_buffer_durations[j];
      }
    }
  }
    
  // Rohdaten in UDP Paket schreiben
  EthPaket.udp.SetData( 0, buffer, i );

  // calculate UDP and IPv6 checksum and send Ethernet packet
  EthPaket.CompletePacket();
  output( EthPaket );
  
  // prüfen ob alle Segemente gesendet wurden, sonst senden erneut aufrufen
  DrivingStatistics_Segmentation_Method_ID = MethodID;
  if (UDP_Segments_left>0)
    settimer(DrivingStatistics_Segmentation_delay, 50);
}

on timer DrivingStatistics_Segmentation_delay
{
  Send_Service_DrivingStatistics_SetGet (DrivingStatistics_Segmentation_Method_ID);
}






////////// speeds Setter //////////

on envVar DrivingStatistics_SetGet_LengthIndicator_Struct_speeds
{
  DrivingStatistics_SetGet_speeds();
}
on envVar DrivingStatistics_SetGet_LengthIndicator_Element_speeds
{
  DrivingStatistics_SetGet_speeds();
}
on envVar DrivingStatistics_SetGet_speeds_memoryLevel
{
  DrivingStatistics_array_speeds_memoryLevel[@DrivingStatistics_SetGet_speeds_Element] = @this;
  DrivingStatistics_SetGet_speeds();
}
on envVar DrivingStatistics_SetGet_speeds_currentValue
{
  DrivingStatistics_array_speeds_currentValue[@DrivingStatistics_SetGet_speeds_Element] = @this;
  DrivingStatistics_SetGet_speeds();
}
on envVar DrivingStatistics_SetGet_speeds_state
{
  DrivingStatistics_array_speeds_state[@DrivingStatistics_SetGet_speeds_Element] = @this;
  DrivingStatistics_SetGet_speeds();
}
on envVar DrivingStatistics_SetGet_speeds_memoryLevel_available
{
  DrivingStatistics_array_speeds_memoryLevel_available[@DrivingStatistics_SetGet_speeds_Element] = @this;
  DrivingStatistics_SetGet_speeds();
}
on envVar DrivingStatistics_SetGet_speeds_currentValue_available
{
  DrivingStatistics_array_speeds_currentValue_available[@DrivingStatistics_SetGet_speeds_Element] = @this;
  DrivingStatistics_SetGet_speeds();
}
on envVar DrivingStatistics_SetGet_speeds_state_available
{
  DrivingStatistics_array_speeds_state_available[@DrivingStatistics_SetGet_speeds_Element] = @this;
  DrivingStatistics_SetGet_speeds();
}
on envVar DrivingStatistics_SetGet_speeds_Payload
{
  DrivingStatistics_SetGet_speeds_update();
}


DrivingStatistics_SetGet_speeds()
{
  word payload_counter = 0;
  word start_pos       = 0;
  word element_length  = 0;
  
  // Length Indicator Struct - Platzhalter
  payload_counter = 0+4;
  start_pos = 0;
  
  for (j=0; j<@DrivingStatistics_SetGet_speeds_Element_TotalNum; j++)
  {
    DrivingStatistics_array_speeds_available_functions[j] = DrivingStatistics_array_speeds_memoryLevel_available[j]
                                                          + DrivingStatistics_array_speeds_currentValue_available[j]
                                                          + DrivingStatistics_array_speeds_state_available[j];
    
    // Length Indicator Element - Platzhalter
    if (DrivingStatistics_array_speeds_available_functions[j] > 0)
    {
      start_pos = payload_counter;
      payload_counter = payload_counter + 4;
    }
    else 
      start_pos = payload_counter;
    
    
    // 0 memoryLevel (uint32)
    if (DrivingStatistics_array_speeds_memoryLevel_available[j] == 1)
    {
      tag_dataID = 0;
      DrivingStatistics_payload_buffer_speeds[payload_counter++] = 2 * 16 /* Wiretype = 2  =^ 32 Bit */ + ((tag_dataID>>8) & 0x0F) /* DataID High Part */ ;
      DrivingStatistics_payload_buffer_speeds[payload_counter++] = tag_dataID & 0xFF /* DataID Low Part */ ;
      
      DrivingStatistics_payload_buffer_speeds[payload_counter++] = DrivingStatistics_array_speeds_memoryLevel[j]>>24 & 0xFF;
      DrivingStatistics_payload_buffer_speeds[payload_counter++] = DrivingStatistics_array_speeds_memoryLevel[j]>>16 & 0xFF;
      DrivingStatistics_payload_buffer_speeds[payload_counter++] = DrivingStatistics_array_speeds_memoryLevel[j]>> 8 & 0xFF;
      DrivingStatistics_payload_buffer_speeds[payload_counter++] = DrivingStatistics_array_speeds_memoryLevel[j]     & 0xFF;
    }
    
    // 1 currentValue (float32)
    if (DrivingStatistics_array_speeds_currentValue_available[j] == 1)
    {
      tag_dataID = 1;
      DrivingStatistics_payload_buffer_speeds[payload_counter++] = 2 * 16 /* Wiretype = 2  =^ 32 Bit */ + ((tag_dataID>>8) & 0x0F) /* DataID High Part */ ;
      DrivingStatistics_payload_buffer_speeds[payload_counter++] = tag_dataID & 0xFF /* DataID Low Part */ ;
      
      temp_converttodword = interpretAsDword (DrivingStatistics_array_speeds_currentValue[j]);
      DrivingStatistics_payload_buffer_speeds[payload_counter++] = temp_converttodword>>24 & 0xFF;
      DrivingStatistics_payload_buffer_speeds[payload_counter++] = temp_converttodword>>16 & 0xFF;
      DrivingStatistics_payload_buffer_speeds[payload_counter++] = temp_converttodword>> 8 & 0xFF;
      DrivingStatistics_payload_buffer_speeds[payload_counter++] = temp_converttodword     & 0xFF;
    }
    
    
    // 2 state (enum32)
    if (DrivingStatistics_array_speeds_state_available[j] == 1)
    {
      tag_dataID = 2;
      DrivingStatistics_payload_buffer_speeds[payload_counter++] = 2 * 16 /* Wiretype = 2  =^ 32 Bit */ + ((tag_dataID>>8) & 0x0F) /* DataID High Part */ ;
      DrivingStatistics_payload_buffer_speeds[payload_counter++] = tag_dataID & 0xFF /* DataID Low Part */ ;
      
      DrivingStatistics_payload_buffer_speeds[payload_counter++] = DrivingStatistics_array_speeds_state[j]>>24 & 0xFF;
      DrivingStatistics_payload_buffer_speeds[payload_counter++] = DrivingStatistics_array_speeds_state[j]>>16 & 0xFF;
      DrivingStatistics_payload_buffer_speeds[payload_counter++] = DrivingStatistics_array_speeds_state[j]>> 8 & 0xFF;
      DrivingStatistics_payload_buffer_speeds[payload_counter++] = DrivingStatistics_array_speeds_state[j]     & 0xFF;
    }
    
    
    //Element Length
    element_length = payload_counter-start_pos;
    if (element_length >0) DrivingStatistics_array_speeds_array_element_length[j] = element_length - 4;
    else                   DrivingStatistics_array_speeds_array_element_length[j] = element_length;
    
    DrivingStatistics_payload_buffer_speeds[start_pos++] = DrivingStatistics_array_speeds_array_element_length[j]>>24 & 0xFF;
    DrivingStatistics_payload_buffer_speeds[start_pos++] = DrivingStatistics_array_speeds_array_element_length[j]>>16 & 0xFF;
    DrivingStatistics_payload_buffer_speeds[start_pos++] = DrivingStatistics_array_speeds_array_element_length[j]>> 8 & 0xFF;
    DrivingStatistics_payload_buffer_speeds[start_pos++] = DrivingStatistics_array_speeds_array_element_length[j]     & 0xFF;
    
    if (DrivingStatistics_array_speeds_array_element_length[j] == 0) payload_counter = payload_counter+4;
  }
  
  // Struct Length
  DrivingStatistics_array_speeds_struct_element_length = 4*@DrivingStatistics_SetGet_speeds_Element_TotalNum;

  for (k=0;k<@DrivingStatistics_SetGet_speeds_Element_TotalNum;k++)
    DrivingStatistics_array_speeds_struct_element_length = DrivingStatistics_array_speeds_struct_element_length + DrivingStatistics_array_speeds_array_element_length[k];
  
  DrivingStatistics_payload_buffer_speeds[0] = DrivingStatistics_array_speeds_struct_element_length>>24 & 0xFF;
  DrivingStatistics_payload_buffer_speeds[1] = DrivingStatistics_array_speeds_struct_element_length>>16 & 0xFF;
  DrivingStatistics_payload_buffer_speeds[2] = DrivingStatistics_array_speeds_struct_element_length>> 8 & 0xFF;
  DrivingStatistics_payload_buffer_speeds[3] = DrivingStatistics_array_speeds_struct_element_length     & 0xFF;


  DrivingStatistics_payload_length_speeds = DrivingStatistics_array_speeds_struct_element_length+4;
  putvalue(DrivingStatistics_SetGet_speeds_Payload, DrivingStatistics_payload_buffer_speeds, DrivingStatistics_payload_length_speeds);
}

on envVar DrivingStatistics_SetGet_speeds_Element_TotalNum
{
  if (@this == 0) @this =  1;
  if (@this > 10) @this = 10;
  
  DrivingStatistics_SetGet_speeds();
  DrivingStatistics_SetGet_speeds_update();
}

on envVar DrivingStatistics_SetGet_speeds_Element
{
  DrivingStatistics_SetGet_speeds_update();
}

on envVar DrivingStatistics_SetGet_speeds_Element_Next
{
  if (@this == 1 && @DrivingStatistics_SetGet_speeds_Element < @DrivingStatistics_SetGet_speeds_Element_TotalNum - 1)
  {
    @DrivingStatistics_SetGet_speeds_Element = @DrivingStatistics_SetGet_speeds_Element + 1;
    DrivingStatistics_SetGet_speeds_update();
  }
}

on envVar DrivingStatistics_SetGet_speeds_Element_Previous
{
  if (@this == 1 && @DrivingStatistics_SetGet_speeds_Element > 0)
  {
    @DrivingStatistics_SetGet_speeds_Element = @DrivingStatistics_SetGet_speeds_Element - 1;
    DrivingStatistics_SetGet_speeds_update();
  }
}
DrivingStatistics_SetGet_speeds_update()
{
  @DrivingStatistics_SetGet_LengthIndicator_Element_speeds = DrivingStatistics_array_speeds_array_element_length[@DrivingStatistics_SetGet_speeds_Element];
  @DrivingStatistics_SetGet_LengthIndicator_Struct_speeds  = DrivingStatistics_array_speeds_struct_element_length;
  @DrivingStatistics_SetGet_Length_speeds                  = DrivingStatistics_payload_length_speeds+8;
  
  @DrivingStatistics_SetGet_speeds_memoryLevel  = DrivingStatistics_array_speeds_memoryLevel[@DrivingStatistics_SetGet_speeds_Element];
  @DrivingStatistics_SetGet_speeds_currentValue = DrivingStatistics_array_speeds_currentValue[@DrivingStatistics_SetGet_speeds_Element];
  @DrivingStatistics_SetGet_speeds_state        = DrivingStatistics_array_speeds_state[@DrivingStatistics_SetGet_speeds_Element];
  
  @DrivingStatistics_SetGet_speeds_memoryLevel_available  = DrivingStatistics_array_speeds_memoryLevel_available[@DrivingStatistics_SetGet_speeds_Element];
  @DrivingStatistics_SetGet_speeds_currentValue_available = DrivingStatistics_array_speeds_currentValue_available[@DrivingStatistics_SetGet_speeds_Element];
  @DrivingStatistics_SetGet_speeds_state_available        = DrivingStatistics_array_speeds_state_available[@DrivingStatistics_SetGet_speeds_Element];
}


DrivingStatistics_speeds_Notification()
{
  word data_length;
  word data_length_element_sum;
  word data_length_element[10];
  byte wiretype;
  byte data_id;
  word start_pos;
  
  payload_rx_counter = 0;
  data_length_element_sum = 0;
  DrivingStatistics_speeds_data_length_element_num = 0;
  DrivingStatistics_speeds_available_reset();
  
  // Gesamtlaenge
  data_length = ((someip_payload_buffer[payload_rx_counter++]&0x000000FF)*16777216
              +  (someip_payload_buffer[payload_rx_counter++]&0x000000FF)*65536
              +  (someip_payload_buffer[payload_rx_counter++]&0x000000FF)*256
              +  (someip_payload_buffer[payload_rx_counter++]&0x000000FF));
  
  // pruefen ob noch Elemente vorhanden sind
  while (data_length_element_sum < data_length)
  {
    // Laenge Element
    data_length_element[DrivingStatistics_speeds_data_length_element_num] = ((someip_payload_buffer[payload_rx_counter++]&0x000000FF)*16777216
                                                                          +  (someip_payload_buffer[payload_rx_counter++]&0x000000FF)*65536
                                                                          +  (someip_payload_buffer[payload_rx_counter++]&0x000000FF)*256
                                                                          +  (someip_payload_buffer[payload_rx_counter++]&0x000000FF));
    
    start_pos = payload_rx_counter;
    
    while (payload_rx_counter < data_length_element[DrivingStatistics_speeds_data_length_element_num] + start_pos)
    {
      // wiretype & data_id pruefen
      wiretype = (someip_payload_buffer[payload_rx_counter++]>>4) & 0x0F;
      data_id = someip_payload_buffer[payload_rx_counter++];
      
      switch (data_id)
      {
        case 0:  DrivingStatistics_Notification_speeds_memoryLevel(); break;
        case 1:  DrivingStatistics_Notification_speeds_currentValue(); break;
        case 2:  DrivingStatistics_Notification_speeds_state(); break;
      }
    }
    data_length_element_sum = data_length_element_sum + data_length_element[DrivingStatistics_speeds_data_length_element_num] + 4;
    
    if (data_length_element_sum < data_length)
      DrivingStatistics_speeds_data_length_element_num++;
  }
  @DrivingStatistics_SetGet_speeds_Element_TotalNum = DrivingStatistics_speeds_data_length_element_num+1;
}

DrivingStatistics_speeds_available_reset()
{
  for (k=0; k<10; k++)
  {
    DrivingStatistics_array_speeds_memoryLevel_available[k]  = 0;
    DrivingStatistics_array_speeds_currentValue_available[k] = 0;
    DrivingStatistics_array_speeds_state_available[k]        = 0;
  }
}


DrivingStatistics_Notification_speeds_memoryLevel()
{
  DrivingStatistics_array_speeds_memoryLevel[DrivingStatistics_speeds_data_length_element_num] = ((someip_payload_buffer[payload_rx_counter++]&0x000000FF)*16777216
                                                                                               +  (someip_payload_buffer[payload_rx_counter++]&0x000000FF)*65536
                                                                                               +  (someip_payload_buffer[payload_rx_counter++]&0x000000FF)*256
                                                                                               +  (someip_payload_buffer[payload_rx_counter++]&0x000000FF));
  
  DrivingStatistics_array_speeds_memoryLevel_available[DrivingStatistics_speeds_data_length_element_num] = 1;
  DrivingStatistics_SetGet_speeds_update();
}
DrivingStatistics_Notification_speeds_currentValue()
{
  dword temp_converttofloat;
  
  temp_converttofloat = ((someip_payload_buffer[payload_rx_counter++]&0x000000FF)*16777216
                      +  (someip_payload_buffer[payload_rx_counter++]&0x000000FF)*65536
                      +  (someip_payload_buffer[payload_rx_counter++]&0x000000FF)*256
                      +  (someip_payload_buffer[payload_rx_counter++]&0x000000FF));
  
  DrivingStatistics_array_speeds_currentValue[DrivingStatistics_speeds_data_length_element_num] = interpretAsFloat (temp_converttofloat);
  
  DrivingStatistics_array_speeds_currentValue_available[DrivingStatistics_speeds_data_length_element_num] = 1;
  DrivingStatistics_SetGet_speeds_update();
}
DrivingStatistics_Notification_speeds_state()
{
  DrivingStatistics_array_speeds_state[DrivingStatistics_speeds_data_length_element_num] = ((someip_payload_buffer[payload_rx_counter++]&0x000000FF)*16777216
                                                                                         +  (someip_payload_buffer[payload_rx_counter++]&0x000000FF)*65536
                                                                                         +  (someip_payload_buffer[payload_rx_counter++]&0x000000FF)*256
                                                                                         +  (someip_payload_buffer[payload_rx_counter++]&0x000000FF));
  
  DrivingStatistics_array_speeds_state_available[DrivingStatistics_speeds_data_length_element_num] = 1;
  DrivingStatistics_SetGet_speeds_update();
}





////////// distances Setter //////////

on envVar DrivingStatistics_SetGet_LengthIndicator_Struct_distances
{
  DrivingStatistics_SetGet_distances();
}
on envVar DrivingStatistics_SetGet_LengthIndicator_Element_distances
{
  DrivingStatistics_SetGet_distances();
}
on envVar DrivingStatistics_SetGet_distances_memoryLevel
{
  DrivingStatistics_array_distances_memoryLevel[@DrivingStatistics_SetGet_distances_Element] = @this;
  DrivingStatistics_SetGet_distances();
}
on envVar DrivingStatistics_SetGet_distances_currentValue
{
  DrivingStatistics_array_distances_currentValue[@DrivingStatistics_SetGet_distances_Element] = @this;
  DrivingStatistics_SetGet_distances();
}
on envVar DrivingStatistics_SetGet_distances_state
{
  DrivingStatistics_array_distances_state[@DrivingStatistics_SetGet_distances_Element] = @this;
  DrivingStatistics_SetGet_distances();
}
on envVar DrivingStatistics_SetGet_distances_memoryLevel_available
{
  DrivingStatistics_array_distances_memoryLevel_available[@DrivingStatistics_SetGet_distances_Element] = @this;
  DrivingStatistics_SetGet_distances();
}
on envVar DrivingStatistics_SetGet_distances_currentValue_available
{
  DrivingStatistics_array_distances_currentValue_available[@DrivingStatistics_SetGet_distances_Element] = @this;
  DrivingStatistics_SetGet_distances();
}
on envVar DrivingStatistics_SetGet_distances_state_available
{
  DrivingStatistics_array_distances_state_available[@DrivingStatistics_SetGet_distances_Element] = @this;
  DrivingStatistics_SetGet_distances();
}
on envVar DrivingStatistics_SetGet_distances_Payload
{
  DrivingStatistics_SetGet_distances_update();
}


DrivingStatistics_SetGet_distances()
{
  word payload_counter = 0;
  word start_pos       = 0;
  word element_length  = 0;
  
  // Length Indicator Struct - Platzhalter
  payload_counter = 0+4;
  start_pos = 0;
  
  for (j=0; j<@DrivingStatistics_SetGet_distances_Element_TotalNum; j++)
  {
    DrivingStatistics_array_distances_available_functions[j] = DrivingStatistics_array_distances_memoryLevel_available[j]
                                                             + DrivingStatistics_array_distances_currentValue_available[j]
                                                             + DrivingStatistics_array_distances_state_available[j];
    
    // Length Indicator Element - Platzhalter
    if (DrivingStatistics_array_distances_available_functions[j] > 0)
    {
      start_pos = payload_counter;
      payload_counter = payload_counter + 4;
    }
    else 
      start_pos = payload_counter;
    
    
    // 0 memoryLevel (uint32)
    if (DrivingStatistics_array_distances_memoryLevel_available[j] == 1)
    {
      tag_dataID = 0;
      DrivingStatistics_payload_buffer_distances[payload_counter++] = 2 * 16 /* Wiretype = 2  =^ 32 Bit */ + ((tag_dataID>>8) & 0x0F) /* DataID High Part */ ;
      DrivingStatistics_payload_buffer_distances[payload_counter++] = tag_dataID & 0xFF /* DataID Low Part */ ;
      
      DrivingStatistics_payload_buffer_distances[payload_counter++] = DrivingStatistics_array_distances_memoryLevel[j]>>24 & 0xFF;
      DrivingStatistics_payload_buffer_distances[payload_counter++] = DrivingStatistics_array_distances_memoryLevel[j]>>16 & 0xFF;
      DrivingStatistics_payload_buffer_distances[payload_counter++] = DrivingStatistics_array_distances_memoryLevel[j]>> 8 & 0xFF;
      DrivingStatistics_payload_buffer_distances[payload_counter++] = DrivingStatistics_array_distances_memoryLevel[j]     & 0xFF;
    }
    
    
    // 1 currentValue (uint32)
    if (DrivingStatistics_array_distances_currentValue_available[j] == 1)
    {
      tag_dataID = 1;
      DrivingStatistics_payload_buffer_distances[payload_counter++] = 2 * 16 /* Wiretype = 2  =^ 32 Bit */ + ((tag_dataID>>8) & 0x0F) /* DataID High Part */ ;
      DrivingStatistics_payload_buffer_distances[payload_counter++] = tag_dataID & 0xFF /* DataID Low Part */ ;
      
      DrivingStatistics_payload_buffer_distances[payload_counter++] = DrivingStatistics_array_distances_currentValue[j]>>24 & 0xFF;
      DrivingStatistics_payload_buffer_distances[payload_counter++] = DrivingStatistics_array_distances_currentValue[j]>>16 & 0xFF;
      DrivingStatistics_payload_buffer_distances[payload_counter++] = DrivingStatistics_array_distances_currentValue[j]>> 8 & 0xFF;
      DrivingStatistics_payload_buffer_distances[payload_counter++] = DrivingStatistics_array_distances_currentValue[j]     & 0xFF;
    }
    
    
    // 2 state (enum32)
    if (DrivingStatistics_array_distances_state_available[j] == 1)
    {
      tag_dataID = 2;
      DrivingStatistics_payload_buffer_distances[payload_counter++] = 2 * 16 /* Wiretype = 2  =^ 32 Bit */ + ((tag_dataID>>8) & 0x0F) /* DataID High Part */ ;
      DrivingStatistics_payload_buffer_distances[payload_counter++] = tag_dataID & 0xFF /* DataID Low Part */ ;
      
      DrivingStatistics_payload_buffer_distances[payload_counter++] = DrivingStatistics_array_distances_state[j]>>24 & 0xFF;
      DrivingStatistics_payload_buffer_distances[payload_counter++] = DrivingStatistics_array_distances_state[j]>>16 & 0xFF;
      DrivingStatistics_payload_buffer_distances[payload_counter++] = DrivingStatistics_array_distances_state[j]>> 8 & 0xFF;
      DrivingStatistics_payload_buffer_distances[payload_counter++] = DrivingStatistics_array_distances_state[j]     & 0xFF;
    }
    
    
    //Element Length
    element_length = payload_counter-start_pos;
    if (element_length >0) DrivingStatistics_array_distances_array_element_length[j] = element_length - 4;
    else                   DrivingStatistics_array_distances_array_element_length[j] = element_length;
    
    DrivingStatistics_payload_buffer_distances[start_pos++] = DrivingStatistics_array_distances_array_element_length[j]>>24 & 0xFF;
    DrivingStatistics_payload_buffer_distances[start_pos++] = DrivingStatistics_array_distances_array_element_length[j]>>16 & 0xFF;
    DrivingStatistics_payload_buffer_distances[start_pos++] = DrivingStatistics_array_distances_array_element_length[j]>> 8 & 0xFF;
    DrivingStatistics_payload_buffer_distances[start_pos++] = DrivingStatistics_array_distances_array_element_length[j]     & 0xFF;
    
    if (DrivingStatistics_array_distances_array_element_length[j] == 0) payload_counter = payload_counter+4;
  }
  
  // Struct Length
  DrivingStatistics_array_distances_struct_element_length = 4*@DrivingStatistics_SetGet_distances_Element_TotalNum;

  for (k=0;k<@DrivingStatistics_SetGet_distances_Element_TotalNum;k++)
    DrivingStatistics_array_distances_struct_element_length = DrivingStatistics_array_distances_struct_element_length + DrivingStatistics_array_distances_array_element_length[k];
  
  DrivingStatistics_payload_buffer_distances[0] = DrivingStatistics_array_distances_struct_element_length>>24 & 0xFF;
  DrivingStatistics_payload_buffer_distances[1] = DrivingStatistics_array_distances_struct_element_length>>16 & 0xFF;
  DrivingStatistics_payload_buffer_distances[2] = DrivingStatistics_array_distances_struct_element_length>> 8 & 0xFF;
  DrivingStatistics_payload_buffer_distances[3] = DrivingStatistics_array_distances_struct_element_length     & 0xFF;


  DrivingStatistics_payload_length_distances = DrivingStatistics_array_distances_struct_element_length+4;
  putvalue(DrivingStatistics_SetGet_distances_Payload, DrivingStatistics_payload_buffer_distances, DrivingStatistics_payload_length_distances);
}

on envVar DrivingStatistics_SetGet_distances_Element_TotalNum
{
  if (@this == 0) @this =  1;
  if (@this > 10) @this = 10;
  
  DrivingStatistics_SetGet_distances();
  DrivingStatistics_SetGet_distances_update();
}

on envVar DrivingStatistics_SetGet_distances_Element
{
  DrivingStatistics_SetGet_distances_update();
}

on envVar DrivingStatistics_SetGet_distances_Element_Next
{
  if (@this == 1 && @DrivingStatistics_SetGet_distances_Element < @DrivingStatistics_SetGet_distances_Element_TotalNum - 1)
  {
    @DrivingStatistics_SetGet_distances_Element = @DrivingStatistics_SetGet_distances_Element + 1;
    DrivingStatistics_SetGet_distances_update();
  }
}

on envVar DrivingStatistics_SetGet_distances_Element_Previous
{
  if (@this == 1 && @DrivingStatistics_SetGet_distances_Element > 0)
  {
    @DrivingStatistics_SetGet_distances_Element = @DrivingStatistics_SetGet_distances_Element - 1;
    DrivingStatistics_SetGet_distances_update();
  }
}
DrivingStatistics_SetGet_distances_update()
{
  @DrivingStatistics_SetGet_LengthIndicator_Element_distances = DrivingStatistics_array_distances_array_element_length[@DrivingStatistics_SetGet_distances_Element];
  @DrivingStatistics_SetGet_LengthIndicator_Struct_distances  = DrivingStatistics_array_distances_struct_element_length;
  @DrivingStatistics_SetGet_Length_distances                  = DrivingStatistics_payload_length_distances+8;
  
  @DrivingStatistics_SetGet_distances_memoryLevel  = DrivingStatistics_array_distances_memoryLevel[@DrivingStatistics_SetGet_distances_Element];
  @DrivingStatistics_SetGet_distances_currentValue = DrivingStatistics_array_distances_currentValue[@DrivingStatistics_SetGet_distances_Element];
  @DrivingStatistics_SetGet_distances_state        = DrivingStatistics_array_distances_state[@DrivingStatistics_SetGet_distances_Element];
  
  @DrivingStatistics_SetGet_distances_memoryLevel_available  = DrivingStatistics_array_distances_memoryLevel_available[@DrivingStatistics_SetGet_distances_Element];
  @DrivingStatistics_SetGet_distances_currentValue_available = DrivingStatistics_array_distances_currentValue_available[@DrivingStatistics_SetGet_distances_Element];
  @DrivingStatistics_SetGet_distances_state_available        = DrivingStatistics_array_distances_state_available[@DrivingStatistics_SetGet_distances_Element];
}


DrivingStatistics_distances_Notification()
{
  word data_length;
  word data_length_element_sum;
  word data_length_element[10];
  byte wirememoryLevel;
  byte data_id;
  word start_pos;
  
  payload_rx_counter = 0;
  data_length_element_sum = 0;
  DrivingStatistics_distances_data_length_element_num = 0;
  DrivingStatistics_distances_available_reset();
  
  // Gesamtlaenge
  data_length = ((someip_payload_buffer[payload_rx_counter++]&0x000000FF)*16777216
              +  (someip_payload_buffer[payload_rx_counter++]&0x000000FF)*65536
              +  (someip_payload_buffer[payload_rx_counter++]&0x000000FF)*256
              +  (someip_payload_buffer[payload_rx_counter++]&0x000000FF));
  
  // pruefen ob noch Elemente vorhanden sind
  while (data_length_element_sum < data_length)
  {
    // Laenge Element
    data_length_element[DrivingStatistics_distances_data_length_element_num] = ((someip_payload_buffer[payload_rx_counter++]&0x000000FF)*16777216
                                                                             +  (someip_payload_buffer[payload_rx_counter++]&0x000000FF)*65536
                                                                             +  (someip_payload_buffer[payload_rx_counter++]&0x000000FF)*256
                                                                             +  (someip_payload_buffer[payload_rx_counter++]&0x000000FF));
   
    start_pos = payload_rx_counter;
    
    while (payload_rx_counter < data_length_element[DrivingStatistics_distances_data_length_element_num] + start_pos)
    {
      // wirememoryLevel & data_id pruefen
      wirememoryLevel = (someip_payload_buffer[payload_rx_counter++]>>4) & 0x0F;
      data_id = someip_payload_buffer[payload_rx_counter++];
      
      switch (data_id)
      {
        case 0:  DrivingStatistics_Notification_distances_memoryLevel(); break;
        case 1:  DrivingStatistics_Notification_distances_currentValue(); break;
        case 2:  DrivingStatistics_Notification_distances_state(); break;
      }
    }
    data_length_element_sum = data_length_element_sum + data_length_element[DrivingStatistics_distances_data_length_element_num] + 4;
    
    if (data_length_element_sum < data_length)
      DrivingStatistics_distances_data_length_element_num++;
  }
  @DrivingStatistics_SetGet_distances_Element_TotalNum = DrivingStatistics_distances_data_length_element_num+1;
}

DrivingStatistics_distances_available_reset()
{
  for (k=0; k<10; k++)
  {
    DrivingStatistics_array_distances_memoryLevel_available[k]  = 0;
    DrivingStatistics_array_distances_currentValue_available[k] = 0;
    DrivingStatistics_array_distances_state_available[k]        = 0;
  }
}


DrivingStatistics_Notification_distances_memoryLevel()
{
  DrivingStatistics_array_distances_memoryLevel[DrivingStatistics_distances_data_length_element_num] = ((someip_payload_buffer[payload_rx_counter++]&0x000000FF)*16777216
                                                                                                     +  (someip_payload_buffer[payload_rx_counter++]&0x000000FF)*65536
                                                                                                     +  (someip_payload_buffer[payload_rx_counter++]&0x000000FF)*256
                                                                                                     +  (someip_payload_buffer[payload_rx_counter++]&0x000000FF));
  
  DrivingStatistics_array_distances_memoryLevel_available[DrivingStatistics_distances_data_length_element_num] = 1;
  DrivingStatistics_SetGet_distances_update();
}
DrivingStatistics_Notification_distances_currentValue()
{
  DrivingStatistics_array_distances_currentValue[DrivingStatistics_distances_data_length_element_num] = ((someip_payload_buffer[payload_rx_counter++]&0x000000FF)*16777216
                                                                                                      +  (someip_payload_buffer[payload_rx_counter++]&0x000000FF)*65536
                                                                                                      +  (someip_payload_buffer[payload_rx_counter++]&0x000000FF)*256
                                                                                                      +  (someip_payload_buffer[payload_rx_counter++]&0x000000FF));
  
  DrivingStatistics_array_distances_currentValue_available[DrivingStatistics_distances_data_length_element_num] = 1;
  DrivingStatistics_SetGet_distances_update();
}
DrivingStatistics_Notification_distances_state()
{
  DrivingStatistics_array_distances_state[DrivingStatistics_distances_data_length_element_num] = ((someip_payload_buffer[payload_rx_counter++]&0x000000FF)*16777216
                                                                                               +  (someip_payload_buffer[payload_rx_counter++]&0x000000FF)*65536
                                                                                               +  (someip_payload_buffer[payload_rx_counter++]&0x000000FF)*256
                                                                                               +  (someip_payload_buffer[payload_rx_counter++]&0x000000FF));
  
  DrivingStatistics_array_distances_state_available[DrivingStatistics_distances_data_length_element_num] = 1;
  DrivingStatistics_SetGet_distances_update();
}






////////// durations Setter //////////

on envVar DrivingStatistics_SetGet_LengthIndicator_Struct_durations
{
  DrivingStatistics_SetGet_durations();
}
on envVar DrivingStatistics_SetGet_LengthIndicator_Element_durations
{
  DrivingStatistics_SetGet_durations();
}
on envVar DrivingStatistics_SetGet_durations_memoryLevel
{
  DrivingStatistics_array_durations_memoryLevel[@DrivingStatistics_SetGet_durations_Element] = @this;
  DrivingStatistics_SetGet_durations();
}
on envVar DrivingStatistics_SetGet_durations_currentValue
{
  DrivingStatistics_array_durations_currentValue[@DrivingStatistics_SetGet_durations_Element] = @this;
  DrivingStatistics_SetGet_durations();
}
on envVar DrivingStatistics_SetGet_durations_state
{
  DrivingStatistics_array_durations_state[@DrivingStatistics_SetGet_durations_Element] = @this;
  DrivingStatistics_SetGet_durations();
}
on envVar DrivingStatistics_SetGet_durations_memoryLevel_available
{
  DrivingStatistics_array_durations_memoryLevel_available[@DrivingStatistics_SetGet_durations_Element] = @this;
  DrivingStatistics_SetGet_durations();
}
on envVar DrivingStatistics_SetGet_durations_currentValue_available
{
  DrivingStatistics_array_durations_currentValue_available[@DrivingStatistics_SetGet_durations_Element] = @this;
  DrivingStatistics_SetGet_durations();
}
on envVar DrivingStatistics_SetGet_durations_state_available
{
  DrivingStatistics_array_durations_state_available[@DrivingStatistics_SetGet_durations_Element] = @this;
  DrivingStatistics_SetGet_durations();
}
on envVar DrivingStatistics_SetGet_durations_Payload
{
  DrivingStatistics_SetGet_durations_update();
}


DrivingStatistics_SetGet_durations()
{
  word payload_counter = 0;
  word start_pos       = 0;
  word element_length  = 0;
  
  // Length Indicator Struct - Platzhalter
  payload_counter = 0+4;
  start_pos = 0;
  
  for (j=0; j<@DrivingStatistics_SetGet_durations_Element_TotalNum; j++)
  {
    DrivingStatistics_array_durations_available_functions[j] = DrivingStatistics_array_durations_memoryLevel_available[j]
                                                             + DrivingStatistics_array_durations_currentValue_available[j]
                                                             + DrivingStatistics_array_durations_state_available[j];
    
    // Length Indicator Element - Platzhalter
    if (DrivingStatistics_array_durations_available_functions[j] > 0)
    {
      start_pos = payload_counter;
      payload_counter = payload_counter + 4;
    }
    else 
      start_pos = payload_counter;
    
    
    // 0 memoryLevel (uint32)
    if (DrivingStatistics_array_durations_memoryLevel_available[j] == 1)
    {
      tag_dataID = 0;
      DrivingStatistics_payload_buffer_durations[payload_counter++] = 2 * 16 /* Wiretype = 2  =^ 32 Bit */ + ((tag_dataID>>8) & 0x0F) /* DataID High Part */ ;
      DrivingStatistics_payload_buffer_durations[payload_counter++] = tag_dataID & 0xFF /* DataID Low Part */ ;
      
      DrivingStatistics_payload_buffer_durations[payload_counter++] = DrivingStatistics_array_durations_memoryLevel[j]>>24 & 0xFF;
      DrivingStatistics_payload_buffer_durations[payload_counter++] = DrivingStatistics_array_durations_memoryLevel[j]>>16 & 0xFF;
      DrivingStatistics_payload_buffer_durations[payload_counter++] = DrivingStatistics_array_durations_memoryLevel[j]>> 8 & 0xFF;
      DrivingStatistics_payload_buffer_durations[payload_counter++] = DrivingStatistics_array_durations_memoryLevel[j]     & 0xFF;
    }
    
    
    // 1 currentValue (uint32)
    if (DrivingStatistics_array_durations_currentValue_available[j] == 1)
    {
      tag_dataID = 1;
      DrivingStatistics_payload_buffer_durations[payload_counter++] = 2 * 16 /* Wiretype = 2  =^ 32 Bit */ + ((tag_dataID>>8) & 0x0F) /* DataID High Part */ ;
      DrivingStatistics_payload_buffer_durations[payload_counter++] = tag_dataID & 0xFF /* DataID Low Part */ ;
      
      DrivingStatistics_payload_buffer_durations[payload_counter++] = DrivingStatistics_array_durations_currentValue[j]>>24 & 0xFF;
      DrivingStatistics_payload_buffer_durations[payload_counter++] = DrivingStatistics_array_durations_currentValue[j]>>16 & 0xFF;
      DrivingStatistics_payload_buffer_durations[payload_counter++] = DrivingStatistics_array_durations_currentValue[j]>> 8 & 0xFF;
      DrivingStatistics_payload_buffer_durations[payload_counter++] = DrivingStatistics_array_durations_currentValue[j]     & 0xFF;
    }
    
    
    // 2 state (enum32)
    if (DrivingStatistics_array_durations_state_available[j] == 1)
    {
      tag_dataID = 2;
      DrivingStatistics_payload_buffer_durations[payload_counter++] = 2 * 16 /* Wiretype = 2  =^ 32 Bit */ + ((tag_dataID>>8) & 0x0F) /* DataID High Part */ ;
      DrivingStatistics_payload_buffer_durations[payload_counter++] = tag_dataID & 0xFF /* DataID Low Part */ ;
      
      DrivingStatistics_payload_buffer_durations[payload_counter++] = DrivingStatistics_array_durations_state[j]>>24 & 0xFF;
      DrivingStatistics_payload_buffer_durations[payload_counter++] = DrivingStatistics_array_durations_state[j]>>16 & 0xFF;
      DrivingStatistics_payload_buffer_durations[payload_counter++] = DrivingStatistics_array_durations_state[j]>> 8 & 0xFF;
      DrivingStatistics_payload_buffer_durations[payload_counter++] = DrivingStatistics_array_durations_state[j]     & 0xFF;
    }
    
    
    //Element Length
    element_length = payload_counter-start_pos;
    if (element_length >0) DrivingStatistics_array_durations_array_element_length[j] = element_length - 4;
    else                   DrivingStatistics_array_durations_array_element_length[j] = element_length;
    
    DrivingStatistics_payload_buffer_durations[start_pos++] = DrivingStatistics_array_durations_array_element_length[j]>>24 & 0xFF;
    DrivingStatistics_payload_buffer_durations[start_pos++] = DrivingStatistics_array_durations_array_element_length[j]>>16 & 0xFF;
    DrivingStatistics_payload_buffer_durations[start_pos++] = DrivingStatistics_array_durations_array_element_length[j]>> 8 & 0xFF;
    DrivingStatistics_payload_buffer_durations[start_pos++] = DrivingStatistics_array_durations_array_element_length[j]     & 0xFF;
    
    if (DrivingStatistics_array_durations_array_element_length[j] == 0) payload_counter = payload_counter+4;
  }
  
  // Struct Length
  DrivingStatistics_array_durations_struct_element_length = 4*@DrivingStatistics_SetGet_durations_Element_TotalNum;

  for (k=0;k<@DrivingStatistics_SetGet_durations_Element_TotalNum;k++)
    DrivingStatistics_array_durations_struct_element_length = DrivingStatistics_array_durations_struct_element_length + DrivingStatistics_array_durations_array_element_length[k];
  
  DrivingStatistics_payload_buffer_durations[0] = DrivingStatistics_array_durations_struct_element_length>>24 & 0xFF;
  DrivingStatistics_payload_buffer_durations[1] = DrivingStatistics_array_durations_struct_element_length>>16 & 0xFF;
  DrivingStatistics_payload_buffer_durations[2] = DrivingStatistics_array_durations_struct_element_length>> 8 & 0xFF;
  DrivingStatistics_payload_buffer_durations[3] = DrivingStatistics_array_durations_struct_element_length     & 0xFF;


  DrivingStatistics_payload_length_durations = DrivingStatistics_array_durations_struct_element_length+4;
  putvalue(DrivingStatistics_SetGet_durations_Payload, DrivingStatistics_payload_buffer_durations, DrivingStatistics_payload_length_durations);
}

on envVar DrivingStatistics_SetGet_durations_Element_TotalNum
{
  if (@this == 0) @this =  1;
  if (@this > 10) @this = 10;
  
  DrivingStatistics_SetGet_durations();
  DrivingStatistics_SetGet_durations_update();
}

on envVar DrivingStatistics_SetGet_durations_Element
{
  DrivingStatistics_SetGet_durations_update();
}

on envVar DrivingStatistics_SetGet_durations_Element_Next
{
  if (@this == 1 && @DrivingStatistics_SetGet_durations_Element < @DrivingStatistics_SetGet_durations_Element_TotalNum - 1)
  {
    @DrivingStatistics_SetGet_durations_Element = @DrivingStatistics_SetGet_durations_Element + 1;
    DrivingStatistics_SetGet_durations_update();
  }
}

on envVar DrivingStatistics_SetGet_durations_Element_Previous
{
  if (@this == 1 && @DrivingStatistics_SetGet_durations_Element > 0)
  {
    @DrivingStatistics_SetGet_durations_Element = @DrivingStatistics_SetGet_durations_Element - 1;
    DrivingStatistics_SetGet_durations_update();
  }
}
DrivingStatistics_SetGet_durations_update()
{
  @DrivingStatistics_SetGet_LengthIndicator_Element_durations = DrivingStatistics_array_durations_array_element_length[@DrivingStatistics_SetGet_durations_Element];
  @DrivingStatistics_SetGet_LengthIndicator_Struct_durations  = DrivingStatistics_array_durations_struct_element_length;
  @DrivingStatistics_SetGet_Length_durations                  = DrivingStatistics_payload_length_durations+8;
  
  @DrivingStatistics_SetGet_durations_memoryLevel  = DrivingStatistics_array_durations_memoryLevel[@DrivingStatistics_SetGet_durations_Element];
  @DrivingStatistics_SetGet_durations_currentValue = DrivingStatistics_array_durations_currentValue[@DrivingStatistics_SetGet_durations_Element];
  @DrivingStatistics_SetGet_durations_state        = DrivingStatistics_array_durations_state[@DrivingStatistics_SetGet_durations_Element];
  
  @DrivingStatistics_SetGet_durations_memoryLevel_available  = DrivingStatistics_array_durations_memoryLevel_available[@DrivingStatistics_SetGet_durations_Element];
  @DrivingStatistics_SetGet_durations_currentValue_available = DrivingStatistics_array_durations_currentValue_available[@DrivingStatistics_SetGet_durations_Element];
  @DrivingStatistics_SetGet_durations_state_available        = DrivingStatistics_array_durations_state_available[@DrivingStatistics_SetGet_durations_Element];
}


DrivingStatistics_durations_Notification()
{
  word data_length;
  word data_length_element_sum;
  word data_length_element[10];
  byte wirememoryLevel;
  byte data_id;
  word start_pos;
  
  payload_rx_counter = 0;
  data_length_element_sum = 0;
  DrivingStatistics_durations_data_length_element_num = 0;
  DrivingStatistics_durations_available_reset();
  
  // Gesamtlaenge
  data_length = ((someip_payload_buffer[payload_rx_counter++]&0x000000FF)*16777216
              +  (someip_payload_buffer[payload_rx_counter++]&0x000000FF)*65536
              +  (someip_payload_buffer[payload_rx_counter++]&0x000000FF)*256
              +  (someip_payload_buffer[payload_rx_counter++]&0x000000FF));
  
  // pruefen ob noch Elemente vorhanden sind
  while (data_length_element_sum < data_length)
  {
    // Laenge Element
    data_length_element[DrivingStatistics_durations_data_length_element_num] = ((someip_payload_buffer[payload_rx_counter++]&0x000000FF)*16777216
                                                                          +  (someip_payload_buffer[payload_rx_counter++]&0x000000FF)*65536
                                                                          +  (someip_payload_buffer[payload_rx_counter++]&0x000000FF)*256
                                                                          +  (someip_payload_buffer[payload_rx_counter++]&0x000000FF));
   
    start_pos = payload_rx_counter;
    
    while (payload_rx_counter < data_length_element[DrivingStatistics_durations_data_length_element_num] + start_pos)
    {
      // wirememoryLevel & data_id pruefen
      wirememoryLevel = (someip_payload_buffer[payload_rx_counter++]>>4) & 0x0F;
      data_id = someip_payload_buffer[payload_rx_counter++];
      
      switch (data_id)
      {
        case 0:  DrivingStatistics_Notification_durations_memoryLevel(); break;
        case 1:  DrivingStatistics_Notification_durations_currentValue(); break;
        case 2:  DrivingStatistics_Notification_durations_state(); break;
      }
    }
    data_length_element_sum = data_length_element_sum + data_length_element[DrivingStatistics_durations_data_length_element_num] + 4;
    
    if (data_length_element_sum < data_length)
      DrivingStatistics_durations_data_length_element_num++;
  }
  @DrivingStatistics_SetGet_durations_Element_TotalNum = DrivingStatistics_durations_data_length_element_num+1;
}

DrivingStatistics_durations_available_reset()
{
  for (k=0; k<10; k++)
  {
    DrivingStatistics_array_durations_memoryLevel_available[k]  = 0;
    DrivingStatistics_array_durations_currentValue_available[k] = 0;
    DrivingStatistics_array_durations_state_available[k]        = 0;
  }
}


DrivingStatistics_Notification_durations_memoryLevel()
{
  DrivingStatistics_array_durations_memoryLevel[DrivingStatistics_durations_data_length_element_num] = ((someip_payload_buffer[payload_rx_counter++]&0x000000FF)*16777216
                                                                                               +  (someip_payload_buffer[payload_rx_counter++]&0x000000FF)*65536
                                                                                               +  (someip_payload_buffer[payload_rx_counter++]&0x000000FF)*256
                                                                                               +  (someip_payload_buffer[payload_rx_counter++]&0x000000FF));
  
  DrivingStatistics_array_durations_memoryLevel_available[DrivingStatistics_durations_data_length_element_num] = 1;
  DrivingStatistics_SetGet_durations_update();
}
DrivingStatistics_Notification_durations_currentValue()
{
  DrivingStatistics_array_durations_currentValue[DrivingStatistics_durations_data_length_element_num] = ((someip_payload_buffer[payload_rx_counter++]&0x000000FF)*16777216
                                                                                                      +  (someip_payload_buffer[payload_rx_counter++]&0x000000FF)*65536
                                                                                                      +  (someip_payload_buffer[payload_rx_counter++]&0x000000FF)*256
                                                                                                      +  (someip_payload_buffer[payload_rx_counter++]&0x000000FF));
  
  DrivingStatistics_array_durations_currentValue_available[DrivingStatistics_durations_data_length_element_num] = 1;
  DrivingStatistics_SetGet_durations_update();
}
DrivingStatistics_Notification_durations_state()
{
  DrivingStatistics_array_durations_state[DrivingStatistics_durations_data_length_element_num] = ((someip_payload_buffer[payload_rx_counter++]&0x000000FF)*16777216
                                                                                               +  (someip_payload_buffer[payload_rx_counter++]&0x000000FF)*65536
                                                                                               +  (someip_payload_buffer[payload_rx_counter++]&0x000000FF)*256
                                                                                               +  (someip_payload_buffer[payload_rx_counter++]&0x000000FF));
  
  DrivingStatistics_array_durations_state_available[DrivingStatistics_durations_data_length_element_num] = 1;
  DrivingStatistics_SetGet_durations_update();
}









////////////////////////////////////////////////////////////////////
////////////////// Service DiagnosticNotification //////////////////
////////////////////////////////////////////////////////////////////

on envVar ServiceDiscovery_Find_Service_DiagnosticNotification
{
  if (@this == 1) Send_ServiceDiscovery_Find_Service_ICAS1Sys02();
}

on envVar DiagnosticNotification_SetGet_notifications_Get
{
  if (@this == 1)
  {
    UDP_Segments_total = @DiagnosticNotification_SetGet_Length_notifications/1404 + 1;
    UDP_Segments_left  = UDP_Segments_total;
    
    if (UDP_Segments_total > 1) seg_id_flag = 1;
    else                        seg_id_flag = 0;
    
    Send_Service_DiagnosticNotification_SetGet (0x4010 & 0x0000FFFF);
  }
}

on envVar DiagnosticNotification_Subscribe_notifications
{
  if (get_subAck_flag == 0)
    Send_ServiceDiscovery_Subscribe_ICAS1Sys02 (0x6046, 0xC010, @this);
  
  DiagnosticNotification_SubscribeStatus_notifications = @this;
}


Send_Service_DiagnosticNotification_SetGet (word MethodID)
{
  ethernetPacket EthPaket;

  // Ethernet Packet - MAC Source address
  getvalue (ServiceDiscovery_EthernetPacket_MAC_Source_ICAS1Sys02, buffer_MAC);
  //EthPaket.source.ParseAddress ( buffer_MAC );
  EthPaket.source = ethGetMacAddressAsNumber (buffer_MAC);
  
  // Ethernet Packet - MAC Destination address
  getvalue (ServiceDiscovery_EthernetPacket_MAC_Destination, buffer_MAC);
  //EthPaket.destination.ParseAddress ( buffer_MAC );
  EthPaket.destination = ethGetMacAddressAsNumber (buffer_MAC);
  
  // Ethernet Packet - VLAN
  EthPaket.SetVlan (@ServiceDiscovery_EthernetPacket_VLAN_TPID, @ServiceDiscovery_EthernetPacket_VLAN_TCI);
  
  // Ethernet Packet - Type
  //EthPaket.ipv6.type = @EthernetPacket_Type;
  if (@ServiceDiscovery_EthernetPacket_Type == 0x86DD) EthPaket.ipv6.Init();
  
  
  // IPv6 Packet - Version
  EthPaket.ipv6.version = @ServiceDiscovery_IPv6Packet_Version;

  // IPv6 Packet - Traffic Class
  EthPaket.ipv6.class = @ServiceDiscovery_IPv6Packet_Traffic_Class;
  
  // IPv6 Packet - Flow Label
  EthPaket.ipv6.flow = @ServiceDiscovery_IPv6Packet_Flow_Label;
  
  // IPv6 Packet - Payload_Length
  EthPaket.ipv6.length = @ServiceDiscovery_IPv6Packet_Payload_Length;
  
  // IPv6 Packet - Next Header
  EthPaket.ipv6.next = @ServiceDiscovery_IPv6Packet_Next_Header;
  if (@ServiceDiscovery_IPv6Packet_Next_Header == 6) EthPaket.tcp.Init();
  if (@ServiceDiscovery_IPv6Packet_Next_Header == 17) EthPaket.udp.Init();
  
  // IPv6 Packet - Hop Limit
  EthPaket.ipv6.hopLimit = @ServiceDiscovery_IPv6Packet_Hop_Limit;

  // IPv6 Packet - IPv6 Destination address    // TODO: char array zu byte array
  buffer_ipv6[0]  = @ServiceDiscovery_IPv6Packet_IP_Destination_Unicast_01>>8 & 0xFF;
  buffer_ipv6[1]  = @ServiceDiscovery_IPv6Packet_IP_Destination_Unicast_01    & 0xFF;
  buffer_ipv6[2]  = @ServiceDiscovery_IPv6Packet_IP_Destination_Unicast_02>>8 & 0xFF;
  buffer_ipv6[3]  = @ServiceDiscovery_IPv6Packet_IP_Destination_Unicast_02    & 0xFF;
  buffer_ipv6[4]  = @ServiceDiscovery_IPv6Packet_IP_Destination_Unicast_03>>8 & 0xFF;
  buffer_ipv6[5]  = @ServiceDiscovery_IPv6Packet_IP_Destination_Unicast_03    & 0xFF;
  buffer_ipv6[6]  = @ServiceDiscovery_IPv6Packet_IP_Destination_Unicast_04>>8 & 0xFF;
  buffer_ipv6[7]  = @ServiceDiscovery_IPv6Packet_IP_Destination_Unicast_04    & 0xFF;
  buffer_ipv6[8]  = @ServiceDiscovery_IPv6Packet_IP_Destination_Unicast_05>>8 & 0xFF;
  buffer_ipv6[9]  = @ServiceDiscovery_IPv6Packet_IP_Destination_Unicast_05    & 0xFF;
  buffer_ipv6[10] = @ServiceDiscovery_IPv6Packet_IP_Destination_Unicast_06>>8 & 0xFF;
  buffer_ipv6[11] = @ServiceDiscovery_IPv6Packet_IP_Destination_Unicast_06    & 0xFF;
  buffer_ipv6[12] = @ServiceDiscovery_IPv6Packet_IP_Destination_Unicast_07>>8 & 0xFF;
  buffer_ipv6[13] = @ServiceDiscovery_IPv6Packet_IP_Destination_Unicast_07    & 0xFF;
  buffer_ipv6[14] = @ServiceDiscovery_IPv6Packet_IP_Destination_Unicast_08>>8 & 0xFF;
  buffer_ipv6[15] = @ServiceDiscovery_IPv6Packet_IP_Destination_Unicast_08    & 0xFF;
  EthPaket.ipv6.destination.SetData ( 0, buffer_ipv6, elcount(buffer_ipv6) );

  // IPv6 Packet - IPv6 Source address    // TODO: char array zu byte array
  buffer_ipv6[0]  = @ServiceDiscovery_IPv6Packet_IP_Source_ICAS1Sys02_01>>8 & 0xFF;
  buffer_ipv6[1]  = @ServiceDiscovery_IPv6Packet_IP_Source_ICAS1Sys02_01    & 0xFF;
  buffer_ipv6[2]  = @ServiceDiscovery_IPv6Packet_IP_Source_ICAS1Sys02_02>>8 & 0xFF;
  buffer_ipv6[3]  = @ServiceDiscovery_IPv6Packet_IP_Source_ICAS1Sys02_02    & 0xFF;
  buffer_ipv6[4]  = @ServiceDiscovery_IPv6Packet_IP_Source_ICAS1Sys02_03>>8 & 0xFF;
  buffer_ipv6[5]  = @ServiceDiscovery_IPv6Packet_IP_Source_ICAS1Sys02_03    & 0xFF;
  buffer_ipv6[6]  = @ServiceDiscovery_IPv6Packet_IP_Source_ICAS1Sys02_04>>8 & 0xFF;
  buffer_ipv6[7]  = @ServiceDiscovery_IPv6Packet_IP_Source_ICAS1Sys02_04    & 0xFF;
  buffer_ipv6[8]  = @ServiceDiscovery_IPv6Packet_IP_Source_ICAS1Sys02_05>>8 & 0xFF;
  buffer_ipv6[9]  = @ServiceDiscovery_IPv6Packet_IP_Source_ICAS1Sys02_05    & 0xFF;
  buffer_ipv6[10] = @ServiceDiscovery_IPv6Packet_IP_Source_ICAS1Sys02_06>>8 & 0xFF;
  buffer_ipv6[11] = @ServiceDiscovery_IPv6Packet_IP_Source_ICAS1Sys02_06    & 0xFF;
  buffer_ipv6[12] = @ServiceDiscovery_IPv6Packet_IP_Source_ICAS1Sys02_07>>8 & 0xFF;
  buffer_ipv6[13] = @ServiceDiscovery_IPv6Packet_IP_Source_ICAS1Sys02_07    & 0xFF;
  buffer_ipv6[14] = @ServiceDiscovery_IPv6Packet_IP_Source_ICAS1Sys02_08>>8 & 0xFF;
  buffer_ipv6[15] = @ServiceDiscovery_IPv6Packet_IP_Source_ICAS1Sys02_08    & 0xFF;
  EthPaket.ipv6.source.SetData ( 0, buffer_ipv6, elcount(buffer_ipv6) );

  
  // UDP Packet - Source Port
  EthPaket.udp.source = @DiagnosticNotification_SetGet_Port_Source;
  
  // UDP Packet - Destination Port
  EthPaket.udp.destination = @DiagnosticNotification_SetGet_Port_Destination;
  
  // UDP Packet - Length
  EthPaket.udp.length = @ServiceDiscovery_UDPPacket_Length;
  
  
  // SOME/IP Packet aus Rohdaten zusammenbauen (buffer array)
  i=0;
  
  // SOME/IP Packet - Message ID, Service ID [16 bit]
  buffer[i++] = @DiagnosticNotification_SetGet_Message_ID_Service_ID>>8 & 0xFF;
  buffer[i++] = @DiagnosticNotification_SetGet_Message_ID_Service_ID    & 0xFF;
  
  // SOME/IP Packet - Message ID, Message ID [16 bit]
  switch (MethodID)
  {
    case 0x4010: @DiagnosticNotification_SetGet_Message_ID_Method_ID = @DiagnosticNotification_SetGet_Message_ID_Method_ID_notifications_Get; break;
  }
  buffer[i++] = @DiagnosticNotification_SetGet_Message_ID_Method_ID>>8 & 0xFF;
  buffer[i++] = @DiagnosticNotification_SetGet_Message_ID_Method_ID    & 0xFF;
  
  // SOME/IP Packet - Length [32 bit]
  if (UDP_Segments_total == 1)
  {
    switch (MethodID)
    {
      case 0x4010: @DiagnosticNotification_SetGet_Length = 8; break;
    }
  }
  else
  {
    if (UDP_Segments_left > 1)
    {
      switch (MethodID)
      {
        case 0x4021: @DiagnosticNotification_SetGet_Length = 1404; break;
      }
    }
    else
    {
      switch (MethodID)
      {
        
      }
    }
  }
  buffer[i++] = @DiagnosticNotification_SetGet_Length>>24 & 0xFF;
  buffer[i++] = @DiagnosticNotification_SetGet_Length>>16 & 0xFF;
  buffer[i++] = @DiagnosticNotification_SetGet_Length>> 8 & 0xFF;
  buffer[i++] = @DiagnosticNotification_SetGet_Length     & 0xFF;
  
  // SOME/IP Packet - Request ID, Client ID [16 bit]
  buffer[i++] = @DiagnosticNotification_SetGet_Request_ID_Client_ID>>8 & 0xFF;
  buffer[i++] = @DiagnosticNotification_SetGet_Request_ID_Client_ID    & 0xFF;
  
  // SOME/IP Packet - Request ID, Session ID) [16 bit]
  if ((UDP_Segments_total == 1) || (seg_id_flag == 1))
  {
    @ServiceDiscovery_SOMEIPPacket_Notification_Request_ID_Session_ID = @ServiceDiscovery_SOMEIPPacket_Notification_Request_ID_Session_ID + 1;
    if (@ServiceDiscovery_SOMEIPPacket_Notification_Request_ID_Session_ID == 0x10000) @ServiceDiscovery_SOMEIPPacket_Notification_Request_ID_Session_ID = 1;
    seg_id_flag = 0;
  }
  
  buffer[i++] = @ServiceDiscovery_SOMEIPPacket_Notification_Request_ID_Session_ID>>8 & 0xFF;
  buffer[i++] = @ServiceDiscovery_SOMEIPPacket_Notification_Request_ID_Session_ID    & 0xFF;
  
  // SOME/IP Packet - Protocol Version [8 bit]
  buffer[i++] = @DiagnosticNotification_SetGet_Protocol_Version;
  
  // SOME/IP Packet - Interface Version [8 bit]
  buffer[i++] = @DiagnosticNotification_SetGet_Interface_Version;
  
  // SOME/IP Packet - Message Type [8 bit]
  buffer[i++] = @DiagnosticNotification_SetGet_Message_Type;
  
  // SOME/IP Packet - Return Code [8 bit]
  buffer[i++] = @DiagnosticNotification_SetGet_Return_Code;
  
  
  if (UDP_Segments_total > 1)
  {
    if (UDP_Segments_left >= 0)
    { 
      // Message Type neu setzen
      buffer[i-2] = @DiagnosticNotification_SetGet_Message_Type + 0x20;
      
      // Offset (16byte Schritte, 1392/16 = 87)
      @DiagnosticNotification_SetGet_Offset = 87 * (UDP_Segments_total - UDP_Segments_left);
      
      // More Segments Flag
      if (UDP_Segments_left > 1) @DiagnosticNotification_SetGet_More_Segments_Flag = 1;
      else                       @DiagnosticNotification_SetGet_More_Segments_Flag = 0;
      
      buffer[i++] =   @DiagnosticNotification_SetGet_Offset>>20 & 0xFF;
      buffer[i++] =   @DiagnosticNotification_SetGet_Offset>>12 & 0xFF;
      buffer[i++] =   @DiagnosticNotification_SetGet_Offset>>4  & 0xFF;
      buffer[i++] = ((@DiagnosticNotification_SetGet_Offset<<4) & 0xF0) + (@DiagnosticNotification_SetGet_More_Segments_Flag & 0x01);
    }
  }
  
  UDP_Segments_left--;
  
    
  // Rohdaten in UDP Paket schreiben
  EthPaket.udp.SetData( 0, buffer, i );

  // calculate UDP and IPv6 checksum and send Ethernet packet
  EthPaket.CompletePacket();
  output( EthPaket );
  
  // prüfen ob alle Segemente gesendet wurden, sonst senden erneut aufrufen
  DiagnosticNotification_Segmentation_Method_ID = MethodID;
  if (UDP_Segments_left>0)
    settimer(DiagnosticNotification_Segmentation_delay, 50);
}

on timer DiagnosticNotification_Segmentation_delay
{
  Send_Service_DiagnosticNotification_SetGet (DiagnosticNotification_Segmentation_Method_ID);
}









////////// notifications //////////

on envVar DiagnosticNotification_SetGet_LengthIndicator_Struct_notifications
{
  DiagnosticNotification_SetGet_notifications();
}
on envVar DiagnosticNotification_SetGet_LengthIndicator_Element_notifications
{
  DiagnosticNotification_SetGet_notifications();
}
on envVar DiagnosticNotification_SetGet_notifications_listId
{
  DiagnosticNotification_array_notifications_listId[@DiagnosticNotification_SetGet_notifications_Element] = @this;
  DiagnosticNotification_SetGet_notifications();
}
on envVar DiagnosticNotification_SetGet_notifications_notificationIds
{
  DiagnosticNotification_array_notifications_notificationIds[@DiagnosticNotification_SetGet_notifications_Element][@DiagnosticNotification_SetGet_notifications_notificationIds_Element] = @this;
  DiagnosticNotification_SetGet_notifications();
}
on envVar DiagnosticNotification_SetGet_notifications_listId_available
{
  DiagnosticNotification_array_notifications_listId_available[@DiagnosticNotification_SetGet_notifications_Element] = @this;
  DiagnosticNotification_SetGet_notifications();
}
on envVar DiagnosticNotification_SetGet_notifications_notificationIds_available
{
  DiagnosticNotification_array_notifications_notificationIds_available[@DiagnosticNotification_SetGet_notifications_Element] = @this;
  DiagnosticNotification_SetGet_notifications();
}
on envVar DiagnosticNotification_SetGet_notifications_Payload
{
  DiagnosticNotification_SetGet_notifications_update();
}


DiagnosticNotification_SetGet_notifications()
{
  word payload_counter = 0;
  word start_pos       = 0;
  word element_length  = 0;
  
  // Length Indicator Struct - Platzhalter
  payload_counter = 0+4;
  start_pos = 0;
  
  for (j=0; j<@DiagnosticNotification_SetGet_notifications_Element_TotalNum; j++)
  {
    DiagnosticNotification_array_notifications_available_functions[j] = DiagnosticNotification_array_notifications_listId_available[j]
                                                                      + DiagnosticNotification_array_notifications_notificationIds_available[j];
    
    // Length Indicator Element - Platzhalter
    if (DiagnosticNotification_array_notifications_available_functions[j] > 0)
    {
      start_pos = payload_counter;
      payload_counter = payload_counter + 4;
    }
    else 
      start_pos = payload_counter;
    
    
    // 0 type (enum32)
    if (DiagnosticNotification_array_notifications_listId_available[j] == 1)
    {
      tag_dataID = 0;
      DiagnosticNotification_payload_buffer_notifications[payload_counter++] = 2 * 16 /* Wiretype = 2  =^ 32 Bit */ + ((tag_dataID>>8) & 0x0F) /* DataID High Part */ ;
      DiagnosticNotification_payload_buffer_notifications[payload_counter++] = tag_dataID & 0xFF /* DataID Low Part */ ;
      
      DiagnosticNotification_payload_buffer_notifications[payload_counter++] = DiagnosticNotification_array_notifications_listId[j]>>24 & 0xFF;
      DiagnosticNotification_payload_buffer_notifications[payload_counter++] = DiagnosticNotification_array_notifications_listId[j]>>16 & 0xFF;
      DiagnosticNotification_payload_buffer_notifications[payload_counter++] = DiagnosticNotification_array_notifications_listId[j]>> 8 & 0xFF;
      DiagnosticNotification_payload_buffer_notifications[payload_counter++] = DiagnosticNotification_array_notifications_listId[j]     & 0xFF;
    }
    
    // 1 notificationIds (int32 array)
    if (DiagnosticNotification_array_notifications_notificationIds_available[j] == 1)
    {
      tag_dataID = 1;
      DiagnosticNotification_payload_buffer_notifications[payload_counter++] = 7 * 16 /* Wiretype = 7 =^ Array mit 4 Byte Länge */ + ((tag_dataID>>8) & 0x0F) /* DataID High Part */ ;
      DiagnosticNotification_payload_buffer_notifications[payload_counter++] = tag_dataID & 0xFF /* DataID Low Part */ ;
      
      // Array Length
      DiagnosticNotification_array_notifications_notificationIds_length = 4 * DiagnosticNotification_array_notifications_notificationIds_nr_of_elements[j];
      DiagnosticNotification_payload_buffer_notifications[payload_counter++] = DiagnosticNotification_array_notifications_notificationIds_length>>24 & 0xFF;
      DiagnosticNotification_payload_buffer_notifications[payload_counter++] = DiagnosticNotification_array_notifications_notificationIds_length>>16 & 0xFF;
      DiagnosticNotification_payload_buffer_notifications[payload_counter++] = DiagnosticNotification_array_notifications_notificationIds_length>> 8 & 0xFF;
      DiagnosticNotification_payload_buffer_notifications[payload_counter++] = DiagnosticNotification_array_notifications_notificationIds_length     & 0xFF;
      
      for (k=0; k<DiagnosticNotification_array_notifications_notificationIds_nr_of_elements[j]; k++)
      {
        DiagnosticNotification_payload_buffer_notifications[payload_counter++] = DiagnosticNotification_array_notifications_notificationIds[j][k]>>24 & 0xFF;
        DiagnosticNotification_payload_buffer_notifications[payload_counter++] = DiagnosticNotification_array_notifications_notificationIds[j][k]>>16 & 0xFF;
        DiagnosticNotification_payload_buffer_notifications[payload_counter++] = DiagnosticNotification_array_notifications_notificationIds[j][k]>> 8 & 0xFF;
        DiagnosticNotification_payload_buffer_notifications[payload_counter++] = DiagnosticNotification_array_notifications_notificationIds[j][k]     & 0xFF;
      }
    }
    
    
    //Element Length
    element_length = payload_counter-start_pos;
    if (element_length >0) DiagnosticNotification_array_notifications_array_element_length[j] = element_length - 4;
    else                   DiagnosticNotification_array_notifications_array_element_length[j] = element_length;
    
    DiagnosticNotification_payload_buffer_notifications[start_pos++] = DiagnosticNotification_array_notifications_array_element_length[j]>>24 & 0xFF;
    DiagnosticNotification_payload_buffer_notifications[start_pos++] = DiagnosticNotification_array_notifications_array_element_length[j]>>16 & 0xFF;
    DiagnosticNotification_payload_buffer_notifications[start_pos++] = DiagnosticNotification_array_notifications_array_element_length[j]>> 8 & 0xFF;
    DiagnosticNotification_payload_buffer_notifications[start_pos++] = DiagnosticNotification_array_notifications_array_element_length[j]     & 0xFF;
    
    if (DiagnosticNotification_array_notifications_array_element_length[j] == 0) payload_counter = payload_counter+4;
  }
  
  // Struct Length
  DiagnosticNotification_array_notifications_struct_element_length = 4*@DiagnosticNotification_SetGet_notifications_Element_TotalNum;

  for (k=0;k<@DiagnosticNotification_SetGet_notifications_Element_TotalNum;k++)
    DiagnosticNotification_array_notifications_struct_element_length = DiagnosticNotification_array_notifications_struct_element_length + DiagnosticNotification_array_notifications_array_element_length[k];
  
  DiagnosticNotification_payload_buffer_notifications[0] = DiagnosticNotification_array_notifications_struct_element_length>>24 & 0xFF;
  DiagnosticNotification_payload_buffer_notifications[1] = DiagnosticNotification_array_notifications_struct_element_length>>16 & 0xFF;
  DiagnosticNotification_payload_buffer_notifications[2] = DiagnosticNotification_array_notifications_struct_element_length>> 8 & 0xFF;
  DiagnosticNotification_payload_buffer_notifications[3] = DiagnosticNotification_array_notifications_struct_element_length     & 0xFF;


  DiagnosticNotification_payload_length_notifications = DiagnosticNotification_array_notifications_struct_element_length+4;
  putvalue(DiagnosticNotification_SetGet_notifications_Payload, DiagnosticNotification_payload_buffer_notifications, DiagnosticNotification_payload_length_notifications);
}

on envVar DiagnosticNotification_SetGet_notifications_Element_TotalNum
{
  if (@this == 0) @this =  1;
  if (@this > 10) @this = 10;
  
  DiagnosticNotification_SetGet_notifications();
  DiagnosticNotification_SetGet_notifications_update();
}

on envVar DiagnosticNotification_SetGet_notifications_Element
{
  DiagnosticNotification_SetGet_notifications_update();
}

on envVar DiagnosticNotification_SetGet_notifications_Element_Next
{
  if (@this == 1 && @DiagnosticNotification_SetGet_notifications_Element < @DiagnosticNotification_SetGet_notifications_Element_TotalNum - 1)
  {
    @DiagnosticNotification_SetGet_notifications_Element = @DiagnosticNotification_SetGet_notifications_Element + 1;
    DiagnosticNotification_SetGet_notifications_update();
  }
}

on envVar DiagnosticNotification_SetGet_notifications_Element_Previous
{
  if (@this == 1 && @DiagnosticNotification_SetGet_notifications_Element > 0)
  {
    @DiagnosticNotification_SetGet_notifications_Element = @DiagnosticNotification_SetGet_notifications_Element - 1;
    DiagnosticNotification_SetGet_notifications_update();
  }
}

on envVar DiagnosticNotification_SetGet_notifications_notificationIds_Element_TotalNum
{
  if (@this == 0) @this =  1;
  if (@this > 10) @this = 10;
  
  DiagnosticNotification_array_notifications_notificationIds_nr_of_elements[@DiagnosticNotification_SetGet_notifications_Element] = @this;
  DiagnosticNotification_SetGet_notifications();
  DiagnosticNotification_SetGet_notifications_update();
}

on envVar DiagnosticNotification_SetGet_notifications_notificationIds_Element
{
  DiagnosticNotification_SetGet_notifications_update();
}

on envVar DiagnosticNotification_SetGet_notifications_notificationIds_Element_Next
{
  if (@this == 1 && @DiagnosticNotification_SetGet_notifications_notificationIds_Element < @DiagnosticNotification_SetGet_notifications_notificationIds_Element_TotalNum - 1)
  {
    @DiagnosticNotification_SetGet_notifications_notificationIds_Element = @DiagnosticNotification_SetGet_notifications_notificationIds_Element + 1;
    
    @DiagnosticNotification_SetGet_notifications_notificationIds = DiagnosticNotification_array_notifications_notificationIds[@DiagnosticNotification_SetGet_notifications_Element][@DiagnosticNotification_SetGet_notifications_notificationIds_Element];
  }
}

on envVar DiagnosticNotification_SetGet_notifications_notificationIds_Element_Previous
{
  if (@this == 1 && @DiagnosticNotification_SetGet_notifications_notificationIds_Element > 0)
  {
    @DiagnosticNotification_SetGet_notifications_notificationIds_Element = @DiagnosticNotification_SetGet_notifications_notificationIds_Element - 1;
    
    @DiagnosticNotification_SetGet_notifications_notificationIds = DiagnosticNotification_array_notifications_notificationIds[@DiagnosticNotification_SetGet_notifications_Element][@DiagnosticNotification_SetGet_notifications_notificationIds_Element];
  }
}

DiagnosticNotification_SetGet_notifications_update()
{
  @DiagnosticNotification_SetGet_LengthIndicator_Element_notifications = DiagnosticNotification_array_notifications_array_element_length[@DiagnosticNotification_SetGet_notifications_Element];
  @DiagnosticNotification_SetGet_LengthIndicator_Struct_notifications  = DiagnosticNotification_array_notifications_struct_element_length;
  @DiagnosticNotification_SetGet_Length_notifications                  = DiagnosticNotification_payload_length_notifications+8;
  
  @DiagnosticNotification_SetGet_notifications_listId = DiagnosticNotification_array_notifications_listId[@DiagnosticNotification_SetGet_notifications_Element];

  @DiagnosticNotification_SetGet_notifications_notificationIds = DiagnosticNotification_array_notifications_notificationIds[@DiagnosticNotification_SetGet_notifications_Element][@DiagnosticNotification_SetGet_notifications_notificationIds_Element];
  
  @DiagnosticNotification_SetGet_notifications_notificationIds_Element_TotalNum = DiagnosticNotification_array_notifications_notificationIds_nr_of_elements[@DiagnosticNotification_SetGet_notifications_Element];

  @DiagnosticNotification_SetGet_notifications_notificationIds_available = DiagnosticNotification_array_notifications_notificationIds_available[@DiagnosticNotification_SetGet_notifications_Element];
}


DiagnosticNotification_notifications_Notification()
{
  word data_length;
  word data_length_element_sum;
  word data_length_element[10];
  byte wiretype;
  byte data_id;
  word start_pos;
  
  payload_rx_counter = 0;
  data_length_element_sum = 0;
  DiagnosticNotification_notifications_data_length_element_num = 0;
  DiagnosticNotification_notifications_available_reset();
  
  // Gesamtlaenge
  data_length = ((someip_payload_buffer[payload_rx_counter++]&0x000000FF)*16777216
              +  (someip_payload_buffer[payload_rx_counter++]&0x000000FF)*65536
              +  (someip_payload_buffer[payload_rx_counter++]&0x000000FF)*256
              +  (someip_payload_buffer[payload_rx_counter++]&0x000000FF));
  
  // pruefen ob noch Elemente vorhanden sind
  while (data_length_element_sum < data_length)
  {
    // Laenge Element
    data_length_element[DiagnosticNotification_notifications_data_length_element_num] = ((someip_payload_buffer[payload_rx_counter++]&0x000000FF)*16777216
                                                                                      +  (someip_payload_buffer[payload_rx_counter++]&0x000000FF)*65536
                                                                                      +  (someip_payload_buffer[payload_rx_counter++]&0x000000FF)*256
                                                                                      +  (someip_payload_buffer[payload_rx_counter++]&0x000000FF));
   
    start_pos = payload_rx_counter;
    
    while (payload_rx_counter < data_length_element[DiagnosticNotification_notifications_data_length_element_num] + start_pos)
    {
      // wiretype & data_id pruefen
      wiretype = (someip_payload_buffer[payload_rx_counter++]>>4) & 0x0F;
      data_id = someip_payload_buffer[payload_rx_counter++];
      
      switch (data_id)
      {
        case 0:  DiagnosticNotification_Notification_notifications_listId(); break;
        case 1:  DiagnosticNotification_Notification_notifications_notificationIds(); break;
      }
    }
    data_length_element_sum = data_length_element_sum + data_length_element[DiagnosticNotification_notifications_data_length_element_num] + 4;
    
    if (data_length_element_sum < data_length)
      DiagnosticNotification_notifications_data_length_element_num++;
  }
  @DiagnosticNotification_SetGet_notifications_Element_TotalNum = DiagnosticNotification_notifications_data_length_element_num+1;
}

DiagnosticNotification_notifications_available_reset()
{
  for (k=0; k<10; k++)
  {
    DiagnosticNotification_array_notifications_listId_available[k]                              = 0;
    DiagnosticNotification_array_notifications_notificationIds_available[k]                      = 0;
  }
}


DiagnosticNotification_Notification_notifications_listId()
{
  DiagnosticNotification_array_notifications_listId[DiagnosticNotification_notifications_data_length_element_num] = ((someip_payload_buffer[payload_rx_counter++]&0x000000FF)*16777216
                                                                                                                  +  (someip_payload_buffer[payload_rx_counter++]&0x000000FF)*65536
                                                                                                                  +  (someip_payload_buffer[payload_rx_counter++]&0x000000FF)*256
                                                                                                                  +  (someip_payload_buffer[payload_rx_counter++]&0x000000FF));
  
  DiagnosticNotification_array_notifications_listId_available[DiagnosticNotification_notifications_data_length_element_num] = 1;
  DiagnosticNotification_SetGet_notifications_update();
}
DiagnosticNotification_Notification_notifications_notificationIds()
{
  byte length;
  
  length = someip_payload_buffer[payload_rx_counter++];
  
  for (k=0; k<length; k++)
  {
    DiagnosticNotification_array_notifications_notificationIds[DiagnosticNotification_notifications_data_length_element_num][k] = someip_payload_buffer[payload_rx_counter++];
  }
  
  DiagnosticNotification_array_notifications_notificationIds_available[DiagnosticNotification_notifications_data_length_element_num] = 1;
  DiagnosticNotification_SetGet_notifications_update();
}












on envVar ServiceDiscovery_EthernetPacket_VLAN_TCI
{
  @ServiceDiscovery_EthernetPacket_VLAN_TCI_Prio = @this>>13 & 0x0003;
  @ServiceDiscovery_EthernetPacket_VLAN_TCI_CFI  = @this>>12 & 0x0001;
  @ServiceDiscovery_EthernetPacket_VLAN_TCI_ID   = @this     & 0x0FFF;
}

on envVar ServiceDiscovery_EthernetPacket_VLAN_TCI_Prio { build_VLAN_TCI(); }
on envVar ServiceDiscovery_EthernetPacket_VLAN_TCI_CFI  { build_VLAN_TCI(); }
on envVar ServiceDiscovery_EthernetPacket_VLAN_TCI_ID   { build_VLAN_TCI(); }


build_VLAN_TCI()
{
  @ServiceDiscovery_EthernetPacket_VLAN_TCI = @ServiceDiscovery_EthernetPacket_VLAN_TCI_ID + @ServiceDiscovery_EthernetPacket_VLAN_TCI_CFI * 4096 + @ServiceDiscovery_EthernetPacket_VLAN_TCI_Prio * 8192;
}

on envVar ServiceDiscovery_SOMEIPPacket_Offer_ICAS1Gateway_Flags
{
  @ServiceDiscovery_SOMEIPPacket_Offer_ICAS1Gateway_Flags_Reboot                       = @this>>7 & 0x01;
  @ServiceDiscovery_SOMEIPPacket_Offer_ICAS1Gateway_Flags_Unicast                      = @this>>6 & 0x01;
  @ServiceDiscovery_SOMEIPPacket_Offer_ICAS1Gateway_Flags_Explicit_Intial_Data_Control = @this>>5 & 0x01;
}

on envVar ServiceDiscovery_SOMEIPPacket_Offer_ICAS1Gateway_Flags_Reboot                       { build_SOMEIP_find_flags_ICAS1Gateway (); }
on envVar ServiceDiscovery_SOMEIPPacket_Offer_ICAS1Gateway_Flags_Unicast                      { build_SOMEIP_find_flags_ICAS1Gateway (); }
on envVar ServiceDiscovery_SOMEIPPacket_Offer_ICAS1Gateway_Flags_Explicit_Intial_Data_Control { build_SOMEIP_find_flags_ICAS1Gateway (); }

build_SOMEIP_find_flags_ICAS1Gateway()
{
  @ServiceDiscovery_SOMEIPPacket_Offer_ICAS1Gateway_Flags = @ServiceDiscovery_SOMEIPPacket_Offer_ICAS1Gateway_Flags_Explicit_Intial_Data_Control * 32 + @ServiceDiscovery_SOMEIPPacket_Offer_ICAS1Gateway_Flags_Unicast * 64 + @ServiceDiscovery_SOMEIPPacket_Offer_ICAS1Gateway_Flags_Reboot * 128;
}

on envVar ServiceDiscovery_SOMEIPPacket_Offer_ICAS1Sys01_Flags
{
  @ServiceDiscovery_SOMEIPPacket_Offer_ICAS1Sys01_Flags_Reboot                       = @this>>7 & 0x01;
  @ServiceDiscovery_SOMEIPPacket_Offer_ICAS1Sys01_Flags_Unicast                      = @this>>6 & 0x01;
  @ServiceDiscovery_SOMEIPPacket_Offer_ICAS1Sys01_Flags_Explicit_Intial_Data_Control = @this>>5 & 0x01;
}

on envVar ServiceDiscovery_SOMEIPPacket_Offer_ICAS1Sys01_Flags_Reboot                       { build_SOMEIP_find_flags_ICAS1Sys01 (); }
on envVar ServiceDiscovery_SOMEIPPacket_Offer_ICAS1Sys01_Flags_Unicast                      { build_SOMEIP_find_flags_ICAS1Sys01 (); }
on envVar ServiceDiscovery_SOMEIPPacket_Offer_ICAS1Sys01_Flags_Explicit_Intial_Data_Control { build_SOMEIP_find_flags_ICAS1Sys01 (); }

build_SOMEIP_find_flags_ICAS1Sys01()
{
  @ServiceDiscovery_SOMEIPPacket_Offer_ICAS1Sys01_Flags = @ServiceDiscovery_SOMEIPPacket_Offer_ICAS1Sys01_Flags_Explicit_Intial_Data_Control * 32 + @ServiceDiscovery_SOMEIPPacket_Offer_ICAS1Sys01_Flags_Unicast * 64 + @ServiceDiscovery_SOMEIPPacket_Offer_ICAS1Sys01_Flags_Reboot * 128;
}

on envVar ServiceDiscovery_SOMEIPPacket_Offer_ICAS3IVI_Flags
{
  @ServiceDiscovery_SOMEIPPacket_Offer_ICAS3IVI_Flags_Reboot                       = @this>>7 & 0x01;
  @ServiceDiscovery_SOMEIPPacket_Offer_ICAS3IVI_Flags_Unicast                      = @this>>6 & 0x01;
  @ServiceDiscovery_SOMEIPPacket_Offer_ICAS3IVI_Flags_Explicit_Intial_Data_Control = @this>>5 & 0x01;
}

on envVar ServiceDiscovery_SOMEIPPacket_Offer_ICAS3IVI_Flags_Reboot                       { build_SOMEIP_find_flags_ICAS3IVI (); }
on envVar ServiceDiscovery_SOMEIPPacket_Offer_ICAS3IVI_Flags_Unicast                      { build_SOMEIP_find_flags_ICAS3IVI (); }
on envVar ServiceDiscovery_SOMEIPPacket_Offer_ICAS3IVI_Flags_Explicit_Intial_Data_Control { build_SOMEIP_find_flags_ICAS3IVI (); }

build_SOMEIP_find_flags_ICAS3IVI()
{
  @ServiceDiscovery_SOMEIPPacket_Offer_ICAS3IVI_Flags = @ServiceDiscovery_SOMEIPPacket_Offer_ICAS3IVI_Flags_Explicit_Intial_Data_Control * 32 + @ServiceDiscovery_SOMEIPPacket_Offer_ICAS3IVI_Flags_Unicast * 64 + @ServiceDiscovery_SOMEIPPacket_Offer_ICAS3IVI_Flags_Reboot * 128;
}






on ethernetPacket *
{
  byte type;
  word length_of_entries_array;
  byte send_subAck_flag;
  
  byte  notification_rx_session_id;
  dword notification_rx_struct_length;
  dword notification_rx_element_length;
  dword someip_array_counter;
  
  if (this.type == 0x86DD /*&&  this.dir == RX*/) // IPv6       wieder einkommentieren, ist nur zum Test per IG!
  {
    // MAC Adresse auslesen und zuweisen
    //ethGetMacAddressAsString ( this.source, buffer_MAC, 18 );
    //putValue (ServiceDiscovery_EthernetPacket_MAC_Destination, buffer_MAC);
    
    if (this.ipv6.next == 17) // UDP
    {
      this.udp.GetData (0, someip_buffer, this.udp.length-8);
      
      // ServiceDiscovery
      if ((someip_buffer[0]&0x000000FF) == 0xFF && (someip_buffer[1]&0x000000FF) == 0xFF && (someip_buffer[2]&0x000000FF) == 0x81 && (someip_buffer[3]&0x000000FF) == 0x00)
      {
        // Länge des Entry Arrays prüfen und Anzahl der Elemente berechnen
        length_of_entries_array = (someip_buffer[20]&0x000000FF) * 16777216 + (someip_buffer[21]&0x000000FF) * 65536 + (someip_buffer[22]&0x000000FF) * 256 + someip_buffer[23]&0x000000FF;
        number_of_entries_array_elements = length_of_entries_array / 16;
        
        for (k=0;k<number_of_entries_array_elements;k++)
        {
          // Entries Array auswerten
          servicediscovery_rx_entries_array_type[k]              =   someip_buffer[24+16*k]     &0x000000FF;
          servicediscovery_rx_entries_array_index_1st_options[k] =   someip_buffer[25+16*k]     &0x000000FF;
          servicediscovery_rx_entries_array_index_2nd_options[k] =   someip_buffer[26+16*k]     &0x000000FF;
          servicediscovery_rx_entries_array_nr_of_opt_1[k]       =  (someip_buffer[27+16*k]>>4) &0x0000000F;
          servicediscovery_rx_entries_array_nr_of_opt_1[k]       =   someip_buffer[27+16*k]     &0x0000000F;
          servicediscovery_rx_entries_array_service_id[k]        = ((someip_buffer[28+16*k]     &0x000000FF) * 256)
                                                                 +  (someip_buffer[29+16*k]     &0x000000FF);
          servicediscovery_rx_entries_array_instance_id[k]       = ((someip_buffer[30+16*k]     &0x000000FF) * 256)
                                                                 +  (someip_buffer[31+16*k]     &0x000000FF);
          servicediscovery_rx_entries_array_major_version[k]     =   someip_buffer[32+16*k]     &0x000000FF;
          servicediscovery_rx_entries_array_ttl[k]               = ((someip_buffer[33+16*k]     &0x000000FF) * 65536)
                                                                 + ((someip_buffer[34+16*k]     &0x000000FF) * 256)
                                                                 +  (someip_buffer[35+16*k]     &0x000000FF);
          servicediscovery_rx_entries_array_eventgroup_id[k]     = ((someip_buffer[38+16*k]     &0x000000FF) * 256)
                                                                 +  (someip_buffer[39+16*k]     &0x000000FF);
          
          
          // Subscribe
          if (servicediscovery_rx_entries_array_type[k] == 6)
          {
            send_subAck_flag = 1; // wenn 1x Subscribe drin, dann ACK senden
          }
          
          
          // Subscribe Ack/NACK
          if (servicediscovery_rx_entries_array_type[k] == 7)
          {
            get_subAck_flag = 1;
            
            // UnitMaster_units
            if (servicediscovery_rx_entries_array_service_id[k]    == 0x600E
            &&  servicediscovery_rx_entries_array_eventgroup_id[k] == 0xC010)
            {
              if (servicediscovery_rx_entries_array_ttl[k] > 0)
                UnitMaster_SubscribeStatus_units = 1;
              else
                UnitMaster_SubscribeStatus_units = 0;
            }
            
            // DisplaySpeed_speeds
            if (servicediscovery_rx_entries_array_service_id[k]    == 0x6021  
            &&  servicediscovery_rx_entries_array_eventgroup_id[k] == 0xC010)
            {
              if (servicediscovery_rx_entries_array_ttl[k] > 0)
                DisplaySpeed_SubscribeStatus_speeds = 1;
              else
                DisplaySpeed_SubscribeStatus_speeds = 0;
            }
            
            // DisplaySpeed_speedWarnings
            if (servicediscovery_rx_entries_array_service_id[k]    == 0x6021 
            &&  servicediscovery_rx_entries_array_eventgroup_id[k] == 0xC020)
            {
              if (servicediscovery_rx_entries_array_ttl[k] > 0)
                DisplaySpeed_SubscribeStatus_speedWarnings = 1;
              else
                DisplaySpeed_SubscribeStatus_speedWarnings = 0;
            }
            
            // DisplaySpeed_speedBlockings
            if (servicediscovery_rx_entries_array_service_id[k]    == 0x6021
            &&  servicediscovery_rx_entries_array_eventgroup_id[k] == 0xC030)
            {
              if (servicediscovery_rx_entries_array_ttl[k] > 0)
                DisplaySpeed_SubscribeStatus_speedBlockings = 1;
              else
                DisplaySpeed_SubscribeStatus_speedBlockings = 0;
            }
            
            // Temperature_temperatures
            if (servicediscovery_rx_entries_array_service_id[k]    == 0x6034
            &&  servicediscovery_rx_entries_array_eventgroup_id[k] == 0xC010)
            {
              if (servicediscovery_rx_entries_array_ttl[k] > 0)
                Temperature_SubscribeStatus_temperatures = 1;
              else
                Temperature_SubscribeStatus_temperatures = 0;
            }
            
            // Temperature_temperatureWarnings
            if (servicediscovery_rx_entries_array_service_id[k]    == 0x6034
            &&  servicediscovery_rx_entries_array_eventgroup_id[k] == 0xC020)
            {
              if (servicediscovery_rx_entries_array_ttl[k] > 0)
                Temperature_SubscribeStatus_temperatureWarnings = 1;
              else
                Temperature_SubscribeStatus_temperatureWarnings = 0;
            }
            
            // DrivingStatistics_speeds
            if (servicediscovery_rx_entries_array_service_id[k]    == 0x6035 
            &&  servicediscovery_rx_entries_array_eventgroup_id[k] == 0xC010)
            {
              if (servicediscovery_rx_entries_array_ttl[k] > 0)
                DrivingStatistics_SubscribeStatus_speeds = 1;
              else
                DrivingStatistics_SubscribeStatus_speeds = 0;
            }
            
            // DrivingStatistics_speedWarnings
            if (servicediscovery_rx_entries_array_service_id[k]    == 0x6035
            &&  servicediscovery_rx_entries_array_eventgroup_id[k] == 0xC020)
            {
              if (servicediscovery_rx_entries_array_ttl[k] > 2)
                DrivingStatistics_SubscribeStatus_distances = 1;
              else
                DrivingStatistics_SubscribeStatus_distances = 0;
            }
            
            // DrivingStatistics_speedBlockings
            if (servicediscovery_rx_entries_array_service_id[k]    == 0x6035
            &&  servicediscovery_rx_entries_array_eventgroup_id[k] == 0xC030)
            {
              if (servicediscovery_rx_entries_array_ttl[k] > 0)
                DrivingStatistics_SubscribeStatus_durations = 1;
              else
                DrivingStatistics_SubscribeStatus_durations = 0;
            }
            
            // DiagnosticNotification_notifications
            if (servicediscovery_rx_entries_array_service_id[k]    == 0x6046
            &&  servicediscovery_rx_entries_array_eventgroup_id[k] == 0xC010)
            {
              if (servicediscovery_rx_entries_array_ttl[k] > 0)
                DiagnosticNotification_SubscribeStatus_notifications = 1;
              else
                DiagnosticNotification_SubscribeStatus_notifications = 0;
            }
            
          }
          
          
          
          // Offer
          if ((someip_buffer[24+16*k]&0x000000FF) == 1)
          {
            servicediscovery_sub_tx_entries_array_service_id[k] = ((someip_buffer[28+16*k]&0x000000FF) * 256) + (someip_buffer[29+16*k]&0x000000FF);
            
            if (servicediscovery_sub_tx_entries_array_service_id[k] == 0x0600E)
            {
              @UnitMaster_available = 1;
              cancelTimer(UnitMaster_available_reset);
              setTimer(UnitMaster_available_reset, 1000);
            }
            if (servicediscovery_sub_tx_entries_array_service_id[k] == 0x06021)
            {
              @DisplaySpeed_available = 1;
              cancelTimer(DisplaySpeed_available_reset);
              setTimer(DisplaySpeed_available_reset, 1000);
            }
            if (servicediscovery_sub_tx_entries_array_service_id[k] == 0x06034)
            {
              @Temperature_available = 1;
              cancelTimer(Temperature_available_reset);
              setTimer(Temperature_available_reset, 1000);
            }
            if (servicediscovery_sub_tx_entries_array_service_id[k] == 0x06035)
            {
              @DrivingStatistics_available = 1;
              cancelTimer(DrivingStatistics_available_reset);
              setTimer(DrivingStatistics_available_reset, 1000);
            }
            if (servicediscovery_sub_tx_entries_array_service_id[k] == 0x06046)
            {
              @DiagnosticNotification_available = 1;
              cancelTimer(DiagnosticNotification_available_reset);
              setTimer(DiagnosticNotification_available_reset, 1000);
            }
          }
        }
        
        if (send_subAck_flag == 1)
        {
          send_subAck_flag = 0;
          
          this.ipv6.destination.GetData (0, buffer_ipv6, 16);
          
          if (buffer_ipv6[14] == 0x00 & buffer_ipv6[15] == 0x10)
            Send_ServiceDiscovery_SubscribeACK_ICAS1Gateway();
          if (buffer_ipv6[14] == 0x01 & buffer_ipv6[15] == 0x06)
            Send_ServiceDiscovery_SubscribeACK_ICAS1Sys01();
          if (buffer_ipv6[14] == 0x01 & buffer_ipv6[15] == 0x08)
            Send_ServiceDiscovery_SubscribeACK_ICAS3IVI();
        }
        
        // SubAck prüfen
        if (get_subAck_flag == 1)
        {
          @UnitMaster_Subscribe_units                     = UnitMaster_SubscribeStatus_units;
          @DisplaySpeed_Subscribe_speeds                  = DisplaySpeed_SubscribeStatus_speeds;
          @DisplaySpeed_Subscribe_speedWarnings           = DisplaySpeed_SubscribeStatus_speedWarnings;
          @DisplaySpeed_Subscribe_speedBlockings          = DisplaySpeed_SubscribeStatus_speedBlockings;
          @Temperature_Subscribe_temperatures             = Temperature_SubscribeStatus_temperatures;
          @Temperature_Subscribe_temperatureWarnings      = Temperature_SubscribeStatus_temperatureWarnings;
          @DrivingStatistics_Subscribe_speeds             = DrivingStatistics_SubscribeStatus_speeds;
          @DrivingStatistics_Subscribe_distances          = DrivingStatistics_SubscribeStatus_distances;
          @DrivingStatistics_Subscribe_durations          = DrivingStatistics_SubscribeStatus_durations;
          @DiagnosticNotification_Subscribe_notifications = DiagnosticNotification_SubscribeStatus_notifications;
          
          settimer(get_subAck_flag_reset, 10);
        }
      }
      
      
      
      // UnitMaster_units
      if (((someip_buffer[0]&0x000000FF) == 0x60 && (someip_buffer[1]&0x000000FF) == 0x0E)
      && (((someip_buffer[2]&0x000000FF) == 0xC0 && (someip_buffer[3]&0x000000FF) == 0x10 && (someip_buffer[14]&0x000000FF) == 0x02)
      ||  ((someip_buffer[2]&0x000000FF) == 0x40 && (someip_buffer[3]&0x000000FF) == 0x10 && (someip_buffer[14]&0x000000FF) == 0x80)
      ||  ((someip_buffer[2]&0x000000FF) == 0x40 && (someip_buffer[3]&0x000000FF) == 0x11 && (someip_buffer[14]&0x000000FF) == 0x80)))
      {
        notification_rx_session_id = (someip_buffer[10]&0x000000FF)*256 + (someip_buffer[11]&0x000000FF);
        
        if ((someip_buffer[13]&0x000000FF) == @UnitMaster_SetGet_Interface_Version)
        {
          // Payload Data ab someip_buffer[16]
          notification_rx_struct_length = (someip_buffer[16]&0x000000FF)*16777216 + (someip_buffer[17]&0x000000FF)*65536
                                        + (someip_buffer[18]&0x000000FF)*256      + (someip_buffer[19]&0x000000FF);
          
          for (k=0; k<notification_rx_struct_length+4; k++)
            someip_payload_buffer[k] = someip_buffer[k+16];
          
          UnitMaster_units_Notification();
        }
        else
          write("UnitMaster: wrong Interface-Version! Send: %d, Expected: %d",someip_buffer[13]&0x000000FF,@UnitMaster_SetGet_Interface_Version);
      }
      
      
      // DisplaySpeed_speeds
      if (((someip_buffer[0]&0x000000FF) == 0x60 && (someip_buffer[1]&0x000000FF) == 0x21)
      && (((someip_buffer[2]&0x000000FF) == 0xC0 && (someip_buffer[3]&0x000000FF) == 0x10 && (someip_buffer[14]&0x000000FF) == 0x02)
      ||  ((someip_buffer[2]&0x000000FF) == 0x40 && (someip_buffer[3]&0x000000FF) == 0x10 && (someip_buffer[14]&0x000000FF) == 0x80)))
      {
        notification_rx_session_id = (someip_buffer[10]&0x000000FF)*256 + (someip_buffer[11]&0x000000FF);
        
        if ((someip_buffer[13]&0x000000FF) == @DisplaySpeed_SetGet_Interface_Version)
        {
          // Payload Data ab someip_buffer[16]
          notification_rx_struct_length = (someip_buffer[16]&0x000000FF)*16777216 + (someip_buffer[17]&0x000000FF)*65536
                                        + (someip_buffer[18]&0x000000FF)*256      + (someip_buffer[19]&0x000000FF);
          
          for (k=0; k<notification_rx_struct_length+4; k++)
            someip_payload_buffer[k] = someip_buffer[k+16];
          
          DisplaySpeed_speeds_Notification();
        }
        else
          write("DisplaySpeed: wrong Interface-Version! Send: %d, Expected: %d",someip_buffer[13]&0x000000FF,@DisplaySpeed_SetGet_Interface_Version);
      }
      
      
      // DisplaySpeed_speedWarnings
      if (((someip_buffer[0]&0x000000FF) == 0x60 && (someip_buffer[1]&0x000000FF) == 0x21)
      && (((someip_buffer[2]&0x000000FF) == 0xC0 && (someip_buffer[3]&0x000000FF) == 0x20 && (someip_buffer[14]&0x000000FF) == 0x02)
      ||  ((someip_buffer[2]&0x000000FF) == 0x40 && (someip_buffer[3]&0x000000FF) == 0x20 && (someip_buffer[14]&0x000000FF) == 0x80)
      ||  ((someip_buffer[2]&0x000000FF) == 0x40 && (someip_buffer[3]&0x000000FF) == 0x21 && (someip_buffer[14]&0x000000FF) == 0x80)))
      {
        notification_rx_session_id = (someip_buffer[10]&0x000000FF)*256 + (someip_buffer[11]&0x000000FF);
        
        if ((someip_buffer[13]&0x000000FF) == @DisplaySpeed_SetGet_Interface_Version)
        {
          // Payload Data ab someip_buffer[16]
          notification_rx_struct_length = (someip_buffer[16]&0x000000FF)*16777216 + (someip_buffer[17]&0x000000FF)*65536
                                        + (someip_buffer[18]&0x000000FF)*256      + (someip_buffer[19]&0x000000FF);
          
          for (k=0; k<notification_rx_struct_length+4; k++)
            someip_payload_buffer[k] = someip_buffer[k+16];
          
          DisplaySpeed_speedWarnings_Notification();
        }
        else
          write("DisplaySpeed: wrong Interface-Version! Send: %d, Expected: %d",someip_buffer[13]&0x000000FF,@DisplaySpeed_SetGet_Interface_Version);
      }
      
      
      // DisplaySpeed_speedBlockings
      if (((someip_buffer[0]&0x000000FF) == 0x60 && (someip_buffer[1]&0x000000FF) == 0x21)
      && (((someip_buffer[2]&0x000000FF) == 0xC0 && (someip_buffer[3]&0x000000FF) == 0x30 && (someip_buffer[14]&0x000000FF) == 0x02)
      ||  ((someip_buffer[2]&0x000000FF) == 0x40 && (someip_buffer[3]&0x000000FF) == 0x30 && (someip_buffer[14]&0x000000FF) == 0x80)))
      {
        notification_rx_session_id = (someip_buffer[10]&0x000000FF)*256 + (someip_buffer[11]&0x000000FF);
        
        if ((someip_buffer[13]&0x000000FF) == @DisplaySpeed_SetGet_Interface_Version)
        {
          // Payload Data ab someip_buffer[16]
          notification_rx_struct_length = (someip_buffer[16]&0x000000FF)*16777216 + (someip_buffer[17]&0x000000FF)*65536
                                        + (someip_buffer[18]&0x000000FF)*256      + (someip_buffer[19]&0x000000FF);
          
          for (k=0; k<notification_rx_struct_length+4; k++)
            someip_payload_buffer[k] = someip_buffer[k+16];
          
          DisplaySpeed_speedBlockings_Notification();
        }
        else
          write("DisplaySpeed: wrong Interface-Version! Send: %d, Expected: %d",someip_buffer[13]&0x000000FF,@DisplaySpeed_SetGet_Interface_Version);
      }
      
      
      // Temperature_temperatures
      if (((someip_buffer[0]&0x000000FF) == 0x60 && (someip_buffer[1]&0x000000FF) == 0x34)
      && (((someip_buffer[2]&0x000000FF) == 0xC0 && (someip_buffer[3]&0x000000FF) == 0x10 && (someip_buffer[14]&0x000000FF) == 0x02)
      ||  ((someip_buffer[2]&0x000000FF) == 0x40 && (someip_buffer[3]&0x000000FF) == 0x10 && (someip_buffer[14]&0x000000FF) == 0x80)))
      {
        notification_rx_session_id = (someip_buffer[10]&0x000000FF)*256 + (someip_buffer[11]&0x000000FF);
        
        if ((someip_buffer[13]&0x000000FF) == @Temperature_SetGet_Interface_Version)
        {
          // Payload Data ab someip_buffer[16]
          notification_rx_struct_length = (someip_buffer[16]&0x000000FF)*16777216 + (someip_buffer[17]&0x000000FF)*65536
                                        + (someip_buffer[18]&0x000000FF)*256      + (someip_buffer[19]&0x000000FF);
          
          for (k=0; k<notification_rx_struct_length+4; k++)
            someip_payload_buffer[k] = someip_buffer[k+16];
          
          Temperature_temperatures_Notification();
        }
        else
          write("Temperature: wrong Interface-Version! Send: %d, Expected: %d",someip_buffer[13]&0x000000FF,@Temperature_SetGet_Interface_Version);
      }
      
      
      // Temperature_temperatureWarnings
      if (((someip_buffer[0]&0x000000FF) == 0x60 && (someip_buffer[1]&0x000000FF) == 0x34)
      && (((someip_buffer[2]&0x000000FF) == 0xC0 && (someip_buffer[3]&0x000000FF) == 0x20 && (someip_buffer[14]&0x000000FF) == 0x02)
      ||  ((someip_buffer[2]&0x000000FF) == 0x40 && (someip_buffer[3]&0x000000FF) == 0x20 && (someip_buffer[14]&0x000000FF) == 0x80)))
      {
        notification_rx_session_id = (someip_buffer[10]&0x000000FF)*256 + (someip_buffer[11]&0x000000FF);
        
        if ((someip_buffer[13]&0x000000FF) == @Temperature_SetGet_Interface_Version)
        {
          // Payload Data ab someip_buffer[16]
          notification_rx_struct_length = (someip_buffer[16]&0x000000FF)*16777216 + (someip_buffer[17]&0x000000FF)*65536
                                        + (someip_buffer[18]&0x000000FF)*256      + (someip_buffer[19]&0x000000FF);
          
          for (k=0; k<notification_rx_struct_length+4; k++)
            someip_payload_buffer[k] = someip_buffer[k+16];
          
          Temperature_temperatureWarnings_Notification();
        }
        else
          write("Temperature: wrong Interface-Version! Send: %d, Expected: %d",someip_buffer[13]&0x000000FF,@Temperature_SetGet_Interface_Version);
      }
      
      
      // DrivingStatistics_speeds
      if (((someip_buffer[0]&0x000000FF) == 0x60 && (someip_buffer[1]&0x000000FF) == 0x35)
      && (((someip_buffer[2]&0x000000FF) == 0xC0 && (someip_buffer[3]&0x000000FF) == 0x10 && (someip_buffer[14]&0x000000FF) == 0x02)
      ||  ((someip_buffer[2]&0x000000FF) == 0x40 && (someip_buffer[3]&0x000000FF) == 0x10 && (someip_buffer[14]&0x000000FF) == 0x80)
      ||  ((someip_buffer[2]&0x000000FF) == 0x40 && (someip_buffer[3]&0x000000FF) == 0x11 && (someip_buffer[14]&0x000000FF) == 0x80)))
      {
        notification_rx_session_id = (someip_buffer[10]&0x000000FF)*256 + (someip_buffer[11]&0x000000FF);
        
        if ((someip_buffer[13]&0x000000FF) == @DrivingStatistics_SetGet_Interface_Version)
        {
          // Payload Data ab someip_buffer[16]
          notification_rx_struct_length = (someip_buffer[16]&0x000000FF)*16777216 + (someip_buffer[17]&0x000000FF)*65536
                                        + (someip_buffer[18]&0x000000FF)*256      + (someip_buffer[19]&0x000000FF);
          
          for (k=0; k<notification_rx_struct_length+4; k++)
            someip_payload_buffer[k] = someip_buffer[k+16];
          
          DrivingStatistics_speeds_Notification();
        }
        else
          write("DrivingStatistics: wrong Interface-Version! Send: %d, Expected: %d",someip_buffer[13]&0x000000FF,@DrivingStatistics_SetGet_Interface_Version);
      }
      
      
      // DrivingStatistics_distances
      if (((someip_buffer[0]&0x000000FF) == 0x60 && (someip_buffer[1]&0x000000FF) == 0x35)
      && (((someip_buffer[2]&0x000000FF) == 0xC0 && (someip_buffer[3]&0x000000FF) == 0x20 && (someip_buffer[14]&0x000000FF) == 0x02)
      ||  ((someip_buffer[2]&0x000000FF) == 0x40 && (someip_buffer[3]&0x000000FF) == 0x20 && (someip_buffer[14]&0x000000FF) == 0x80)
      ||  ((someip_buffer[2]&0x000000FF) == 0x40 && (someip_buffer[3]&0x000000FF) == 0x21 && (someip_buffer[14]&0x000000FF) == 0x80)))
      {
        notification_rx_session_id = (someip_buffer[10]&0x000000FF)*256 + (someip_buffer[11]&0x000000FF);
        
        if ((someip_buffer[13]&0x000000FF) == @DrivingStatistics_SetGet_Interface_Version)
        {
          // Payload Data ab someip_buffer[16]
          notification_rx_struct_length = (someip_buffer[16]&0x000000FF)*16777216 + (someip_buffer[17]&0x000000FF)*65536
                                        + (someip_buffer[18]&0x000000FF)*256      + (someip_buffer[19]&0x000000FF);
          
          for (k=0; k<notification_rx_struct_length+4; k++)
            someip_payload_buffer[k] = someip_buffer[k+16];
          
          DrivingStatistics_distances_Notification();
        }
        else
          write("DrivingStatistics: wrong Interface-Version! Send: %d, Expected: %d",someip_buffer[13]&0x000000FF,@DrivingStatistics_SetGet_Interface_Version);
      }
      
      
      // DrivingStatistics_durations
      if (((someip_buffer[0]&0x000000FF) == 0x60 && (someip_buffer[1]&0x000000FF) == 0x35)
      && (((someip_buffer[2]&0x000000FF) == 0xC0 && (someip_buffer[3]&0x000000FF) == 0x30 && (someip_buffer[14]&0x000000FF) == 0x02)
      ||  ((someip_buffer[2]&0x000000FF) == 0x40 && (someip_buffer[3]&0x000000FF) == 0x30 && (someip_buffer[14]&0x000000FF) == 0x80)
      ||  ((someip_buffer[2]&0x000000FF) == 0x40 && (someip_buffer[3]&0x000000FF) == 0x31 && (someip_buffer[14]&0x000000FF) == 0x80)))
      {
        notification_rx_session_id = (someip_buffer[10]&0x000000FF)*256 + (someip_buffer[11]&0x000000FF);
        
        if ((someip_buffer[13]&0x000000FF) == @DrivingStatistics_SetGet_Interface_Version)
        {
          // Payload Data ab someip_buffer[16]
          notification_rx_struct_length = (someip_buffer[16]&0x000000FF)*16777216 + (someip_buffer[17]&0x000000FF)*65536
                                        + (someip_buffer[18]&0x000000FF)*256      + (someip_buffer[19]&0x000000FF);
          
          for (k=0; k<notification_rx_struct_length+4; k++)
            someip_payload_buffer[k] = someip_buffer[k+16];
          
          DrivingStatistics_durations_Notification();
        }
        else
          write("DrivingStatistics: wrong Interface-Version! Send: %d, Expected: %d",someip_buffer[13]&0x000000FF,@DrivingStatistics_SetGet_Interface_Version);
      }
      
      
      // DiagnosticNotification_notifications
      if (((someip_buffer[0]&0x000000FF) == 0x60 && (someip_buffer[1]&0x000000FF) == 0x46)
      && (((someip_buffer[2]&0x000000FF) == 0xC0 && (someip_buffer[3]&0x000000FF) == 0x10 && (someip_buffer[14]&0x000000FF) == 0x02)
      ||  ((someip_buffer[2]&0x000000FF) == 0x40 && (someip_buffer[3]&0x000000FF) == 0x10 && (someip_buffer[14]&0x000000FF) == 0x80)))
      {
        notification_rx_session_id = (someip_buffer[10]&0x000000FF)*256 + (someip_buffer[11]&0x000000FF);
        
        if ((someip_buffer[13]&0x000000FF) == @DiagnosticNotification_SetGet_Interface_Version)
        {
          // Payload Data ab someip_buffer[16]
          notification_rx_struct_length = (someip_buffer[16]&0x000000FF)*16777216 + (someip_buffer[17]&0x000000FF)*65536
                                        + (someip_buffer[18]&0x000000FF)*256      + (someip_buffer[19]&0x000000FF);
          
          for (k=0; k<notification_rx_struct_length+4; k++)
            someip_payload_buffer[k] = someip_buffer[k+16];
          
          DiagnosticNotification_notifications_Notification();
        }
        else
          write("DiagnosticNotification: wrong Interface-Version! Send: %d, Expected: %d",someip_buffer[13]&0x000000FF,@DiagnosticNotification_SetGet_Interface_Version);
      }
    }
  }
}








on timer get_subAck_flag_reset { get_subAck_flag = 0; }

on timer UnitMaster_available_reset             { @UnitMaster_available             = 0; }
on timer DisplaySpeed_available_reset           { @DisplaySpeed_available           = 0; }
on timer Temperature_available_reset            { @Temperature_available            = 0; }
on timer DrivingStatistics_available_reset      { @DrivingStatistics_available      = 0; }
on timer DiagnosticNotification_available_reset { @DiagnosticNotification_available = 0; }



on preStop
{
  @UnitMaster_Subscribe_units                     = 0;
  @DisplaySpeed_Subscribe_speeds                  = 0;
  @DisplaySpeed_Subscribe_speedWarnings           = 0;
  @DisplaySpeed_Subscribe_speedBlockings          = 0;
  @Temperature_Subscribe_temperatures             = 0;
  @Temperature_Subscribe_temperatureWarnings      = 0;
  @DrivingStatistics_Subscribe_speeds             = 0;
  @DrivingStatistics_Subscribe_distances          = 0;
  @DrivingStatistics_Subscribe_durations          = 0;
  @DiagnosticNotification_Subscribe_notifications = 0;
}