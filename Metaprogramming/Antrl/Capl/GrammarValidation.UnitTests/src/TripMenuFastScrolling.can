/*@@var:*/
/***************************************************************************
*=====================      Copyright by Continental AG      ===============
****************************************************************************
* Title            : TripMenuFastSrolling.can
*
* Description  : Test 1.18 (T_128)
*                Trip Menu Fast Scrolling (Up/Down).
*
* Responsible  : Wolfgang Mauder <Wolfgang.Mauder-EXT@continental-corporation.com>
*
* Revision List: (Will NOT be filled by XStudio)
*
* Archive: Rev. 1 WolMau: Inital version
*          Rev. 2 WolMau: Keypress output changed
*                         Two slow scolls in the beginning for each direction
*          Rev. 3 WolMau: Fast switching freqency increased to 5Hz
*
****************************************************************************/

variables
{
   msTimer oTimerKey;

   int iTimerKey;
   int iTimerKeySlow = 1000;
   int iTimerKeyFast = 90;
   int iCounter = 0;
   
   byte u8KeyMode ;
   byte u8Direction; //0 = Down, 1 = Up
}
/*@@end*/

/*@@key:'u':*/
on key'u'
{
    write("Keyboard input \'u\' -> Measurement start"); 
    write("Start with slow scroll");

    iCounter = 0;//Counts two slow scrolls through complete menu 
    iTimerKey = iTimerKeySlow;

    u8KeyMode = 1;//start with button "press"
    u8Direction = 1;//Press Up button

    //Up and down button not pressed in the beginning
    putValue(Env_OFN_Down_1_Play, 0); 
    putValue(Env_OFN_Down_1_Play, 0);

    //Start timer
    setTimer(oTimerKey, iTimerKey);  
     
}
/*@@end*/

/*@@timer:oTimerKey:*/
on timer oTimerKey
{
    doKeyAction();
    setTimer(oTimerKey, iTimerKey);   
}
/*@@end*/

/*@@caplFunc:doKeyAction():*///function
doKeyAction ()
{
   switch (u8KeyMode) {
      case 0:
         if(u8Direction == 0) {//Down
            putValue(Env_OFN_Down_1_Play, 1); 
         } else {//Up
            putValue(Env_OFN_Up_1_Play, 1);
         }
         break;
      case 1:
         if(u8Direction == 0) {//Dowm
            putValue(Env_OFN_Down_1_Play, 0); 
         } else {//Up
            putValue(Env_OFN_Up_1_Play, 0);
         }
         break;
   }

   iCounter++;
   if(iCounter == 16) {
      write("Switch to fast scoll");
      iTimerKey = iTimerKeyFast;//after two slow scolls through menu switch to fast scrolling
   }

   u8KeyMode++;
   if (u8KeyMode > 1) {
      u8KeyMode = 0;
   }
}
/*@@end*/

/*@@key:'d':*/
on key 'd'
{
    write("Keyboard input \'d\' -> Measurement start"); 
    write("Start with slow scroll");

    iCounter = 0;//Counts two slow scrolls through complete menu 
    iTimerKey = iTimerKeySlow;

    u8KeyMode = 1;//start with button "press"
    u8Direction = 0;//Press Down button

    //Up and down button not pressed in the beginning
    putValue(Env_OFN_Down_1_Play, 0); 
    putValue(Env_OFN_Down_1_Play, 0); 
    
    //Start timer
    setTimer(oTimerKey, iTimerKey);  
     
}
/*@@end*/

