/*@@var:*/
/***************************************************************************
*=====================      Copyright by Continental AG      ===============
****************************************************************************
* Title            : APIUpdateBurst.can
*
* Description  : Test chapter 10
*                Sends additional CAN messages to increase API updates.
*
* Responsible  : Christian Spahn <Christian.Spahn-EXT@continental-corporation.com>
*
* Revision List: (Will NOT be filled by XStudio)
*
* Archive: Rev. 4 WolMau: - Message output msg_EL_Stat_AR added in timer 
*                           t_SBW_DrvPosn_Disp_Rq_TCM_AR
*          Rev. 3 WolMau  - Not existing Fuel_Stat_AR to FuelLvl_Stat_AR
*          Rev. 2 ChrSpa: - Added version information
*          Rev. 1 ChrSpa: - Inital checkin
*
****************************************************************************/

variables
{
    msTimer t_EngCtrl_Stat_AR;
    msTimer t_FuelLvl_Stat_AR;
    msTimer t_SBW_DrvPosn_Disp_Rq_TCM_AR;
    message EngCtrl_Stat_AR msg_EngCtrl_Stat_AR;
    message FuelLvl_Stat_AR msg_FuelLvl_Stat_AR;
    message SBW_DrvPosn_Disp_Rq_TCM_AR msg_SBW_DrvPosn_Disp_Rq_TCM_AR;
    message EL_TurnInd_Rq_AR msg_EL_TurnInd_Rq_AR;
    message EL_Stat_AR msg_EL_Stat_AR;
}
/*@@end*/

/*@@timer:t_EngCtrl_Stat_AR:*/
on timer t_EngCtrl_Stat_AR
{
  msg_EngCtrl_Stat_AR.EngCoolTemp++;
  if (msg_EngCtrl_Stat_AR.EngCoolTemp > 165) {
     msg_EngCtrl_Stat_AR.EngCoolTemp = 0;
  }

  setTimer(t_EngCtrl_Stat_AR, 13);
  output(msg_EngCtrl_Stat_AR);
}
/*@@end*/

/*@@startStart:Start:*/
on start
{
    setTimer(t_EngCtrl_Stat_AR, 1000);
    setTimer(t_FuelLvl_Stat_AR, 1000);
    setTimer(t_SBW_DrvPosn_Disp_Rq_TCM_AR, 1000);
}
/*@@end*/

/*@@timer:t_FuelLvl_Stat_AR:*/
on timer t_FuelLvl_Stat_AR
{
   msg_FuelLvl_Stat_AR.TankLvl++;

   setTimer(t_FuelLvl_Stat_AR, 19);
   output(msg_FuelLvl_Stat_AR);
}
/*@@end*/

/*@@caplFunc:nextGear(byte):*///function
byte nextGear (byte gear)
{
  gear++;
  switch (gear) {
  case (8):
    gear = 49;
    break;
  case (56):
    gear = 1;
    break;
  default:
    break;
  }
  return gear;

}
/*@@end*/

/*@@timer:t_SBW_DrvPosn_Disp_Rq_TCM_AR:*/
on timer t_SBW_DrvPosn_Disp_Rq_TCM_AR
{
  msg_SBW_DrvPosn_Disp_Rq_TCM_AR.TxDrvPosn_Disp_Rq_TCM = nextGear(msg_SBW_DrvPosn_Disp_Rq_TCM_AR.TxDrvPosn_Disp_Rq_TCM);
  msg_SBW_DrvPosn_Disp_Rq_TCM_AR.TxDrvProg_Disp_Rq_TCM = nextDrvProgram(msg_SBW_DrvPosn_Disp_Rq_TCM_AR.TxDrvProg_Disp_Rq_TCM);
  output(msg_SBW_DrvPosn_Disp_Rq_TCM_AR);

  msg_EL_TurnInd_Rq_AR.EF_Actv = 1;
  msg_EL_TurnInd_Rq_AR.TurnLmpOnDur = 60;
  msg_EL_TurnInd_Rq_AR.TurnInd_FL_On_Rq = !msg_EL_TurnInd_Rq_AR.TurnInd_FL_On_Rq;
  msg_EL_TurnInd_Rq_AR.TurnInd_FR_On_Rq = !msg_EL_TurnInd_Rq_AR.TurnInd_FR_On_Rq;
  output(msg_EL_TurnInd_Rq_AR);

  msg_EL_Stat_AR.HiBm_IndLmp_On_Rq = !msg_EL_Stat_AR.HiBm_IndLmp_On_Rq;
  msg_EL_Stat_AR.LoBm_IndLmp_On_Rq = !msg_EL_Stat_AR.LoBm_IndLmp_On_Rq;
  msg_EL_Stat_AR.PosnLmp_IndLmp_On_Rq = !msg_EL_Stat_AR.PosnLmp_IndLmp_On_Rq;
  msg_EL_Stat_AR.FogLmp_Ft_IndLmp_On_Rq = !msg_EL_Stat_AR.FogLmp_Ft_IndLmp_On_Rq;
  msg_EL_Stat_AR.FogLmp_R_IndLmp_On_Rq = !msg_EL_Stat_AR.FogLmp_R_IndLmp_On_Rq;
  output(msg_EL_Stat_AR);

  setTimer(t_SBW_DrvPosn_Disp_Rq_TCM_AR, 23);
}
/*@@end*/

/*@@caplFunc:nextDrvProgram(byte):*///function
byte nextDrvProgram (byte drvPrg)
{
  switch (drvPrg) {
  case (26):
    drvPrg = 32;
    break;
  case (32):
    drvPrg = 65;
    break;
  case (65):
    drvPrg = 67;
    break;
  case (67):
    drvPrg = 69;
    break;
  case (69):
    drvPrg = 70;
    break;
  case (70):
    drvPrg = 77;
    break;
  case (77):
    drvPrg = 83;
    break;
  case (83):
    drvPrg = 84;
    break;
  case (84):
    drvPrg = 87;
  case (87):
  default:
    drvPrg = 26;
    break;
  }
  return drvPrg;
}
/*@@end*/

