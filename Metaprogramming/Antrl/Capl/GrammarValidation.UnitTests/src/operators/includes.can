includes
{
    #include "one.can"
    #include "two.can"
    #include "three.can"
}

variables
{
    int i;
    char naneArray[255];
}

on key 'A'
{
    int j;
    j = 25;

    write("The value of j is %d", j);
}

qword myFunc(int input1, int input2)
{
    return 0;
}