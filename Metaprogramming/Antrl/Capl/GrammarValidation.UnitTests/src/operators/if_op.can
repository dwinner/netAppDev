variables
{

}

increment_clock_minutes()
{
    int clock_minutes;
    clock_minutes = clock_minutes + 1;
    if (clock_minutes >= 60) // if true
    {
        clock_minutes = 0;
        // increment hour variable
    }

    if (clock_minutes >= 60) // if true
    {
        clock_minutes = 0;
    }
    else // if false
    {
        clock_minutes = clock_minutes + 1;
    }
}