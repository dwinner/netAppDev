includes
{    
}

variables
{    
}

export testcase MyCAPL_TC(signal * sigToBeSet, signal* sigToBeChecked, float valToBeSet, float valToBeChecked, int timeToBeWaited)
{
    // simulation of the 1st signal:    
    teststep("", "Stimulation of values - signal '%s' = %.2f",
        sigToBeSet.name,
        valToBeSet);
    $sigToBeSet=valToBeSet;

    // waiting till 2nd signal should be checked:
    testWaitForTimeout(timeToBeWaited);
    teststep("", "Waited for %d ms", timeToBeWaited);

    // evaluating 2nd signal:
    testValidateSignalMatch("", sigToBeChecked, valToBeChecked);
}