/*@!Encoding:1252*/
includes
{
  #include "../../_DLL/latest_BAP_DLL.cin"
}

variables
{

	//@BAPSIMGEN_VAR_SECTION_BEGIN

	/***************************************************/
	/*            BapSimGen ASG template               */
	/***************************************************/

	/************** Ausgabe Konsolen (Traces) ***********/
	dword gBAP_Trace;
	dword gError_Trace;

	/************** Node Verwaltung ***************/
	//Power on/off
	byte gSG_PowerOnOff=0x01;     // wird mit Power_off/on gesetzt
	byte gBAP_Init=0;             // schon mal initialisiert?

	const Power_off = 0x00;
	const Power_on	= 0x01;

	mstimer TaskTimer;				//real communication timer

	/************** Request **************/
	const Requestbuffer_lines = 100;
	const BAP_buffer_size = 4096;

	/************ Speichern von Requests im "Ringbuffer" ***********/
	int   gBAP_Requestbuffer_status     [Requestbuffer_lines];		            // 0: kein Eintrag, 1:pending
	dword gBAP_Request_header			[Requestbuffer_lines] [6];				// beinhaltet auch skalare Daten
	dword gBAP_Request_data             [Requestbuffer_lines] [BAP_buffer_size];// ringbuffer Eintrag fuer BAP-Request


	/************** Indication **************/
	// enthaelt die derzeitige Indication
	dword gBAP_Indication_header[6];	
	byte  gBAP_Indication_data[BAP_buffer_size];		

	/************** Konstanten ****************/

	//BAP Data Type 
	const Bap_void				=0;
	const Bap_uint8				=1;
	const Bap_uint16			=2;
	const Bap_uint32			=3;
	const Bap_byteSequence		=4;
	const Bap_error				=5;
	const Bap_acknowledge		=6;

	char Datatype_Text[7][20] =
	{
		"void", "uint8", "uint16", "uint32", "byteSequence", "error", "acknowledge"
	};

	//BAP request types
	const DataSetGet_REQ  = 0x00;
	const DataSet_REQ	  = 0x01;
	const DataGet_REQ	  = 0x02;
	const Data_REQ		  = 0x03;
	const Changed_REQ	  = 0x04;
	const Start_REQ		  = 0x05;
	const StartResult_REQ = 0x06;
	const AbortResult_REQ = 0x07;
	const Processing_REQ  = 0x08;
	const Result_REQ      = 0x09;
	const DataAck_REQ     = 0x0A;
	const Ack_REQ         = 0x0B;
	const Invalid_REQ     = 0x1F;      // Interne Kennzeichnung fuer einen ungueltigen Request

	//eigene Error-Definition
	const Error_REQ=0x20;

	char Requesttype_Text[33][30] =
	{
		"DataSetGet_REQ", "DataSet_REQ", "DataGet_REQ", "Data_REQ",			/* 00 .. 03 */
		"Changed_REQ", "Start_REQ", "StartResult_REQ", "AbortResult_REQ",   /* 04 .. 07 */
		"Processing_REQ", "Result_REQ", "DataAck_REQ", "Ack_REQ", 			/* 08 .. 0b */
		"Invalid_REQ", "Invalid_REQ", "Invalid_REQ", "Invalid_REQ",  		/* 0c .. 0f */
		"Invalid_REQ", "Invalid_REQ", "Invalid_REQ", "Invalid_REQ",  		/* 10 .. 13 */
		"Invalid_REQ", "Invalid_REQ", "Invalid_REQ", "Invalid_REQ",  		/* 14 .. 17 */
		"Invalid_REQ", "Invalid_REQ", "Invalid_REQ", "Invalid_REQ", 		/* 18 .. 1b */
		"Invalid_REQ", "Invalid_REQ", "Invalid_REQ", "Invalid_REQ",  		/* 1c .. 1f */
		"Error_REQ"	  														/* 20 */
	};

	//BAP indication types
	const Data_IND			 = 0x00;
	const Reset_IND			 = 0x01;
	const DataAck_IND        = 0x02;
	const Result_IND		 = 0x03;
	const Processing_IND	 = 0x04;
  	const Changed_IND		 = 0x05;
  	const DataSetGet_IND	 = 0x06;
	const DataSet_IND		 = 0x07;
	const DataGet_IND		 = 0x08;
	const Ack_IND            = 0x09;
	const Processing_CNF_IND = 0x0A;
	const Start_IND			 = 0x0B;
	const StartResult_IND	 = 0x0C;
	const AbortResult_IND	 = 0x0D;
	const Invalid_IND		 = 0x1F; // Kennzeichnung fuer eine ungueltige Indication
	const Error_IND			 = 0x20;
	
	char Indicationtype_Text[33][30] =
	{
		"Data_IND", "Reset_IND", "DataAck_IND", "Result_IND",			 	/* 00 .. 03 */
		"Processing_IND", "Changed_IND", "DataSetGet_IND", "DataSet_IND", 	/* 04 .. 07 */
		"DataGet_IND", "Ack_IND", "Processing_CNF_IND", "Start_REQ",	 	/* 08 .. 0b */
		"StartResult_REQ", "AbortResult_REQ", "Invalid_REQ", "Invalid_REQ", /* 0c .. 0f */
		"Invalid_REQ", "Invalid_REQ", "Invalid_REQ", "Invalid_REQ",  		/* 10 .. 13 */
		"Invalid_REQ", "Invalid_REQ", "Invalid_REQ", "Invalid_REQ",  		/* 14 .. 17 */
		"Invalid_REQ", "Invalid_REQ", "Invalid_REQ", "Invalid_REQ", 		/* 18 .. 1b */
		"Invalid_REQ", "Invalid_REQ", "Invalid_REQ", "Invalid_REQ",  		/* 1c .. 1f */
		"Error_REQ"	  														/* 20 */
	};	
	
	char Acknowledgetype_Text[24][30] =
	{
		"Property_SetGet_ACK", "Array_SetGet_ACK", "Property_Set_ACK", "Array_Set_ACK",  			/* 00 .. 03 */
		"Method_Start_ACK", "Method_StartResult_ACK", "Method_AbortResult_ACK", "Property_Get_ACK",	/* 04 .. 07 */
		"Array_Get_ACK", "Cache_GetAll_ACK", "Property_Ack_ACK", "Property_Status_ACK",	   			/* 08 .. 0b */
		"Property_StatusAck_ACK", "Property_Error_ACK", "Array_Status_ACK", "Array_Changed_ACK",	/* 0c .. 0f */
		"Array_Error_ACK", "Method_Processing_ACK", "Method_Result_ACK", "Method_Error_ACK",  		/* 10 .. 13 */
		"Unknown_ACK", "Unknown_ACK", "Unknown_ACK", "Unknown_ACK"									/* 14 .. 17 */
	};

	/**************************** Global Function-ID's ******************************/
	/** TODO: already_pressed kann zwischen den Funktionen geshared werden          */

	byte already_pressed = 0;

	const FctID_GetAll									= 0x01;
	const FctID_BAP_Config								= 0x02;
	const FctID_FunctionList							= 0x03;
	const FctID_HeartBeat								= 0x04;
    
    char SGtype[4]="ASG";

	char  dbcan_path[255]           = "BAP\\ASG15_BC_MFA_72\\bapdb\\BAP_only_MQB_MLBevo_v1.60.dbc";
	char  xml_path[255]             = "BAP\\ASG15_BC_MFA_72\\bapxml\\BAP_SW16_BC_MLBevo_P30DF72_ASG1_ZR_V1.50.xml";
	dword NODE_INDEX                =  0;
	char  NODE_NAME[100]            = "BC_MFA";
	const LSGID                     = 15;
	char  panel_name[100]           = "ASG15_1";
	char  bapconfig_panel_name[100]    = "panel1";
	char  common_panel_name[100]    = "panel2";
	const TaskTime                  = 10;
	const heartBeatFactor                               = 5;
	 const C_ASG_15_1_0_1_ID = 1;
	 byte C_ASG_15_1_0_1GetAll_BTN_already_pressed = 0;
	 char gCheckbox1[100] = "checkbox_C_ASG_15_1_0_1";
	 char gErrField1[100] = "errfield_C_ASG_15_1_0_1";
	 byte gC_ASG_15_1_0_1_ErrCode = 1;
	 const P_ASG_15_1_0_2_ID = 2;
	 byte P_ASG_15_1_0_2Get_BTN_already_pressed = 0;
	 char gCheckbox2[100] = "checkbox_P_ASG_15_1_0_2";
	 char gErrField2[100] = "errfield_P_ASG_15_1_0_2";
	 byte gP_ASG_15_1_0_2_ErrCode = 1;
	 const P_ASG_15_1_0_3_ID = 3;
	 byte P_ASG_15_1_0_3Get_BTN_already_pressed = 0;
	 char gCheckbox3[100] = "checkbox_P_ASG_15_1_0_3";
	 char gErrField3[100] = "errfield_P_ASG_15_1_0_3";
	 byte gP_ASG_15_1_0_3_ErrCode = 1;
	 const P_ASG_15_1_0_4_ID = 4;
	 byte P_ASG_15_1_0_4Get_BTN_already_pressed = 0;
	 char gCheckbox4[100] = "checkbox_P_ASG_15_1_0_4";
	 char gErrField4[100] = "errfield_P_ASG_15_1_0_4";
	 byte gP_ASG_15_1_0_4_ErrCode = 1;
	 const P_ASG_15_1_0_13_ID = 13;
	 byte P_ASG_15_1_0_13Get_BTN_already_pressed = 0;
	 byte P_ASG_15_1_0_13SetGet_BTN_already_pressed = 0;
	 char gCheckbox13[100] = "checkbox_P_ASG_15_1_0_13";
	 char gErrField13[100] = "errfield_P_ASG_15_1_0_13";
	 byte gP_ASG_15_1_0_13_ErrCode = 1;
	 char gPanel13[100] = "panel_P_ASG_15_1_0_13";
	 const P_ASG_15_1_0_14_ID = 14;
	 byte P_ASG_15_1_0_14Get_BTN_already_pressed = 0;
	 char gCheckbox14[100] = "checkbox_P_ASG_15_1_0_14";
	 char gErrField14[100] = "errfield_P_ASG_15_1_0_14";
	 byte gP_ASG_15_1_0_14_ErrCode = 1;
	 char gPanel14[100] = "panel_P_ASG_15_1_0_14";
	 const P_ASG_15_1_0_15_ID = 15;
	 byte P_ASG_15_1_0_15Get_BTN_already_pressed = 0;
	 char gCheckbox15[100] = "checkbox_P_ASG_15_1_0_15";
	 char gErrField15[100] = "errfield_P_ASG_15_1_0_15";
	 byte gP_ASG_15_1_0_15_ErrCode = 1;
	 char gPanel15[100] = "panel_P_ASG_15_1_0_15";
	 const P_ASG_15_1_0_16_ID = 16;
	 byte P_ASG_15_1_0_16Get_BTN_already_pressed = 0;
	 byte P_ASG_15_1_0_16SetGet_BTN_already_pressed = 0;
	 char gCheckbox16[100] = "checkbox_P_ASG_15_1_0_16";
	 char gErrField16[100] = "errfield_P_ASG_15_1_0_16";
	 byte gP_ASG_15_1_0_16_ErrCode = 1;
	 char gPanel16[100] = "panel_P_ASG_15_1_0_16";
	 const M_ASG_15_1_0_17_ID = 17;
	 byte M_ASG_15_1_0_17StartResult_BTN_already_pressed = 0;
	 char gCheckbox17[100] = "checkbox_M_ASG_15_1_0_17";
	 char gErrField17[100] = "errfield_M_ASG_15_1_0_17";
	 byte gM_ASG_15_1_0_17_ErrCode = 1;
	 char gPanel17[100] = "panel_M_ASG_15_1_0_17";
	 const P_ASG_15_1_0_18_ID = 18;
	 byte P_ASG_15_1_0_18Get_BTN_already_pressed = 0;
	 byte P_ASG_15_1_0_18SetGet_BTN_already_pressed = 0;
	 char gCheckbox18[100] = "checkbox_P_ASG_15_1_0_18";
	 char gErrField18[100] = "errfield_P_ASG_15_1_0_18";
	 byte gP_ASG_15_1_0_18_ErrCode = 1;
	 char gPanel18[100] = "panel_P_ASG_15_1_0_18";
	 const P_ASG_15_1_0_19_ID = 19;
	 byte P_ASG_15_1_0_19Get_BTN_already_pressed = 0;
	 char gCheckbox19[100] = "checkbox_P_ASG_15_1_0_19";
	 char gErrField19[100] = "errfield_P_ASG_15_1_0_19";
	 byte gP_ASG_15_1_0_19_ErrCode = 1;
	 char gPanel19[100] = "panel_P_ASG_15_1_0_19";
	 const P_ASG_15_1_0_20_ID = 20;
	 byte P_ASG_15_1_0_20Get_BTN_already_pressed = 0;
	 char gCheckbox20[100] = "checkbox_P_ASG_15_1_0_20";
	 char gErrField20[100] = "errfield_P_ASG_15_1_0_20";
	 byte gP_ASG_15_1_0_20_ErrCode = 1;
	 char gPanel20[100] = "panel_P_ASG_15_1_0_20";
	 const P_ASG_15_1_0_21_ID = 21;
	 byte P_ASG_15_1_0_21Get_BTN_already_pressed = 0;
	 char gCheckbox21[100] = "checkbox_P_ASG_15_1_0_21";
	 char gErrField21[100] = "errfield_P_ASG_15_1_0_21";
	 byte gP_ASG_15_1_0_21_ErrCode = 1;
	 char gPanel21[100] = "panel_P_ASG_15_1_0_21";
	 const P_ASG_15_1_0_22_ID = 22;
	 byte P_ASG_15_1_0_22Get_BTN_already_pressed = 0;
	 char gCheckbox22[100] = "checkbox_P_ASG_15_1_0_22";
	 char gErrField22[100] = "errfield_P_ASG_15_1_0_22";
	 byte gP_ASG_15_1_0_22_ErrCode = 1;
	 char gPanel22[100] = "panel_P_ASG_15_1_0_22";
	 const P_ASG_15_1_0_23_ID = 23;
	 byte P_ASG_15_1_0_23Get_BTN_already_pressed = 0;
	 char gCheckbox23[100] = "checkbox_P_ASG_15_1_0_23";
	 char gErrField23[100] = "errfield_P_ASG_15_1_0_23";
	 byte gP_ASG_15_1_0_23_ErrCode = 1;
	 char gPanel23[100] = "panel_P_ASG_15_1_0_23";
	 const P_ASG_15_1_0_24_ID = 24;
	 byte P_ASG_15_1_0_24Get_BTN_already_pressed = 0;
	 char gCheckbox24[100] = "checkbox_P_ASG_15_1_0_24";
	 char gErrField24[100] = "errfield_P_ASG_15_1_0_24";
	 byte gP_ASG_15_1_0_24_ErrCode = 1;
	 char gPanel24[100] = "panel_P_ASG_15_1_0_24";
	 const P_ASG_15_1_0_25_ID = 25;
	 byte P_ASG_15_1_0_25Get_BTN_already_pressed = 0;
	 char gCheckbox25[100] = "checkbox_P_ASG_15_1_0_25";
	 char gErrField25[100] = "errfield_P_ASG_15_1_0_25";
	 byte gP_ASG_15_1_0_25_ErrCode = 1;
	 char gPanel25[100] = "panel_P_ASG_15_1_0_25";
	 const P_ASG_15_1_0_26_ID = 26;
	 byte P_ASG_15_1_0_26Get_BTN_already_pressed = 0;
	 char gCheckbox26[100] = "checkbox_P_ASG_15_1_0_26";
	 char gErrField26[100] = "errfield_P_ASG_15_1_0_26";
	 byte gP_ASG_15_1_0_26_ErrCode = 1;
	 char gPanel26[100] = "panel_P_ASG_15_1_0_26";
	 const P_ASG_15_1_0_27_ID = 27;
	 byte P_ASG_15_1_0_27Get_BTN_already_pressed = 0;
	 char gCheckbox27[100] = "checkbox_P_ASG_15_1_0_27";
	 char gErrField27[100] = "errfield_P_ASG_15_1_0_27";
	 byte gP_ASG_15_1_0_27_ErrCode = 1;
	 char gPanel27[100] = "panel_P_ASG_15_1_0_27";
	 const P_ASG_15_1_0_28_ID = 28;
	 byte P_ASG_15_1_0_28Get_BTN_already_pressed = 0;
	 char gCheckbox28[100] = "checkbox_P_ASG_15_1_0_28";
	 char gErrField28[100] = "errfield_P_ASG_15_1_0_28";
	 byte gP_ASG_15_1_0_28_ErrCode = 1;
	 char gPanel28[100] = "panel_P_ASG_15_1_0_28";
	 const P_ASG_15_1_0_29_ID = 29;
	 byte P_ASG_15_1_0_29Get_BTN_already_pressed = 0;
	 char gCheckbox29[100] = "checkbox_P_ASG_15_1_0_29";
	 char gErrField29[100] = "errfield_P_ASG_15_1_0_29";
	 byte gP_ASG_15_1_0_29_ErrCode = 1;
	 char gPanel29[100] = "panel_P_ASG_15_1_0_29";
	 const P_ASG_15_1_0_30_ID = 30;
	 byte P_ASG_15_1_0_30Get_BTN_already_pressed = 0;
	 char gCheckbox30[100] = "checkbox_P_ASG_15_1_0_30";
	 char gErrField30[100] = "errfield_P_ASG_15_1_0_30";
	 byte gP_ASG_15_1_0_30_ErrCode = 1;
	 char gPanel30[100] = "panel_P_ASG_15_1_0_30";
	 const A_ASG_15_1_0_31_ID = 31;
	 byte A_ASG_15_1_0_31Get_BTN_already_pressed = 0;
	 char gCheckbox31[100] = "checkbox_A_ASG_15_1_0_31";
	 char gErrField31[100] = "errfield_A_ASG_15_1_0_31";
	 byte gA_ASG_15_1_0_31_ErrCode = 1;
	 char gPanel31[100] = "panel_A_ASG_15_1_0_31";
	 byte A_ASG_15_1_0_31_DataIndex_Decr_already_pressed = 0;
	 byte A_ASG_15_1_0_31_DataIndex_Incr_already_pressed = 0;
	 byte A_ASG_15_1_0_31_DataIndex_SetGet_Decr_already_pressed = 0;
	 byte A_ASG_15_1_0_31_DataIndex_SetGet_Incr_already_pressed = 0;
	 byte A_ASG_15_1_0_31_generateData_Btn_already_pressed = 0;
	 byte A_ASG_15_1_0_31_loadArray_Btn_already_pressed = 0;
	 _align(1) struct A_ASG_15_1_0_31_ArrayDataStruct {
		 word Param1;
		 word Param2;
		 byte Param3[46];
		 word Param3_Length;
		 byte Param4[302];
		 word Param4_Length;
	 };
	 struct A_ASG_15_1_0_31_ArrayDataStruct A_ASG_15_1_0_31_ArrayDataList[255];
	 const A_ASG_15_1_0_31_ArrayDataList_Length = 255;
	 long A_ASG_15_1_0_31_Data_3_LenList[255];
	 byte A_ASG_15_1_0_31_Data_3_CntList[255];
	 long A_ASG_15_1_0_31_Data_3_SetGet_LenList[255];
	 byte A_ASG_15_1_0_31_Data_3_SetGet_CntList[255];
	 long A_ASG_15_1_0_31_Data_4_LenList[255];
	 byte A_ASG_15_1_0_31_Data_4_CntList[255];
	 long A_ASG_15_1_0_31_Data_4_SetGet_LenList[255];
	 byte A_ASG_15_1_0_31_Data_4_SetGet_CntList[255];
	 const P_ASG_15_1_0_32_ID = 32;
	 byte P_ASG_15_1_0_32Get_BTN_already_pressed = 0;
	 char gCheckbox32[100] = "checkbox_P_ASG_15_1_0_32";
	 char gErrField32[100] = "errfield_P_ASG_15_1_0_32";
	 byte gP_ASG_15_1_0_32_ErrCode = 1;
	 char gPanel32[100] = "panel_P_ASG_15_1_0_32";
	 const P_ASG_15_1_0_33_ID = 33;
	 byte P_ASG_15_1_0_33Get_BTN_already_pressed = 0;
	 char gCheckbox33[100] = "checkbox_P_ASG_15_1_0_33";
	 char gErrField33[100] = "errfield_P_ASG_15_1_0_33";
	 byte gP_ASG_15_1_0_33_ErrCode = 1;
	 char gPanel33[100] = "panel_P_ASG_15_1_0_33";
	 const P_ASG_15_1_0_34_ID = 34;
	 byte P_ASG_15_1_0_34Get_BTN_already_pressed = 0;
	 char gCheckbox34[100] = "checkbox_P_ASG_15_1_0_34";
	 char gErrField34[100] = "errfield_P_ASG_15_1_0_34";
	 byte gP_ASG_15_1_0_34_ErrCode = 1;
	 char gPanel34[100] = "panel_P_ASG_15_1_0_34";
	 const P_ASG_15_1_0_35_ID = 35;
	 byte P_ASG_15_1_0_35Get_BTN_already_pressed = 0;
	 char gCheckbox35[100] = "checkbox_P_ASG_15_1_0_35";
	 char gErrField35[100] = "errfield_P_ASG_15_1_0_35";
	 byte gP_ASG_15_1_0_35_ErrCode = 1;
	 char gPanel35[100] = "panel_P_ASG_15_1_0_35";
	 const A_ASG_15_1_0_36_ID = 36;
	 byte A_ASG_15_1_0_36Get_BTN_already_pressed = 0;
	 byte A_ASG_15_1_0_36SetGet_BTN_already_pressed = 0;
	 char gCheckbox36[100] = "checkbox_A_ASG_15_1_0_36";
	 char gErrField36[100] = "errfield_A_ASG_15_1_0_36";
	 byte gA_ASG_15_1_0_36_ErrCode = 1;
	 char gPanel36[100] = "panel_A_ASG_15_1_0_36";
	 byte A_ASG_15_1_0_36_DataIndex_Decr_already_pressed = 0;
	 byte A_ASG_15_1_0_36_DataIndex_Incr_already_pressed = 0;
	 byte A_ASG_15_1_0_36_DataIndex_SetGet_Decr_already_pressed = 0;
	 byte A_ASG_15_1_0_36_DataIndex_SetGet_Incr_already_pressed = 0;
	 byte A_ASG_15_1_0_36_generateData_Btn_already_pressed = 0;
	 byte A_ASG_15_1_0_36_loadArray_Btn_already_pressed = 0;
	 _align(1) struct A_ASG_15_1_0_36_ArrayDataStruct {
		 dword Param1;
		 byte Param2;
		 byte Param3;
		 dword Param4;
		 byte Param5[255];//[2];
		 word Param5_Length;
	 };
	 struct A_ASG_15_1_0_36_ArrayDataStruct A_ASG_15_1_0_36_ArrayDataList[400];//[70];
	 const A_ASG_15_1_0_36_ArrayDataList_Length = 400;//70;
	 long A_ASG_15_1_0_36_Data_5_LenList[400];//[70];
	 byte A_ASG_15_1_0_36_Data_5_CntList[400];//[70];
	 long A_ASG_15_1_0_36_Data_5_SetGet_LenList[400];//[70];
	 byte A_ASG_15_1_0_36_Data_5_SetGet_CntList[400];//[70];
	 const P_ASG_15_1_0_37_ID = 37;
	 byte P_ASG_15_1_0_37Get_BTN_already_pressed = 0;
	 byte P_ASG_15_1_0_37SetGet_BTN_already_pressed = 0;
	 char gCheckbox37[100] = "checkbox_P_ASG_15_1_0_37";
	 char gErrField37[100] = "errfield_P_ASG_15_1_0_37";
	 byte gP_ASG_15_1_0_37_ErrCode = 1;
	 char gPanel37[100] = "panel_P_ASG_15_1_0_37";


	/// Begin: Definition der BUS-Schnittstellen
	
	// FLEXRAY NOT ENABLED!
	
	// ETHERNET NOT ENABLED! 
	
	//// End Bus Schnittstellen
}

on preStart
{
	char Version[200];
	char Path[255];

	/***** Erzeugen der Ausgabeconsolen *****/	
	gBAP_Trace=writecreate("BAP-Trace");		//write-window for BAP-cummunication
	writeclear(gBAP_Trace);						//clear BAP-window in write-window
	
	gError_Trace=writecreate("Error");			//error-window for BAP-cummunication
	writeclear(gError_Trace);					//clear error-window in write-window
	
	writeclear(1);								//clear CAPL-window in write-window
	
	/**** Versionsstring von DLL holen und auf Bildschirm ausgeben ***/	
	BAP150_GetVersions(Version, 200);
	writelineEx(gBAP_Trace, 0, "Versionx:%s", Version);
											
  NODE_INDEX = BAP150_CreateNode();
  writelineEx(gBAP_Trace, 0, "ASG %d Nodeindex:%d", LSGID, Version);

	// FLEXRAY NOT ENABLED!
	
}

DisableFctCtrl ()
{
  	EnableControl(panel_name, common_panel_name, 0);
	EnableControl(panel_name,gErrField1,0);
	EnableControl(panel_name,gErrField2,0);
	EnableControl(panel_name,gErrField3,0);
	EnableControl(panel_name,gErrField4,0);
	EnableControl(panel_name,gErrField13,0);
	EnableControl(panel_name,gPanel13,0);
	EnableControl(panel_name,"panel_P_ASG_15_1_0_13",0);
	EnableControl(panel_name,gErrField14,0);
	EnableControl(panel_name,gPanel14,0);
	EnableControl(panel_name,"panel_P_ASG_15_1_0_14",0);
	EnableControl(panel_name,gErrField15,0);
	EnableControl(panel_name,gPanel15,0);
	EnableControl(panel_name,"panel_P_ASG_15_1_0_15",0);
	EnableControl(panel_name,gErrField16,0);
	EnableControl(panel_name,gPanel16,0);
	EnableControl(panel_name,"panel_P_ASG_15_1_0_16",0);
	EnableControl(panel_name,gErrField17,0);
	EnableControl(panel_name,gPanel17,0);
	EnableControl(panel_name,"panel_M_ASG_15_1_0_17_Result",0);
	EnableControl(panel_name,"panel_M_ASG_15_1_0_17_Processing",0);
	EnableControl(panel_name,"panel_M_ASG_15_1_0_17_Start",0);
	EnableControl(panel_name,gErrField18,0);
	EnableControl(panel_name,gPanel18,0);
	EnableControl(panel_name,"panel_P_ASG_15_1_0_18",0);
	EnableControl(panel_name,gErrField19,0);
	EnableControl(panel_name,gPanel19,0);
	EnableControl(panel_name,"panel_P_ASG_15_1_0_19",0);
	EnableControl(panel_name,gErrField20,0);
	EnableControl(panel_name,gPanel20,0);
	EnableControl(panel_name,"panel_P_ASG_15_1_0_20",0);
	EnableControl(panel_name,gErrField21,0);
	EnableControl(panel_name,gPanel21,0);
	EnableControl(panel_name,"panel_P_ASG_15_1_0_21",0);
	EnableControl(panel_name,gErrField22,0);
	EnableControl(panel_name,gPanel22,0);
	EnableControl(panel_name,"panel_P_ASG_15_1_0_22",0);
	EnableControl(panel_name,gErrField23,0);
	EnableControl(panel_name,gPanel23,0);
	EnableControl(panel_name,"panel_P_ASG_15_1_0_23",0);
	EnableControl(panel_name,gErrField24,0);
	EnableControl(panel_name,gPanel24,0);
	EnableControl(panel_name,"panel_P_ASG_15_1_0_24",0);
	EnableControl(panel_name,gErrField25,0);
	EnableControl(panel_name,gPanel25,0);
	EnableControl(panel_name,"panel_P_ASG_15_1_0_25",0);
	EnableControl(panel_name,gErrField26,0);
	EnableControl(panel_name,gPanel26,0);
	EnableControl(panel_name,"panel_P_ASG_15_1_0_26",0);
	EnableControl(panel_name,gErrField27,0);
	EnableControl(panel_name,gPanel27,0);
	EnableControl(panel_name,"panel_P_ASG_15_1_0_27",0);
	EnableControl(panel_name,gErrField28,0);
	EnableControl(panel_name,gPanel28,0);
	EnableControl(panel_name,"panel_P_ASG_15_1_0_28",0);
	EnableControl(panel_name,gErrField29,0);
	EnableControl(panel_name,gPanel29,0);
	EnableControl(panel_name,"panel_P_ASG_15_1_0_29",0);
	EnableControl(panel_name,gErrField30,0);
	EnableControl(panel_name,gPanel30,0);
	EnableControl(panel_name,"panel_P_ASG_15_1_0_30",0);
	EnableControl(panel_name,gErrField31,0);
	EnableControl(panel_name,gPanel31,0);
	EnableControl(panel_name,"panel_A_ASG_15_1_0_31",0);
	EnableControl(panel_name,"panel_A_ASG_15_1_0_31_Changed",0);
	EnableControl(panel_name,"panel_A_ASG_15_1_0_31_SetGet",0);
	EnableControl(panel_name,gErrField32,0);
	EnableControl(panel_name,gPanel32,0);
	EnableControl(panel_name,"panel_P_ASG_15_1_0_32",0);
	EnableControl(panel_name,gErrField33,0);
	EnableControl(panel_name,gPanel33,0);
	EnableControl(panel_name,"panel_P_ASG_15_1_0_33",0);
	EnableControl(panel_name,gErrField34,0);
	EnableControl(panel_name,gPanel34,0);
	EnableControl(panel_name,"panel_P_ASG_15_1_0_34",0);
	EnableControl(panel_name,gErrField35,0);
	EnableControl(panel_name,gPanel35,0);
	EnableControl(panel_name,"panel_P_ASG_15_1_0_35",0);
	EnableControl(panel_name,gErrField36,0);
	EnableControl(panel_name,gPanel36,0);
	EnableControl(panel_name,"panel_A_ASG_15_1_0_36",0);
	EnableControl(panel_name,"panel_A_ASG_15_1_0_36_Changed",0);
	EnableControl(panel_name,"panel_A_ASG_15_1_0_36_SetGet",0);
	EnableControl(panel_name,gErrField37,0);
	EnableControl(panel_name,gPanel37,0);
	EnableControl(panel_name,"panel_P_ASG_15_1_0_37",0);

}

EnableFctCtrl ()
{
  	EnableControl(panel_name, common_panel_name, 1);
		 EnableControl(panel_name,gPanel13,1);
		 EnableControl(panel_name,gErrField13,1);
		 EnableControl(panel_name,gPanel14,1);
		 EnableControl(panel_name,gErrField14,1);
		 EnableControl(panel_name,gPanel15,1);
		 EnableControl(panel_name,gErrField15,1);
		 EnableControl(panel_name,gPanel16,1);
		 EnableControl(panel_name,gErrField16,1);
		 EnableControl(panel_name,gPanel17,1);
		 EnableControl(panel_name,gErrField17,1);
		 EnableControl(panel_name,gPanel18,1);
		 EnableControl(panel_name,gErrField18,1);
		 EnableControl(panel_name,gPanel19,1);
		 EnableControl(panel_name,gErrField19,1);
		 EnableControl(panel_name,gPanel20,1);
		 EnableControl(panel_name,gErrField20,1);
		 EnableControl(panel_name,gPanel21,1);
		 EnableControl(panel_name,gErrField21,1);
		 EnableControl(panel_name,gPanel22,1);
		 EnableControl(panel_name,gErrField22,1);
		 EnableControl(panel_name,gPanel23,1);
		 EnableControl(panel_name,gErrField23,1);
		 EnableControl(panel_name,gPanel24,1);
		 EnableControl(panel_name,gErrField24,1);
		 EnableControl(panel_name,gPanel25,1);
		 EnableControl(panel_name,gErrField25,1);
		 EnableControl(panel_name,gPanel26,1);
		 EnableControl(panel_name,gErrField26,1);
		 EnableControl(panel_name,gPanel27,1);
		 EnableControl(panel_name,gErrField27,1);
		 EnableControl(panel_name,gPanel28,1);
		 EnableControl(panel_name,gErrField28,1);
		 EnableControl(panel_name,gPanel29,1);
		 EnableControl(panel_name,gErrField29,1);
		 EnableControl(panel_name,gPanel30,1);
		 EnableControl(panel_name,gErrField30,1);
		 EnableControl(panel_name,gPanel31,1);
		 EnableControl(panel_name,gErrField31,1);
		 EnableControl(panel_name,gPanel32,1);
		 EnableControl(panel_name,gErrField32,1);
		 EnableControl(panel_name,gPanel33,1);
		 EnableControl(panel_name,gErrField33,1);
		 EnableControl(panel_name,gPanel34,1);
		 EnableControl(panel_name,gErrField34,1);
		 EnableControl(panel_name,gPanel35,1);
		 EnableControl(panel_name,gErrField35,1);
		 EnableControl(panel_name,gPanel36,1);
		 EnableControl(panel_name,gErrField36,1);
		 EnableControl(panel_name,gPanel37,1);
		 EnableControl(panel_name,gErrField37,1);

}

EnableConfigCtrl ()
{
  	if(getValue(C_ASG_15_1_0_1_FctLstItemEn))
	{
		setControlForeColor(panel_name, gCheckbox1, MakeRGB(0,240,0));
	}
	else
	{
		setControlForeColor(panel_name, gCheckbox1, MakeRGB(250,0,0));
	}
	if(getValue(P_ASG_15_1_0_2_FctLstItemEn))
	{
		setControlForeColor(panel_name, gCheckbox2, MakeRGB(0,240,0));
	}
	else
	{
		setControlForeColor(panel_name, gCheckbox2, MakeRGB(250,0,0));
	}
	if(getValue(P_ASG_15_1_0_3_FctLstItemEn))
	{
		setControlForeColor(panel_name, gCheckbox3, MakeRGB(0,240,0));
	}
	else
	{
		setControlForeColor(panel_name, gCheckbox3, MakeRGB(250,0,0));
	}
	EnableControl(panel_name, "panel_P_ASG_15_1_0_4", 1);
	if(getValue(P_ASG_15_1_0_4_FctLstItemEn))
	{
		setControlForeColor(panel_name, gCheckbox4, MakeRGB(0,240,0));
	}
	else
	{
		setControlForeColor(panel_name, gCheckbox4, MakeRGB(250,0,0));
	}
	if(getValue(P_ASG_15_1_0_13_FctLstItemEn))
	{
		EnableControl(panel_name, "panel_P_ASG_15_1_0_13",1);
		EnableControl(panel_name,"errfield_P_ASG_15_1_0_13",1);
		setControlForeColor(panel_name, gCheckbox13, MakeRGB(0,240,0));
	}
	else
	{
		EnableControl(panel_name, "panel_P_ASG_15_1_0_13",0);
		EnableControl(panel_name,"errfield_P_ASG_15_1_0_13",0);
		setControlForeColor(panel_name, gCheckbox13, MakeRGB(250,0,0));
	}
	if(getValue(P_ASG_15_1_0_14_FctLstItemEn))
	{
		EnableControl(panel_name, "panel_P_ASG_15_1_0_14",1);
		EnableControl(panel_name,"errfield_P_ASG_15_1_0_14",1);
		setControlForeColor(panel_name, gCheckbox14, MakeRGB(0,240,0));
	}
	else
	{
		EnableControl(panel_name, "panel_P_ASG_15_1_0_14",0);
		EnableControl(panel_name,"errfield_P_ASG_15_1_0_14",0);
		setControlForeColor(panel_name, gCheckbox14, MakeRGB(250,0,0));
	}
	if(getValue(P_ASG_15_1_0_15_FctLstItemEn))
	{
		EnableControl(panel_name, "panel_P_ASG_15_1_0_15",1);
		EnableControl(panel_name,"errfield_P_ASG_15_1_0_15",1);
		setControlForeColor(panel_name, gCheckbox15, MakeRGB(0,240,0));
	}
	else
	{
		EnableControl(panel_name, "panel_P_ASG_15_1_0_15",0);
		EnableControl(panel_name,"errfield_P_ASG_15_1_0_15",0);
		setControlForeColor(panel_name, gCheckbox15, MakeRGB(250,0,0));
	}
	if(getValue(P_ASG_15_1_0_16_FctLstItemEn))
	{
		EnableControl(panel_name, "panel_P_ASG_15_1_0_16",1);
		EnableControl(panel_name,"errfield_P_ASG_15_1_0_16",1);
		setControlForeColor(panel_name, gCheckbox16, MakeRGB(0,240,0));
	}
	else
	{
		EnableControl(panel_name, "panel_P_ASG_15_1_0_16",0);
		EnableControl(panel_name,"errfield_P_ASG_15_1_0_16",0);
		setControlForeColor(panel_name, gCheckbox16, MakeRGB(250,0,0));
	}
	if(getValue(M_ASG_15_1_0_17_FctLstItemEn))
	{
		EnableControl(panel_name, "panel_M_ASG_15_1_0_17",1);
		EnableControl(panel_name,"errfield_M_ASG_15_1_0_17",1);
		EnableControl(panel_name,"panel_M_ASG_15_1_0_17_Processing",1);
		EnableControl(panel_name,"panel_M_ASG_15_1_0_17_Start",1);
		setControlForeColor(panel_name, gCheckbox17, MakeRGB(0,240,0));
	}
	else
	{
		EnableControl(panel_name, "panel_M_ASG_15_1_0_17",0);
		EnableControl(panel_name,"errfield_M_ASG_15_1_0_17",0);
		EnableControl(panel_name,"panel_M_ASG_15_1_0_17_Processing",0);
		EnableControl(panel_name,"panel_M_ASG_15_1_0_17_Start",0);
		setControlForeColor(panel_name, gCheckbox17, MakeRGB(250,0,0));
	}
	if(getValue(P_ASG_15_1_0_18_FctLstItemEn))
	{
		EnableControl(panel_name, "panel_P_ASG_15_1_0_18",1);
		EnableControl(panel_name,"errfield_P_ASG_15_1_0_18",1);
		setControlForeColor(panel_name, gCheckbox18, MakeRGB(0,240,0));
	}
	else
	{
		EnableControl(panel_name, "panel_P_ASG_15_1_0_18",0);
		EnableControl(panel_name,"errfield_P_ASG_15_1_0_18",0);
		setControlForeColor(panel_name, gCheckbox18, MakeRGB(250,0,0));
	}
	if(getValue(P_ASG_15_1_0_19_FctLstItemEn))
	{
		EnableControl(panel_name, "panel_P_ASG_15_1_0_19",1);
		EnableControl(panel_name,"errfield_P_ASG_15_1_0_19",1);
		setControlForeColor(panel_name, gCheckbox19, MakeRGB(0,240,0));
	}
	else
	{
		EnableControl(panel_name, "panel_P_ASG_15_1_0_19",0);
		EnableControl(panel_name,"errfield_P_ASG_15_1_0_19",0);
		setControlForeColor(panel_name, gCheckbox19, MakeRGB(250,0,0));
	}
	if(getValue(P_ASG_15_1_0_20_FctLstItemEn))
	{
		EnableControl(panel_name, "panel_P_ASG_15_1_0_20",1);
		EnableControl(panel_name,"errfield_P_ASG_15_1_0_20",1);
		setControlForeColor(panel_name, gCheckbox20, MakeRGB(0,240,0));
	}
	else
	{
		EnableControl(panel_name, "panel_P_ASG_15_1_0_20",0);
		EnableControl(panel_name,"errfield_P_ASG_15_1_0_20",0);
		setControlForeColor(panel_name, gCheckbox20, MakeRGB(250,0,0));
	}
	if(getValue(P_ASG_15_1_0_21_FctLstItemEn))
	{
		EnableControl(panel_name, "panel_P_ASG_15_1_0_21",1);
		EnableControl(panel_name,"errfield_P_ASG_15_1_0_21",1);
		setControlForeColor(panel_name, gCheckbox21, MakeRGB(0,240,0));
	}
	else
	{
		EnableControl(panel_name, "panel_P_ASG_15_1_0_21",0);
		EnableControl(panel_name,"errfield_P_ASG_15_1_0_21",0);
		setControlForeColor(panel_name, gCheckbox21, MakeRGB(250,0,0));
	}
	if(getValue(P_ASG_15_1_0_22_FctLstItemEn))
	{
		EnableControl(panel_name, "panel_P_ASG_15_1_0_22",1);
		EnableControl(panel_name,"errfield_P_ASG_15_1_0_22",1);
		setControlForeColor(panel_name, gCheckbox22, MakeRGB(0,240,0));
	}
	else
	{
		EnableControl(panel_name, "panel_P_ASG_15_1_0_22",0);
		EnableControl(panel_name,"errfield_P_ASG_15_1_0_22",0);
		setControlForeColor(panel_name, gCheckbox22, MakeRGB(250,0,0));
	}
	if(getValue(P_ASG_15_1_0_23_FctLstItemEn))
	{
		EnableControl(panel_name, "panel_P_ASG_15_1_0_23",1);
		EnableControl(panel_name,"errfield_P_ASG_15_1_0_23",1);
		setControlForeColor(panel_name, gCheckbox23, MakeRGB(0,240,0));
	}
	else
	{
		EnableControl(panel_name, "panel_P_ASG_15_1_0_23",0);
		EnableControl(panel_name,"errfield_P_ASG_15_1_0_23",0);
		setControlForeColor(panel_name, gCheckbox23, MakeRGB(250,0,0));
	}
	if(getValue(P_ASG_15_1_0_24_FctLstItemEn))
	{
		EnableControl(panel_name, "panel_P_ASG_15_1_0_24",1);
		EnableControl(panel_name,"errfield_P_ASG_15_1_0_24",1);
		setControlForeColor(panel_name, gCheckbox24, MakeRGB(0,240,0));
	}
	else
	{
		EnableControl(panel_name, "panel_P_ASG_15_1_0_24",0);
		EnableControl(panel_name,"errfield_P_ASG_15_1_0_24",0);
		setControlForeColor(panel_name, gCheckbox24, MakeRGB(250,0,0));
	}
	if(getValue(P_ASG_15_1_0_25_FctLstItemEn))
	{
		EnableControl(panel_name, "panel_P_ASG_15_1_0_25",1);
		EnableControl(panel_name,"errfield_P_ASG_15_1_0_25",1);
		setControlForeColor(panel_name, gCheckbox25, MakeRGB(0,240,0));
	}
	else
	{
		EnableControl(panel_name, "panel_P_ASG_15_1_0_25",0);
		EnableControl(panel_name,"errfield_P_ASG_15_1_0_25",0);
		setControlForeColor(panel_name, gCheckbox25, MakeRGB(250,0,0));
	}
	if(getValue(P_ASG_15_1_0_26_FctLstItemEn))
	{
		EnableControl(panel_name, "panel_P_ASG_15_1_0_26",1);
		EnableControl(panel_name,"errfield_P_ASG_15_1_0_26",1);
		setControlForeColor(panel_name, gCheckbox26, MakeRGB(0,240,0));
	}
	else
	{
		EnableControl(panel_name, "panel_P_ASG_15_1_0_26",0);
		EnableControl(panel_name,"errfield_P_ASG_15_1_0_26",0);
		setControlForeColor(panel_name, gCheckbox26, MakeRGB(250,0,0));
	}
	if(getValue(P_ASG_15_1_0_27_FctLstItemEn))
	{
		EnableControl(panel_name, "panel_P_ASG_15_1_0_27",1);
		EnableControl(panel_name,"errfield_P_ASG_15_1_0_27",1);
		setControlForeColor(panel_name, gCheckbox27, MakeRGB(0,240,0));
	}
	else
	{
		EnableControl(panel_name, "panel_P_ASG_15_1_0_27",0);
		EnableControl(panel_name,"errfield_P_ASG_15_1_0_27",0);
		setControlForeColor(panel_name, gCheckbox27, MakeRGB(250,0,0));
	}
	if(getValue(P_ASG_15_1_0_28_FctLstItemEn))
	{
		EnableControl(panel_name, "panel_P_ASG_15_1_0_28",1);
		EnableControl(panel_name,"errfield_P_ASG_15_1_0_28",1);
		setControlForeColor(panel_name, gCheckbox28, MakeRGB(0,240,0));
	}
	else
	{
		EnableControl(panel_name, "panel_P_ASG_15_1_0_28",0);
		EnableControl(panel_name,"errfield_P_ASG_15_1_0_28",0);
		setControlForeColor(panel_name, gCheckbox28, MakeRGB(250,0,0));
	}
	if(getValue(P_ASG_15_1_0_29_FctLstItemEn))
	{
		EnableControl(panel_name, "panel_P_ASG_15_1_0_29",1);
		EnableControl(panel_name,"errfield_P_ASG_15_1_0_29",1);
		setControlForeColor(panel_name, gCheckbox29, MakeRGB(0,240,0));
	}
	else
	{
		EnableControl(panel_name, "panel_P_ASG_15_1_0_29",0);
		EnableControl(panel_name,"errfield_P_ASG_15_1_0_29",0);
		setControlForeColor(panel_name, gCheckbox29, MakeRGB(250,0,0));
	}
	if(getValue(P_ASG_15_1_0_30_FctLstItemEn))
	{
		EnableControl(panel_name, "panel_P_ASG_15_1_0_30",1);
		EnableControl(panel_name,"errfield_P_ASG_15_1_0_30",1);
		setControlForeColor(panel_name, gCheckbox30, MakeRGB(0,240,0));
	}
	else
	{
		EnableControl(panel_name, "panel_P_ASG_15_1_0_30",0);
		EnableControl(panel_name,"errfield_P_ASG_15_1_0_30",0);
		setControlForeColor(panel_name, gCheckbox30, MakeRGB(250,0,0));
	}
	if(getValue(A_ASG_15_1_0_31_FctLstItemEn))
	{
		EnableControl(panel_name, "panel_A_ASG_15_1_0_31",1);
		EnableControl(panel_name,"errfield_A_ASG_15_1_0_31",1);
		EnableControl(panel_name,"panel_A_ASG_15_1_0_31_Changed",1);
		EnableControl(panel_name,"panel_A_ASG_15_1_0_31_SetGet",1);
		setControlForeColor(panel_name, gCheckbox31, MakeRGB(0,240,0));
	}
	else
	{
		EnableControl(panel_name, "panel_A_ASG_15_1_0_31",0);
		EnableControl(panel_name,"errfield_A_ASG_15_1_0_31",0);
		EnableControl(panel_name,"panel_A_ASG_15_1_0_31_Changed",0);
		EnableControl(panel_name,"panel_A_ASG_15_1_0_31_SetGet",0);
		setControlForeColor(panel_name, gCheckbox31, MakeRGB(250,0,0));
	}
	if(getValue(P_ASG_15_1_0_32_FctLstItemEn))
	{
		EnableControl(panel_name, "panel_P_ASG_15_1_0_32",1);
		EnableControl(panel_name,"errfield_P_ASG_15_1_0_32",1);
		setControlForeColor(panel_name, gCheckbox32, MakeRGB(0,240,0));
	}
	else
	{
		EnableControl(panel_name, "panel_P_ASG_15_1_0_32",0);
		EnableControl(panel_name,"errfield_P_ASG_15_1_0_32",0);
		setControlForeColor(panel_name, gCheckbox32, MakeRGB(250,0,0));
	}
	if(getValue(P_ASG_15_1_0_33_FctLstItemEn))
	{
		EnableControl(panel_name, "panel_P_ASG_15_1_0_33",1);
		EnableControl(panel_name,"errfield_P_ASG_15_1_0_33",1);
		setControlForeColor(panel_name, gCheckbox33, MakeRGB(0,240,0));
	}
	else
	{
		EnableControl(panel_name, "panel_P_ASG_15_1_0_33",0);
		EnableControl(panel_name,"errfield_P_ASG_15_1_0_33",0);
		setControlForeColor(panel_name, gCheckbox33, MakeRGB(250,0,0));
	}
	if(getValue(P_ASG_15_1_0_34_FctLstItemEn))
	{
		EnableControl(panel_name, "panel_P_ASG_15_1_0_34",1);
		EnableControl(panel_name,"errfield_P_ASG_15_1_0_34",1);
		setControlForeColor(panel_name, gCheckbox34, MakeRGB(0,240,0));
	}
	else
	{
		EnableControl(panel_name, "panel_P_ASG_15_1_0_34",0);
		EnableControl(panel_name,"errfield_P_ASG_15_1_0_34",0);
		setControlForeColor(panel_name, gCheckbox34, MakeRGB(250,0,0));
	}
	if(getValue(P_ASG_15_1_0_35_FctLstItemEn))
	{
		EnableControl(panel_name, "panel_P_ASG_15_1_0_35",1);
		EnableControl(panel_name,"errfield_P_ASG_15_1_0_35",1);
		setControlForeColor(panel_name, gCheckbox35, MakeRGB(0,240,0));
	}
	else
	{
		EnableControl(panel_name, "panel_P_ASG_15_1_0_35",0);
		EnableControl(panel_name,"errfield_P_ASG_15_1_0_35",0);
		setControlForeColor(panel_name, gCheckbox35, MakeRGB(250,0,0));
	}
	if(getValue(A_ASG_15_1_0_36_FctLstItemEn))
	{
		EnableControl(panel_name, "panel_A_ASG_15_1_0_36",1);
		EnableControl(panel_name,"errfield_A_ASG_15_1_0_36",1);
		EnableControl(panel_name,"panel_A_ASG_15_1_0_36_Changed",1);
		EnableControl(panel_name,"panel_A_ASG_15_1_0_36_SetGet",1);
		setControlForeColor(panel_name, gCheckbox36, MakeRGB(0,240,0));
	}
	else
	{
		EnableControl(panel_name, "panel_A_ASG_15_1_0_36",0);
		EnableControl(panel_name,"errfield_A_ASG_15_1_0_36",0);
		EnableControl(panel_name,"panel_A_ASG_15_1_0_36_Changed",0);
		EnableControl(panel_name,"panel_A_ASG_15_1_0_36_SetGet",0);
		setControlForeColor(panel_name, gCheckbox36, MakeRGB(250,0,0));
	}
	if(getValue(P_ASG_15_1_0_37_FctLstItemEn))
	{
		EnableControl(panel_name, "panel_P_ASG_15_1_0_37",1);
		EnableControl(panel_name,"errfield_P_ASG_15_1_0_37",1);
		setControlForeColor(panel_name, gCheckbox37, MakeRGB(0,240,0));
	}
	else
	{
		EnableControl(panel_name, "panel_P_ASG_15_1_0_37",0);
		EnableControl(panel_name,"errfield_P_ASG_15_1_0_37",0);
		setControlForeColor(panel_name, gCheckbox37, MakeRGB(250,0,0));
	}

}

DisableReservedFld ()
{
  	EnableControl(panel_name,"P_ASG_15_1_0_16_5_reserved",0);
	EnableControl(panel_name,"P_ASG_15_1_0_16_6_reserved",0);

}

resetErrfieldColor()
{
  	setControlBackColor(panel_name, "errfield_C_ASG_15_1_0_1", MakeRGB(255,255,255));
	setControlBackColor(panel_name, "errfield_P_ASG_15_1_0_2", MakeRGB(255,255,255));
	setControlBackColor(panel_name, "errfield_P_ASG_15_1_0_3", MakeRGB(255,255,255));
	setControlBackColor(panel_name, "errfield_P_ASG_15_1_0_4", MakeRGB(255,255,255));
	setControlBackColor(panel_name, "errfield_P_ASG_15_1_0_13", MakeRGB(255,255,255));
	setControlBackColor(panel_name, "errfield_P_ASG_15_1_0_14", MakeRGB(255,255,255));
	setControlBackColor(panel_name, "errfield_P_ASG_15_1_0_15", MakeRGB(255,255,255));
	setControlBackColor(panel_name, "errfield_P_ASG_15_1_0_16", MakeRGB(255,255,255));
	setControlBackColor(panel_name, "errfield_M_ASG_15_1_0_17", MakeRGB(255,255,255));
	setControlBackColor(panel_name, "errfield_P_ASG_15_1_0_18", MakeRGB(255,255,255));
	setControlBackColor(panel_name, "errfield_P_ASG_15_1_0_19", MakeRGB(255,255,255));
	setControlBackColor(panel_name, "errfield_P_ASG_15_1_0_20", MakeRGB(255,255,255));
	setControlBackColor(panel_name, "errfield_P_ASG_15_1_0_21", MakeRGB(255,255,255));
	setControlBackColor(panel_name, "errfield_P_ASG_15_1_0_22", MakeRGB(255,255,255));
	setControlBackColor(panel_name, "errfield_P_ASG_15_1_0_23", MakeRGB(255,255,255));
	setControlBackColor(panel_name, "errfield_P_ASG_15_1_0_24", MakeRGB(255,255,255));
	setControlBackColor(panel_name, "errfield_P_ASG_15_1_0_25", MakeRGB(255,255,255));
	setControlBackColor(panel_name, "errfield_P_ASG_15_1_0_26", MakeRGB(255,255,255));
	setControlBackColor(panel_name, "errfield_P_ASG_15_1_0_27", MakeRGB(255,255,255));
	setControlBackColor(panel_name, "errfield_P_ASG_15_1_0_28", MakeRGB(255,255,255));
	setControlBackColor(panel_name, "errfield_P_ASG_15_1_0_29", MakeRGB(255,255,255));
	setControlBackColor(panel_name, "errfield_P_ASG_15_1_0_30", MakeRGB(255,255,255));
	setControlBackColor(panel_name, "errfield_A_ASG_15_1_0_31", MakeRGB(255,255,255));
	setControlBackColor(panel_name, "errfield_P_ASG_15_1_0_32", MakeRGB(255,255,255));
	setControlBackColor(panel_name, "errfield_P_ASG_15_1_0_33", MakeRGB(255,255,255));
	setControlBackColor(panel_name, "errfield_P_ASG_15_1_0_34", MakeRGB(255,255,255));
	setControlBackColor(panel_name, "errfield_P_ASG_15_1_0_35", MakeRGB(255,255,255));
	setControlBackColor(panel_name, "errfield_A_ASG_15_1_0_36", MakeRGB(255,255,255));
	setControlBackColor(panel_name, "errfield_P_ASG_15_1_0_37", MakeRGB(255,255,255));

}

CANoe_Shutdown ()
{
	// Timer 
	canceltimer(TaskTimer);		//cancel real CAN-communication timer

	// Ruecksetzen der Hintergrundfarbe der Error-Felder
	resetErrfieldColor();
	// Deaktivierung aller Panel Elemente 
	DisableFctCtrl();
	EnableControl(panel_name, bapconfig_panel_name, 0); 
	EnableConfigCtrl();

}

on timer TaskTimer
{

	/*** Aufruf des BAP Task in DLL fuer NODE_INDEX ***/
	BAP150_Task(NODE_INDEX);	

	/*** Pollen ueber die anstehenden Indications (Lesen aus DLL, Auslesen eines Puffers der DLL) ***/
	BAP_DLL_Indication();	
	
	/*** Pollen ueber die anstehenden Requests (Schreiben in DLL, dort werden evt. Sendeauftraege gesetzt) ***/
	BAP_DLL_Request();
	
	/*** Abarbeiten der ausstehenden Sendeauftraege innerhalb der BAP DLL und Versenden ueber CANoe ***/
	BAP_CAN_TX_Request();
  
  BAP_DLL_SetRxData();

	/*** Retriggern des Timers mit 10 ms ***/
	setTimer(TaskTimer, TaskTime); // @TODO bei anderer Taskzeit muss hier modifiziert werden
}


BAP_DLL_SetRxData()
{
}

BAP_DLL_Indication()	//function to get received BAP-data from DLL (at BAL-interface)
{
	int i, length, datalength, temp;
	byte Indication_data[BAP_buffer_size];		// indication data from DLL
	dword Indication_header[6];					// indication header from DLL
	byte BAP_data_type;

	//init local variables
	length=0;
	datalength=0;
	temp=0;
	BAP_data_type=0;

	for(i=0;i<6;i++)
		Indication_header[i]=0;

	for(i=0;i<BAP_buffer_size;i++)
		Indication_data[i]=0;

	// BAP-Stack needs this information for successful BAP150_GetIndication 
	Indication_header[4]=BAP_buffer_size;

	while (BAP150_GetInd(NODE_INDEX, Indication_header, Indication_data) == 0)
	{		
		//read header and write in global variable
		for (i = 0; i < 6; i++) {
			gBAP_Indication_header[i]=Indication_header[i];	
		}

		// nur Bytesequneces haben Datenanteil
		if (gBAP_Indication_header[3] == Bap_byteSequence)
		{
			for (i = 0; i < BAP_buffer_size; i++) {
				gBAP_Indication_data[i]=Indication_data[i];	
			}
		}	
		// Verarbeiten der Indication
		Process_Current_Indication();

		// Vorbereiten fuer naechsten Durchlauf 
		Indication_header[4]=BAP_buffer_size;
	} 
}

ChangeConfig(long paramIndex,long config[])
{

        byte temp ;
        temp = BAP150_ChangeConfig(NODE_INDEX, paramIndex, config);
        if(temp == 0)
            writelineEx(gBAP_Trace, 0, "BAP150_ChangeConfig for %s succesful (LSG %d, NODE_INDEX %d)", NODE_NAME, LSGID, NODE_INDEX);
        else
            writelineEx(gError_Trace, 0, "BAP150_ChangeConfig error 0x%X for %s (LSG %d, NODE_INDEX %d)", temp, NODE_NAME, LSGID, NODE_INDEX);        
}

PrintIndicationError(char reason[])
{
	writelineEx(gError_Trace, 0, "%s - %s lsgId:%d fctid:%d indType:%s dataType:%s",
		reason, SGtype, gBAP_Indication_header[0], gBAP_Indication_header[1], Indicationtype_Text[gBAP_Indication_header[2]], Datatype_Text[gBAP_Indication_header[3]]);
}

BapOnOff(byte _on)
{
  int length, temp;
  char Path[255];
  
  /***** Einschalten ******/
  if(_on==1){
    
    if(@BusType_ASG15_1 == 0){  // Uses CAN
      getAbsFilePath(dbcan_path, Path, 255);
      if(BAP180_LoadDB(NODE_INDEX,1, 0, Path) != 0){
        writelineEx(gError_Trace, 0, "Fehler beim Laden: %s !", Path);
      }
    }
    
    /**** Laden des BAP XML Files ****/
    getAbsFilePath(xml_path, Path, 255);
    writelineEx(gBAP_Trace, 0, "Load BAP-XML-File: %s", Path);
    if (BAP150_LoadConfig(NODE_INDEX, Path) != 0) {
        writelineEx(gError_Trace, 0, "Fehler beim Laden: %s !", Path);
    }

    if (BAP150_AddCanMap(NODE_INDEX, 1, 1) != 0) {
        writelineEx(gError_Trace, 0, "Fehler beim Mappen!");
    }
  
    // soll der BAP Stack wieder initlialisiert werden?                                 
    if(gBAP_Init==0){
        //gBAP_Init=1;
        temp=BAP150_Init(NODE_INDEX, LSGID);
        if(temp==0)
            writelineEx(gBAP_Trace, 0, "BAP_Init for %s succesful (LSG %d, NODE_INDEX %d)", NODE_NAME, LSGID, NODE_INDEX);
        else
            writelineEx(gError_Trace, 0, "BAP_Init error 0x%X for %s (LSG %d, NODE_INDEX %d)", temp, NODE_NAME, LSGID, NODE_INDEX);         
    }

    // Initialisierung aller Variablen
    Initialize_Variables();                     

    // Aktivierung aller Panelelemente
    //EnableFctCtrl();
    initInvalidFields();
    EnableControl(panel_name, common_panel_name, 1);
    EnableControl(panel_name, bapconfig_panel_name, 1); 
    DisableReservedFld();
    
    
    //BAP-Shutdown
    temp = BAP150_Shutdown(NODE_INDEX, LSGID);
    if(temp==0)
        writelineEx(gBAP_Trace, 0, "BAP_Shutdown for %s succesful (LSG %d, NODE_INDEX %d)", NODE_NAME, LSGID, NODE_INDEX);
    else
        writelineEx(gError_Trace, 0, "BAP_Shutdown error 0x%X for %s (LSG %d, NODE_INDEX %d)", temp, NODE_NAME, LSGID, NODE_INDEX); 

    //BAP-Start
    temp = BAP150_Start(NODE_INDEX, LSGID);             
    if(temp == 0)
        writelineEx(gBAP_Trace, 0, "BAP_Start for %s succesful (LSG %d, NODE_INDEX %d)", NODE_NAME, LSGID, NODE_INDEX);
    else
        writelineEx(gError_Trace, 0, "BAP_Start error 0x%X for %s (LSG %d, NODE_INDEX %d)", temp, NODE_NAME, LSGID, NODE_INDEX);        

    // setze den Timer fuer den zyklischen Aufruf des CANoe-"Tasks"
    setTimer(TaskTimer, 10);                
// ETHERNET AND FLEXRAY NOT ENABLED!
    //  BAPFsg_ProcessDebug(NODE_INDEX,DEBUG_CAN_CHANNEL, DEBUG_ID, LSGID, DEBUG_SWITCH_ON);    
  }
  else{ /***** Ausschalten ****/
      
      BAP150_Shutdown(NODE_INDEX,LSGID);
      
      CANoe_Shutdown();
      
      // ETHERNET NOT ENABLED! (CALL_FCT_CLOSE_UPD_SOCKET_TOKEN)
  }
}

Initialize_Variables()	//initialize/reset all global variables
{
	int i;
	byte  Init_data[BAP_buffer_size];	// InitSend data for DLL

	/**** Request Buffer Geschichten initialisieren ****/
	for (i = 0; i < Requestbuffer_lines; i++)
	{
		gBAP_Requestbuffer_status[i] = 0;
	}
	for (i = 0; i < BAP_buffer_size; i++)
	{
		Init_data[i] = 0;
	}
	
	/* Wert im Eingabefeld initialisieren*/
	putValue(P_ASG_15_1_0_13, 0);
	getValue(P_ASG_15_1_0_16,Init_data);
	putValue(P_ASG_15_1_0_16,Init_data, 9);
	getValue(P_ASG_15_1_0_18,Init_data);
	putValue(P_ASG_15_1_0_18,Init_data, 5);
	getValue(P_ASG_15_1_0_37,Init_data);
	putValue(P_ASG_15_1_0_37,Init_data, 5);
	/* Farbe setzen*/
	putValue(C_ASG_15_1_0_1_State,"");
	setControlBackColor(panel_name, "errfield_C_ASG_15_1_0_1_State", MakeRGB(255,255,255));

}

initInvalidFields()	//initialize/reset all global variables
{
	    setControlBackColor(panel_name, "panel1_edit", MakeRGB(220,220,220));
    setControlBackColor(panel_name, "panel_P_ASG_15_1_0_4", MakeRGB(220,220,220));
    setControlBackColor(panel_name, "panel_P_ASG_15_1_0_13", MakeRGB(220,220,220));
    setControlBackColor(panel_name, "panel_P_ASG_15_1_0_14", MakeRGB(220,220,220));
    setControlBackColor(panel_name, "panel_P_ASG_15_1_0_15", MakeRGB(220,220,220));
    setControlBackColor(panel_name, "panel_P_ASG_15_1_0_16", MakeRGB(220,220,220));
    setControlBackColor(panel_name, "panel_M_ASG_15_1_0_17_Result",MakeRGB(220,220,220));
    setControlBackColor(panel_name, "panel_M_ASG_15_1_0_17_Processing",MakeRGB(220,220,220));
    setControlBackColor(panel_name, "panel_P_ASG_15_1_0_18", MakeRGB(220,220,220));
    setControlBackColor(panel_name, "panel_P_ASG_15_1_0_19", MakeRGB(220,220,220));
    setControlBackColor(panel_name, "panel_P_ASG_15_1_0_20", MakeRGB(220,220,220));
    setControlBackColor(panel_name, "panel_P_ASG_15_1_0_21", MakeRGB(220,220,220));
    setControlBackColor(panel_name, "panel_P_ASG_15_1_0_22", MakeRGB(220,220,220));
    setControlBackColor(panel_name, "panel_P_ASG_15_1_0_23", MakeRGB(220,220,220));
    setControlBackColor(panel_name, "panel_P_ASG_15_1_0_24", MakeRGB(220,220,220));
    setControlBackColor(panel_name, "panel_P_ASG_15_1_0_25", MakeRGB(220,220,220));
    setControlBackColor(panel_name, "panel_P_ASG_15_1_0_26", MakeRGB(220,220,220));
    setControlBackColor(panel_name, "panel_P_ASG_15_1_0_27", MakeRGB(220,220,220));
    setControlBackColor(panel_name, "panel_P_ASG_15_1_0_28", MakeRGB(220,220,220));
    setControlBackColor(panel_name, "panel_P_ASG_15_1_0_29", MakeRGB(220,220,220));
    setControlBackColor(panel_name, "panel_P_ASG_15_1_0_30", MakeRGB(220,220,220));
    setControlBackColor(panel_name, "panel_A_ASG_15_1_0_31", MakeRGB(220,220,220));
    setControlBackColor(panel_name, "panel_A_ASG_15_1_0_31_Changed",MakeRGB(220,220,220));
    setControlBackColor(panel_name, "panel_P_ASG_15_1_0_32", MakeRGB(220,220,220));
    setControlBackColor(panel_name, "panel_P_ASG_15_1_0_33", MakeRGB(220,220,220));
    setControlBackColor(panel_name, "panel_P_ASG_15_1_0_34", MakeRGB(220,220,220));
    setControlBackColor(panel_name, "panel_P_ASG_15_1_0_35", MakeRGB(220,220,220));
    setControlBackColor(panel_name, "panel_A_ASG_15_1_0_36", MakeRGB(220,220,220));
    setControlBackColor(panel_name, "panel_A_ASG_15_1_0_36_Changed",MakeRGB(220,220,220));
    setControlBackColor(panel_name, "panel_P_ASG_15_1_0_37", MakeRGB(220,220,220));

}

on start
{
	// noch nicht eingeschaltet
	gSG_PowerOnOff=0;
	// noch nicht initialisiert
	gBAP_Init=0;
	// open the panel, nur fuer CANoe-Version >= 5.1 erlaubt
	//openPanel(panel_name);
	// deaktiviere alle aktiven Panel Elemente, ausser AN/AUSS
    CANoe_Shutdown();
    // ungueltige Felder initialisieren
    initInvalidFields();    
    
// ETHERNET AND FLEXRAY NOT ENABLED!
}

BAP_CAN_TX_Request()	//Function to send BAP-data over CAN
{
   int i;
   byte DestIp[16];
   byte TX_Data[1500];				// CAN-data
   byte TX_Data_FR[10];    		// FlexRay-Data
   dword TX_Header[13];			// Header
   message 0x100 TX_Message;	// dummy-message, Adresse wird noch modifiziert
   
   byte send_result;
   
   // ONLY CAN IS ENABLED! 
      TX_Header[0] = 1; /*BusType: 1=Can, 2=Lin, 3=Flexray, 4=Ethernet*/
   		TX_Header[2] = 8; // max-Length of TX_Data

		// Pollen ueber die Queue, die von der DLL zur Verfuegung gestellt wird
		// Diese Daten muessen ueber den CAN Bus gesendet werden
	   	while (BAP180_GetTxData(NODE_INDEX,TX_Header,TX_Data) == 0) {	
        TX_Message.CAN = TX_Header[1]; 		//CAN channel
        TX_Message.ID = TX_Header[3]; 	  //Can ID
        TX_Message.DataLength = TX_Header[2]; 		// received length
			
			  for (i=0; i<TX_Message.DataLength; i++) {	//CAN data-bytes
		  		TX_Message.byte(i) = TX_Data[i];
		  	}
		  	
        TX_Message.EDL = 0;
        TX_Message.BRS = 0;
        if(TX_Header[4] & 2) 
          TX_Message.EDL = 1;
        if(TX_Header[4] & 4) 
          TX_Message.BRS = 1;
        
		  	output(TX_Message);					//send CAN message
		  	
		  	//Versions Output
		  	if(TX_Data[0] == 0x40 && TX_Data[1] == 0x00 && TX_Header[2] == 4)
		  	{
		    	writelineEx(gBAP_Trace, 0,"Major Version: %i, Minor Version: %i", TX_Data[2], TX_Data[3]);
		  	}       
		  	TX_Header[2] = 8; // max-Length of TX_Data
	   	} 
   // ONLY CAN IS ENABLED!
   // FLEXRAY NOT ENABLED! (TX_FR_TOKEN)
   // ETHERNET NOT ENABLED! (TX_IP_TOKEN)
}

ringbuffer_write (byte lsgID, byte fctID, byte request, byte dataType, word length, dword singleData, byte data[])
{
	int bufferline, i;

	bufferline = getNextWriteIndex();	//get next free position in ring-buffer

	if (bufferline == -1) 
	{
		writelineEx(gError_Trace, 0, "Crititcal Error: No free buffer found!");
		return;
	}
		
	gBAP_Request_header[bufferline][0] = lsgID;	// LSG
	gBAP_Request_header[bufferline][1] = fctID;	// FCT
	gBAP_Request_header[bufferline][3] = dataType; // dataType

    //writelineEx(gBAP_Trace, 0, "Write request in buffer ASG NODEINDEX:%d lsgid:%d fctid:%d requesttype:%d datatype:%d length:%d", 
    //        NODE_INDEX,lsgID,fctID,request,dataType,length);
	switch (dataType)
	{
		case Bap_void:
			gBAP_Request_header[bufferline][2] = request;	// request
			gBAP_Request_header[bufferline][4] = 0;	// length
				// Void
			// @TODO?		
			break;
		case Bap_uint8:
			gBAP_Request_header[bufferline][2] = request;		// request
			gBAP_Request_header[bufferline][5] = singleData;	// Daten		
			break;
		case Bap_uint16:
			gBAP_Request_header[bufferline][2] = request;		// request
			gBAP_Request_header[bufferline][5] = singleData;	// Daten
			break;			
		case Bap_uint32:
			gBAP_Request_header[bufferline][2] = request;		// request
			gBAP_Request_header[bufferline][5] = singleData;	// Daten		
			break;	
		case Bap_byteSequence:
			gBAP_Request_header[bufferline][2] = request;	// request
			gBAP_Request_header[bufferline][4] = length;	// length
			// Daten der ByteSequence kopieren
			for(i = 0; i < BAP_buffer_size; i++)									
				gBAP_Request_data[bufferline][i] = data[i];
		case Bap_error:
			gBAP_Request_header[bufferline][5] = singleData;	// Errorcode						
			break;
		default:
			break;
	}

			

}

float round (float value, float step)
{
	return _floor(value / step + 0.5) * step;
}

Request_Void (byte lsgID, byte fctID, byte request)
{
	int i;
	byte dataArray [BAP_buffer_size];

	// Initialisieren eines Arrays
	for(i=0;i<BAP_buffer_size;i++) dataArray [i]=0;

	ringbuffer_write (lsgID, fctID, request, Bap_void, 0, 0, dataArray);	
}

Request_Int8 (byte lsgID, byte fctID, byte request, dword data)
{
	int i;
	byte dataArray [BAP_buffer_size];

	// Initialisieren eines Arrays
	for(i=0;i<BAP_buffer_size;i++) dataArray [i]=0;

	ringbuffer_write (lsgID, fctID, request, Bap_uint8, 0, data, dataArray);

}

Request_Int16 (byte lsgID, byte fctID, byte request, dword data)
{
	int i;
	byte dataArray [BAP_buffer_size];

	// Initialisieren eines Arrays
	for(i=0;i<BAP_buffer_size;i++) dataArray [i]=0;

	ringbuffer_write (lsgID, fctID, request, Bap_uint16, 0, data, dataArray);

}

Request_Int32 (byte lsgID, byte fctID, byte request, dword data)
{
	int i;
	byte dataArray [BAP_buffer_size];

	// Initialisieren eines Arrays
	for(i=0;i<BAP_buffer_size;i++) dataArray [i]=0;

	ringbuffer_write (lsgID, fctID, request, Bap_uint32, 0, data, dataArray);
}

Request_ByteSequence (byte lsgID, byte fctID, byte request, byte data[], word length)
{
	int i;
	byte dataArray [BAP_buffer_size];

	// Initialisieren eines Arrays
	for(i=0;i<BAP_buffer_size;i++) dataArray [i]=0;

	// Fuellen des Arrays
	for(i=0;i<length;i++) dataArray [i]=data[i];

	ringbuffer_write (lsgID, fctID, request, Bap_byteSequence, length, 0, dataArray);
}

Request_Error (byte lsgID, byte fctID, byte errorCode)
{
	int i;
	byte dataArray [BAP_buffer_size];

	// Initialisieren eines Arrays
	for(i=0;i<BAP_buffer_size;i++) dataArray [i]=0;

	ringbuffer_write (lsgID, fctID, 0, Bap_error, 0, errorCode, dataArray);
}

DisplayRequestErrorCode(dword fctID, dword errCode)
{
       switch(fctID)
   {
       case C_ASG_15_1_0_1_ID:
           gC_ASG_15_1_0_1_ErrCode = 0;
           putValue(C_ASG_15_1_0_1_ErrCode,  errCode);
           setControlBackColor(panel_name,"errfield_C_ASG_15_1_0_1", MakeRGB(255,79,79));
       break;
       case P_ASG_15_1_0_2_ID:
           gP_ASG_15_1_0_2_ErrCode = 0;
           putValue(P_ASG_15_1_0_2_ErrCode,  errCode);
           setControlBackColor(panel_name,"errfield_P_ASG_15_1_0_2", MakeRGB(255,79,79));
       break;
       case P_ASG_15_1_0_3_ID:
           gP_ASG_15_1_0_3_ErrCode = 0;
           putValue(P_ASG_15_1_0_3_ErrCode,  errCode);
           setControlBackColor(panel_name,"errfield_P_ASG_15_1_0_3", MakeRGB(255,79,79));
       break;
       case P_ASG_15_1_0_4_ID:
           gP_ASG_15_1_0_4_ErrCode = 0;
           putValue(P_ASG_15_1_0_4_ErrCode,  errCode);
           setControlBackColor(panel_name,"errfield_P_ASG_15_1_0_4", MakeRGB(255,79,79));
       break;
       case P_ASG_15_1_0_13_ID:
           gP_ASG_15_1_0_13_ErrCode = 0;
           putValue(P_ASG_15_1_0_13_ErrCode,  errCode);
           setControlBackColor(panel_name,"errfield_P_ASG_15_1_0_13", MakeRGB(255,79,79));
       break;
       case P_ASG_15_1_0_14_ID:
           gP_ASG_15_1_0_14_ErrCode = 0;
           putValue(P_ASG_15_1_0_14_ErrCode,  errCode);
           setControlBackColor(panel_name,"errfield_P_ASG_15_1_0_14", MakeRGB(255,79,79));
       break;
       case P_ASG_15_1_0_15_ID:
           gP_ASG_15_1_0_15_ErrCode = 0;
           putValue(P_ASG_15_1_0_15_ErrCode,  errCode);
           setControlBackColor(panel_name,"errfield_P_ASG_15_1_0_15", MakeRGB(255,79,79));
       break;
       case P_ASG_15_1_0_16_ID:
           gP_ASG_15_1_0_16_ErrCode = 0;
           putValue(P_ASG_15_1_0_16_ErrCode,  errCode);
           setControlBackColor(panel_name,"errfield_P_ASG_15_1_0_16", MakeRGB(255,79,79));
       break;
       case M_ASG_15_1_0_17_ID:
           gM_ASG_15_1_0_17_ErrCode = 0;
           putValue(M_ASG_15_1_0_17_ErrCode,  errCode);
           setControlBackColor(panel_name,"errfield_M_ASG_15_1_0_17", MakeRGB(255,79,79));
           putValue(M_ASG_15_1_0_17_State,  "ReqErr");
       break;
       case P_ASG_15_1_0_18_ID:
           gP_ASG_15_1_0_18_ErrCode = 0;
           putValue(P_ASG_15_1_0_18_ErrCode,  errCode);
           setControlBackColor(panel_name,"errfield_P_ASG_15_1_0_18", MakeRGB(255,79,79));
       break;
       case P_ASG_15_1_0_19_ID:
           gP_ASG_15_1_0_19_ErrCode = 0;
           putValue(P_ASG_15_1_0_19_ErrCode,  errCode);
           setControlBackColor(panel_name,"errfield_P_ASG_15_1_0_19", MakeRGB(255,79,79));
       break;
       case P_ASG_15_1_0_20_ID:
           gP_ASG_15_1_0_20_ErrCode = 0;
           putValue(P_ASG_15_1_0_20_ErrCode,  errCode);
           setControlBackColor(panel_name,"errfield_P_ASG_15_1_0_20", MakeRGB(255,79,79));
       break;
       case P_ASG_15_1_0_21_ID:
           gP_ASG_15_1_0_21_ErrCode = 0;
           putValue(P_ASG_15_1_0_21_ErrCode,  errCode);
           setControlBackColor(panel_name,"errfield_P_ASG_15_1_0_21", MakeRGB(255,79,79));
       break;
       case P_ASG_15_1_0_22_ID:
           gP_ASG_15_1_0_22_ErrCode = 0;
           putValue(P_ASG_15_1_0_22_ErrCode,  errCode);
           setControlBackColor(panel_name,"errfield_P_ASG_15_1_0_22", MakeRGB(255,79,79));
       break;
       case P_ASG_15_1_0_23_ID:
           gP_ASG_15_1_0_23_ErrCode = 0;
           putValue(P_ASG_15_1_0_23_ErrCode,  errCode);
           setControlBackColor(panel_name,"errfield_P_ASG_15_1_0_23", MakeRGB(255,79,79));
       break;
       case P_ASG_15_1_0_24_ID:
           gP_ASG_15_1_0_24_ErrCode = 0;
           putValue(P_ASG_15_1_0_24_ErrCode,  errCode);
           setControlBackColor(panel_name,"errfield_P_ASG_15_1_0_24", MakeRGB(255,79,79));
       break;
       case P_ASG_15_1_0_25_ID:
           gP_ASG_15_1_0_25_ErrCode = 0;
           putValue(P_ASG_15_1_0_25_ErrCode,  errCode);
           setControlBackColor(panel_name,"errfield_P_ASG_15_1_0_25", MakeRGB(255,79,79));
       break;
       case P_ASG_15_1_0_26_ID:
           gP_ASG_15_1_0_26_ErrCode = 0;
           putValue(P_ASG_15_1_0_26_ErrCode,  errCode);
           setControlBackColor(panel_name,"errfield_P_ASG_15_1_0_26", MakeRGB(255,79,79));
       break;
       case P_ASG_15_1_0_27_ID:
           gP_ASG_15_1_0_27_ErrCode = 0;
           putValue(P_ASG_15_1_0_27_ErrCode,  errCode);
           setControlBackColor(panel_name,"errfield_P_ASG_15_1_0_27", MakeRGB(255,79,79));
       break;
       case P_ASG_15_1_0_28_ID:
           gP_ASG_15_1_0_28_ErrCode = 0;
           putValue(P_ASG_15_1_0_28_ErrCode,  errCode);
           setControlBackColor(panel_name,"errfield_P_ASG_15_1_0_28", MakeRGB(255,79,79));
       break;
       case P_ASG_15_1_0_29_ID:
           gP_ASG_15_1_0_29_ErrCode = 0;
           putValue(P_ASG_15_1_0_29_ErrCode,  errCode);
           setControlBackColor(panel_name,"errfield_P_ASG_15_1_0_29", MakeRGB(255,79,79));
       break;
       case P_ASG_15_1_0_30_ID:
           gP_ASG_15_1_0_30_ErrCode = 0;
           putValue(P_ASG_15_1_0_30_ErrCode,  errCode);
           setControlBackColor(panel_name,"errfield_P_ASG_15_1_0_30", MakeRGB(255,79,79));
       break;
       case A_ASG_15_1_0_31_ID:
           gA_ASG_15_1_0_31_ErrCode = 0;
           putValue(A_ASG_15_1_0_31_ErrCode,  errCode);
           setControlBackColor(panel_name,"errfield_A_ASG_15_1_0_31", MakeRGB(255,79,79));
       break;
       case P_ASG_15_1_0_32_ID:
           gP_ASG_15_1_0_32_ErrCode = 0;
           putValue(P_ASG_15_1_0_32_ErrCode,  errCode);
           setControlBackColor(panel_name,"errfield_P_ASG_15_1_0_32", MakeRGB(255,79,79));
       break;
       case P_ASG_15_1_0_33_ID:
           gP_ASG_15_1_0_33_ErrCode = 0;
           putValue(P_ASG_15_1_0_33_ErrCode,  errCode);
           setControlBackColor(panel_name,"errfield_P_ASG_15_1_0_33", MakeRGB(255,79,79));
       break;
       case P_ASG_15_1_0_34_ID:
           gP_ASG_15_1_0_34_ErrCode = 0;
           putValue(P_ASG_15_1_0_34_ErrCode,  errCode);
           setControlBackColor(panel_name,"errfield_P_ASG_15_1_0_34", MakeRGB(255,79,79));
       break;
       case P_ASG_15_1_0_35_ID:
           gP_ASG_15_1_0_35_ErrCode = 0;
           putValue(P_ASG_15_1_0_35_ErrCode,  errCode);
           setControlBackColor(panel_name,"errfield_P_ASG_15_1_0_35", MakeRGB(255,79,79));
       break;
       case A_ASG_15_1_0_36_ID:
           gA_ASG_15_1_0_36_ErrCode = 0;
           putValue(A_ASG_15_1_0_36_ErrCode,  errCode);
           setControlBackColor(panel_name,"errfield_A_ASG_15_1_0_36", MakeRGB(255,79,79));
       break;
       case P_ASG_15_1_0_37_ID:
           gP_ASG_15_1_0_37_ErrCode = 0;
           putValue(P_ASG_15_1_0_37_ErrCode,  errCode);
           setControlBackColor(panel_name,"errfield_P_ASG_15_1_0_37", MakeRGB(255,79,79));
       break;
       default:
           writelineEx(gError_Trace, 0, "%s%d/%d Unknown Functionid in  displayErrorCode", SGtype, LSGID,fctID);
   }

}

BAP_DLL_Request ()
{
	int i;
    int l=0;
	byte temp;
	byte Request_data[4096];	//Request data for DLL
	dword Request_header[6];	//Request header for DLL
	byte dataValid;
	int nextElementToRead;
	
	// defaultmaessig ist senden OK
	dataValid = 1;

	// loeschen der Daten "Container"
	for(i=0;i<6;i++)
		Request_header[i]=0;
	for(i=0;i<BAP_buffer_size;i++)
		Request_data[i]=0;

    
	// Verarbeiten aller noch offenen Requests	
	while ((nextElementToRead = getNextReadIndex()) != -1) 
	{
		// Fuer alle Datentypen gleich
		Request_header[0]=gBAP_Request_header [nextElementToRead][0];		//LSG-ID
		Request_header[1]=gBAP_Request_header [nextElementToRead][1];		//Function-ID
		Request_header[2]=gBAP_Request_header [nextElementToRead][2];		//request type
		Request_header[3]=gBAP_Request_header [nextElementToRead][3];		//BAP data type

		switch(gBAP_Request_header[nextElementToRead][3]){
			case Bap_uint32:
                l=2;
            case Bap_uint16:
                l++;
            case Bap_uint8:
			case Bap_error: // Request (2) wird dabei ignoriert
                l++;
			case Bap_void:  // Datenfeld (5) wird dabei ignoriert
				Request_header[4]=l;												//	not used
				Request_header[5]=gBAP_Request_header [nextElementToRead][5];		// Daten
			break;
			case Bap_byteSequence:									
				Request_header[4]=gBAP_Request_header [nextElementToRead][4];		// length
				Request_header[5]=0;												// not used

				// data-array for BAP-DLL funcion 'BAP_Request'
				for(i=0;i<BAP_buffer_size;i++)
					Request_data[i]=gBAP_Request_data [nextElementToRead][i];
				break;			
			default:
				writelineEx(gError_Trace, 0, "BAP_DLL_Request: invalid BAP-Data-Type: %d", gBAP_Request_header[nextElementToRead][3]);
				dataValid = 0;
			break;			
		}
		
		if(dataValid){
            // wie heisst der Request?
            writelineEx(gBAP_Trace, 0, "%s%d/%d BAP_Request %s datatype:%s length:%d", SGtype, Request_header[0],Request_header[1],Requesttype_Text[Request_header[2]],Datatype_Text[Request_header[3]],Request_header[4]);
			temp = BAP150_Request(NODE_INDEX, Request_header, Request_data);	//send data to BAP-DLL	
			// BAP-Request failed
            if(temp != 0){
                // Fehlercode: Request failed
                writelineEx(gError_Trace, 0, "%s%d/%d Error during BAP_Request errorcode: 0x%X", SGtype, Request_header[0],Request_header[1],temp);
                DisplayRequestErrorCode(Request_header[1],temp);
            } 
		}

	}
} 

int getNextReadIndex ()
{
	int i, ret;
	// der Puffer wird nach dem naechsten zu lesenden Eintrag durchsucht
	// Existiert keiner wird -1 zurueckgegeben
	ret = -1;

	for (i = 0; i < Requestbuffer_lines; i++)
	{
		if (gBAP_Requestbuffer_status[i] == 1)
		{
			// zum verschicken
			ret = i;
			// und wieder freigeben
			gBAP_Requestbuffer_status[i] = 0;
			break;
		}
	}

	return (ret);
}

int getNextWriteIndex ()
{
	int i, ret;
	// der Puffer wird nach dem naechsten freien Eintrag durchsucht
	// Existiert keiner wird -1 zurueckgegeben
	ret = -1;

	for (i = 0; i < Requestbuffer_lines; i++)
	{
		if (gBAP_Requestbuffer_status[i] == 0)
		{
			// zum schreiben
			ret = i;
			// belegen
			gBAP_Requestbuffer_status[i] = 1;
			break;
		}
	}

	return (ret);
}

byte  isBitForFctSetted(word fctid, byte fctList[])
{
    byte byteNo ;
    byte bitno ;
    byte fctValue ;

    byteNo = fctid / 8;
    bitno = fctid % 8;

    fctValue = 0x80 >> bitno;

    return (fctList[byteNo] & fctValue)?1:0;
}

UpdateAllProperties()
{
	Request_Void(LSGID,P_ASG_15_1_0_2_ID,DataGet_REQ);
	Request_Void(LSGID,P_ASG_15_1_0_3_ID,DataGet_REQ);
	Request_Void(LSGID,P_ASG_15_1_0_4_ID,DataGet_REQ);
	Request_Void(LSGID,P_ASG_15_1_0_13_ID,DataGet_REQ);
	Request_Void(LSGID,P_ASG_15_1_0_14_ID,DataGet_REQ);
	Request_Void(LSGID,P_ASG_15_1_0_15_ID,DataGet_REQ);
	Request_Void(LSGID,P_ASG_15_1_0_16_ID,DataGet_REQ);
	Request_Void(LSGID,P_ASG_15_1_0_18_ID,DataGet_REQ);
	Request_Void(LSGID,P_ASG_15_1_0_19_ID,DataGet_REQ);
	Request_Void(LSGID,P_ASG_15_1_0_20_ID,DataGet_REQ);
	Request_Void(LSGID,P_ASG_15_1_0_21_ID,DataGet_REQ);
	Request_Void(LSGID,P_ASG_15_1_0_22_ID,DataGet_REQ);
	Request_Void(LSGID,P_ASG_15_1_0_23_ID,DataGet_REQ);
	Request_Void(LSGID,P_ASG_15_1_0_24_ID,DataGet_REQ);
	Request_Void(LSGID,P_ASG_15_1_0_25_ID,DataGet_REQ);
	Request_Void(LSGID,P_ASG_15_1_0_26_ID,DataGet_REQ);
	Request_Void(LSGID,P_ASG_15_1_0_27_ID,DataGet_REQ);
	Request_Void(LSGID,P_ASG_15_1_0_28_ID,DataGet_REQ);
	Request_Void(LSGID,P_ASG_15_1_0_29_ID,DataGet_REQ);
	Request_Void(LSGID,P_ASG_15_1_0_30_ID,DataGet_REQ);
	Request_Void(LSGID,P_ASG_15_1_0_32_ID,DataGet_REQ);
	Request_Void(LSGID,P_ASG_15_1_0_33_ID,DataGet_REQ);
	Request_Void(LSGID,P_ASG_15_1_0_34_ID,DataGet_REQ);
	Request_Void(LSGID,P_ASG_15_1_0_35_ID,DataGet_REQ);
	Request_Void(LSGID,P_ASG_15_1_0_37_ID,DataGet_REQ);

}

Process_Current_Indication ()
{
   int rxsize;
   int txsize;
   byte temp[BAP_buffer_size];
   char buffer[BAP_buffer_size];
   if(strncmp(Datatype_Text[gBAP_Indication_header[3]], "acknowledge", 4)!=0) 
       writelineEx(gBAP_Trace, 0, "NodeIndex: %d: CurrentIndication %s lsgid:%d fctid:%d indType:%s dataType=%s length=%d",
               NODE_INDEX, SGtype, gBAP_Indication_header[0], gBAP_Indication_header[1], Indicationtype_Text[gBAP_Indication_header[2]], Datatype_Text[gBAP_Indication_header[3]], gBAP_Indication_header[4]);
   else 
       writelineEx(gBAP_Trace, 0, "Internal acknowledge %s-%d fctid:%d indType:%s dataType=%s length=%d",
               SGtype, gBAP_Indication_header[0], gBAP_Indication_header[1], Acknowledgetype_Text[gBAP_Indication_header[5]], Datatype_Text[gBAP_Indication_header[3]], gBAP_Indication_header[4]);
   switch(gBAP_Indication_header[0])  // LSGID
   {
   case LSGID:
       switch(gBAP_Indication_header[1]) // FCTID
       {
    case C_ASG_15_1_0_1_ID: 
        switch(gBAP_Indication_header[3]) // Datentyp 
        {
        case Bap_void:
            switch (gBAP_Indication_header[2]) // IndType
            {
                case Data_IND: // Indicationtyp pruefen
                    //Now every Property with Cache is updated
                    UpdateAllProperties();
                    putValue(C_ASG_15_1_0_1_State, "StatusAll");
                    setControlBackColor(panel_name, "errfield_C_ASG_15_1_0_1_State", MakeRGB(255,255,255));
                    break;
                default:
                    PrintIndicationError("Illegal IndType");
                    break;
            }
            break;
            case Bap_error:
               snprintf(buffer,BAP_buffer_size-1,"Error %02x", gBAP_Indication_header[5]);
               putValue(C_ASG_15_1_0_1_State, buffer);
               setControlBackColor(panel_name, "errfield_C_ASG_15_1_0_1_State", MakeRGB(255,79,79));
               break;
            case Bap_acknowledge:
                break;
            default:
                PrintIndicationError("Illegal DataType");
                break;
        }
    break;
    case P_ASG_15_1_0_2_ID: 
        switch(gBAP_Indication_header[3]) // Datentyp 
        {
        case Bap_byteSequence:
            switch (gBAP_Indication_header[2]) // IndType
            {
                case Reset_IND: // Nur fuer FctId 2 (BAPConfig) relevant
                   putValue(C_ASG_15_1_0_1_State, "");
                   setControlBackColor(panel_name, "errfield_C_ASG_15_1_0_1_State", MakeRGB(255,255,255));
                   initInvalidFields();
                   // Fall through
                case Data_IND: // Indicationtyp pruefen
                    // Daten setzen
                    putValue(BAPCFG_ASG_15_1_0_ProtocolMajor, gBAP_Indication_data[0]);
                    putValue(BAPCFG_ASG_15_1_0_ProtocolMinor, gBAP_Indication_data[1]);
                    putValue(BAPCFG_ASG_15_1_0_LsgClassMajor, gBAP_Indication_data[2]);
                    putValue(BAPCFG_ASG_15_1_0_LsgClassMinor, gBAP_Indication_data[3]);
                    putValue(BAPCFG_ASG_15_1_0_DFMajor, gBAP_Indication_data[4]);
                    putValue(BAPCFG_ASG_15_1_0_DFMinor, gBAP_Indication_data[5]);
                    setControlBackColor(panel_name, "errfield_P_ASG_15_1_0_2", MakeRGB(255,255,255));  
                    setControlBackColor(panel_name, "panel1_edit", MakeRGB(255,255,255));  
                    break;
                default:
                    PrintIndicationError("Illegal IndType");
                    break;
            }
            break;
            case Bap_error:
                putValue(P_ASG_15_1_0_2_ErrCode,  gBAP_Indication_header[5]);
                setControlBackColor(panel_name, "errfield_P_ASG_15_1_0_2", MakeRGB(255,79,79));  
                setControlBackColor(panel_name, "panel1_edit", MakeRGB(220,220,220));  
                break;
            case Bap_acknowledge:
                break;
            default:
                PrintIndicationError("Illegal DataType");
                break;
        }
    break;
    case P_ASG_15_1_0_3_ID: 
       switch(gBAP_Indication_header[3]) // Datentyp
       {
            case Bap_byteSequence:
                switch (gBAP_Indication_header[2]) // IndType
                {
                    case Data_IND: // Indicationtyp pruefen
                    case Reset_IND: // Nur fuer FctId 2 (BAPConfig) relevant
                    {
                        setControlBackColor(panel_name, "errfield_P_ASG_15_1_0_3", MakeRGB(255,255,255));
                        if(isBitForFctSetted(P_ASG_15_1_0_37_ID,gBAP_Indication_data))
                        {
                            putValue(P_ASG_15_1_0_37_FctLstItemEn, 1);
                            setControlForeColor(panel_name, gCheckbox37,MakeRGB(0,240,0));
                            EnableControl(panel_name, gPanel37, 1);
                            EnableControl(panel_name, "panel_P_ASG_15_1_0_37",1);
                        }
                        else
                        {
                            putValue(P_ASG_15_1_0_37_FctLstItemEn, 0);
                            setControlForeColor(panel_name, gCheckbox37,MakeRGB(250,0,0));
                            EnableControl(panel_name, gPanel37, 0);
                            EnableControl(panel_name, "panel_P_ASG_15_1_0_37",0);
                        }

                        if(isBitForFctSetted(A_ASG_15_1_0_36_ID,gBAP_Indication_data))
                        {
                            putValue(A_ASG_15_1_0_36_FctLstItemEn, 1);
                            setControlForeColor(panel_name, gCheckbox36,MakeRGB(0,240,0));
                            EnableControl(panel_name, gPanel36, 1);
                            EnableControl(panel_name, "panel_A_ASG_15_1_0_36",1);
                            EnableControl(panel_name, "panel_A_ASG_15_1_0_36_Changed",1);
                            EnableControl(panel_name, "panel_A_ASG_15_1_0_36_SetGet",1);
                        }
                        else
                        {
                            putValue(A_ASG_15_1_0_36_FctLstItemEn, 0);
                            setControlForeColor(panel_name, gCheckbox36,MakeRGB(250,0,0));
                            EnableControl(panel_name, gPanel36, 0);
                            EnableControl(panel_name, "panel_A_ASG_15_1_0_36",0);
                            EnableControl(panel_name, "panel_A_ASG_15_1_0_36_Changed",0);
                            EnableControl(panel_name, "panel_A_ASG_15_1_0_36_SetGet",0);
                        }

                        if(isBitForFctSetted(P_ASG_15_1_0_35_ID,gBAP_Indication_data))
                        {
                            putValue(P_ASG_15_1_0_35_FctLstItemEn, 1);
                            setControlForeColor(panel_name, gCheckbox35,MakeRGB(0,240,0));
                            EnableControl(panel_name, gPanel35, 1);
                            EnableControl(panel_name, "panel_P_ASG_15_1_0_35",1);
                        }
                        else
                        {
                            putValue(P_ASG_15_1_0_35_FctLstItemEn, 0);
                            setControlForeColor(panel_name, gCheckbox35,MakeRGB(250,0,0));
                            EnableControl(panel_name, gPanel35, 0);
                            EnableControl(panel_name, "panel_P_ASG_15_1_0_35",0);
                        }

                        if(isBitForFctSetted(P_ASG_15_1_0_34_ID,gBAP_Indication_data))
                        {
                            putValue(P_ASG_15_1_0_34_FctLstItemEn, 1);
                            setControlForeColor(panel_name, gCheckbox34,MakeRGB(0,240,0));
                            EnableControl(panel_name, gPanel34, 1);
                            EnableControl(panel_name, "panel_P_ASG_15_1_0_34",1);
                        }
                        else
                        {
                            putValue(P_ASG_15_1_0_34_FctLstItemEn, 0);
                            setControlForeColor(panel_name, gCheckbox34,MakeRGB(250,0,0));
                            EnableControl(panel_name, gPanel34, 0);
                            EnableControl(panel_name, "panel_P_ASG_15_1_0_34",0);
                        }

                        if(isBitForFctSetted(P_ASG_15_1_0_33_ID,gBAP_Indication_data))
                        {
                            putValue(P_ASG_15_1_0_33_FctLstItemEn, 1);
                            setControlForeColor(panel_name, gCheckbox33,MakeRGB(0,240,0));
                            EnableControl(panel_name, gPanel33, 1);
                            EnableControl(panel_name, "panel_P_ASG_15_1_0_33",1);
                        }
                        else
                        {
                            putValue(P_ASG_15_1_0_33_FctLstItemEn, 0);
                            setControlForeColor(panel_name, gCheckbox33,MakeRGB(250,0,0));
                            EnableControl(panel_name, gPanel33, 0);
                            EnableControl(panel_name, "panel_P_ASG_15_1_0_33",0);
                        }

                        if(isBitForFctSetted(P_ASG_15_1_0_32_ID,gBAP_Indication_data))
                        {
                            putValue(P_ASG_15_1_0_32_FctLstItemEn, 1);
                            setControlForeColor(panel_name, gCheckbox32,MakeRGB(0,240,0));
                            EnableControl(panel_name, gPanel32, 1);
                            EnableControl(panel_name, "panel_P_ASG_15_1_0_32",1);
                        }
                        else
                        {
                            putValue(P_ASG_15_1_0_32_FctLstItemEn, 0);
                            setControlForeColor(panel_name, gCheckbox32,MakeRGB(250,0,0));
                            EnableControl(panel_name, gPanel32, 0);
                            EnableControl(panel_name, "panel_P_ASG_15_1_0_32",0);
                        }

                        if(isBitForFctSetted(A_ASG_15_1_0_31_ID,gBAP_Indication_data))
                        {
                            putValue(A_ASG_15_1_0_31_FctLstItemEn, 1);
                            setControlForeColor(panel_name, gCheckbox31,MakeRGB(0,240,0));
                            EnableControl(panel_name, gPanel31, 1);
                            EnableControl(panel_name, "panel_A_ASG_15_1_0_31",1);
                            EnableControl(panel_name, "panel_A_ASG_15_1_0_31_Changed",1);
                            EnableControl(panel_name, "panel_A_ASG_15_1_0_31_SetGet",1);
                        }
                        else
                        {
                            putValue(A_ASG_15_1_0_31_FctLstItemEn, 0);
                            setControlForeColor(panel_name, gCheckbox31,MakeRGB(250,0,0));
                            EnableControl(panel_name, gPanel31, 0);
                            EnableControl(panel_name, "panel_A_ASG_15_1_0_31",0);
                            EnableControl(panel_name, "panel_A_ASG_15_1_0_31_Changed",0);
                            EnableControl(panel_name, "panel_A_ASG_15_1_0_31_SetGet",0);
                        }

                        if(isBitForFctSetted(P_ASG_15_1_0_30_ID,gBAP_Indication_data))
                        {
                            putValue(P_ASG_15_1_0_30_FctLstItemEn, 1);
                            setControlForeColor(panel_name, gCheckbox30,MakeRGB(0,240,0));
                            EnableControl(panel_name, gPanel30, 1);
                            EnableControl(panel_name, "panel_P_ASG_15_1_0_30",1);
                        }
                        else
                        {
                            putValue(P_ASG_15_1_0_30_FctLstItemEn, 0);
                            setControlForeColor(panel_name, gCheckbox30,MakeRGB(250,0,0));
                            EnableControl(panel_name, gPanel30, 0);
                            EnableControl(panel_name, "panel_P_ASG_15_1_0_30",0);
                        }

                        if(isBitForFctSetted(P_ASG_15_1_0_19_ID,gBAP_Indication_data))
                        {
                            putValue(P_ASG_15_1_0_19_FctLstItemEn, 1);
                            setControlForeColor(panel_name, gCheckbox19,MakeRGB(0,240,0));
                            EnableControl(panel_name, gPanel19, 1);
                            EnableControl(panel_name, "panel_P_ASG_15_1_0_19",1);
                        }
                        else
                        {
                            putValue(P_ASG_15_1_0_19_FctLstItemEn, 0);
                            setControlForeColor(panel_name, gCheckbox19,MakeRGB(250,0,0));
                            EnableControl(panel_name, gPanel19, 0);
                            EnableControl(panel_name, "panel_P_ASG_15_1_0_19",0);
                        }

                        if(isBitForFctSetted(P_ASG_15_1_0_18_ID,gBAP_Indication_data))
                        {
                            putValue(P_ASG_15_1_0_18_FctLstItemEn, 1);
                            setControlForeColor(panel_name, gCheckbox18,MakeRGB(0,240,0));
                            EnableControl(panel_name, gPanel18, 1);
                            EnableControl(panel_name, "panel_P_ASG_15_1_0_18",1);
                        }
                        else
                        {
                            putValue(P_ASG_15_1_0_18_FctLstItemEn, 0);
                            setControlForeColor(panel_name, gCheckbox18,MakeRGB(250,0,0));
                            EnableControl(panel_name, gPanel18, 0);
                            EnableControl(panel_name, "panel_P_ASG_15_1_0_18",0);
                        }

                        if(isBitForFctSetted(M_ASG_15_1_0_17_ID,gBAP_Indication_data))
                        {
                            putValue(M_ASG_15_1_0_17_FctLstItemEn, 1);
                            setControlForeColor(panel_name, gCheckbox17,MakeRGB(0,240,0));
                            EnableControl(panel_name, gPanel17, 1);
                            EnableControl(panel_name, "panel_M_ASG_15_1_0_17_Result",1);
                            EnableControl(panel_name, "panel_M_ASG_15_1_0_17_Processing",1);
                            EnableControl(panel_name, "panel_M_ASG_15_1_0_17_Start",1);
                        }
                        else
                        {
                            putValue(M_ASG_15_1_0_17_FctLstItemEn, 0);
                            setControlForeColor(panel_name, gCheckbox17,MakeRGB(250,0,0));
                            EnableControl(panel_name, gPanel17, 0);
                            EnableControl(panel_name, "panel_M_ASG_15_1_0_17_Result",0);
                            EnableControl(panel_name, "panel_M_ASG_15_1_0_17_Processing",0);
                            EnableControl(panel_name, "panel_M_ASG_15_1_0_17_Start",0);
                        }

                        if(isBitForFctSetted(P_ASG_15_1_0_16_ID,gBAP_Indication_data))
                        {
                            putValue(P_ASG_15_1_0_16_FctLstItemEn, 1);
                            setControlForeColor(panel_name, gCheckbox16,MakeRGB(0,240,0));
                            EnableControl(panel_name, gPanel16, 1);
                            EnableControl(panel_name, "panel_P_ASG_15_1_0_16",1);
                        }
                        else
                        {
                            putValue(P_ASG_15_1_0_16_FctLstItemEn, 0);
                            setControlForeColor(panel_name, gCheckbox16,MakeRGB(250,0,0));
                            EnableControl(panel_name, gPanel16, 0);
                            EnableControl(panel_name, "panel_P_ASG_15_1_0_16",0);
                        }

                        if(isBitForFctSetted(P_ASG_15_1_0_15_ID,gBAP_Indication_data))
                        {
                            putValue(P_ASG_15_1_0_15_FctLstItemEn, 1);
                            setControlForeColor(panel_name, gCheckbox15,MakeRGB(0,240,0));
                            EnableControl(panel_name, gPanel15, 1);
                            EnableControl(panel_name, "panel_P_ASG_15_1_0_15",1);
                        }
                        else
                        {
                            putValue(P_ASG_15_1_0_15_FctLstItemEn, 0);
                            setControlForeColor(panel_name, gCheckbox15,MakeRGB(250,0,0));
                            EnableControl(panel_name, gPanel15, 0);
                            EnableControl(panel_name, "panel_P_ASG_15_1_0_15",0);
                        }

                        if(isBitForFctSetted(P_ASG_15_1_0_14_ID,gBAP_Indication_data))
                        {
                            putValue(P_ASG_15_1_0_14_FctLstItemEn, 1);
                            setControlForeColor(panel_name, gCheckbox14,MakeRGB(0,240,0));
                            EnableControl(panel_name, gPanel14, 1);
                            EnableControl(panel_name, "panel_P_ASG_15_1_0_14",1);
                        }
                        else
                        {
                            putValue(P_ASG_15_1_0_14_FctLstItemEn, 0);
                            setControlForeColor(panel_name, gCheckbox14,MakeRGB(250,0,0));
                            EnableControl(panel_name, gPanel14, 0);
                            EnableControl(panel_name, "panel_P_ASG_15_1_0_14",0);
                        }

                        if(isBitForFctSetted(P_ASG_15_1_0_13_ID,gBAP_Indication_data))
                        {
                            putValue(P_ASG_15_1_0_13_FctLstItemEn, 1);
                            setControlForeColor(panel_name, gCheckbox13,MakeRGB(0,240,0));
                            EnableControl(panel_name, gPanel13, 1);
                            EnableControl(panel_name, "panel_P_ASG_15_1_0_13",1);
                        }
                        else
                        {
                            putValue(P_ASG_15_1_0_13_FctLstItemEn, 0);
                            setControlForeColor(panel_name, gCheckbox13,MakeRGB(250,0,0));
                            EnableControl(panel_name, gPanel13, 0);
                            EnableControl(panel_name, "panel_P_ASG_15_1_0_13",0);
                        }

                        if(isBitForFctSetted(P_ASG_15_1_0_29_ID,gBAP_Indication_data))
                        {
                            putValue(P_ASG_15_1_0_29_FctLstItemEn, 1);
                            setControlForeColor(panel_name, gCheckbox29,MakeRGB(0,240,0));
                            EnableControl(panel_name, gPanel29, 1);
                            EnableControl(panel_name, "panel_P_ASG_15_1_0_29",1);
                        }
                        else
                        {
                            putValue(P_ASG_15_1_0_29_FctLstItemEn, 0);
                            setControlForeColor(panel_name, gCheckbox29,MakeRGB(250,0,0));
                            EnableControl(panel_name, gPanel29, 0);
                            EnableControl(panel_name, "panel_P_ASG_15_1_0_29",0);
                        }

                        if(isBitForFctSetted(P_ASG_15_1_0_28_ID,gBAP_Indication_data))
                        {
                            putValue(P_ASG_15_1_0_28_FctLstItemEn, 1);
                            setControlForeColor(panel_name, gCheckbox28,MakeRGB(0,240,0));
                            EnableControl(panel_name, gPanel28, 1);
                            EnableControl(panel_name, "panel_P_ASG_15_1_0_28",1);
                        }
                        else
                        {
                            putValue(P_ASG_15_1_0_28_FctLstItemEn, 0);
                            setControlForeColor(panel_name, gCheckbox28,MakeRGB(250,0,0));
                            EnableControl(panel_name, gPanel28, 0);
                            EnableControl(panel_name, "panel_P_ASG_15_1_0_28",0);
                        }

                        if(isBitForFctSetted(P_ASG_15_1_0_27_ID,gBAP_Indication_data))
                        {
                            putValue(P_ASG_15_1_0_27_FctLstItemEn, 1);
                            setControlForeColor(panel_name, gCheckbox27,MakeRGB(0,240,0));
                            EnableControl(panel_name, gPanel27, 1);
                            EnableControl(panel_name, "panel_P_ASG_15_1_0_27",1);
                        }
                        else
                        {
                            putValue(P_ASG_15_1_0_27_FctLstItemEn, 0);
                            setControlForeColor(panel_name, gCheckbox27,MakeRGB(250,0,0));
                            EnableControl(panel_name, gPanel27, 0);
                            EnableControl(panel_name, "panel_P_ASG_15_1_0_27",0);
                        }

                        if(isBitForFctSetted(P_ASG_15_1_0_26_ID,gBAP_Indication_data))
                        {
                            putValue(P_ASG_15_1_0_26_FctLstItemEn, 1);
                            setControlForeColor(panel_name, gCheckbox26,MakeRGB(0,240,0));
                            EnableControl(panel_name, gPanel26, 1);
                            EnableControl(panel_name, "panel_P_ASG_15_1_0_26",1);
                        }
                        else
                        {
                            putValue(P_ASG_15_1_0_26_FctLstItemEn, 0);
                            setControlForeColor(panel_name, gCheckbox26,MakeRGB(250,0,0));
                            EnableControl(panel_name, gPanel26, 0);
                            EnableControl(panel_name, "panel_P_ASG_15_1_0_26",0);
                        }

                        if(isBitForFctSetted(P_ASG_15_1_0_4_ID,gBAP_Indication_data))
                        {
                            putValue(P_ASG_15_1_0_4_FctLstItemEn, 1);
                            setControlForeColor(panel_name, gCheckbox4,MakeRGB(0,240,0));
                        }
                        else
                        {
                            putValue(P_ASG_15_1_0_4_FctLstItemEn, 0);
                            setControlForeColor(panel_name, gCheckbox4,MakeRGB(250,0,0));
                        }

                        if(isBitForFctSetted(P_ASG_15_1_0_25_ID,gBAP_Indication_data))
                        {
                            putValue(P_ASG_15_1_0_25_FctLstItemEn, 1);
                            setControlForeColor(panel_name, gCheckbox25,MakeRGB(0,240,0));
                            EnableControl(panel_name, gPanel25, 1);
                            EnableControl(panel_name, "panel_P_ASG_15_1_0_25",1);
                        }
                        else
                        {
                            putValue(P_ASG_15_1_0_25_FctLstItemEn, 0);
                            setControlForeColor(panel_name, gCheckbox25,MakeRGB(250,0,0));
                            EnableControl(panel_name, gPanel25, 0);
                            EnableControl(panel_name, "panel_P_ASG_15_1_0_25",0);
                        }

                        if(isBitForFctSetted(P_ASG_15_1_0_3_ID,gBAP_Indication_data))
                        {
                            putValue(P_ASG_15_1_0_3_FctLstItemEn, 1);
                            setControlForeColor(panel_name, gCheckbox3,MakeRGB(0,240,0));
                        }
                        else
                        {
                            putValue(P_ASG_15_1_0_3_FctLstItemEn, 0);
                            setControlForeColor(panel_name, gCheckbox3,MakeRGB(250,0,0));
                        }

                        if(isBitForFctSetted(P_ASG_15_1_0_24_ID,gBAP_Indication_data))
                        {
                            putValue(P_ASG_15_1_0_24_FctLstItemEn, 1);
                            setControlForeColor(panel_name, gCheckbox24,MakeRGB(0,240,0));
                            EnableControl(panel_name, gPanel24, 1);
                            EnableControl(panel_name, "panel_P_ASG_15_1_0_24",1);
                        }
                        else
                        {
                            putValue(P_ASG_15_1_0_24_FctLstItemEn, 0);
                            setControlForeColor(panel_name, gCheckbox24,MakeRGB(250,0,0));
                            EnableControl(panel_name, gPanel24, 0);
                            EnableControl(panel_name, "panel_P_ASG_15_1_0_24",0);
                        }

                        if(isBitForFctSetted(P_ASG_15_1_0_2_ID,gBAP_Indication_data))
                        {
                            putValue(P_ASG_15_1_0_2_FctLstItemEn, 1);
                            setControlForeColor(panel_name, gCheckbox2,MakeRGB(0,240,0));
                        }
                        else
                        {
                            putValue(P_ASG_15_1_0_2_FctLstItemEn, 0);
                            setControlForeColor(panel_name, gCheckbox2,MakeRGB(250,0,0));
                        }

                        if(isBitForFctSetted(P_ASG_15_1_0_23_ID,gBAP_Indication_data))
                        {
                            putValue(P_ASG_15_1_0_23_FctLstItemEn, 1);
                            setControlForeColor(panel_name, gCheckbox23,MakeRGB(0,240,0));
                            EnableControl(panel_name, gPanel23, 1);
                            EnableControl(panel_name, "panel_P_ASG_15_1_0_23",1);
                        }
                        else
                        {
                            putValue(P_ASG_15_1_0_23_FctLstItemEn, 0);
                            setControlForeColor(panel_name, gCheckbox23,MakeRGB(250,0,0));
                            EnableControl(panel_name, gPanel23, 0);
                            EnableControl(panel_name, "panel_P_ASG_15_1_0_23",0);
                        }

                        if(isBitForFctSetted(C_ASG_15_1_0_1_ID,gBAP_Indication_data))
                        {
                            putValue(C_ASG_15_1_0_1_FctLstItemEn, 1);
                            setControlForeColor(panel_name, gCheckbox1,MakeRGB(0,240,0));
                        }
                        else
                        {
                            putValue(C_ASG_15_1_0_1_FctLstItemEn, 0);
                            setControlForeColor(panel_name, gCheckbox1,MakeRGB(250,0,0));
                        }

                        if(isBitForFctSetted(P_ASG_15_1_0_22_ID,gBAP_Indication_data))
                        {
                            putValue(P_ASG_15_1_0_22_FctLstItemEn, 1);
                            setControlForeColor(panel_name, gCheckbox22,MakeRGB(0,240,0));
                            EnableControl(panel_name, gPanel22, 1);
                            EnableControl(panel_name, "panel_P_ASG_15_1_0_22",1);
                        }
                        else
                        {
                            putValue(P_ASG_15_1_0_22_FctLstItemEn, 0);
                            setControlForeColor(panel_name, gCheckbox22,MakeRGB(250,0,0));
                            EnableControl(panel_name, gPanel22, 0);
                            EnableControl(panel_name, "panel_P_ASG_15_1_0_22",0);
                        }

                        if(isBitForFctSetted(P_ASG_15_1_0_21_ID,gBAP_Indication_data))
                        {
                            putValue(P_ASG_15_1_0_21_FctLstItemEn, 1);
                            setControlForeColor(panel_name, gCheckbox21,MakeRGB(0,240,0));
                            EnableControl(panel_name, gPanel21, 1);
                            EnableControl(panel_name, "panel_P_ASG_15_1_0_21",1);
                        }
                        else
                        {
                            putValue(P_ASG_15_1_0_21_FctLstItemEn, 0);
                            setControlForeColor(panel_name, gCheckbox21,MakeRGB(250,0,0));
                            EnableControl(panel_name, gPanel21, 0);
                            EnableControl(panel_name, "panel_P_ASG_15_1_0_21",0);
                        }

                        if(isBitForFctSetted(P_ASG_15_1_0_20_ID,gBAP_Indication_data))
                        {
                            putValue(P_ASG_15_1_0_20_FctLstItemEn, 1);
                            setControlForeColor(panel_name, gCheckbox20,MakeRGB(0,240,0));
                            EnableControl(panel_name, gPanel20, 1);
                            EnableControl(panel_name, "panel_P_ASG_15_1_0_20",1);
                        }
                        else
                        {
                            putValue(P_ASG_15_1_0_20_FctLstItemEn, 0);
                            setControlForeColor(panel_name, gCheckbox20,MakeRGB(250,0,0));
                            EnableControl(panel_name, gPanel20, 0);
                            EnableControl(panel_name, "panel_P_ASG_15_1_0_20",0);
                        }

                     }
                        break;
                    default:
                      writelineEx(gError_Trace, 0, "NodeIndex: %d: Illegal IndType : lsgid:%d fctid:%d indType:%d",
                           NODE_INDEX, gBAP_Indication_header[0], gBAP_Indication_header[1], gBAP_Indication_header[2]);
                       break;
                  }
                  break;
            case Bap_error:
                putValue(P_ASG_15_1_0_3_ErrCode,  gBAP_Indication_header[5]);
                setControlBackColor(panel_name, "errfield_P_ASG_15_1_0_3", MakeRGB(255,79,79));
                break;
            case Bap_acknowledge:
            	 break;
            default:
                PrintIndicationError("Illegal DataType");
                break;
       }
       break;
    case P_ASG_15_1_0_4_ID: 
        switch(gBAP_Indication_header[3]) // Datentyp 
        {
           case Bap_uint8:
                   switch(gBAP_Indication_header[2]) // IndType
                   {
                       case Data_IND: // Indicationtyp pruefen
                           // Daten setzen
                           putValue(P_ASG_15_1_0_4, gBAP_Indication_header[5]);
                           setControlBackColor(panel_name, "errfield_P_ASG_15_1_0_4", MakeRGB(255,255,255));  
                           setControlBackColor(panel_name, "panel_P_ASG_15_1_0_4", MakeRGB(255,255,255));  
                           break;                              
                       default:
                           PrintIndicationError("Illegal IndType");
                           break;
                   }
                   break;
            case Bap_error:
                putValue(P_ASG_15_1_0_4_ErrCode,  gBAP_Indication_header[5]);
                setControlBackColor(panel_name, "errfield_P_ASG_15_1_0_4", MakeRGB(255,79,79));  
                setControlBackColor(panel_name, "panel_P_ASG_15_1_0_4", MakeRGB(220,220,220));  
                if(gBAP_Indication_header[5]==0x21)
                {
                   putValue(C_ASG_15_1_0_1_State, "");
                   setControlBackColor(panel_name, "errfield_C_ASG_15_1_0_1_State", MakeRGB(255,255,255));
                }
                break;
            case Bap_acknowledge:
                break;
            default:
                PrintIndicationError("Illegal DataType");
                break;
        }
    break;
    case P_ASG_15_1_0_13_ID: 
        switch(gBAP_Indication_header[3]) // Datentyp 
        {
            case Bap_uint8:
                    switch(gBAP_Indication_header[2]) // IndType
                    {
                        case Data_IND: // Indicationtyp pruefen
                            // Daten setzen
                            putValue(P_ASG_15_1_0_13, gBAP_Indication_header[5]);
                            setControlBackColor(panel_name, "errfield_P_ASG_15_1_0_13", MakeRGB(255,255,255));  
                            setControlBackColor(panel_name, "panel_P_ASG_15_1_0_13", MakeRGB(255,255,255));  
                            break;                              
                        default:
                            PrintIndicationError("Illegal IndType");
                            break;
                    }
                    break;
            case Bap_error:
                gP_ASG_15_1_0_13_ErrCode = 0;
                putValue(P_ASG_15_1_0_13_ErrCode,  gBAP_Indication_header[5]);
                setControlBackColor(panel_name, "errfield_P_ASG_15_1_0_13", MakeRGB(255,79,79));  
                setControlBackColor(panel_name, "panel_P_ASG_15_1_0_13", MakeRGB(220,220,220));  
                break;
            case Bap_acknowledge:
                break;
            default:
                    PrintIndicationError("Illegal DataType");
                    break;
        }
    break;
    case P_ASG_15_1_0_14_ID: 
        switch(gBAP_Indication_header[3]) // Datentyp 
        {
            case Bap_byteSequence:
                switch (gBAP_Indication_header[2]) // IndType
                {
                    case Data_IND: // Indicationtyp pruefen
                        // Daten setzen
                        putValue(P_ASG_15_1_0_14, gBAP_Indication_data, gBAP_Indication_header[4]);
                        setControlBackColor(panel_name, "errfield_P_ASG_15_1_0_14", MakeRGB(255,255,255));  
                        setControlBackColor(panel_name, "panel_P_ASG_15_1_0_14", MakeRGB(255,255,255));  
                        break;
                    default:
                        PrintIndicationError("Illegal IndType");
                        break;
                }
                break;
            case Bap_error:
                gP_ASG_15_1_0_14_ErrCode = 0;
                putValue(P_ASG_15_1_0_14_ErrCode,  gBAP_Indication_header[5]);
                setControlBackColor(panel_name, "errfield_P_ASG_15_1_0_14", MakeRGB(255,79,79));  
                setControlBackColor(panel_name, "panel_P_ASG_15_1_0_14", MakeRGB(220,220,220));  
                break;
            case Bap_acknowledge:
                break;
            default:
                PrintIndicationError("Illegal DataType");
                break;
        }
    break;
    case P_ASG_15_1_0_15_ID: 
        switch(gBAP_Indication_header[3]) // Datentyp 
        {
            case Bap_uint8:
                    switch(gBAP_Indication_header[2]) // IndType
                    {
                        case Data_IND: // Indicationtyp pruefen
                            // Daten setzen
                            putValue(P_ASG_15_1_0_15, gBAP_Indication_header[5]);
                            setControlBackColor(panel_name, "errfield_P_ASG_15_1_0_15", MakeRGB(255,255,255));  
                            setControlBackColor(panel_name, "panel_P_ASG_15_1_0_15", MakeRGB(255,255,255));  
                            break;                              
                        default:
                            PrintIndicationError("Illegal IndType");
                            break;
                    }
                    break;
            case Bap_error:
                gP_ASG_15_1_0_15_ErrCode = 0;
                putValue(P_ASG_15_1_0_15_ErrCode,  gBAP_Indication_header[5]);
                setControlBackColor(panel_name, "errfield_P_ASG_15_1_0_15", MakeRGB(255,79,79));  
                setControlBackColor(panel_name, "panel_P_ASG_15_1_0_15", MakeRGB(220,220,220));  
                break;
            case Bap_acknowledge:
                break;
            default:
                    PrintIndicationError("Illegal DataType");
                    break;
        }
    break;
    case P_ASG_15_1_0_16_ID: 
        switch(gBAP_Indication_header[3]) // Datentyp 
        {
            case Bap_byteSequence:
                switch (gBAP_Indication_header[2]) // IndType
                {
                    case Data_IND: // Indicationtyp pruefen
                        // Daten setzen
                        putValue(P_ASG_15_1_0_16, gBAP_Indication_data, gBAP_Indication_header[4]);
                        setControlBackColor(panel_name, "errfield_P_ASG_15_1_0_16", MakeRGB(255,255,255));  
                        setControlBackColor(panel_name, "panel_P_ASG_15_1_0_16", MakeRGB(255,255,255));  
                        break;
                    default:
                        PrintIndicationError("Illegal IndType");
                        break;
                }
                break;
            case Bap_error:
                gP_ASG_15_1_0_16_ErrCode = 0;
                putValue(P_ASG_15_1_0_16_ErrCode,  gBAP_Indication_header[5]);
                setControlBackColor(panel_name, "errfield_P_ASG_15_1_0_16", MakeRGB(255,79,79));  
                setControlBackColor(panel_name, "panel_P_ASG_15_1_0_16", MakeRGB(220,220,220));  
                break;
            case Bap_acknowledge:
                break;
            default:
                PrintIndicationError("Illegal DataType");
                break;
        }
    break;
    case M_ASG_15_1_0_17_ID: 
            switch(gBAP_Indication_header[3]) // Datentyp
            {
                case Bap_uint8:
                    switch (gBAP_Indication_header[2]) // IndType
                    {
                        case Result_IND: 
                            putValue(M_ASG_15_1_0_17_State, "Result");
                            // Daten setzen
                            putValue(M_ASG_15_1_0_17_Result, gBAP_Indication_header[5]);
                            setControlBackColor(panel_name, "errfield_M_ASG_15_1_0_17", MakeRGB(255,255,255));  
                            setControlBackColor(panel_name, "panel_M_ASG_15_1_0_17_Result", MakeRGB(255,255,255));  
                            break;
                        case Processing_IND:    
                            putValue(M_ASG_15_1_0_17_State, "Running");
                            // Wert von Processing anzeigen
                            putValue(M_ASG_15_1_0_17_Processing, gBAP_Indication_header[5]);
                            setControlBackColor(panel_name, "errfield_M_ASG_15_1_0_17_Result", MakeRGB(255,255,255));  
                            setControlBackColor(panel_name, "panel_M_ASG_15_1_0_17_Processing", MakeRGB(255,255,255));  
                            break;
                        default:
                            PrintIndicationError("Illegal IndType");
                            break;
                    }
                    break;
            case Bap_error:
                gM_ASG_15_1_0_17_ErrCode = 0;
                putValue(M_ASG_15_1_0_17_State, "Error");
                putValue(M_ASG_15_1_0_17_ErrCode,  gBAP_Indication_header[5]);
                setControlBackColor(panel_name, "errfield_M_ASG_15_1_0_17", MakeRGB(255,79,79));  
                setControlBackColor(panel_name, "panel_M_ASG_15_1_0_17_Result", MakeRGB(220,220,220));  
                setControlBackColor(panel_name, "panel_M_ASG_15_1_0_17_Processing", MakeRGB(220,220,220));  
                break;
            case Bap_acknowledge:
                break;
            default:
                    PrintIndicationError("Illegal DataType");
                    break;
            }
    break;
    case P_ASG_15_1_0_18_ID: 
        switch(gBAP_Indication_header[3]) // Datentyp 
        {
            case Bap_byteSequence:
                switch (gBAP_Indication_header[2]) // IndType
                {
                    case Data_IND: // Indicationtyp pruefen
                        // Daten setzen
                        putValue(P_ASG_15_1_0_18, gBAP_Indication_data, gBAP_Indication_header[4]);
                        setControlBackColor(panel_name, "errfield_P_ASG_15_1_0_18", MakeRGB(255,255,255));  
                        setControlBackColor(panel_name, "panel_P_ASG_15_1_0_18", MakeRGB(255,255,255));  
                        break;
                    default:
                        PrintIndicationError("Illegal IndType");
                        break;
                }
                break;
            case Bap_error:
                gP_ASG_15_1_0_18_ErrCode = 0;
                putValue(P_ASG_15_1_0_18_ErrCode,  gBAP_Indication_header[5]);
                setControlBackColor(panel_name, "errfield_P_ASG_15_1_0_18", MakeRGB(255,79,79));  
                setControlBackColor(panel_name, "panel_P_ASG_15_1_0_18", MakeRGB(220,220,220));  
                break;
            case Bap_acknowledge:
                break;
            default:
                PrintIndicationError("Illegal DataType");
                break;
        }
    break;
    case P_ASG_15_1_0_19_ID: 
        switch(gBAP_Indication_header[3]) // Datentyp 
        {
            case Bap_byteSequence:
                switch (gBAP_Indication_header[2]) // IndType
                {
                    case Data_IND: // Indicationtyp pruefen
                        // Daten setzen
                        putValue(P_ASG_15_1_0_19, gBAP_Indication_data, gBAP_Indication_header[4]);
                        setControlBackColor(panel_name, "errfield_P_ASG_15_1_0_19", MakeRGB(255,255,255));  
                        setControlBackColor(panel_name, "panel_P_ASG_15_1_0_19", MakeRGB(255,255,255));  
                        break;
                    default:
                        PrintIndicationError("Illegal IndType");
                        break;
                }
                break;
            case Bap_error:
                gP_ASG_15_1_0_19_ErrCode = 0;
                putValue(P_ASG_15_1_0_19_ErrCode,  gBAP_Indication_header[5]);
                setControlBackColor(panel_name, "errfield_P_ASG_15_1_0_19", MakeRGB(255,79,79));  
                setControlBackColor(panel_name, "panel_P_ASG_15_1_0_19", MakeRGB(220,220,220));  
                break;
            case Bap_acknowledge:
                break;
            default:
                PrintIndicationError("Illegal DataType");
                break;
        }
    break;
    case P_ASG_15_1_0_20_ID: 
        switch(gBAP_Indication_header[3]) // Datentyp 
        {
            case Bap_byteSequence:
                switch (gBAP_Indication_header[2]) // IndType
                {
                    case Data_IND: // Indicationtyp pruefen
                        // Daten setzen
                        putValue(P_ASG_15_1_0_20, gBAP_Indication_data, gBAP_Indication_header[4]);
                        setControlBackColor(panel_name, "errfield_P_ASG_15_1_0_20", MakeRGB(255,255,255));  
                        setControlBackColor(panel_name, "panel_P_ASG_15_1_0_20", MakeRGB(255,255,255));  
                        break;
                    default:
                        PrintIndicationError("Illegal IndType");
                        break;
                }
                break;
            case Bap_error:
                gP_ASG_15_1_0_20_ErrCode = 0;
                putValue(P_ASG_15_1_0_20_ErrCode,  gBAP_Indication_header[5]);
                setControlBackColor(panel_name, "errfield_P_ASG_15_1_0_20", MakeRGB(255,79,79));  
                setControlBackColor(panel_name, "panel_P_ASG_15_1_0_20", MakeRGB(220,220,220));  
                break;
            case Bap_acknowledge:
                break;
            default:
                PrintIndicationError("Illegal DataType");
                break;
        }
    break;
    case P_ASG_15_1_0_21_ID: 
        switch(gBAP_Indication_header[3]) // Datentyp 
        {
            case Bap_byteSequence:
                switch (gBAP_Indication_header[2]) // IndType
                {
                    case Data_IND: // Indicationtyp pruefen
                        // Daten setzen
                        putValue(P_ASG_15_1_0_21, gBAP_Indication_data, gBAP_Indication_header[4]);
                        setControlBackColor(panel_name, "errfield_P_ASG_15_1_0_21", MakeRGB(255,255,255));  
                        setControlBackColor(panel_name, "panel_P_ASG_15_1_0_21", MakeRGB(255,255,255));  
                        break;
                    default:
                        PrintIndicationError("Illegal IndType");
                        break;
                }
                break;
            case Bap_error:
                gP_ASG_15_1_0_21_ErrCode = 0;
                putValue(P_ASG_15_1_0_21_ErrCode,  gBAP_Indication_header[5]);
                setControlBackColor(panel_name, "errfield_P_ASG_15_1_0_21", MakeRGB(255,79,79));  
                setControlBackColor(panel_name, "panel_P_ASG_15_1_0_21", MakeRGB(220,220,220));  
                break;
            case Bap_acknowledge:
                break;
            default:
                PrintIndicationError("Illegal DataType");
                break;
        }
    break;
    case P_ASG_15_1_0_22_ID: 
        switch(gBAP_Indication_header[3]) // Datentyp 
        {
            case Bap_byteSequence:
                switch (gBAP_Indication_header[2]) // IndType
                {
                    case Data_IND: // Indicationtyp pruefen
                        // Daten setzen
                        putValue(P_ASG_15_1_0_22, gBAP_Indication_data, gBAP_Indication_header[4]);
                        setControlBackColor(panel_name, "errfield_P_ASG_15_1_0_22", MakeRGB(255,255,255));  
                        setControlBackColor(panel_name, "panel_P_ASG_15_1_0_22", MakeRGB(255,255,255));  
                        break;
                    default:
                        PrintIndicationError("Illegal IndType");
                        break;
                }
                break;
            case Bap_error:
                gP_ASG_15_1_0_22_ErrCode = 0;
                putValue(P_ASG_15_1_0_22_ErrCode,  gBAP_Indication_header[5]);
                setControlBackColor(panel_name, "errfield_P_ASG_15_1_0_22", MakeRGB(255,79,79));  
                setControlBackColor(panel_name, "panel_P_ASG_15_1_0_22", MakeRGB(220,220,220));  
                break;
            case Bap_acknowledge:
                break;
            default:
                PrintIndicationError("Illegal DataType");
                break;
        }
    break;
    case P_ASG_15_1_0_23_ID: 
        switch(gBAP_Indication_header[3]) // Datentyp 
        {
            case Bap_byteSequence:
                switch (gBAP_Indication_header[2]) // IndType
                {
                    case Data_IND: // Indicationtyp pruefen
                        // Daten setzen
                        putValue(P_ASG_15_1_0_23, gBAP_Indication_data, gBAP_Indication_header[4]);
                        setControlBackColor(panel_name, "errfield_P_ASG_15_1_0_23", MakeRGB(255,255,255));  
                        setControlBackColor(panel_name, "panel_P_ASG_15_1_0_23", MakeRGB(255,255,255));  
                        break;
                    default:
                        PrintIndicationError("Illegal IndType");
                        break;
                }
                break;
            case Bap_error:
                gP_ASG_15_1_0_23_ErrCode = 0;
                putValue(P_ASG_15_1_0_23_ErrCode,  gBAP_Indication_header[5]);
                setControlBackColor(panel_name, "errfield_P_ASG_15_1_0_23", MakeRGB(255,79,79));  
                setControlBackColor(panel_name, "panel_P_ASG_15_1_0_23", MakeRGB(220,220,220));  
                break;
            case Bap_acknowledge:
                break;
            default:
                PrintIndicationError("Illegal DataType");
                break;
        }
    break;
    case P_ASG_15_1_0_24_ID: 
        switch(gBAP_Indication_header[3]) // Datentyp 
        {
            case Bap_byteSequence:
                switch (gBAP_Indication_header[2]) // IndType
                {
                    case Data_IND: // Indicationtyp pruefen
                        // Daten setzen
                        putValue(P_ASG_15_1_0_24, gBAP_Indication_data, gBAP_Indication_header[4]);
                        setControlBackColor(panel_name, "errfield_P_ASG_15_1_0_24", MakeRGB(255,255,255));  
                        setControlBackColor(panel_name, "panel_P_ASG_15_1_0_24", MakeRGB(255,255,255));  
                        break;
                    default:
                        PrintIndicationError("Illegal IndType");
                        break;
                }
                break;
            case Bap_error:
                gP_ASG_15_1_0_24_ErrCode = 0;
                putValue(P_ASG_15_1_0_24_ErrCode,  gBAP_Indication_header[5]);
                setControlBackColor(panel_name, "errfield_P_ASG_15_1_0_24", MakeRGB(255,79,79));  
                setControlBackColor(panel_name, "panel_P_ASG_15_1_0_24", MakeRGB(220,220,220));  
                break;
            case Bap_acknowledge:
                break;
            default:
                PrintIndicationError("Illegal DataType");
                break;
        }
    break;
    case P_ASG_15_1_0_25_ID: 
        switch(gBAP_Indication_header[3]) // Datentyp 
        {
            case Bap_byteSequence:
                switch (gBAP_Indication_header[2]) // IndType
                {
                    case Data_IND: // Indicationtyp pruefen
                        // Daten setzen
                        putValue(P_ASG_15_1_0_25, gBAP_Indication_data, gBAP_Indication_header[4]);
                        setControlBackColor(panel_name, "errfield_P_ASG_15_1_0_25", MakeRGB(255,255,255));  
                        setControlBackColor(panel_name, "panel_P_ASG_15_1_0_25", MakeRGB(255,255,255));  
                        break;
                    default:
                        PrintIndicationError("Illegal IndType");
                        break;
                }
                break;
            case Bap_error:
                gP_ASG_15_1_0_25_ErrCode = 0;
                putValue(P_ASG_15_1_0_25_ErrCode,  gBAP_Indication_header[5]);
                setControlBackColor(panel_name, "errfield_P_ASG_15_1_0_25", MakeRGB(255,79,79));  
                setControlBackColor(panel_name, "panel_P_ASG_15_1_0_25", MakeRGB(220,220,220));  
                break;
            case Bap_acknowledge:
                break;
            default:
                PrintIndicationError("Illegal DataType");
                break;
        }
    break;
    case P_ASG_15_1_0_26_ID: 
        switch(gBAP_Indication_header[3]) // Datentyp 
        {
            case Bap_byteSequence:
                switch (gBAP_Indication_header[2]) // IndType
                {
                    case Data_IND: // Indicationtyp pruefen
                        // Daten setzen
                        putValue(P_ASG_15_1_0_26, gBAP_Indication_data, gBAP_Indication_header[4]);
                        setControlBackColor(panel_name, "errfield_P_ASG_15_1_0_26", MakeRGB(255,255,255));  
                        setControlBackColor(panel_name, "panel_P_ASG_15_1_0_26", MakeRGB(255,255,255));  
                        break;
                    default:
                        PrintIndicationError("Illegal IndType");
                        break;
                }
                break;
            case Bap_error:
                gP_ASG_15_1_0_26_ErrCode = 0;
                putValue(P_ASG_15_1_0_26_ErrCode,  gBAP_Indication_header[5]);
                setControlBackColor(panel_name, "errfield_P_ASG_15_1_0_26", MakeRGB(255,79,79));  
                setControlBackColor(panel_name, "panel_P_ASG_15_1_0_26", MakeRGB(220,220,220));  
                break;
            case Bap_acknowledge:
                break;
            default:
                PrintIndicationError("Illegal DataType");
                break;
        }
    break;
    case P_ASG_15_1_0_27_ID: 
        switch(gBAP_Indication_header[3]) // Datentyp 
        {
            case Bap_byteSequence:
                switch (gBAP_Indication_header[2]) // IndType
                {
                    case Data_IND: // Indicationtyp pruefen
                        // Daten setzen
                        putValue(P_ASG_15_1_0_27, gBAP_Indication_data, gBAP_Indication_header[4]);
                        setControlBackColor(panel_name, "errfield_P_ASG_15_1_0_27", MakeRGB(255,255,255));  
                        setControlBackColor(panel_name, "panel_P_ASG_15_1_0_27", MakeRGB(255,255,255));  
                        break;
                    default:
                        PrintIndicationError("Illegal IndType");
                        break;
                }
                break;
            case Bap_error:
                gP_ASG_15_1_0_27_ErrCode = 0;
                putValue(P_ASG_15_1_0_27_ErrCode,  gBAP_Indication_header[5]);
                setControlBackColor(panel_name, "errfield_P_ASG_15_1_0_27", MakeRGB(255,79,79));  
                setControlBackColor(panel_name, "panel_P_ASG_15_1_0_27", MakeRGB(220,220,220));  
                break;
            case Bap_acknowledge:
                break;
            default:
                PrintIndicationError("Illegal DataType");
                break;
        }
    break;
    case P_ASG_15_1_0_28_ID: 
        switch(gBAP_Indication_header[3]) // Datentyp 
        {
            case Bap_byteSequence:
                switch (gBAP_Indication_header[2]) // IndType
                {
                    case Data_IND: // Indicationtyp pruefen
                        // Daten setzen
                        putValue(P_ASG_15_1_0_28, gBAP_Indication_data, gBAP_Indication_header[4]);
                        setControlBackColor(panel_name, "errfield_P_ASG_15_1_0_28", MakeRGB(255,255,255));  
                        setControlBackColor(panel_name, "panel_P_ASG_15_1_0_28", MakeRGB(255,255,255));  
                        break;
                    default:
                        PrintIndicationError("Illegal IndType");
                        break;
                }
                break;
            case Bap_error:
                gP_ASG_15_1_0_28_ErrCode = 0;
                putValue(P_ASG_15_1_0_28_ErrCode,  gBAP_Indication_header[5]);
                setControlBackColor(panel_name, "errfield_P_ASG_15_1_0_28", MakeRGB(255,79,79));  
                setControlBackColor(panel_name, "panel_P_ASG_15_1_0_28", MakeRGB(220,220,220));  
                break;
            case Bap_acknowledge:
                break;
            default:
                PrintIndicationError("Illegal DataType");
                break;
        }
    break;
    case P_ASG_15_1_0_29_ID: 
        switch(gBAP_Indication_header[3]) // Datentyp 
        {
            case Bap_byteSequence:
                switch (gBAP_Indication_header[2]) // IndType
                {
                    case Data_IND: // Indicationtyp pruefen
                        // Daten setzen
                        putValue(P_ASG_15_1_0_29, gBAP_Indication_data, gBAP_Indication_header[4]);
                        setControlBackColor(panel_name, "errfield_P_ASG_15_1_0_29", MakeRGB(255,255,255));  
                        setControlBackColor(panel_name, "panel_P_ASG_15_1_0_29", MakeRGB(255,255,255));  
                        break;
                    default:
                        PrintIndicationError("Illegal IndType");
                        break;
                }
                break;
            case Bap_error:
                gP_ASG_15_1_0_29_ErrCode = 0;
                putValue(P_ASG_15_1_0_29_ErrCode,  gBAP_Indication_header[5]);
                setControlBackColor(panel_name, "errfield_P_ASG_15_1_0_29", MakeRGB(255,79,79));  
                setControlBackColor(panel_name, "panel_P_ASG_15_1_0_29", MakeRGB(220,220,220));  
                break;
            case Bap_acknowledge:
                break;
            default:
                PrintIndicationError("Illegal DataType");
                break;
        }
    break;
    case P_ASG_15_1_0_30_ID: 
        switch(gBAP_Indication_header[3]) // Datentyp 
        {
            case Bap_byteSequence:
                switch (gBAP_Indication_header[2]) // IndType
                {
                    case Data_IND: // Indicationtyp pruefen
                        // Daten setzen
                        putValue(P_ASG_15_1_0_30, gBAP_Indication_data, gBAP_Indication_header[4]);
                        setControlBackColor(panel_name, "errfield_P_ASG_15_1_0_30", MakeRGB(255,255,255));  
                        setControlBackColor(panel_name, "panel_P_ASG_15_1_0_30", MakeRGB(255,255,255));  
                        break;
                    default:
                        PrintIndicationError("Illegal IndType");
                        break;
                }
                break;
            case Bap_error:
                gP_ASG_15_1_0_30_ErrCode = 0;
                putValue(P_ASG_15_1_0_30_ErrCode,  gBAP_Indication_header[5]);
                setControlBackColor(panel_name, "errfield_P_ASG_15_1_0_30", MakeRGB(255,79,79));  
                setControlBackColor(panel_name, "panel_P_ASG_15_1_0_30", MakeRGB(220,220,220));  
                break;
            case Bap_acknowledge:
                break;
            default:
                PrintIndicationError("Illegal DataType");
                break;
        }
    break;
    case A_ASG_15_1_0_31_ID: 
        switch(gBAP_Indication_header[3]) // Datentyp 
        {
            case Bap_byteSequence:
                switch (gBAP_Indication_header[2]) // IndType
                {
                    case Data_IND: // Indicationtyp pruefen
                        // Daten setzen
                        //putValue(A_ASG_15_1_0_31, gBAP_Indication_data, gBAP_Indication_header[4]);
                        A_ASG_15_1_0_31_DataInd();
                        setControlBackColor(panel_name, "errfield_A_ASG_15_1_0_31", MakeRGB(255,255,255));  
                        setControlBackColor(panel_name, "panel_A_ASG_15_1_0_31", MakeRGB(255,255,255));  
                        break;
                    case Changed_IND: // Indicationtyp pruefen
                        // Daten setzen
                        //putValue(A_ASG_15_1_0_31_Changed, gBAP_Indication_data, gBAP_Indication_header[4]);
                        A_ASG_15_1_0_31_ChangedInd();
                        setControlBackColor(panel_name, "errfield_A_ASG_15_1_0_31", MakeRGB(255,255,255));  
                        setControlBackColor(panel_name, "panel_A_ASG_15_1_0_31_Changed", MakeRGB(255,255,255));  
                        break;
                    default:
                        PrintIndicationError("Illegal IndType");
                        break;
                }
                break;
            case Bap_error:
                gA_ASG_15_1_0_31_ErrCode = 0;
                putValue(A_ASG_15_1_0_31_ErrCode,  gBAP_Indication_header[5]);
                setControlBackColor(panel_name, "errfield_A_ASG_15_1_0_31", MakeRGB(255,79,79));  
                setControlBackColor(panel_name, "panel_A_ASG_15_1_0_31", MakeRGB(220,220,220));  
                setControlBackColor(panel_name, "panel_A_ASG_15_1_0_31_Changed", MakeRGB(220,220,220));  
                break;
            case Bap_acknowledge:
                break;
            default:
                    PrintIndicationError("Illegal DataType");
                    break;
        }
    break;
    case P_ASG_15_1_0_32_ID: 
        switch(gBAP_Indication_header[3]) // Datentyp 
        {
            case Bap_byteSequence:
                switch (gBAP_Indication_header[2]) // IndType
                {
                    case Data_IND: // Indicationtyp pruefen
                        // Daten setzen
                        putValue(P_ASG_15_1_0_32, gBAP_Indication_data, gBAP_Indication_header[4]);
                        setControlBackColor(panel_name, "errfield_P_ASG_15_1_0_32", MakeRGB(255,255,255));  
                        setControlBackColor(panel_name, "panel_P_ASG_15_1_0_32", MakeRGB(255,255,255));  
                        break;
                    default:
                        PrintIndicationError("Illegal IndType");
                        break;
                }
                break;
            case Bap_error:
                gP_ASG_15_1_0_32_ErrCode = 0;
                putValue(P_ASG_15_1_0_32_ErrCode,  gBAP_Indication_header[5]);
                setControlBackColor(panel_name, "errfield_P_ASG_15_1_0_32", MakeRGB(255,79,79));  
                setControlBackColor(panel_name, "panel_P_ASG_15_1_0_32", MakeRGB(220,220,220));  
                break;
            case Bap_acknowledge:
                break;
            default:
                PrintIndicationError("Illegal DataType");
                break;
        }
    break;
    case P_ASG_15_1_0_33_ID: 
        switch(gBAP_Indication_header[3]) // Datentyp 
        {
            case Bap_byteSequence:
                switch (gBAP_Indication_header[2]) // IndType
                {
                    case Data_IND: // Indicationtyp pruefen
                        // Daten setzen
                        putValue(P_ASG_15_1_0_33, gBAP_Indication_data, gBAP_Indication_header[4]);
                        setControlBackColor(panel_name, "errfield_P_ASG_15_1_0_33", MakeRGB(255,255,255));  
                        setControlBackColor(panel_name, "panel_P_ASG_15_1_0_33", MakeRGB(255,255,255));  
                        break;
                    default:
                        PrintIndicationError("Illegal IndType");
                        break;
                }
                break;
            case Bap_error:
                gP_ASG_15_1_0_33_ErrCode = 0;
                putValue(P_ASG_15_1_0_33_ErrCode,  gBAP_Indication_header[5]);
                setControlBackColor(panel_name, "errfield_P_ASG_15_1_0_33", MakeRGB(255,79,79));  
                setControlBackColor(panel_name, "panel_P_ASG_15_1_0_33", MakeRGB(220,220,220));  
                break;
            case Bap_acknowledge:
                break;
            default:
                PrintIndicationError("Illegal DataType");
                break;
        }
    break;
    case P_ASG_15_1_0_34_ID: 
        switch(gBAP_Indication_header[3]) // Datentyp 
        {
            case Bap_byteSequence:
                switch (gBAP_Indication_header[2]) // IndType
                {
                    case Data_IND: // Indicationtyp pruefen
                        // Daten setzen
                        putValue(P_ASG_15_1_0_34, gBAP_Indication_data, gBAP_Indication_header[4]);
                        setControlBackColor(panel_name, "errfield_P_ASG_15_1_0_34", MakeRGB(255,255,255));  
                        setControlBackColor(panel_name, "panel_P_ASG_15_1_0_34", MakeRGB(255,255,255));  
                        break;
                    default:
                        PrintIndicationError("Illegal IndType");
                        break;
                }
                break;
            case Bap_error:
                gP_ASG_15_1_0_34_ErrCode = 0;
                putValue(P_ASG_15_1_0_34_ErrCode,  gBAP_Indication_header[5]);
                setControlBackColor(panel_name, "errfield_P_ASG_15_1_0_34", MakeRGB(255,79,79));  
                setControlBackColor(panel_name, "panel_P_ASG_15_1_0_34", MakeRGB(220,220,220));  
                break;
            case Bap_acknowledge:
                break;
            default:
                PrintIndicationError("Illegal DataType");
                break;
        }
    break;
    case P_ASG_15_1_0_35_ID: 
        switch(gBAP_Indication_header[3]) // Datentyp 
        {
            case Bap_byteSequence:
                switch (gBAP_Indication_header[2]) // IndType
                {
                    case Data_IND: // Indicationtyp pruefen
                        // Daten setzen
                        putValue(P_ASG_15_1_0_35, gBAP_Indication_data, gBAP_Indication_header[4]);
                        setControlBackColor(panel_name, "errfield_P_ASG_15_1_0_35", MakeRGB(255,255,255));  
                        setControlBackColor(panel_name, "panel_P_ASG_15_1_0_35", MakeRGB(255,255,255));  
                        break;
                    default:
                        PrintIndicationError("Illegal IndType");
                        break;
                }
                break;
            case Bap_error:
                gP_ASG_15_1_0_35_ErrCode = 0;
                putValue(P_ASG_15_1_0_35_ErrCode,  gBAP_Indication_header[5]);
                setControlBackColor(panel_name, "errfield_P_ASG_15_1_0_35", MakeRGB(255,79,79));  
                setControlBackColor(panel_name, "panel_P_ASG_15_1_0_35", MakeRGB(220,220,220));  
                break;
            case Bap_acknowledge:
                break;
            default:
                PrintIndicationError("Illegal DataType");
                break;
        }
    break;
    case A_ASG_15_1_0_36_ID: 
        switch(gBAP_Indication_header[3]) // Datentyp 
        {
            case Bap_byteSequence:
                switch (gBAP_Indication_header[2]) // IndType
                {
                    case Data_IND: // Indicationtyp pruefen
                        // Daten setzen
                        //putValue(A_ASG_15_1_0_36, gBAP_Indication_data, gBAP_Indication_header[4]);
                        A_ASG_15_1_0_36_DataInd();
                        setControlBackColor(panel_name, "errfield_A_ASG_15_1_0_36", MakeRGB(255,255,255));  
                        setControlBackColor(panel_name, "panel_A_ASG_15_1_0_36", MakeRGB(255,255,255));  
                        break;
                    case Changed_IND: // Indicationtyp pruefen
                        // Daten setzen
                        //putValue(A_ASG_15_1_0_36_Changed, gBAP_Indication_data, gBAP_Indication_header[4]);
                        A_ASG_15_1_0_36_ChangedInd();
                        setControlBackColor(panel_name, "errfield_A_ASG_15_1_0_36", MakeRGB(255,255,255));  
                        setControlBackColor(panel_name, "panel_A_ASG_15_1_0_36_Changed", MakeRGB(255,255,255));  
                        break;
                    default:
                        PrintIndicationError("Illegal IndType");
                        break;
                }
                break;
            case Bap_error:
                gA_ASG_15_1_0_36_ErrCode = 0;
                putValue(A_ASG_15_1_0_36_ErrCode,  gBAP_Indication_header[5]);
                setControlBackColor(panel_name, "errfield_A_ASG_15_1_0_36", MakeRGB(255,79,79));  
                setControlBackColor(panel_name, "panel_A_ASG_15_1_0_36", MakeRGB(220,220,220));  
                setControlBackColor(panel_name, "panel_A_ASG_15_1_0_36_Changed", MakeRGB(220,220,220));  
                break;
            case Bap_acknowledge:
                break;
            default:
                    PrintIndicationError("Illegal DataType");
                    break;
        }
    break;
    case P_ASG_15_1_0_37_ID: 
        switch(gBAP_Indication_header[3]) // Datentyp 
        {
            case Bap_byteSequence:
                switch (gBAP_Indication_header[2]) // IndType
                {
                    case Data_IND: // Indicationtyp pruefen
                        // Daten setzen
                        putValue(P_ASG_15_1_0_37, gBAP_Indication_data, gBAP_Indication_header[4]);
                        setControlBackColor(panel_name, "errfield_P_ASG_15_1_0_37", MakeRGB(255,255,255));  
                        setControlBackColor(panel_name, "panel_P_ASG_15_1_0_37", MakeRGB(255,255,255));  
                        break;
                    default:
                        PrintIndicationError("Illegal IndType");
                        break;
                }
                break;
            case Bap_error:
                gP_ASG_15_1_0_37_ErrCode = 0;
                putValue(P_ASG_15_1_0_37_ErrCode,  gBAP_Indication_header[5]);
                setControlBackColor(panel_name, "errfield_P_ASG_15_1_0_37", MakeRGB(255,79,79));  
                setControlBackColor(panel_name, "panel_P_ASG_15_1_0_37", MakeRGB(220,220,220));  
                break;
            case Bap_acknowledge:
                break;
            default:
                PrintIndicationError("Illegal DataType");
                break;
        }
    break;
       default:
           writelineEx(gError_Trace, 0, "NodeIndex: %d: Illegal Fct: lsgid:%d fctid:%d indType:%d",
           NODE_INDEX, gBAP_Indication_header[0], gBAP_Indication_header[1], gBAP_Indication_header[2]);
           break;
       }
       break;
   default:
       writelineEx(gError_Trace, 0, "NodeIndex: %d: Illegal LSGID: lsgid:%d fctid:%d indType:%s", NODE_INDEX, gBAP_Indication_header[0], gBAP_Indication_header[1], Indicationtype_Text[gBAP_Indication_header[2]]);
       break;
   }
}


on message BAP_BC_FSG_01
{
   int i, temp;
   byte RX_Data[64];            // received CAN-DATA
   dword RX_Header[4];         // received CAN-Header
   if(gSG_PowerOnOff==Power_on){
       if(this.msgChannel == 1){
           RX_Header[0]=1; /*BusType: 1=Can, 2=Lin, 3=Flexray, 4=Ethernet*/
           RX_Header[1]=1;
           RX_Header[2]=this.DataLength; // received length
           RX_Header[3]=this.ID;
           for (i=0; i<this.DataLength; i++) {
               RX_Data[i]=this.byte(i);
           }
           temp=BAP180_SetRxData(NODE_INDEX, RX_Header, RX_Data);
       }
   }
}



intertelegram_err(long fctId)
{
    long data[4];
    data[0]=LSGID;
    data[1]=fctId;
    data[2]=1;
    data[3]=940;
    ChangeConfig(0x0020,data);
}

sequence_err(long fctId, long size)
{
    long data[5];
    long lastSeg;

    lastSeg = size-5;

    data[0]=LSGID;
    data[1]=fctId;
    data[2]=lastSeg/7+1;
    data[3]=1;
    data[4]=(lastSeg/7+4) & 15;
    ChangeConfig(0x0021,data);
}

intertelegram_err_off(long fctId)
{
    long data[4];
    data[0]=LSGID;
    data[1]=fctId;
    data[2]=5000;
    data[3]=0;
    ChangeConfig(0x0020,data);
}

sequence_err_off(long fctId)
{
    long data[5];

    data[0]=LSGID;
    data[1]=fctId;
    data[2]=5000;
    data[3]=0;
    data[4]=0;
    ChangeConfig(0x0021,data);
}

// START OF BUS CONFIG PANEL CAPL

// ETHERNET AND FLEXRAY NOT ENABLED! (ENABLE_BUS_SELECTOR_PANEL_TOKEN)

// ETHERNET AND FLEXRAY NOT ENABLED! (ENABLE_CAN_FRAME_TOKEN)

// ETHERNET AND FLEXRAY NOT ENABLED! (ENABLE_FR_FRAME_TOKEN)

// ETHERNET AND FLEXRAY NOT ENABLED! (ENABLE_ETHERNET_FRAME_TOKEN)

// ETHERNET AND FLEXRAY NOT ENABLED! (ON_ENVVAR_BUSTYPE_TOKEN)

// ETHERNET NOT ENABLED! (ON_UDP_RECEIVE_FROM_TOKEN)

// ETHERNET NOT ENABLED!

on envVar ON_OFF_ASG15_1
{
   BapOnOff(getvalue(this));
   gSG_PowerOnOff=getvalue(ON_OFF_ASG15_1);
}
on envVar C_ASG_15_1_0_1GetAll_BTN
{
 if (C_ASG_15_1_0_1GetAll_BTN_already_pressed == 0)
  {
     C_ASG_15_1_0_1GetAll_BTN_already_pressed = 1;
     Request_Void(LSGID, C_ASG_15_1_0_1_ID, DataGet_REQ); 
     putValue(C_ASG_15_1_0_1_State, "GetAll");
     setControlBackColor(panel_name, "errfield_C_ASG_15_1_0_1_State", MakeRGB(255,255,255));
 }
 else
 {
     C_ASG_15_1_0_1GetAll_BTN_already_pressed = 0;
 }
}
on envVar P_ASG_15_1_0_2Get_BTN
{
 if (P_ASG_15_1_0_2Get_BTN_already_pressed == 0)
  {
       putValue(P_ASG_15_1_0_2_ErrCode,0);
       SetControlBackColor(panel_name,"errField_P_ASG_15_1_0_2",MakeRGB(255,255,255));
       P_ASG_15_1_0_2Get_BTN_already_pressed = 1;
 }
 else
 {
       Request_Void(LSGID, P_ASG_15_1_0_2_ID, DataGet_REQ); 
       P_ASG_15_1_0_2Get_BTN_already_pressed = 0;
 }
}
on envVar P_ASG_15_1_0_3Get_BTN
{
 if (P_ASG_15_1_0_3Get_BTN_already_pressed == 0)
  {
       putValue(P_ASG_15_1_0_3_ErrCode,0);
       SetControlBackColor(panel_name,"errField_P_ASG_15_1_0_3",MakeRGB(255,255,255));
       P_ASG_15_1_0_3Get_BTN_already_pressed = 1;
 }
 else
 {
       Request_Void(LSGID, P_ASG_15_1_0_3_ID, DataGet_REQ); 
       P_ASG_15_1_0_3Get_BTN_already_pressed = 0;
 }
}
on envVar P_ASG_15_1_0_4Get_BTN
{
 if (P_ASG_15_1_0_4Get_BTN_already_pressed == 0)
  {
       putValue(P_ASG_15_1_0_4_ErrCode,0);
       SetControlBackColor(panel_name,"errField_P_ASG_15_1_0_4",MakeRGB(255,255,255));
       P_ASG_15_1_0_4Get_BTN_already_pressed = 1;
 }
 else
 {
       Request_Void(LSGID, P_ASG_15_1_0_4_ID, DataGet_REQ); 
       P_ASG_15_1_0_4Get_BTN_already_pressed = 0;
 }
}
on envVar P_ASG_15_1_0_13Get_BTN
{
 if (P_ASG_15_1_0_13Get_BTN_already_pressed == 0)
  {
       putValue(P_ASG_15_1_0_13_ErrCode,0);
       SetControlBackColor(panel_name,"errField_P_ASG_15_1_0_13",MakeRGB(255,255,255));
       P_ASG_15_1_0_13Get_BTN_already_pressed = 1;
 }
 else
 {
       Request_Void(LSGID, P_ASG_15_1_0_13_ID, DataGet_REQ); 
       P_ASG_15_1_0_13Get_BTN_already_pressed = 0;
 }
}
on envVar P_ASG_15_1_0_13SetGet_BTN
{
    if (P_ASG_15_1_0_13SetGet_BTN_already_pressed == 0)
    {
       putValue(P_ASG_15_1_0_13_ErrCode,0);
       SetControlBackColor(panel_name,"errField_P_ASG_15_1_0_13",MakeRGB(255,255,255));
       P_ASG_15_1_0_13SetGet_BTN_already_pressed = 1;
    }
    else
    {
       Request_Int8(LSGID, P_ASG_15_1_0_13_ID, DataSetGet_REQ, getValue(P_ASG_15_1_0_13));
       P_ASG_15_1_0_13SetGet_BTN_already_pressed = 0;
    }
}
on envVar P_ASG_15_1_0_13 // bus value of FSG_Control (13).
{
	// opcodes: Error-Status
	byte param1; // Controlcode
	// DATATYPE_UINTXX
	param1 = getValue(P_ASG_15_1_0_13);
	putValue(P_ASG_15_1_0_13_1, param1);
}

on envVar P_ASG_15_1_0_13_1_0
{
	byte bitval;
	//thisval steht hier fuer den bitfield-wert, 
	//aus Generierungsgruenden hier keine einheitliche Bezeichnung moeglich.
	byte thisval; // Controlcode
	bitval= getValue(this);
	thisval = getValue(P_ASG_15_1_0_13_1);
	thisval = thisval&~(1<<0)|(bitval<<0);
	putValue(P_ASG_15_1_0_13_1,thisval);
}

on envVar P_ASG_15_1_0_13_1_4
{
	byte bitval;
	//thisval steht hier fuer den bitfield-wert, 
	//aus Generierungsgruenden hier keine einheitliche Bezeichnung moeglich.
	byte thisval; // Controlcode
	bitval= getValue(this);
	thisval = getValue(P_ASG_15_1_0_13_1);
	thisval = thisval&~(1<<4)|(bitval<<4);
	putValue(P_ASG_15_1_0_13_1,thisval);
}

on envVar P_ASG_15_1_0_13_1 // FSG_Control.Controlcode
{
	byte superval;

	//Update Childvalue (BitField)
	byte mask=0x01;
	int i = 0;
	byte thisval; // Controlcode
	thisval = getValue(this);
	if(thisval&(mask<<0))
		putValue(P_ASG_15_1_0_13_1_0, 1);
	else
		putValue(P_ASG_15_1_0_13_1_0, 0);
	if(thisval&(mask<<4))
		putValue(P_ASG_15_1_0_13_1_4, 1);
	else
		putValue(P_ASG_15_1_0_13_1_4, 0);

    // Update superval
	superval = getValue(P_ASG_15_1_0_13);
	superval = thisval;
	putValue(P_ASG_15_1_0_13,superval);
}

on envVar P_ASG_15_1_0_14Get_BTN
{
 if (P_ASG_15_1_0_14Get_BTN_already_pressed == 0)
  {
       putValue(P_ASG_15_1_0_14_ErrCode,0);
       SetControlBackColor(panel_name,"errField_P_ASG_15_1_0_14",MakeRGB(255,255,255));
       P_ASG_15_1_0_14Get_BTN_already_pressed = 1;
 }
 else
 {
       Request_Void(LSGID, P_ASG_15_1_0_14_ID, DataGet_REQ); 
       P_ASG_15_1_0_14Get_BTN_already_pressed = 0;
 }
}
on envVar P_ASG_15_1_0_14 // bus value of FSG_Setup (14).
{
	// opcodes: Error-Status
	word param1; // DisplayInstallation1
	byte param2; // DisplayInstallation2
	byte param3; // PrimaryEngineType
	byte param4; // SecondaryEngineType
	byte param5; // FunctionSupport
	byte param6; // Extension1
	// DATATYPE_BYTESEQUENCE / DATATYPE_FIXEDBYTESEQUENCE
	int i;
	byte superval[6];
	int currentPos;
	currentPos = 0;
	for( i = 0; i < 6; i++ ) {
		superval[i] = 0;
	}
	getValue(P_ASG_15_1_0_14, superval);
	///////// Start param1 - UINT16 /////////
	param1 = superval[currentPos++]|(superval[currentPos++]<<8);
	putValue(P_ASG_15_1_0_14_1, param1);
	///////// Start param2 - UINT8 /////////
	param2 = superval[currentPos++];
	putValue(P_ASG_15_1_0_14_2, param2);
	///////// Start param3 - NIBBLE /////////
	param3 = (superval[currentPos] & 0xf0)>>4;
	putValue(P_ASG_15_1_0_14_3, param3);
	///////// Start param4 - NIBBLE /////////
	param4 = superval[currentPos++] & 0x0f;
	putValue(P_ASG_15_1_0_14_4, param4);
	///////// Start param5 - UINT8 /////////
	param5 = superval[currentPos++];
	putValue(P_ASG_15_1_0_14_5, param5);
	///////// Start param6 - UINT8 /////////
	param6 = superval[currentPos++];
	putValue(P_ASG_15_1_0_14_6, round((param6 * 1.0) - (0) + (0), 1.0));
}

on envVar P_ASG_15_1_0_14_1_0
{
	byte bitval;
	//thisval steht hier fuer den bitfield-wert, 
	//aus Generierungsgruenden hier keine einheitliche Bezeichnung moeglich.
	word thisval; // DisplayInstallation1
	bitval= getValue(this);
	thisval = getValue(P_ASG_15_1_0_14_1);
	thisval = thisval&~(1<<0)|(bitval<<0);
	putValue(P_ASG_15_1_0_14_1,thisval);
}

on envVar P_ASG_15_1_0_14_1_1
{
	byte bitval;
	//thisval steht hier fuer den bitfield-wert, 
	//aus Generierungsgruenden hier keine einheitliche Bezeichnung moeglich.
	word thisval; // DisplayInstallation1
	bitval= getValue(this);
	thisval = getValue(P_ASG_15_1_0_14_1);
	thisval = thisval&~(1<<1)|(bitval<<1);
	putValue(P_ASG_15_1_0_14_1,thisval);
}

on envVar P_ASG_15_1_0_14_1_2
{
	byte bitval;
	//thisval steht hier fuer den bitfield-wert, 
	//aus Generierungsgruenden hier keine einheitliche Bezeichnung moeglich.
	word thisval; // DisplayInstallation1
	bitval= getValue(this);
	thisval = getValue(P_ASG_15_1_0_14_1);
	thisval = thisval&~(1<<2)|(bitval<<2);
	putValue(P_ASG_15_1_0_14_1,thisval);
}

on envVar P_ASG_15_1_0_14_1_3
{
	byte bitval;
	//thisval steht hier fuer den bitfield-wert, 
	//aus Generierungsgruenden hier keine einheitliche Bezeichnung moeglich.
	word thisval; // DisplayInstallation1
	bitval= getValue(this);
	thisval = getValue(P_ASG_15_1_0_14_1);
	thisval = thisval&~(1<<3)|(bitval<<3);
	putValue(P_ASG_15_1_0_14_1,thisval);
}

on envVar P_ASG_15_1_0_14_1_4
{
	byte bitval;
	//thisval steht hier fuer den bitfield-wert, 
	//aus Generierungsgruenden hier keine einheitliche Bezeichnung moeglich.
	word thisval; // DisplayInstallation1
	bitval= getValue(this);
	thisval = getValue(P_ASG_15_1_0_14_1);
	thisval = thisval&~(1<<4)|(bitval<<4);
	putValue(P_ASG_15_1_0_14_1,thisval);
}

on envVar P_ASG_15_1_0_14_1_5
{
	byte bitval;
	//thisval steht hier fuer den bitfield-wert, 
	//aus Generierungsgruenden hier keine einheitliche Bezeichnung moeglich.
	word thisval; // DisplayInstallation1
	bitval= getValue(this);
	thisval = getValue(P_ASG_15_1_0_14_1);
	thisval = thisval&~(1<<5)|(bitval<<5);
	putValue(P_ASG_15_1_0_14_1,thisval);
}

on envVar P_ASG_15_1_0_14_1_6
{
	byte bitval;
	//thisval steht hier fuer den bitfield-wert, 
	//aus Generierungsgruenden hier keine einheitliche Bezeichnung moeglich.
	word thisval; // DisplayInstallation1
	bitval= getValue(this);
	thisval = getValue(P_ASG_15_1_0_14_1);
	thisval = thisval&~(1<<6)|(bitval<<6);
	putValue(P_ASG_15_1_0_14_1,thisval);
}

on envVar P_ASG_15_1_0_14_1_7
{
	byte bitval;
	//thisval steht hier fuer den bitfield-wert, 
	//aus Generierungsgruenden hier keine einheitliche Bezeichnung moeglich.
	word thisval; // DisplayInstallation1
	bitval= getValue(this);
	thisval = getValue(P_ASG_15_1_0_14_1);
	thisval = thisval&~(1<<7)|(bitval<<7);
	putValue(P_ASG_15_1_0_14_1,thisval);
}

on envVar P_ASG_15_1_0_14_1_8
{
	byte bitval;
	//thisval steht hier fuer den bitfield-wert, 
	//aus Generierungsgruenden hier keine einheitliche Bezeichnung moeglich.
	word thisval; // DisplayInstallation1
	bitval= getValue(this);
	thisval = getValue(P_ASG_15_1_0_14_1);
	thisval = thisval&~(1<<8)|(bitval<<8);
	putValue(P_ASG_15_1_0_14_1,thisval);
}

on envVar P_ASG_15_1_0_14_1_9
{
	byte bitval;
	//thisval steht hier fuer den bitfield-wert, 
	//aus Generierungsgruenden hier keine einheitliche Bezeichnung moeglich.
	word thisval; // DisplayInstallation1
	bitval= getValue(this);
	thisval = getValue(P_ASG_15_1_0_14_1);
	thisval = thisval&~(1<<9)|(bitval<<9);
	putValue(P_ASG_15_1_0_14_1,thisval);
}

on envVar P_ASG_15_1_0_14_1_10
{
	byte bitval;
	//thisval steht hier fuer den bitfield-wert, 
	//aus Generierungsgruenden hier keine einheitliche Bezeichnung moeglich.
	word thisval; // DisplayInstallation1
	bitval= getValue(this);
	thisval = getValue(P_ASG_15_1_0_14_1);
	thisval = thisval&~(1<<10)|(bitval<<10);
	putValue(P_ASG_15_1_0_14_1,thisval);
}

on envVar P_ASG_15_1_0_14_1_11
{
	byte bitval;
	//thisval steht hier fuer den bitfield-wert, 
	//aus Generierungsgruenden hier keine einheitliche Bezeichnung moeglich.
	word thisval; // DisplayInstallation1
	bitval= getValue(this);
	thisval = getValue(P_ASG_15_1_0_14_1);
	thisval = thisval&~(1<<11)|(bitval<<11);
	putValue(P_ASG_15_1_0_14_1,thisval);
}

on envVar P_ASG_15_1_0_14_1_12
{
	byte bitval;
	//thisval steht hier fuer den bitfield-wert, 
	//aus Generierungsgruenden hier keine einheitliche Bezeichnung moeglich.
	word thisval; // DisplayInstallation1
	bitval= getValue(this);
	thisval = getValue(P_ASG_15_1_0_14_1);
	thisval = thisval&~(1<<12)|(bitval<<12);
	putValue(P_ASG_15_1_0_14_1,thisval);
}

on envVar P_ASG_15_1_0_14_1_13
{
	byte bitval;
	//thisval steht hier fuer den bitfield-wert, 
	//aus Generierungsgruenden hier keine einheitliche Bezeichnung moeglich.
	word thisval; // DisplayInstallation1
	bitval= getValue(this);
	thisval = getValue(P_ASG_15_1_0_14_1);
	thisval = thisval&~(1<<13)|(bitval<<13);
	putValue(P_ASG_15_1_0_14_1,thisval);
}

on envVar P_ASG_15_1_0_14_1_14
{
	byte bitval;
	//thisval steht hier fuer den bitfield-wert, 
	//aus Generierungsgruenden hier keine einheitliche Bezeichnung moeglich.
	word thisval; // DisplayInstallation1
	bitval= getValue(this);
	thisval = getValue(P_ASG_15_1_0_14_1);
	thisval = thisval&~(1<<14)|(bitval<<14);
	putValue(P_ASG_15_1_0_14_1,thisval);
}

on envVar P_ASG_15_1_0_14_1_15
{
	byte bitval;
	//thisval steht hier fuer den bitfield-wert, 
	//aus Generierungsgruenden hier keine einheitliche Bezeichnung moeglich.
	word thisval; // DisplayInstallation1
	bitval= getValue(this);
	thisval = getValue(P_ASG_15_1_0_14_1);
	thisval = thisval&~(1<<15)|(bitval<<15);
	putValue(P_ASG_15_1_0_14_1,thisval);
}

on envVar P_ASG_15_1_0_14_1 // FSG_Setup.DisplayInstallation1
{
	byte superval[6];

	//Update Childvalue (BitField)
	byte mask=0x01;
	int i = 0;
	word thisval; // DisplayInstallation1
	thisval = getValue(this);
	if(thisval&(mask<<0))
		putValue(P_ASG_15_1_0_14_1_0, 1);
	else
		putValue(P_ASG_15_1_0_14_1_0, 0);
	if(thisval&(mask<<1))
		putValue(P_ASG_15_1_0_14_1_1, 1);
	else
		putValue(P_ASG_15_1_0_14_1_1, 0);
	if(thisval&(mask<<2))
		putValue(P_ASG_15_1_0_14_1_2, 1);
	else
		putValue(P_ASG_15_1_0_14_1_2, 0);
	if(thisval&(mask<<3))
		putValue(P_ASG_15_1_0_14_1_3, 1);
	else
		putValue(P_ASG_15_1_0_14_1_3, 0);
	if(thisval&(mask<<4))
		putValue(P_ASG_15_1_0_14_1_4, 1);
	else
		putValue(P_ASG_15_1_0_14_1_4, 0);
	if(thisval&(mask<<5))
		putValue(P_ASG_15_1_0_14_1_5, 1);
	else
		putValue(P_ASG_15_1_0_14_1_5, 0);
	if(thisval&(mask<<6))
		putValue(P_ASG_15_1_0_14_1_6, 1);
	else
		putValue(P_ASG_15_1_0_14_1_6, 0);
	if(thisval&(mask<<7))
		putValue(P_ASG_15_1_0_14_1_7, 1);
	else
		putValue(P_ASG_15_1_0_14_1_7, 0);
	if(thisval&(mask<<8))
		putValue(P_ASG_15_1_0_14_1_8, 1);
	else
		putValue(P_ASG_15_1_0_14_1_8, 0);
	if(thisval&(mask<<9))
		putValue(P_ASG_15_1_0_14_1_9, 1);
	else
		putValue(P_ASG_15_1_0_14_1_9, 0);
	if(thisval&(mask<<10))
		putValue(P_ASG_15_1_0_14_1_10, 1);
	else
		putValue(P_ASG_15_1_0_14_1_10, 0);
	if(thisval&(mask<<11))
		putValue(P_ASG_15_1_0_14_1_11, 1);
	else
		putValue(P_ASG_15_1_0_14_1_11, 0);
	if(thisval&(mask<<12))
		putValue(P_ASG_15_1_0_14_1_12, 1);
	else
		putValue(P_ASG_15_1_0_14_1_12, 0);
	if(thisval&(mask<<13))
		putValue(P_ASG_15_1_0_14_1_13, 1);
	else
		putValue(P_ASG_15_1_0_14_1_13, 0);
	if(thisval&(mask<<14))
		putValue(P_ASG_15_1_0_14_1_14, 1);
	else
		putValue(P_ASG_15_1_0_14_1_14, 0);
	if(thisval&(mask<<15))
		putValue(P_ASG_15_1_0_14_1_15, 1);
	else
		putValue(P_ASG_15_1_0_14_1_15, 0);

    // Update superval
	getValue(P_ASG_15_1_0_14, superval);
	superval[0]=thisval&0x00ff;
	superval[1]=(thisval&0xff00)>>8;
	putValue(P_ASG_15_1_0_14,superval);
}

on envVar P_ASG_15_1_0_14_2_0
{
	byte bitval;
	//thisval steht hier fuer den bitfield-wert, 
	//aus Generierungsgruenden hier keine einheitliche Bezeichnung moeglich.
	byte thisval; // DisplayInstallation2
	bitval= getValue(this);
	thisval = getValue(P_ASG_15_1_0_14_2);
	thisval = thisval&~(1<<0)|(bitval<<0);
	putValue(P_ASG_15_1_0_14_2,thisval);
}

on envVar P_ASG_15_1_0_14_2_1
{
	byte bitval;
	//thisval steht hier fuer den bitfield-wert, 
	//aus Generierungsgruenden hier keine einheitliche Bezeichnung moeglich.
	byte thisval; // DisplayInstallation2
	bitval= getValue(this);
	thisval = getValue(P_ASG_15_1_0_14_2);
	thisval = thisval&~(1<<1)|(bitval<<1);
	putValue(P_ASG_15_1_0_14_2,thisval);
}

on envVar P_ASG_15_1_0_14_2_2
{
	byte bitval;
	//thisval steht hier fuer den bitfield-wert, 
	//aus Generierungsgruenden hier keine einheitliche Bezeichnung moeglich.
	byte thisval; // DisplayInstallation2
	bitval= getValue(this);
	thisval = getValue(P_ASG_15_1_0_14_2);
	thisval = thisval&~(1<<2)|(bitval<<2);
	putValue(P_ASG_15_1_0_14_2,thisval);
}

on envVar P_ASG_15_1_0_14_2 // FSG_Setup.DisplayInstallation2
{
	byte superval[6];

	//Update Childvalue (BitField)
	byte mask=0x01;
	int i = 0;
	byte thisval; // DisplayInstallation2
	thisval = getValue(this);
	if(thisval&(mask<<0))
		putValue(P_ASG_15_1_0_14_2_0, 1);
	else
		putValue(P_ASG_15_1_0_14_2_0, 0);
	if(thisval&(mask<<1))
		putValue(P_ASG_15_1_0_14_2_1, 1);
	else
		putValue(P_ASG_15_1_0_14_2_1, 0);
	if(thisval&(mask<<2))
		putValue(P_ASG_15_1_0_14_2_2, 1);
	else
		putValue(P_ASG_15_1_0_14_2_2, 0);

    // Update superval
	getValue(P_ASG_15_1_0_14, superval);
	superval[2]=thisval;
	putValue(P_ASG_15_1_0_14,superval);
}

on envVar P_ASG_15_1_0_14_3 // FSG_Setup.PrimaryEngineType
{
	byte superval[6];

	//Update Childvalue (Enum)
	byte thisval; // PrimaryEngineType
	thisval = 0x0f & getValue(this);

    // Update superval
	getValue(P_ASG_15_1_0_14, superval);
	superval[3]= superval[3]&0x0f;
	superval[3]= superval[3]|(thisval<<4);
	putValue(P_ASG_15_1_0_14,superval);
}

on envVar P_ASG_15_1_0_14_4 // FSG_Setup.SecondaryEngineType
{
	byte superval[6];

	//Update Childvalue (Enum)
	byte thisval; // SecondaryEngineType
	thisval = 0x0f & getValue(this);

    // Update superval
	getValue(P_ASG_15_1_0_14, superval);
	superval[3]= superval[3]&0xf0;
	superval[3]= superval[3]|thisval;
	putValue(P_ASG_15_1_0_14,superval);
}

on envVar P_ASG_15_1_0_14_5_0
{
	byte bitval;
	//thisval steht hier fuer den bitfield-wert, 
	//aus Generierungsgruenden hier keine einheitliche Bezeichnung moeglich.
	byte thisval; // FunctionSupport
	bitval= getValue(this);
	thisval = getValue(P_ASG_15_1_0_14_5);
	thisval = thisval&~(1<<0)|(bitval<<0);
	putValue(P_ASG_15_1_0_14_5,thisval);
}

on envVar P_ASG_15_1_0_14_5 // FSG_Setup.FunctionSupport
{
	byte superval[6];

	//Update Childvalue (BitField)
	byte mask=0x01;
	int i = 0;
	byte thisval; // FunctionSupport
	thisval = getValue(this);
	if(thisval&(mask<<0))
		putValue(P_ASG_15_1_0_14_5_0, 1);
	else
		putValue(P_ASG_15_1_0_14_5_0, 0);

    // Update superval
	getValue(P_ASG_15_1_0_14, superval);
	superval[4]=thisval;
	putValue(P_ASG_15_1_0_14,superval);
}

// Ueberwachung der Darstellungsvariable der Range.
on envVar P_ASG_15_1_0_14_6_range // FSG_Setup.Extension1 
{
	@P_ASG_15_1_0_14_6 = @P_ASG_15_1_0_14_6_range - (0); // slider = range - min
}

on envVar P_ASG_15_1_0_14_6 // FSG_Setup.Extension1
{
	byte superval[6];

	//Update Childvalue (Number)
	byte thisval; // Extension1
	float slider_value;

	slider_value = 0; // Konstanter Parameter.
	@P_ASG_15_1_0_14_6_range = slider_value + (0); // real value := slider value + range min.
	thisval = (byte)round((slider_value + (0) - (0)) / (1.0), 1); // bus value := (slider value + min - offset) / step.

    // Update superval
	getValue(P_ASG_15_1_0_14, superval);
	superval[5]=thisval;
	putValue(P_ASG_15_1_0_14,superval);
}

on envVar P_ASG_15_1_0_15Get_BTN
{
 if (P_ASG_15_1_0_15Get_BTN_already_pressed == 0)
  {
       putValue(P_ASG_15_1_0_15_ErrCode,0);
       SetControlBackColor(panel_name,"errField_P_ASG_15_1_0_15",MakeRGB(255,255,255));
       P_ASG_15_1_0_15Get_BTN_already_pressed = 1;
 }
 else
 {
       Request_Void(LSGID, P_ASG_15_1_0_15_ID, DataGet_REQ); 
       P_ASG_15_1_0_15Get_BTN_already_pressed = 0;
 }
}
on envVar P_ASG_15_1_0_15 // bus value of FSG_OperationState (15).
{
	// opcodes: Error-Status
	byte param1; // OP_State
	// DATATYPE_UINTXX
	param1 = getValue(P_ASG_15_1_0_15);
	putValue(P_ASG_15_1_0_15_1, param1);
}

on envVar P_ASG_15_1_0_15_1 // FSG_OperationState.OP_State
{
	byte superval;

	//Update Childvalue (Enum)
	byte thisval; // OP_State
	thisval = getValue(this);

    // Update superval
	superval = getValue(P_ASG_15_1_0_15);
	superval = thisval;
	putValue(P_ASG_15_1_0_15,superval);
}

on envVar P_ASG_15_1_0_16Get_BTN
{
 if (P_ASG_15_1_0_16Get_BTN_already_pressed == 0)
  {
       putValue(P_ASG_15_1_0_16_ErrCode,0);
       SetControlBackColor(panel_name,"errField_P_ASG_15_1_0_16",MakeRGB(255,255,255));
       P_ASG_15_1_0_16Get_BTN_already_pressed = 1;
 }
 else
 {
       Request_Void(LSGID, P_ASG_15_1_0_16_ID, DataGet_REQ); 
       P_ASG_15_1_0_16Get_BTN_already_pressed = 0;
 }
}
on envVar P_ASG_15_1_0_16SetGet_BTN
{
	byte BAPTemp[9];
    if (P_ASG_15_1_0_16SetGet_BTN_already_pressed == 0)
    {
       putValue(P_ASG_15_1_0_16_ErrCode,0);
       SetControlBackColor(panel_name,"errField_P_ASG_15_1_0_16",MakeRGB(255,255,255));
       P_ASG_15_1_0_16SetGet_BTN_already_pressed = 1;
    }
    else
    {
	   P_ASG_15_1_0_16_BuildFct();
       getValue(P_ASG_15_1_0_16, BAPTemp);
       Request_ByteSequence(LSGID, P_ASG_15_1_0_16_ID, DataSetGet_REQ, BAPTemp, getValueSize(P_ASG_15_1_0_16));
       if(getValue(P_ASG_15_1_0_16_IntTlgEn)) //getValue(IT))
       {
         intertelegram_err(P_ASG_15_1_0_16_ID);
       }
       if(getValue(P_ASG_15_1_0_16_SegmEn))   //getvalue(SG)
       {
         sequence_err(P_ASG_15_1_0_16_ID,elCount(BAPTemp));
       }
       P_ASG_15_1_0_16SetGet_BTN_already_pressed = 0;
    }
}
// Man darf gleichzeitig nur Checkbox fuer SegmError oder IntertelegramError aktiviert werden
on envVar P_ASG_15_1_0_16_IntTlgEn
{
       if(getValue(this)) 
       {
           putValue(P_ASG_15_1_0_16_SegmEn,0);
           intertelegram_err(P_ASG_15_1_0_16_ID);
       }
       else
       {
           intertelegram_err_off(P_ASG_15_1_0_16_ID);
       }
}
// Man darf gleichzeitig nur Checkbox fuer SegmError oder IntertelegramError aktiviert werden
on envVar P_ASG_15_1_0_16_SegmEn
{
       if(getValue(this)) 
       {
           putValue(P_ASG_15_1_0_16_IntTlgEn,0);
           sequence_err(P_ASG_15_1_0_16_ID,getValueSize(P_ASG_15_1_0_16_SegmEn));
       }
       else
       {
              sequence_err_off(P_ASG_15_1_0_16_ID);
       }
}
on envVar P_ASG_15_1_0_16 // bus value of DisplayConfiguration (16).
{
	// opcodes: Error-Status
	word param1; // ShortTermMenue
	word param2; // LongTermMenue
	word param3; // CycleMenue
	byte param4; // ExtendedMenue
	byte param5; // Extension1
	byte param6; // Extension2
	// DATATYPE_BYTESEQUENCE / DATATYPE_FIXEDBYTESEQUENCE
	int i;
	byte superval[9];
	int currentPos;
	currentPos = 0;
	for( i = 0; i < 9; i++ ) {
		superval[i] = 0;
	}
	getValue(P_ASG_15_1_0_16, superval);
	///////// Start param1 - UINT16 /////////
	param1 = superval[currentPos++]|(superval[currentPos++]<<8);
	putValue(P_ASG_15_1_0_16_1, param1);
	///////// Start param2 - UINT16 /////////
	param2 = superval[currentPos++]|(superval[currentPos++]<<8);
	putValue(P_ASG_15_1_0_16_2, param2);
	///////// Start param3 - UINT16 /////////
	param3 = superval[currentPos++]|(superval[currentPos++]<<8);
	putValue(P_ASG_15_1_0_16_3, param3);
	///////// Start param4 - UINT8 /////////
	param4 = superval[currentPos++];
	putValue(P_ASG_15_1_0_16_4, param4);
	///////// Start param5 - UINT8 /////////
	param5 = superval[currentPos++];
	putValue(P_ASG_15_1_0_16_5, round((param5 * 1.0) - (0) + (0), 1.0));
	///////// Start param6 - UINT8 /////////
	param6 = superval[currentPos++];
	putValue(P_ASG_15_1_0_16_6, round((param6 * 1.0) - (0) + (0), 1.0));
}

// Updates the bus value field and other dependencies.
P_ASG_15_1_0_16_BuildFct()
{
	word param1; // ShortTermMenue
	word param2; // LongTermMenue
	word param3; // CycleMenue
	byte param4; // ExtendedMenue
	byte param5; // Extension1
	byte param6; // Extension2

	int i;
	byte superval[9];
	int currentPos;
	currentPos = 0;
// gen_BuildFunc_SetSuperVals 
	param1 = getValue(P_ASG_15_1_0_16_1);
	@P_ASG_15_1_0_16_1_0 = (param1 & 1) > 0;
	@P_ASG_15_1_0_16_1_1 = (param1 & 2) > 0;
	@P_ASG_15_1_0_16_1_2 = (param1 & 4) > 0;
	@P_ASG_15_1_0_16_1_3 = (param1 & 8) > 0;
	@P_ASG_15_1_0_16_1_4 = (param1 & 16) > 0;
	@P_ASG_15_1_0_16_1_5 = (param1 & 32) > 0;
	@P_ASG_15_1_0_16_1_6 = (param1 & 64) > 0;
	@P_ASG_15_1_0_16_1_7 = (param1 & 128) > 0;
	@P_ASG_15_1_0_16_1_8 = (param1 & 256) > 0;
	@P_ASG_15_1_0_16_1_9 = (param1 & 512) > 0;
	@P_ASG_15_1_0_16_1_10 = (param1 & 1024) > 0;
	@P_ASG_15_1_0_16_1_11 = (param1 & 2048) > 0;
	@P_ASG_15_1_0_16_1_12 = (param1 & 4096) > 0;
	@P_ASG_15_1_0_16_1_13 = (param1 & 8192) > 0;
	@P_ASG_15_1_0_16_1_14 = (param1 & 16384) > 0;
	superval[currentPos++]=param1&0x00ff;
	superval[currentPos++]=(param1&0xff00)>>8;
// gen_BuildFunc_SetSuperVals 
	param2 = getValue(P_ASG_15_1_0_16_2);
	@P_ASG_15_1_0_16_2_0 = (param2 & 1) > 0;
	@P_ASG_15_1_0_16_2_1 = (param2 & 2) > 0;
	@P_ASG_15_1_0_16_2_2 = (param2 & 4) > 0;
	@P_ASG_15_1_0_16_2_3 = (param2 & 8) > 0;
	@P_ASG_15_1_0_16_2_4 = (param2 & 16) > 0;
	@P_ASG_15_1_0_16_2_5 = (param2 & 32) > 0;
	@P_ASG_15_1_0_16_2_6 = (param2 & 64) > 0;
	@P_ASG_15_1_0_16_2_7 = (param2 & 128) > 0;
	@P_ASG_15_1_0_16_2_8 = (param2 & 256) > 0;
	@P_ASG_15_1_0_16_2_9 = (param2 & 512) > 0;
	@P_ASG_15_1_0_16_2_10 = (param2 & 1024) > 0;
	@P_ASG_15_1_0_16_2_11 = (param2 & 2048) > 0;
	@P_ASG_15_1_0_16_2_12 = (param2 & 4096) > 0;
	@P_ASG_15_1_0_16_2_13 = (param2 & 8192) > 0;
	@P_ASG_15_1_0_16_2_14 = (param2 & 16384) > 0;
	superval[currentPos++]=param2&0x00ff;
	superval[currentPos++]=(param2&0xff00)>>8;
// gen_BuildFunc_SetSuperVals 
	param3 = getValue(P_ASG_15_1_0_16_3);
	@P_ASG_15_1_0_16_3_0 = (param3 & 1) > 0;
	@P_ASG_15_1_0_16_3_1 = (param3 & 2) > 0;
	@P_ASG_15_1_0_16_3_2 = (param3 & 4) > 0;
	@P_ASG_15_1_0_16_3_3 = (param3 & 8) > 0;
	@P_ASG_15_1_0_16_3_4 = (param3 & 16) > 0;
	@P_ASG_15_1_0_16_3_5 = (param3 & 32) > 0;
	@P_ASG_15_1_0_16_3_6 = (param3 & 64) > 0;
	@P_ASG_15_1_0_16_3_7 = (param3 & 128) > 0;
	@P_ASG_15_1_0_16_3_8 = (param3 & 256) > 0;
	@P_ASG_15_1_0_16_3_9 = (param3 & 512) > 0;
	@P_ASG_15_1_0_16_3_10 = (param3 & 1024) > 0;
	@P_ASG_15_1_0_16_3_11 = (param3 & 2048) > 0;
	@P_ASG_15_1_0_16_3_12 = (param3 & 4096) > 0;
	@P_ASG_15_1_0_16_3_13 = (param3 & 8192) > 0;
	@P_ASG_15_1_0_16_3_14 = (param3 & 16384) > 0;
	superval[currentPos++]=param3&0x00ff;
	superval[currentPos++]=(param3&0xff00)>>8;
// gen_BuildFunc_SetSuperVals 
	param4 = getValue(P_ASG_15_1_0_16_4);
	@P_ASG_15_1_0_16_4_0 = (param4 & 1) > 0;
	@P_ASG_15_1_0_16_4_1 = (param4 & 2) > 0;
	@P_ASG_15_1_0_16_4_2 = (param4 & 4) > 0;
	@P_ASG_15_1_0_16_4_3 = (param4 & 8) > 0;
	@P_ASG_15_1_0_16_4_4 = (param4 & 16) > 0;
	@P_ASG_15_1_0_16_4_5 = (param4 & 32) > 0;
	@P_ASG_15_1_0_16_4_6 = (param4 & 64) > 0;
	@P_ASG_15_1_0_16_4_7 = (param4 & 128) > 0;
	superval[currentPos++]=param4;
// gen_BuildFunc_SetSuperVals 
	@P_ASG_15_1_0_16_5_range = round(@P_ASG_15_1_0_16_5 + (0), 1.0); // slider value + min = real value
	param5 = 0; // underlying parameter has constant value 0.
	superval[currentPos++]=param5;
// gen_BuildFunc_SetSuperVals 
	@P_ASG_15_1_0_16_6_range = round(@P_ASG_15_1_0_16_6 + (0), 1.0); // slider value + min = real value
	param6 = 0; // underlying parameter has constant value 0.
	superval[currentPos++]=param6;
	putValue(P_ASG_15_1_0_16, superval, currentPos);
}


on envVar P_ASG_15_1_0_16_1_0
{
	byte bitval;
	//thisval steht hier fuer den bitfield-wert, 
	//aus Generierungsgruenden hier keine einheitliche Bezeichnung moeglich.
	word thisval; // ShortTermMenue
	bitval= getValue(this);
	thisval = getValue(P_ASG_15_1_0_16_1);
	thisval = thisval&~(1<<0)|(bitval<<0);
	putValue(P_ASG_15_1_0_16_1,thisval);
}

on envVar P_ASG_15_1_0_16_1_1
{
	byte bitval;
	//thisval steht hier fuer den bitfield-wert, 
	//aus Generierungsgruenden hier keine einheitliche Bezeichnung moeglich.
	word thisval; // ShortTermMenue
	bitval= getValue(this);
	thisval = getValue(P_ASG_15_1_0_16_1);
	thisval = thisval&~(1<<1)|(bitval<<1);
	putValue(P_ASG_15_1_0_16_1,thisval);
}

on envVar P_ASG_15_1_0_16_1_2
{
	byte bitval;
	//thisval steht hier fuer den bitfield-wert, 
	//aus Generierungsgruenden hier keine einheitliche Bezeichnung moeglich.
	word thisval; // ShortTermMenue
	bitval= getValue(this);
	thisval = getValue(P_ASG_15_1_0_16_1);
	thisval = thisval&~(1<<2)|(bitval<<2);
	putValue(P_ASG_15_1_0_16_1,thisval);
}

on envVar P_ASG_15_1_0_16_1_3
{
	byte bitval;
	//thisval steht hier fuer den bitfield-wert, 
	//aus Generierungsgruenden hier keine einheitliche Bezeichnung moeglich.
	word thisval; // ShortTermMenue
	bitval= getValue(this);
	thisval = getValue(P_ASG_15_1_0_16_1);
	thisval = thisval&~(1<<3)|(bitval<<3);
	putValue(P_ASG_15_1_0_16_1,thisval);
}

on envVar P_ASG_15_1_0_16_1_4
{
	byte bitval;
	//thisval steht hier fuer den bitfield-wert, 
	//aus Generierungsgruenden hier keine einheitliche Bezeichnung moeglich.
	word thisval; // ShortTermMenue
	bitval= getValue(this);
	thisval = getValue(P_ASG_15_1_0_16_1);
	thisval = thisval&~(1<<4)|(bitval<<4);
	putValue(P_ASG_15_1_0_16_1,thisval);
}

on envVar P_ASG_15_1_0_16_1_5
{
	byte bitval;
	//thisval steht hier fuer den bitfield-wert, 
	//aus Generierungsgruenden hier keine einheitliche Bezeichnung moeglich.
	word thisval; // ShortTermMenue
	bitval= getValue(this);
	thisval = getValue(P_ASG_15_1_0_16_1);
	thisval = thisval&~(1<<5)|(bitval<<5);
	putValue(P_ASG_15_1_0_16_1,thisval);
}

on envVar P_ASG_15_1_0_16_1_6
{
	byte bitval;
	//thisval steht hier fuer den bitfield-wert, 
	//aus Generierungsgruenden hier keine einheitliche Bezeichnung moeglich.
	word thisval; // ShortTermMenue
	bitval= getValue(this);
	thisval = getValue(P_ASG_15_1_0_16_1);
	thisval = thisval&~(1<<6)|(bitval<<6);
	putValue(P_ASG_15_1_0_16_1,thisval);
}

on envVar P_ASG_15_1_0_16_1_7
{
	byte bitval;
	//thisval steht hier fuer den bitfield-wert, 
	//aus Generierungsgruenden hier keine einheitliche Bezeichnung moeglich.
	word thisval; // ShortTermMenue
	bitval= getValue(this);
	thisval = getValue(P_ASG_15_1_0_16_1);
	thisval = thisval&~(1<<7)|(bitval<<7);
	putValue(P_ASG_15_1_0_16_1,thisval);
}

on envVar P_ASG_15_1_0_16_1_8
{
	byte bitval;
	//thisval steht hier fuer den bitfield-wert, 
	//aus Generierungsgruenden hier keine einheitliche Bezeichnung moeglich.
	word thisval; // ShortTermMenue
	bitval= getValue(this);
	thisval = getValue(P_ASG_15_1_0_16_1);
	thisval = thisval&~(1<<8)|(bitval<<8);
	putValue(P_ASG_15_1_0_16_1,thisval);
}

on envVar P_ASG_15_1_0_16_1_9
{
	byte bitval;
	//thisval steht hier fuer den bitfield-wert, 
	//aus Generierungsgruenden hier keine einheitliche Bezeichnung moeglich.
	word thisval; // ShortTermMenue
	bitval= getValue(this);
	thisval = getValue(P_ASG_15_1_0_16_1);
	thisval = thisval&~(1<<9)|(bitval<<9);
	putValue(P_ASG_15_1_0_16_1,thisval);
}

on envVar P_ASG_15_1_0_16_1_10
{
	byte bitval;
	//thisval steht hier fuer den bitfield-wert, 
	//aus Generierungsgruenden hier keine einheitliche Bezeichnung moeglich.
	word thisval; // ShortTermMenue
	bitval= getValue(this);
	thisval = getValue(P_ASG_15_1_0_16_1);
	thisval = thisval&~(1<<10)|(bitval<<10);
	putValue(P_ASG_15_1_0_16_1,thisval);
}

on envVar P_ASG_15_1_0_16_1_11
{
	byte bitval;
	//thisval steht hier fuer den bitfield-wert, 
	//aus Generierungsgruenden hier keine einheitliche Bezeichnung moeglich.
	word thisval; // ShortTermMenue
	bitval= getValue(this);
	thisval = getValue(P_ASG_15_1_0_16_1);
	thisval = thisval&~(1<<11)|(bitval<<11);
	putValue(P_ASG_15_1_0_16_1,thisval);
}

on envVar P_ASG_15_1_0_16_1_12
{
	byte bitval;
	//thisval steht hier fuer den bitfield-wert, 
	//aus Generierungsgruenden hier keine einheitliche Bezeichnung moeglich.
	word thisval; // ShortTermMenue
	bitval= getValue(this);
	thisval = getValue(P_ASG_15_1_0_16_1);
	thisval = thisval&~(1<<12)|(bitval<<12);
	putValue(P_ASG_15_1_0_16_1,thisval);
}

on envVar P_ASG_15_1_0_16_1_13
{
	byte bitval;
	//thisval steht hier fuer den bitfield-wert, 
	//aus Generierungsgruenden hier keine einheitliche Bezeichnung moeglich.
	word thisval; // ShortTermMenue
	bitval= getValue(this);
	thisval = getValue(P_ASG_15_1_0_16_1);
	thisval = thisval&~(1<<13)|(bitval<<13);
	putValue(P_ASG_15_1_0_16_1,thisval);
}

on envVar P_ASG_15_1_0_16_1_14
{
	byte bitval;
	//thisval steht hier fuer den bitfield-wert, 
	//aus Generierungsgruenden hier keine einheitliche Bezeichnung moeglich.
	word thisval; // ShortTermMenue
	bitval= getValue(this);
	thisval = getValue(P_ASG_15_1_0_16_1);
	thisval = thisval&~(1<<14)|(bitval<<14);
	putValue(P_ASG_15_1_0_16_1,thisval);
}

on envVar P_ASG_15_1_0_16_1 // DisplayConfiguration.ShortTermMenue
{
	P_ASG_15_1_0_16_BuildFct();
}

on envVar P_ASG_15_1_0_16_2_0
{
	byte bitval;
	//thisval steht hier fuer den bitfield-wert, 
	//aus Generierungsgruenden hier keine einheitliche Bezeichnung moeglich.
	word thisval; // LongTermMenue
	bitval= getValue(this);
	thisval = getValue(P_ASG_15_1_0_16_2);
	thisval = thisval&~(1<<0)|(bitval<<0);
	putValue(P_ASG_15_1_0_16_2,thisval);
}

on envVar P_ASG_15_1_0_16_2_1
{
	byte bitval;
	//thisval steht hier fuer den bitfield-wert, 
	//aus Generierungsgruenden hier keine einheitliche Bezeichnung moeglich.
	word thisval; // LongTermMenue
	bitval= getValue(this);
	thisval = getValue(P_ASG_15_1_0_16_2);
	thisval = thisval&~(1<<1)|(bitval<<1);
	putValue(P_ASG_15_1_0_16_2,thisval);
}

on envVar P_ASG_15_1_0_16_2_2
{
	byte bitval;
	//thisval steht hier fuer den bitfield-wert, 
	//aus Generierungsgruenden hier keine einheitliche Bezeichnung moeglich.
	word thisval; // LongTermMenue
	bitval= getValue(this);
	thisval = getValue(P_ASG_15_1_0_16_2);
	thisval = thisval&~(1<<2)|(bitval<<2);
	putValue(P_ASG_15_1_0_16_2,thisval);
}

on envVar P_ASG_15_1_0_16_2_3
{
	byte bitval;
	//thisval steht hier fuer den bitfield-wert, 
	//aus Generierungsgruenden hier keine einheitliche Bezeichnung moeglich.
	word thisval; // LongTermMenue
	bitval= getValue(this);
	thisval = getValue(P_ASG_15_1_0_16_2);
	thisval = thisval&~(1<<3)|(bitval<<3);
	putValue(P_ASG_15_1_0_16_2,thisval);
}

on envVar P_ASG_15_1_0_16_2_4
{
	byte bitval;
	//thisval steht hier fuer den bitfield-wert, 
	//aus Generierungsgruenden hier keine einheitliche Bezeichnung moeglich.
	word thisval; // LongTermMenue
	bitval= getValue(this);
	thisval = getValue(P_ASG_15_1_0_16_2);
	thisval = thisval&~(1<<4)|(bitval<<4);
	putValue(P_ASG_15_1_0_16_2,thisval);
}

on envVar P_ASG_15_1_0_16_2_5
{
	byte bitval;
	//thisval steht hier fuer den bitfield-wert, 
	//aus Generierungsgruenden hier keine einheitliche Bezeichnung moeglich.
	word thisval; // LongTermMenue
	bitval= getValue(this);
	thisval = getValue(P_ASG_15_1_0_16_2);
	thisval = thisval&~(1<<5)|(bitval<<5);
	putValue(P_ASG_15_1_0_16_2,thisval);
}

on envVar P_ASG_15_1_0_16_2_6
{
	byte bitval;
	//thisval steht hier fuer den bitfield-wert, 
	//aus Generierungsgruenden hier keine einheitliche Bezeichnung moeglich.
	word thisval; // LongTermMenue
	bitval= getValue(this);
	thisval = getValue(P_ASG_15_1_0_16_2);
	thisval = thisval&~(1<<6)|(bitval<<6);
	putValue(P_ASG_15_1_0_16_2,thisval);
}

on envVar P_ASG_15_1_0_16_2_7
{
	byte bitval;
	//thisval steht hier fuer den bitfield-wert, 
	//aus Generierungsgruenden hier keine einheitliche Bezeichnung moeglich.
	word thisval; // LongTermMenue
	bitval= getValue(this);
	thisval = getValue(P_ASG_15_1_0_16_2);
	thisval = thisval&~(1<<7)|(bitval<<7);
	putValue(P_ASG_15_1_0_16_2,thisval);
}

on envVar P_ASG_15_1_0_16_2_8
{
	byte bitval;
	//thisval steht hier fuer den bitfield-wert, 
	//aus Generierungsgruenden hier keine einheitliche Bezeichnung moeglich.
	word thisval; // LongTermMenue
	bitval= getValue(this);
	thisval = getValue(P_ASG_15_1_0_16_2);
	thisval = thisval&~(1<<8)|(bitval<<8);
	putValue(P_ASG_15_1_0_16_2,thisval);
}

on envVar P_ASG_15_1_0_16_2_9
{
	byte bitval;
	//thisval steht hier fuer den bitfield-wert, 
	//aus Generierungsgruenden hier keine einheitliche Bezeichnung moeglich.
	word thisval; // LongTermMenue
	bitval= getValue(this);
	thisval = getValue(P_ASG_15_1_0_16_2);
	thisval = thisval&~(1<<9)|(bitval<<9);
	putValue(P_ASG_15_1_0_16_2,thisval);
}

on envVar P_ASG_15_1_0_16_2_10
{
	byte bitval;
	//thisval steht hier fuer den bitfield-wert, 
	//aus Generierungsgruenden hier keine einheitliche Bezeichnung moeglich.
	word thisval; // LongTermMenue
	bitval= getValue(this);
	thisval = getValue(P_ASG_15_1_0_16_2);
	thisval = thisval&~(1<<10)|(bitval<<10);
	putValue(P_ASG_15_1_0_16_2,thisval);
}

on envVar P_ASG_15_1_0_16_2_11
{
	byte bitval;
	//thisval steht hier fuer den bitfield-wert, 
	//aus Generierungsgruenden hier keine einheitliche Bezeichnung moeglich.
	word thisval; // LongTermMenue
	bitval= getValue(this);
	thisval = getValue(P_ASG_15_1_0_16_2);
	thisval = thisval&~(1<<11)|(bitval<<11);
	putValue(P_ASG_15_1_0_16_2,thisval);
}

on envVar P_ASG_15_1_0_16_2_12
{
	byte bitval;
	//thisval steht hier fuer den bitfield-wert, 
	//aus Generierungsgruenden hier keine einheitliche Bezeichnung moeglich.
	word thisval; // LongTermMenue
	bitval= getValue(this);
	thisval = getValue(P_ASG_15_1_0_16_2);
	thisval = thisval&~(1<<12)|(bitval<<12);
	putValue(P_ASG_15_1_0_16_2,thisval);
}

on envVar P_ASG_15_1_0_16_2_13
{
	byte bitval;
	//thisval steht hier fuer den bitfield-wert, 
	//aus Generierungsgruenden hier keine einheitliche Bezeichnung moeglich.
	word thisval; // LongTermMenue
	bitval= getValue(this);
	thisval = getValue(P_ASG_15_1_0_16_2);
	thisval = thisval&~(1<<13)|(bitval<<13);
	putValue(P_ASG_15_1_0_16_2,thisval);
}

on envVar P_ASG_15_1_0_16_2_14
{
	byte bitval;
	//thisval steht hier fuer den bitfield-wert, 
	//aus Generierungsgruenden hier keine einheitliche Bezeichnung moeglich.
	word thisval; // LongTermMenue
	bitval= getValue(this);
	thisval = getValue(P_ASG_15_1_0_16_2);
	thisval = thisval&~(1<<14)|(bitval<<14);
	putValue(P_ASG_15_1_0_16_2,thisval);
}

on envVar P_ASG_15_1_0_16_2 // DisplayConfiguration.LongTermMenue
{
	P_ASG_15_1_0_16_BuildFct();
}

on envVar P_ASG_15_1_0_16_3_0
{
	byte bitval;
	//thisval steht hier fuer den bitfield-wert, 
	//aus Generierungsgruenden hier keine einheitliche Bezeichnung moeglich.
	word thisval; // CycleMenue
	bitval= getValue(this);
	thisval = getValue(P_ASG_15_1_0_16_3);
	thisval = thisval&~(1<<0)|(bitval<<0);
	putValue(P_ASG_15_1_0_16_3,thisval);
}

on envVar P_ASG_15_1_0_16_3_1
{
	byte bitval;
	//thisval steht hier fuer den bitfield-wert, 
	//aus Generierungsgruenden hier keine einheitliche Bezeichnung moeglich.
	word thisval; // CycleMenue
	bitval= getValue(this);
	thisval = getValue(P_ASG_15_1_0_16_3);
	thisval = thisval&~(1<<1)|(bitval<<1);
	putValue(P_ASG_15_1_0_16_3,thisval);
}

on envVar P_ASG_15_1_0_16_3_2
{
	byte bitval;
	//thisval steht hier fuer den bitfield-wert, 
	//aus Generierungsgruenden hier keine einheitliche Bezeichnung moeglich.
	word thisval; // CycleMenue
	bitval= getValue(this);
	thisval = getValue(P_ASG_15_1_0_16_3);
	thisval = thisval&~(1<<2)|(bitval<<2);
	putValue(P_ASG_15_1_0_16_3,thisval);
}

on envVar P_ASG_15_1_0_16_3_3
{
	byte bitval;
	//thisval steht hier fuer den bitfield-wert, 
	//aus Generierungsgruenden hier keine einheitliche Bezeichnung moeglich.
	word thisval; // CycleMenue
	bitval= getValue(this);
	thisval = getValue(P_ASG_15_1_0_16_3);
	thisval = thisval&~(1<<3)|(bitval<<3);
	putValue(P_ASG_15_1_0_16_3,thisval);
}

on envVar P_ASG_15_1_0_16_3_4
{
	byte bitval;
	//thisval steht hier fuer den bitfield-wert, 
	//aus Generierungsgruenden hier keine einheitliche Bezeichnung moeglich.
	word thisval; // CycleMenue
	bitval= getValue(this);
	thisval = getValue(P_ASG_15_1_0_16_3);
	thisval = thisval&~(1<<4)|(bitval<<4);
	putValue(P_ASG_15_1_0_16_3,thisval);
}

on envVar P_ASG_15_1_0_16_3_5
{
	byte bitval;
	//thisval steht hier fuer den bitfield-wert, 
	//aus Generierungsgruenden hier keine einheitliche Bezeichnung moeglich.
	word thisval; // CycleMenue
	bitval= getValue(this);
	thisval = getValue(P_ASG_15_1_0_16_3);
	thisval = thisval&~(1<<5)|(bitval<<5);
	putValue(P_ASG_15_1_0_16_3,thisval);
}

on envVar P_ASG_15_1_0_16_3_6
{
	byte bitval;
	//thisval steht hier fuer den bitfield-wert, 
	//aus Generierungsgruenden hier keine einheitliche Bezeichnung moeglich.
	word thisval; // CycleMenue
	bitval= getValue(this);
	thisval = getValue(P_ASG_15_1_0_16_3);
	thisval = thisval&~(1<<6)|(bitval<<6);
	putValue(P_ASG_15_1_0_16_3,thisval);
}

on envVar P_ASG_15_1_0_16_3_7
{
	byte bitval;
	//thisval steht hier fuer den bitfield-wert, 
	//aus Generierungsgruenden hier keine einheitliche Bezeichnung moeglich.
	word thisval; // CycleMenue
	bitval= getValue(this);
	thisval = getValue(P_ASG_15_1_0_16_3);
	thisval = thisval&~(1<<7)|(bitval<<7);
	putValue(P_ASG_15_1_0_16_3,thisval);
}

on envVar P_ASG_15_1_0_16_3_8
{
	byte bitval;
	//thisval steht hier fuer den bitfield-wert, 
	//aus Generierungsgruenden hier keine einheitliche Bezeichnung moeglich.
	word thisval; // CycleMenue
	bitval= getValue(this);
	thisval = getValue(P_ASG_15_1_0_16_3);
	thisval = thisval&~(1<<8)|(bitval<<8);
	putValue(P_ASG_15_1_0_16_3,thisval);
}

on envVar P_ASG_15_1_0_16_3_9
{
	byte bitval;
	//thisval steht hier fuer den bitfield-wert, 
	//aus Generierungsgruenden hier keine einheitliche Bezeichnung moeglich.
	word thisval; // CycleMenue
	bitval= getValue(this);
	thisval = getValue(P_ASG_15_1_0_16_3);
	thisval = thisval&~(1<<9)|(bitval<<9);
	putValue(P_ASG_15_1_0_16_3,thisval);
}

on envVar P_ASG_15_1_0_16_3_10
{
	byte bitval;
	//thisval steht hier fuer den bitfield-wert, 
	//aus Generierungsgruenden hier keine einheitliche Bezeichnung moeglich.
	word thisval; // CycleMenue
	bitval= getValue(this);
	thisval = getValue(P_ASG_15_1_0_16_3);
	thisval = thisval&~(1<<10)|(bitval<<10);
	putValue(P_ASG_15_1_0_16_3,thisval);
}

on envVar P_ASG_15_1_0_16_3_11
{
	byte bitval;
	//thisval steht hier fuer den bitfield-wert, 
	//aus Generierungsgruenden hier keine einheitliche Bezeichnung moeglich.
	word thisval; // CycleMenue
	bitval= getValue(this);
	thisval = getValue(P_ASG_15_1_0_16_3);
	thisval = thisval&~(1<<11)|(bitval<<11);
	putValue(P_ASG_15_1_0_16_3,thisval);
}

on envVar P_ASG_15_1_0_16_3_12
{
	byte bitval;
	//thisval steht hier fuer den bitfield-wert, 
	//aus Generierungsgruenden hier keine einheitliche Bezeichnung moeglich.
	word thisval; // CycleMenue
	bitval= getValue(this);
	thisval = getValue(P_ASG_15_1_0_16_3);
	thisval = thisval&~(1<<12)|(bitval<<12);
	putValue(P_ASG_15_1_0_16_3,thisval);
}

on envVar P_ASG_15_1_0_16_3_13
{
	byte bitval;
	//thisval steht hier fuer den bitfield-wert, 
	//aus Generierungsgruenden hier keine einheitliche Bezeichnung moeglich.
	word thisval; // CycleMenue
	bitval= getValue(this);
	thisval = getValue(P_ASG_15_1_0_16_3);
	thisval = thisval&~(1<<13)|(bitval<<13);
	putValue(P_ASG_15_1_0_16_3,thisval);
}

on envVar P_ASG_15_1_0_16_3_14
{
	byte bitval;
	//thisval steht hier fuer den bitfield-wert, 
	//aus Generierungsgruenden hier keine einheitliche Bezeichnung moeglich.
	word thisval; // CycleMenue
	bitval= getValue(this);
	thisval = getValue(P_ASG_15_1_0_16_3);
	thisval = thisval&~(1<<14)|(bitval<<14);
	putValue(P_ASG_15_1_0_16_3,thisval);
}

on envVar P_ASG_15_1_0_16_3 // DisplayConfiguration.CycleMenue
{
	P_ASG_15_1_0_16_BuildFct();
}

on envVar P_ASG_15_1_0_16_4_0
{
	byte bitval;
	//thisval steht hier fuer den bitfield-wert, 
	//aus Generierungsgruenden hier keine einheitliche Bezeichnung moeglich.
	byte thisval; // ExtendedMenue
	bitval= getValue(this);
	thisval = getValue(P_ASG_15_1_0_16_4);
	thisval = thisval&~(1<<0)|(bitval<<0);
	putValue(P_ASG_15_1_0_16_4,thisval);
}

on envVar P_ASG_15_1_0_16_4_1
{
	byte bitval;
	//thisval steht hier fuer den bitfield-wert, 
	//aus Generierungsgruenden hier keine einheitliche Bezeichnung moeglich.
	byte thisval; // ExtendedMenue
	bitval= getValue(this);
	thisval = getValue(P_ASG_15_1_0_16_4);
	thisval = thisval&~(1<<1)|(bitval<<1);
	putValue(P_ASG_15_1_0_16_4,thisval);
}

on envVar P_ASG_15_1_0_16_4_2
{
	byte bitval;
	//thisval steht hier fuer den bitfield-wert, 
	//aus Generierungsgruenden hier keine einheitliche Bezeichnung moeglich.
	byte thisval; // ExtendedMenue
	bitval= getValue(this);
	thisval = getValue(P_ASG_15_1_0_16_4);
	thisval = thisval&~(1<<2)|(bitval<<2);
	putValue(P_ASG_15_1_0_16_4,thisval);
}

on envVar P_ASG_15_1_0_16_4_3
{
	byte bitval;
	//thisval steht hier fuer den bitfield-wert, 
	//aus Generierungsgruenden hier keine einheitliche Bezeichnung moeglich.
	byte thisval; // ExtendedMenue
	bitval= getValue(this);
	thisval = getValue(P_ASG_15_1_0_16_4);
	thisval = thisval&~(1<<3)|(bitval<<3);
	putValue(P_ASG_15_1_0_16_4,thisval);
}

on envVar P_ASG_15_1_0_16_4_4
{
	byte bitval;
	//thisval steht hier fuer den bitfield-wert, 
	//aus Generierungsgruenden hier keine einheitliche Bezeichnung moeglich.
	byte thisval; // ExtendedMenue
	bitval= getValue(this);
	thisval = getValue(P_ASG_15_1_0_16_4);
	thisval = thisval&~(1<<4)|(bitval<<4);
	putValue(P_ASG_15_1_0_16_4,thisval);
}

on envVar P_ASG_15_1_0_16_4_5
{
	byte bitval;
	//thisval steht hier fuer den bitfield-wert, 
	//aus Generierungsgruenden hier keine einheitliche Bezeichnung moeglich.
	byte thisval; // ExtendedMenue
	bitval= getValue(this);
	thisval = getValue(P_ASG_15_1_0_16_4);
	thisval = thisval&~(1<<5)|(bitval<<5);
	putValue(P_ASG_15_1_0_16_4,thisval);
}

on envVar P_ASG_15_1_0_16_4_6
{
	byte bitval;
	//thisval steht hier fuer den bitfield-wert, 
	//aus Generierungsgruenden hier keine einheitliche Bezeichnung moeglich.
	byte thisval; // ExtendedMenue
	bitval= getValue(this);
	thisval = getValue(P_ASG_15_1_0_16_4);
	thisval = thisval&~(1<<6)|(bitval<<6);
	putValue(P_ASG_15_1_0_16_4,thisval);
}

on envVar P_ASG_15_1_0_16_4_7
{
	byte bitval;
	//thisval steht hier fuer den bitfield-wert, 
	//aus Generierungsgruenden hier keine einheitliche Bezeichnung moeglich.
	byte thisval; // ExtendedMenue
	bitval= getValue(this);
	thisval = getValue(P_ASG_15_1_0_16_4);
	thisval = thisval&~(1<<7)|(bitval<<7);
	putValue(P_ASG_15_1_0_16_4,thisval);
}

on envVar P_ASG_15_1_0_16_4 // DisplayConfiguration.ExtendedMenue
{
	P_ASG_15_1_0_16_BuildFct();
}

// Ueberwachung der Darstellungsvariable der Range.
on envVar P_ASG_15_1_0_16_5_range // DisplayConfiguration.Extension1 
{
	@P_ASG_15_1_0_16_5 = @P_ASG_15_1_0_16_5_range - (0); // slider = range - min
}

on envVar P_ASG_15_1_0_16_5 // DisplayConfiguration.Extension1
{
	P_ASG_15_1_0_16_BuildFct();
}

// Ueberwachung der Darstellungsvariable der Range.
on envVar P_ASG_15_1_0_16_6_range // DisplayConfiguration.Extension2 
{
	@P_ASG_15_1_0_16_6 = @P_ASG_15_1_0_16_6_range - (0); // slider = range - min
}

on envVar P_ASG_15_1_0_16_6 // DisplayConfiguration.Extension2
{
	P_ASG_15_1_0_16_BuildFct();
}

on envVar M_ASG_15_1_0_17StartResult_BTN
{
    if (M_ASG_15_1_0_17StartResult_BTN_already_pressed == 0)
    {
        putValue(M_ASG_15_1_0_17_ErrCode,0);
        SetControlBackColor(panel_name,"errField_M_ASG_15_1_0_17",MakeRGB(255,255,255));
        M_ASG_15_1_0_17StartResult_BTN_already_pressed = 1;
    }
    else
    {
        Request_Int8(LSGID, M_ASG_15_1_0_17_ID, StartResult_REQ, getValue(M_ASG_15_1_0_17_Start));
        putValue(M_ASG_15_1_0_17_State, "Started");
        M_ASG_15_1_0_17StartResult_BTN_already_pressed = 0;
    }
}
on envVar M_ASG_15_1_0_17_Result // bus value of Reset (17).
{
	// opcodes: Error-Processing-Result
	byte param1; // Result
	// DATATYPE_UINTXX
	param1 = getValue(M_ASG_15_1_0_17_Result);
	putValue(M_ASG_15_1_0_17_Result_1, param1);
}

on envVar M_ASG_15_1_0_17_Result_1_0
{
	byte bitval;
	//thisval steht hier fuer den bitfield-wert, 
	//aus Generierungsgruenden hier keine einheitliche Bezeichnung moeglich.
	byte thisval; // Result
	bitval= getValue(this);
	thisval = getValue(M_ASG_15_1_0_17_Result_1);
	thisval = thisval&~(1<<0)|(bitval<<0);
	putValue(M_ASG_15_1_0_17_Result_1,thisval);
}

on envVar M_ASG_15_1_0_17_Result_1 // Reset.Result
{
	byte superval;

	//Update Childvalue (BitField)
	byte mask=0x01;
	int i = 0;
	byte thisval; // Result
	thisval = getValue(this);
	if(thisval&(mask<<0))
		putValue(M_ASG_15_1_0_17_Result_1_0, 1);
	else
		putValue(M_ASG_15_1_0_17_Result_1_0, 0);

    // Update superval
	superval = getValue(M_ASG_15_1_0_17_Result);
	superval = thisval;
	putValue(M_ASG_15_1_0_17_Result,superval);
}

on envVar M_ASG_15_1_0_17_Processing // bus value of Reset (17).
{
	// opcodes: Error-Processing-Result
	byte param1; // Menue
	// DATATYPE_UINTXX
	param1 = getValue(M_ASG_15_1_0_17_Processing);
	putValue(M_ASG_15_1_0_17_Processing_1, param1);
}

on envVar M_ASG_15_1_0_17_Processing_1_1
{
	byte bitval;
	//thisval steht hier fuer den bitfield-wert, 
	//aus Generierungsgruenden hier keine einheitliche Bezeichnung moeglich.
	byte thisval; // Menue
	bitval= getValue(this);
	thisval = getValue(M_ASG_15_1_0_17_Processing_1);
	thisval = thisval&~(1<<1)|(bitval<<1);
	putValue(M_ASG_15_1_0_17_Processing_1,thisval);
}

on envVar M_ASG_15_1_0_17_Processing_1_2
{
	byte bitval;
	//thisval steht hier fuer den bitfield-wert, 
	//aus Generierungsgruenden hier keine einheitliche Bezeichnung moeglich.
	byte thisval; // Menue
	bitval= getValue(this);
	thisval = getValue(M_ASG_15_1_0_17_Processing_1);
	thisval = thisval&~(1<<2)|(bitval<<2);
	putValue(M_ASG_15_1_0_17_Processing_1,thisval);
}

on envVar M_ASG_15_1_0_17_Processing_1_3
{
	byte bitval;
	//thisval steht hier fuer den bitfield-wert, 
	//aus Generierungsgruenden hier keine einheitliche Bezeichnung moeglich.
	byte thisval; // Menue
	bitval= getValue(this);
	thisval = getValue(M_ASG_15_1_0_17_Processing_1);
	thisval = thisval&~(1<<3)|(bitval<<3);
	putValue(M_ASG_15_1_0_17_Processing_1,thisval);
}

on envVar M_ASG_15_1_0_17_Processing_1_4
{
	byte bitval;
	//thisval steht hier fuer den bitfield-wert, 
	//aus Generierungsgruenden hier keine einheitliche Bezeichnung moeglich.
	byte thisval; // Menue
	bitval= getValue(this);
	thisval = getValue(M_ASG_15_1_0_17_Processing_1);
	thisval = thisval&~(1<<4)|(bitval<<4);
	putValue(M_ASG_15_1_0_17_Processing_1,thisval);
}

on envVar M_ASG_15_1_0_17_Processing_1_5
{
	byte bitval;
	//thisval steht hier fuer den bitfield-wert, 
	//aus Generierungsgruenden hier keine einheitliche Bezeichnung moeglich.
	byte thisval; // Menue
	bitval= getValue(this);
	thisval = getValue(M_ASG_15_1_0_17_Processing_1);
	thisval = thisval&~(1<<5)|(bitval<<5);
	putValue(M_ASG_15_1_0_17_Processing_1,thisval);
}

on envVar M_ASG_15_1_0_17_Processing_1_6
{
	byte bitval;
	//thisval steht hier fuer den bitfield-wert, 
	//aus Generierungsgruenden hier keine einheitliche Bezeichnung moeglich.
	byte thisval; // Menue
	bitval= getValue(this);
	thisval = getValue(M_ASG_15_1_0_17_Processing_1);
	thisval = thisval&~(1<<6)|(bitval<<6);
	putValue(M_ASG_15_1_0_17_Processing_1,thisval);
}

on envVar M_ASG_15_1_0_17_Processing_1_7
{
	byte bitval;
	//thisval steht hier fuer den bitfield-wert, 
	//aus Generierungsgruenden hier keine einheitliche Bezeichnung moeglich.
	byte thisval; // Menue
	bitval= getValue(this);
	thisval = getValue(M_ASG_15_1_0_17_Processing_1);
	thisval = thisval&~(1<<7)|(bitval<<7);
	putValue(M_ASG_15_1_0_17_Processing_1,thisval);
}

on envVar M_ASG_15_1_0_17_Processing_1 // Reset.Menue
{
	byte superval;

	//Update Childvalue (BitField)
	byte mask=0x01;
	int i = 0;
	byte thisval; // Menue
	thisval = getValue(this);
	if(thisval&(mask<<1))
		putValue(M_ASG_15_1_0_17_Processing_1_1, 1);
	else
		putValue(M_ASG_15_1_0_17_Processing_1_1, 0);
	if(thisval&(mask<<2))
		putValue(M_ASG_15_1_0_17_Processing_1_2, 1);
	else
		putValue(M_ASG_15_1_0_17_Processing_1_2, 0);
	if(thisval&(mask<<3))
		putValue(M_ASG_15_1_0_17_Processing_1_3, 1);
	else
		putValue(M_ASG_15_1_0_17_Processing_1_3, 0);
	if(thisval&(mask<<4))
		putValue(M_ASG_15_1_0_17_Processing_1_4, 1);
	else
		putValue(M_ASG_15_1_0_17_Processing_1_4, 0);
	if(thisval&(mask<<5))
		putValue(M_ASG_15_1_0_17_Processing_1_5, 1);
	else
		putValue(M_ASG_15_1_0_17_Processing_1_5, 0);
	if(thisval&(mask<<6))
		putValue(M_ASG_15_1_0_17_Processing_1_6, 1);
	else
		putValue(M_ASG_15_1_0_17_Processing_1_6, 0);
	if(thisval&(mask<<7))
		putValue(M_ASG_15_1_0_17_Processing_1_7, 1);
	else
		putValue(M_ASG_15_1_0_17_Processing_1_7, 0);

    // Update superval
	superval = getValue(M_ASG_15_1_0_17_Processing);
	superval = thisval;
	putValue(M_ASG_15_1_0_17_Processing,superval);
}

on envVar M_ASG_15_1_0_17_Start // bus value of Reset (17).
{
	// opcodes: StartResult
	byte param1; // Menue
	// DATATYPE_UINTXX
	param1 = getValue(M_ASG_15_1_0_17_Start);
	putValue(M_ASG_15_1_0_17_Start_1, param1);
}

on envVar M_ASG_15_1_0_17_Start_1_1
{
	byte bitval;
	//thisval steht hier fuer den bitfield-wert, 
	//aus Generierungsgruenden hier keine einheitliche Bezeichnung moeglich.
	byte thisval; // Menue
	bitval= getValue(this);
	thisval = getValue(M_ASG_15_1_0_17_Start_1);
	thisval = thisval&~(1<<1)|(bitval<<1);
	putValue(M_ASG_15_1_0_17_Start_1,thisval);
}

on envVar M_ASG_15_1_0_17_Start_1_2
{
	byte bitval;
	//thisval steht hier fuer den bitfield-wert, 
	//aus Generierungsgruenden hier keine einheitliche Bezeichnung moeglich.
	byte thisval; // Menue
	bitval= getValue(this);
	thisval = getValue(M_ASG_15_1_0_17_Start_1);
	thisval = thisval&~(1<<2)|(bitval<<2);
	putValue(M_ASG_15_1_0_17_Start_1,thisval);
}

on envVar M_ASG_15_1_0_17_Start_1_3
{
	byte bitval;
	//thisval steht hier fuer den bitfield-wert, 
	//aus Generierungsgruenden hier keine einheitliche Bezeichnung moeglich.
	byte thisval; // Menue
	bitval= getValue(this);
	thisval = getValue(M_ASG_15_1_0_17_Start_1);
	thisval = thisval&~(1<<3)|(bitval<<3);
	putValue(M_ASG_15_1_0_17_Start_1,thisval);
}

on envVar M_ASG_15_1_0_17_Start_1_4
{
	byte bitval;
	//thisval steht hier fuer den bitfield-wert, 
	//aus Generierungsgruenden hier keine einheitliche Bezeichnung moeglich.
	byte thisval; // Menue
	bitval= getValue(this);
	thisval = getValue(M_ASG_15_1_0_17_Start_1);
	thisval = thisval&~(1<<4)|(bitval<<4);
	putValue(M_ASG_15_1_0_17_Start_1,thisval);
}

on envVar M_ASG_15_1_0_17_Start_1_5
{
	byte bitval;
	//thisval steht hier fuer den bitfield-wert, 
	//aus Generierungsgruenden hier keine einheitliche Bezeichnung moeglich.
	byte thisval; // Menue
	bitval= getValue(this);
	thisval = getValue(M_ASG_15_1_0_17_Start_1);
	thisval = thisval&~(1<<5)|(bitval<<5);
	putValue(M_ASG_15_1_0_17_Start_1,thisval);
}

on envVar M_ASG_15_1_0_17_Start_1_6
{
	byte bitval;
	//thisval steht hier fuer den bitfield-wert, 
	//aus Generierungsgruenden hier keine einheitliche Bezeichnung moeglich.
	byte thisval; // Menue
	bitval= getValue(this);
	thisval = getValue(M_ASG_15_1_0_17_Start_1);
	thisval = thisval&~(1<<6)|(bitval<<6);
	putValue(M_ASG_15_1_0_17_Start_1,thisval);
}

on envVar M_ASG_15_1_0_17_Start_1_7
{
	byte bitval;
	//thisval steht hier fuer den bitfield-wert, 
	//aus Generierungsgruenden hier keine einheitliche Bezeichnung moeglich.
	byte thisval; // Menue
	bitval= getValue(this);
	thisval = getValue(M_ASG_15_1_0_17_Start_1);
	thisval = thisval&~(1<<7)|(bitval<<7);
	putValue(M_ASG_15_1_0_17_Start_1,thisval);
}

on envVar M_ASG_15_1_0_17_Start_1 // Reset.Menue
{
	byte superval;

	//Update Childvalue (BitField)
	byte mask=0x01;
	int i = 0;
	byte thisval; // Menue
	thisval = getValue(this);
	if(thisval&(mask<<1))
		putValue(M_ASG_15_1_0_17_Start_1_1, 1);
	else
		putValue(M_ASG_15_1_0_17_Start_1_1, 0);
	if(thisval&(mask<<2))
		putValue(M_ASG_15_1_0_17_Start_1_2, 1);
	else
		putValue(M_ASG_15_1_0_17_Start_1_2, 0);
	if(thisval&(mask<<3))
		putValue(M_ASG_15_1_0_17_Start_1_3, 1);
	else
		putValue(M_ASG_15_1_0_17_Start_1_3, 0);
	if(thisval&(mask<<4))
		putValue(M_ASG_15_1_0_17_Start_1_4, 1);
	else
		putValue(M_ASG_15_1_0_17_Start_1_4, 0);
	if(thisval&(mask<<5))
		putValue(M_ASG_15_1_0_17_Start_1_5, 1);
	else
		putValue(M_ASG_15_1_0_17_Start_1_5, 0);
	if(thisval&(mask<<6))
		putValue(M_ASG_15_1_0_17_Start_1_6, 1);
	else
		putValue(M_ASG_15_1_0_17_Start_1_6, 0);
	if(thisval&(mask<<7))
		putValue(M_ASG_15_1_0_17_Start_1_7, 1);
	else
		putValue(M_ASG_15_1_0_17_Start_1_7, 0);

    // Update superval
	superval = getValue(M_ASG_15_1_0_17_Start);
	superval = thisval;
	putValue(M_ASG_15_1_0_17_Start,superval);
}

on envVar P_ASG_15_1_0_18Get_BTN
{
 if (P_ASG_15_1_0_18Get_BTN_already_pressed == 0)
  {
       putValue(P_ASG_15_1_0_18_ErrCode,0);
       SetControlBackColor(panel_name,"errField_P_ASG_15_1_0_18",MakeRGB(255,255,255));
       P_ASG_15_1_0_18Get_BTN_already_pressed = 1;
 }
 else
 {
       Request_Void(LSGID, P_ASG_15_1_0_18_ID, DataGet_REQ); 
       P_ASG_15_1_0_18Get_BTN_already_pressed = 0;
 }
}
on envVar P_ASG_15_1_0_18SetGet_BTN
{
	byte BAPTemp[5];
    if (P_ASG_15_1_0_18SetGet_BTN_already_pressed == 0)
    {
       putValue(P_ASG_15_1_0_18_ErrCode,0);
       SetControlBackColor(panel_name,"errField_P_ASG_15_1_0_18",MakeRGB(255,255,255));
       P_ASG_15_1_0_18SetGet_BTN_already_pressed = 1;
    }
    else
    {
       getValue(P_ASG_15_1_0_18, BAPTemp);
       Request_ByteSequence(LSGID, P_ASG_15_1_0_18_ID, DataSetGet_REQ, BAPTemp, getValueSize(P_ASG_15_1_0_18));
       P_ASG_15_1_0_18SetGet_BTN_already_pressed = 0;
    }
}
on envVar P_ASG_15_1_0_18 // bus value of SpeedWarning (18).
{
	// opcodes: Error-Status
	byte param1; // State
	word param2; // Speed_Value
	byte param3; // Speed_Unit
	byte param4; // Extension1
	// DATATYPE_BYTESEQUENCE / DATATYPE_FIXEDBYTESEQUENCE
	int i;
	byte superval[5];
	int currentPos;
	currentPos = 0;
	for( i = 0; i < 5; i++ ) {
		superval[i] = 0;
	}
	getValue(P_ASG_15_1_0_18, superval);
	///////// Start param1 - UINT8 /////////
	param1 = superval[currentPos++];
	putValue(P_ASG_15_1_0_18_1, param1);
	///////// Start param2 - UINT16 /////////
	param2 = superval[currentPos++]|(superval[currentPos++]<<8);
	putValue(P_ASG_15_1_0_18_2, round((param2 * 1.0) - (0) + (0), 1.0));
	///////// Start param3 - UINT8 /////////
	param3 = superval[currentPos++];
	putValue(P_ASG_15_1_0_18_3, param3);
	///////// Start param4 - UINT8 /////////
	param4 = superval[currentPos++];
	putValue(P_ASG_15_1_0_18_4, round((param4 * 1.0) - (0) + (0), 1.0));
}

on envVar P_ASG_15_1_0_18_1_0
{
	byte bitval;
	//thisval steht hier fuer den bitfield-wert, 
	//aus Generierungsgruenden hier keine einheitliche Bezeichnung moeglich.
	byte thisval; // State
	bitval= getValue(this);
	thisval = getValue(P_ASG_15_1_0_18_1);
	thisval = thisval&~(1<<0)|(bitval<<0);
	putValue(P_ASG_15_1_0_18_1,thisval);
}

on envVar P_ASG_15_1_0_18_1 // SpeedWarning.State
{
	byte superval[5];

	//Update Childvalue (BitField)
	byte mask=0x01;
	int i = 0;
	byte thisval; // State
	thisval = getValue(this);
	if(thisval&(mask<<0))
		putValue(P_ASG_15_1_0_18_1_0, 1);
	else
		putValue(P_ASG_15_1_0_18_1_0, 0);

    // Update superval
	getValue(P_ASG_15_1_0_18, superval);
	superval[0]=thisval;
	putValue(P_ASG_15_1_0_18,superval);
}

// Ueberwachung der Darstellungsvariable der Range.
on envVar P_ASG_15_1_0_18_2_range // SpeedWarning.Speed_Value 
{
	@P_ASG_15_1_0_18_2 = @P_ASG_15_1_0_18_2_range - (0); // slider = range - min
}

on envVar P_ASG_15_1_0_18_2 // SpeedWarning.Speed_Value
{
	byte superval[5];

	//Update Childvalue (Number)
	word thisval; // Speed_Value
	float slider_value;

	slider_value = round(@P_ASG_15_1_0_18_2, 1.0);
	@P_ASG_15_1_0_18_2_range = slider_value + (0); // real value := slider value + range min.
	thisval = (word)round((slider_value + (0) - (0)) / (1.0), 1); // bus value := (slider value + min - offset) / step.

    // Update superval
	getValue(P_ASG_15_1_0_18, superval);
	superval[1]=thisval&0x00ff;
	superval[2]=(thisval&0xff00)>>8;
	putValue(P_ASG_15_1_0_18,superval);
}

on envVar P_ASG_15_1_0_18_3 // SpeedWarning.Speed_Unit
{
	byte superval[5];

	//Update Childvalue (Enum)
	byte thisval; // Speed_Unit
	thisval = getValue(this);

    // Update superval
	getValue(P_ASG_15_1_0_18, superval);
	superval[3]=thisval;
	putValue(P_ASG_15_1_0_18,superval);
}

// Ueberwachung der Darstellungsvariable der Range.
on envVar P_ASG_15_1_0_18_4_range // SpeedWarning.Extension1 
{
	@P_ASG_15_1_0_18_4 = @P_ASG_15_1_0_18_4_range - (0); // slider = range - min
}

on envVar P_ASG_15_1_0_18_4 // SpeedWarning.Extension1
{
	byte superval[5];

	//Update Childvalue (Number)
	byte thisval; // Extension1
	float slider_value;

	slider_value = 0; // Konstanter Parameter.
	@P_ASG_15_1_0_18_4_range = slider_value + (0); // real value := slider value + range min.
	thisval = (byte)round((slider_value + (0) - (0)) / (1.0), 1); // bus value := (slider value + min - offset) / step.

    // Update superval
	getValue(P_ASG_15_1_0_18, superval);
	superval[4]=thisval;
	putValue(P_ASG_15_1_0_18,superval);
}

on envVar P_ASG_15_1_0_19Get_BTN
{
 if (P_ASG_15_1_0_19Get_BTN_already_pressed == 0)
  {
       putValue(P_ASG_15_1_0_19_ErrCode,0);
       SetControlBackColor(panel_name,"errField_P_ASG_15_1_0_19",MakeRGB(255,255,255));
       P_ASG_15_1_0_19Get_BTN_already_pressed = 1;
 }
 else
 {
       Request_Void(LSGID, P_ASG_15_1_0_19_ID, DataGet_REQ); 
       P_ASG_15_1_0_19Get_BTN_already_pressed = 0;
 }
}
on envVar P_ASG_15_1_0_19 // bus value of CurrentConsumption (19).
{
	// opcodes: Error-Status
	int param1; // Consumption1_Value
	byte param2; // Consumption1_Unit
	int param3; // Consumption2_Value
	byte param4; // Consumption2_Unit
	// DATATYPE_BYTESEQUENCE / DATATYPE_FIXEDBYTESEQUENCE
	int i;
	byte superval[6];
	int currentPos;
	currentPos = 0;
	for( i = 0; i < 6; i++ ) {
		superval[i] = 0;
	}
	getValue(P_ASG_15_1_0_19, superval);
	///////// Start param1 - UINT16 /////////
	param1 = superval[currentPos++]|(superval[currentPos++]<<8);
	putValue(P_ASG_15_1_0_19_1, round((param1 * 0.1) - (-3276) + (0), 0.1));
	///////// Start param2 - UINT8 /////////
	param2 = superval[currentPos++];
	putValue(P_ASG_15_1_0_19_2, param2);
	///////// Start param3 - UINT16 /////////
	param3 = superval[currentPos++]|(superval[currentPos++]<<8);
	putValue(P_ASG_15_1_0_19_3, round((param3 * 0.1) - (-3276) + (0), 0.1));
	///////// Start param4 - UINT8 /////////
	param4 = superval[currentPos++];
	putValue(P_ASG_15_1_0_19_4, param4);
}

// Ueberwachung der Darstellungsvariable der Range.
on envVar P_ASG_15_1_0_19_1_range // CurrentConsumption.Consumption1_Value 
{
	@P_ASG_15_1_0_19_1 = @P_ASG_15_1_0_19_1_range - (-3276); // slider = range - min
}

on envVar P_ASG_15_1_0_19_1 // CurrentConsumption.Consumption1_Value
{
	byte superval[6];

	//Update Childvalue (Number)
	int thisval; // Consumption1_Value
	float slider_value;

	slider_value = round(@P_ASG_15_1_0_19_1, 0.1);
	@P_ASG_15_1_0_19_1_range = slider_value + (-3276); // real value := slider value + range min.
	thisval = (int)round((slider_value + (-3276) - (0)) / (0.1), 1); // bus value := (slider value + min - offset) / step.

    // Update superval
	getValue(P_ASG_15_1_0_19, superval);
	superval[0]=thisval&0x00ff;
	superval[1]=(thisval&0xff00)>>8;
	putValue(P_ASG_15_1_0_19,superval);
}

on envVar P_ASG_15_1_0_19_2 // CurrentConsumption.Consumption1_Unit
{
	byte superval[6];

	//Update Childvalue (Enum)
	byte thisval; // Consumption1_Unit
	thisval = getValue(this);

    // Update superval
	getValue(P_ASG_15_1_0_19, superval);
	superval[2]=thisval;
	putValue(P_ASG_15_1_0_19,superval);
}

// Ueberwachung der Darstellungsvariable der Range.
on envVar P_ASG_15_1_0_19_3_range // CurrentConsumption.Consumption2_Value 
{
	@P_ASG_15_1_0_19_3 = @P_ASG_15_1_0_19_3_range - (-3276); // slider = range - min
}

on envVar P_ASG_15_1_0_19_3 // CurrentConsumption.Consumption2_Value
{
	byte superval[6];

	//Update Childvalue (Number)
	int thisval; // Consumption2_Value
	float slider_value;

	slider_value = round(@P_ASG_15_1_0_19_3, 0.1);
	@P_ASG_15_1_0_19_3_range = slider_value + (-3276); // real value := slider value + range min.
	thisval = (int)round((slider_value + (-3276) - (0)) / (0.1), 1); // bus value := (slider value + min - offset) / step.

    // Update superval
	getValue(P_ASG_15_1_0_19, superval);
	superval[3]=thisval&0x00ff;
	superval[4]=(thisval&0xff00)>>8;
	putValue(P_ASG_15_1_0_19,superval);
}

on envVar P_ASG_15_1_0_19_4 // CurrentConsumption.Consumption2_Unit
{
	byte superval[6];

	//Update Childvalue (Enum)
	byte thisval; // Consumption2_Unit
	thisval = getValue(this);

    // Update superval
	getValue(P_ASG_15_1_0_19, superval);
	superval[5]=thisval;
	putValue(P_ASG_15_1_0_19,superval);
}

on envVar P_ASG_15_1_0_20Get_BTN
{
 if (P_ASG_15_1_0_20Get_BTN_already_pressed == 0)
  {
       putValue(P_ASG_15_1_0_20_ErrCode,0);
       SetControlBackColor(panel_name,"errField_P_ASG_15_1_0_20",MakeRGB(255,255,255));
       P_ASG_15_1_0_20Get_BTN_already_pressed = 1;
 }
 else
 {
       Request_Void(LSGID, P_ASG_15_1_0_20_ID, DataGet_REQ); 
       P_ASG_15_1_0_20Get_BTN_already_pressed = 0;
 }
}
on envVar P_ASG_15_1_0_20 // bus value of CurrentRange (20).
{
	// opcodes: Error-Status
	word param1; // Range1_Value
	word param2; // Range2_Value
	word param3; // TotalRange_Value
	byte param4; // Range_Unit
	// DATATYPE_BYTESEQUENCE / DATATYPE_FIXEDBYTESEQUENCE
	int i;
	byte superval[7];
	int currentPos;
	currentPos = 0;
	for( i = 0; i < 7; i++ ) {
		superval[i] = 0;
	}
	getValue(P_ASG_15_1_0_20, superval);
	///////// Start param1 - UINT16 /////////
	param1 = superval[currentPos++]|(superval[currentPos++]<<8);
	putValue(P_ASG_15_1_0_20_1, round((param1 * 1.0) - (0) + (0), 1.0));
	///////// Start param2 - UINT16 /////////
	param2 = superval[currentPos++]|(superval[currentPos++]<<8);
	putValue(P_ASG_15_1_0_20_2, round((param2 * 1.0) - (0) + (0), 1.0));
	///////// Start param3 - UINT16 /////////
	param3 = superval[currentPos++]|(superval[currentPos++]<<8);
	putValue(P_ASG_15_1_0_20_3, round((param3 * 1.0) - (0) + (0), 1.0));
	///////// Start param4 - UINT8 /////////
	param4 = superval[currentPos++];
	putValue(P_ASG_15_1_0_20_4, param4);
}

// Updates the bus value field and other dependencies.
P_ASG_15_1_0_20_BuildFct()
{
	word param1; // Range1_Value
	word param2; // Range2_Value
	word param3; // TotalRange_Value
	byte param4; // Range_Unit

	int i;
	byte superval[7];
	int currentPos;
	currentPos = 0;
// gen_BuildFunc_SetSuperVals 
	@P_ASG_15_1_0_20_1_range = round(@P_ASG_15_1_0_20_1 + (0), 1.0); // slider value + min = real value
	param1 = round( (@P_ASG_15_1_0_20_1 + (0) - (0)) / (1.0), 1.0); // (slider value + min - offset) / step = busvalue
	superval[currentPos++]=param1&0x00ff;
	superval[currentPos++]=(param1&0xff00)>>8;
// gen_BuildFunc_SetSuperVals 
	@P_ASG_15_1_0_20_2_range = round(@P_ASG_15_1_0_20_2 + (0), 1.0); // slider value + min = real value
	param2 = round( (@P_ASG_15_1_0_20_2 + (0) - (0)) / (1.0), 1.0); // (slider value + min - offset) / step = busvalue
	superval[currentPos++]=param2&0x00ff;
	superval[currentPos++]=(param2&0xff00)>>8;
// gen_BuildFunc_SetSuperVals 
	@P_ASG_15_1_0_20_3_range = round(@P_ASG_15_1_0_20_3 + (0), 1.0); // slider value + min = real value
	param3 = round( (@P_ASG_15_1_0_20_3 + (0) - (0)) / (1.0), 1.0); // (slider value + min - offset) / step = busvalue
	superval[currentPos++]=param3&0x00ff;
	superval[currentPos++]=(param3&0xff00)>>8;
// gen_BuildFunc_SetSuperVals 
	param4 = getValue(P_ASG_15_1_0_20_4);
	superval[currentPos++]=param4;
	putValue(P_ASG_15_1_0_20, superval, currentPos);
}


// Ueberwachung der Darstellungsvariable der Range.
on envVar P_ASG_15_1_0_20_1_range // CurrentRange.Range1_Value 
{
	@P_ASG_15_1_0_20_1 = @P_ASG_15_1_0_20_1_range - (0); // slider = range - min
}

on envVar P_ASG_15_1_0_20_1 // CurrentRange.Range1_Value
{
	P_ASG_15_1_0_20_BuildFct();
}

// Ueberwachung der Darstellungsvariable der Range.
on envVar P_ASG_15_1_0_20_2_range // CurrentRange.Range2_Value 
{
	@P_ASG_15_1_0_20_2 = @P_ASG_15_1_0_20_2_range - (0); // slider = range - min
}

on envVar P_ASG_15_1_0_20_2 // CurrentRange.Range2_Value
{
	P_ASG_15_1_0_20_BuildFct();
}

// Ueberwachung der Darstellungsvariable der Range.
on envVar P_ASG_15_1_0_20_3_range // CurrentRange.TotalRange_Value 
{
	@P_ASG_15_1_0_20_3 = @P_ASG_15_1_0_20_3_range - (0); // slider = range - min
}

on envVar P_ASG_15_1_0_20_3 // CurrentRange.TotalRange_Value
{
	P_ASG_15_1_0_20_BuildFct();
}

on envVar P_ASG_15_1_0_20_4 // CurrentRange.Range_Unit
{
	P_ASG_15_1_0_20_BuildFct();
}

on envVar P_ASG_15_1_0_21Get_BTN
{
 if (P_ASG_15_1_0_21Get_BTN_already_pressed == 0)
  {
       putValue(P_ASG_15_1_0_21_ErrCode,0);
       SetControlBackColor(panel_name,"errField_P_ASG_15_1_0_21",MakeRGB(255,255,255));
       P_ASG_15_1_0_21Get_BTN_already_pressed = 1;
 }
 else
 {
       Request_Void(LSGID, P_ASG_15_1_0_21_ID, DataGet_REQ); 
       P_ASG_15_1_0_21Get_BTN_already_pressed = 0;
 }
}
on envVar P_ASG_15_1_0_21 // bus value of TotalDistance (21).
{
	// opcodes: Error-Status
	dword param1; // Distance_Value
	byte param2; // Distance_Unit
	// DATATYPE_BYTESEQUENCE / DATATYPE_FIXEDBYTESEQUENCE
	int i;
	byte superval[5];
	int currentPos;
	currentPos = 0;
	for( i = 0; i < 5; i++ ) {
		superval[i] = 0;
	}
	getValue(P_ASG_15_1_0_21, superval);
	///////// Start param1 - UINT32 /////////
	param1 = superval[currentPos++]|(superval[currentPos++]<<8)|(superval[currentPos++]<<16)|(superval[currentPos++]<<24);
	putValue(P_ASG_15_1_0_21_1, round((param1 * 0.1) - (0) + (0), 0.1));
	///////// Start param2 - UINT8 /////////
	param2 = superval[currentPos++];
	putValue(P_ASG_15_1_0_21_2, param2);
}

// Ueberwachung der Darstellungsvariable der Range.
on envVar P_ASG_15_1_0_21_1_range // TotalDistance.Distance_Value 
{
	@P_ASG_15_1_0_21_1 = @P_ASG_15_1_0_21_1_range - (0); // slider = range - min
}

on envVar P_ASG_15_1_0_21_1 // TotalDistance.Distance_Value
{
	byte superval[5];

	//Update Childvalue (Number)
	dword thisval; // Distance_Value
	float slider_value;

	slider_value = round(@P_ASG_15_1_0_21_1, 0.1);
	@P_ASG_15_1_0_21_1_range = slider_value + (0); // real value := slider value + range min.
	thisval = (dword)round((slider_value + (0) - (0)) / (0.1), 1); // bus value := (slider value + min - offset) / step.

    // Update superval
	getValue(P_ASG_15_1_0_21, superval);
	superval[0]= thisval&0x000000ff;
	superval[1]=(thisval&0x0000ff00)>>8;
	superval[2]=(thisval&0x00ff0000)>>16;
	superval[3]=(thisval&0xff000000)>>24;
	putValue(P_ASG_15_1_0_21,superval);
}

on envVar P_ASG_15_1_0_21_2 // TotalDistance.Distance_Unit
{
	byte superval[5];

	//Update Childvalue (Enum)
	byte thisval; // Distance_Unit
	thisval = getValue(this);

    // Update superval
	getValue(P_ASG_15_1_0_21, superval);
	superval[4]=thisval;
	putValue(P_ASG_15_1_0_21,superval);
}

on envVar P_ASG_15_1_0_22Get_BTN
{
 if (P_ASG_15_1_0_22Get_BTN_already_pressed == 0)
  {
       putValue(P_ASG_15_1_0_22_ErrCode,0);
       SetControlBackColor(panel_name,"errField_P_ASG_15_1_0_22",MakeRGB(255,255,255));
       P_ASG_15_1_0_22Get_BTN_already_pressed = 1;
 }
 else
 {
       Request_Void(LSGID, P_ASG_15_1_0_22_ID, DataGet_REQ); 
       P_ASG_15_1_0_22Get_BTN_already_pressed = 0;
 }
}
on envVar P_ASG_15_1_0_22 // bus value of ShortTermFIS1 (22).
{
	// opcodes: Error-Status
	int param1; // AverageConsumption1_Value
	byte param2; // Consumption1_Unit
	int param3; // AverageConsumption2_Value
	byte param4; // Consumption2_Unit
	word param5; // AverageSpeed_Value
	byte param6; // Speed_Unit
	dword param7; // Distance_Value
	byte param8; // Distance_Unit
	dword param9; // Time_Value
	// DATATYPE_BYTESEQUENCE / DATATYPE_FIXEDBYTESEQUENCE
	int i;
	byte superval[18];
	int currentPos;
	currentPos = 0;
	for( i = 0; i < 18; i++ ) {
		superval[i] = 0;
	}
	getValue(P_ASG_15_1_0_22, superval);
	///////// Start param1 - UINT16 /////////
	param1 = superval[currentPos++]|(superval[currentPos++]<<8);
	putValue(P_ASG_15_1_0_22_1, round((param1 * 0.1) - (-3276) + (0), 0.1));
	///////// Start param2 - UINT8 /////////
	param2 = superval[currentPos++];
	putValue(P_ASG_15_1_0_22_2, param2);
	///////// Start param3 - UINT16 /////////
	param3 = superval[currentPos++]|(superval[currentPos++]<<8);
	putValue(P_ASG_15_1_0_22_3, round((param3 * 0.1) - (-3276) + (0), 0.1));
	///////// Start param4 - UINT8 /////////
	param4 = superval[currentPos++];
	putValue(P_ASG_15_1_0_22_4, param4);
	///////// Start param5 - UINT16 /////////
	param5 = superval[currentPos++]|(superval[currentPos++]<<8);
	putValue(P_ASG_15_1_0_22_5, round((param5 * 0.1) - (0) + (0), 0.1));
	///////// Start param6 - UINT8 /////////
	param6 = superval[currentPos++];
	putValue(P_ASG_15_1_0_22_6, param6);
	///////// Start param7 - UINT32 /////////
	param7 = superval[currentPos++]|(superval[currentPos++]<<8)|(superval[currentPos++]<<16)|(superval[currentPos++]<<24);
	putValue(P_ASG_15_1_0_22_7, round((param7 * 0.1) - (0) + (0), 0.1));
	///////// Start param8 - UINT8 /////////
	param8 = superval[currentPos++];
	putValue(P_ASG_15_1_0_22_8, param8);
	///////// Start param9 - UINT32 /////////
	param9 = superval[currentPos++]|(superval[currentPos++]<<8)|(superval[currentPos++]<<16)|(superval[currentPos++]<<24);
	putValue(P_ASG_15_1_0_22_9, round((param9 * 1.0) - (0) + (0), 1.0));
}

// Updates the bus value field and other dependencies.
P_ASG_15_1_0_22_BuildFct()
{
	int param1; // AverageConsumption1_Value
	byte param2; // Consumption1_Unit
	int param3; // AverageConsumption2_Value
	byte param4; // Consumption2_Unit
	word param5; // AverageSpeed_Value
	byte param6; // Speed_Unit
	dword param7; // Distance_Value
	byte param8; // Distance_Unit
	dword param9; // Time_Value

	int i;
	byte superval[18];
	int currentPos;
	currentPos = 0;
// gen_BuildFunc_SetSuperVals 
	@P_ASG_15_1_0_22_1_range = round(@P_ASG_15_1_0_22_1 + (-3276), 0.1); // slider value + min = real value
	param1 = round( (@P_ASG_15_1_0_22_1 + (-3276) - (0)) / (0.1), 0.1); // (slider value + min - offset) / step = busvalue
	superval[currentPos++]=param1&0x00ff;
	superval[currentPos++]=(param1&0xff00)>>8;
// gen_BuildFunc_SetSuperVals 
	param2 = getValue(P_ASG_15_1_0_22_2);
	superval[currentPos++]=param2;
// gen_BuildFunc_SetSuperVals 
	@P_ASG_15_1_0_22_3_range = round(@P_ASG_15_1_0_22_3 + (-3276), 0.1); // slider value + min = real value
	param3 = round( (@P_ASG_15_1_0_22_3 + (-3276) - (0)) / (0.1), 0.1); // (slider value + min - offset) / step = busvalue
	superval[currentPos++]=param3&0x00ff;
	superval[currentPos++]=(param3&0xff00)>>8;
// gen_BuildFunc_SetSuperVals 
	param4 = getValue(P_ASG_15_1_0_22_4);
	superval[currentPos++]=param4;
// gen_BuildFunc_SetSuperVals 
	@P_ASG_15_1_0_22_5_range = round(@P_ASG_15_1_0_22_5 + (0), 0.1); // slider value + min = real value
	param5 = round( (@P_ASG_15_1_0_22_5 + (0) - (0)) / (0.1), 0.1); // (slider value + min - offset) / step = busvalue
	superval[currentPos++]=param5&0x00ff;
	superval[currentPos++]=(param5&0xff00)>>8;
// gen_BuildFunc_SetSuperVals 
	param6 = getValue(P_ASG_15_1_0_22_6);
	superval[currentPos++]=param6;
// gen_BuildFunc_SetSuperVals 
	@P_ASG_15_1_0_22_7_range = round(@P_ASG_15_1_0_22_7 + (0), 0.1); // slider value + min = real value
	param7 = round( (@P_ASG_15_1_0_22_7 + (0) - (0)) / (0.1), 0.1); // (slider value + min - offset) / step = busvalue
	superval[currentPos++]= param7&0x000000ff;
	superval[currentPos++]=(param7&0x0000ff00)>>8;
	superval[currentPos++]=(param7&0x00ff0000)>>16;
	superval[currentPos++]=(param7&0xff000000)>>24;
// gen_BuildFunc_SetSuperVals 
	param8 = getValue(P_ASG_15_1_0_22_8);
	superval[currentPos++]=param8;
// gen_BuildFunc_SetSuperVals 
	@P_ASG_15_1_0_22_9_range = round(@P_ASG_15_1_0_22_9 + (0), 1.0); // slider value + min = real value
	param9 = round( (@P_ASG_15_1_0_22_9 + (0) - (0)) / (1.0), 1.0); // (slider value + min - offset) / step = busvalue
	superval[currentPos++]= param9&0x000000ff;
	superval[currentPos++]=(param9&0x0000ff00)>>8;
	superval[currentPos++]=(param9&0x00ff0000)>>16;
	superval[currentPos++]=(param9&0xff000000)>>24;
	putValue(P_ASG_15_1_0_22, superval, currentPos);
}


// Ueberwachung der Darstellungsvariable der Range.
on envVar P_ASG_15_1_0_22_1_range // ShortTermFIS1.AverageConsumption1_Value 
{
	@P_ASG_15_1_0_22_1 = @P_ASG_15_1_0_22_1_range - (-3276); // slider = range - min
}

on envVar P_ASG_15_1_0_22_1 // ShortTermFIS1.AverageConsumption1_Value
{
	P_ASG_15_1_0_22_BuildFct();
}

on envVar P_ASG_15_1_0_22_2 // ShortTermFIS1.Consumption1_Unit
{
	P_ASG_15_1_0_22_BuildFct();
}

// Ueberwachung der Darstellungsvariable der Range.
on envVar P_ASG_15_1_0_22_3_range // ShortTermFIS1.AverageConsumption2_Value 
{
	@P_ASG_15_1_0_22_3 = @P_ASG_15_1_0_22_3_range - (-3276); // slider = range - min
}

on envVar P_ASG_15_1_0_22_3 // ShortTermFIS1.AverageConsumption2_Value
{
	P_ASG_15_1_0_22_BuildFct();
}

on envVar P_ASG_15_1_0_22_4 // ShortTermFIS1.Consumption2_Unit
{
	P_ASG_15_1_0_22_BuildFct();
}

// Ueberwachung der Darstellungsvariable der Range.
on envVar P_ASG_15_1_0_22_5_range // ShortTermFIS1.AverageSpeed_Value 
{
	@P_ASG_15_1_0_22_5 = @P_ASG_15_1_0_22_5_range - (0); // slider = range - min
}

on envVar P_ASG_15_1_0_22_5 // ShortTermFIS1.AverageSpeed_Value
{
	P_ASG_15_1_0_22_BuildFct();
}

on envVar P_ASG_15_1_0_22_6 // ShortTermFIS1.Speed_Unit
{
	P_ASG_15_1_0_22_BuildFct();
}

// Ueberwachung der Darstellungsvariable der Range.
on envVar P_ASG_15_1_0_22_7_range // ShortTermFIS1.Distance_Value 
{
	@P_ASG_15_1_0_22_7 = @P_ASG_15_1_0_22_7_range - (0); // slider = range - min
}

on envVar P_ASG_15_1_0_22_7 // ShortTermFIS1.Distance_Value
{
	P_ASG_15_1_0_22_BuildFct();
}

on envVar P_ASG_15_1_0_22_8 // ShortTermFIS1.Distance_Unit
{
	P_ASG_15_1_0_22_BuildFct();
}

// Ueberwachung der Darstellungsvariable der Range.
on envVar P_ASG_15_1_0_22_9_range // ShortTermFIS1.Time_Value 
{
	@P_ASG_15_1_0_22_9 = @P_ASG_15_1_0_22_9_range - (0); // slider = range - min
}

on envVar P_ASG_15_1_0_22_9 // ShortTermFIS1.Time_Value
{
	P_ASG_15_1_0_22_BuildFct();
}

on envVar P_ASG_15_1_0_23Get_BTN
{
 if (P_ASG_15_1_0_23Get_BTN_already_pressed == 0)
  {
       putValue(P_ASG_15_1_0_23_ErrCode,0);
       SetControlBackColor(panel_name,"errField_P_ASG_15_1_0_23",MakeRGB(255,255,255));
       P_ASG_15_1_0_23Get_BTN_already_pressed = 1;
 }
 else
 {
       Request_Void(LSGID, P_ASG_15_1_0_23_ID, DataGet_REQ); 
       P_ASG_15_1_0_23Get_BTN_already_pressed = 0;
 }
}
on envVar P_ASG_15_1_0_23 // bus value of ShortTermFIS2 (23).
{
	// opcodes: Error-Status
	word param1; // ComfortPowerConsumption
	byte param2; // ComfortPowerConsumption_Unit
	dword param3; // ZeroEmissionDistance_Value
	byte param4; // Distance_Unit
	dword param5; // ZeroEmissionTime_Value
	byte param6; // Extension1
	byte param7; // Extension2
	byte param8; // Extension3
	byte param9; // Extension4
	byte param10; // Extension5
	byte param11; // Extension6
	// DATATYPE_BYTESEQUENCE / DATATYPE_FIXEDBYTESEQUENCE
	int i;
	byte superval[18];
	int currentPos;
	currentPos = 0;
	for( i = 0; i < 18; i++ ) {
		superval[i] = 0;
	}
	getValue(P_ASG_15_1_0_23, superval);
	///////// Start param1 - UINT16 /////////
	param1 = superval[currentPos++]|(superval[currentPos++]<<8);
	putValue(P_ASG_15_1_0_23_1, round((param1 * 0.01) - (0) + (0), 0.01));
	///////// Start param2 - UINT8 /////////
	param2 = superval[currentPos++];
	putValue(P_ASG_15_1_0_23_2, param2);
	///////// Start param3 - UINT32 /////////
	param3 = superval[currentPos++]|(superval[currentPos++]<<8)|(superval[currentPos++]<<16)|(superval[currentPos++]<<24);
	putValue(P_ASG_15_1_0_23_3, round((param3 * 0.1) - (0) + (0), 0.1));
	///////// Start param4 - UINT8 /////////
	param4 = superval[currentPos++];
	putValue(P_ASG_15_1_0_23_4, param4);
	///////// Start param5 - UINT32 /////////
	param5 = superval[currentPos++]|(superval[currentPos++]<<8)|(superval[currentPos++]<<16)|(superval[currentPos++]<<24);
	putValue(P_ASG_15_1_0_23_5, round((param5 * 1.0) - (0) + (0), 1.0));
	///////// Start param6 - UINT8 /////////
	param6 = superval[currentPos++];
	putValue(P_ASG_15_1_0_23_6, round((param6 * 1.0) - (0) + (0), 1.0));
	///////// Start param7 - UINT8 /////////
	param7 = superval[currentPos++];
	putValue(P_ASG_15_1_0_23_7, round((param7 * 1.0) - (0) + (0), 1.0));
	///////// Start param8 - UINT8 /////////
	param8 = superval[currentPos++];
	putValue(P_ASG_15_1_0_23_8, round((param8 * 1.0) - (0) + (0), 1.0));
	///////// Start param9 - UINT8 /////////
	param9 = superval[currentPos++];
	putValue(P_ASG_15_1_0_23_9, round((param9 * 1.0) - (0) + (0), 1.0));
	///////// Start param10 - UINT8 /////////
	param10 = superval[currentPos++];
	putValue(P_ASG_15_1_0_23_10, round((param10 * 1.0) - (0) + (0), 1.0));
	///////// Start param11 - UINT8 /////////
	param11 = superval[currentPos++];
	putValue(P_ASG_15_1_0_23_11, round((param11 * 1.0) - (0) + (0), 1.0));
}

// Updates the bus value field and other dependencies.
P_ASG_15_1_0_23_BuildFct()
{
	word param1; // ComfortPowerConsumption
	byte param2; // ComfortPowerConsumption_Unit
	dword param3; // ZeroEmissionDistance_Value
	byte param4; // Distance_Unit
	dword param5; // ZeroEmissionTime_Value
	byte param6; // Extension1
	byte param7; // Extension2
	byte param8; // Extension3
	byte param9; // Extension4
	byte param10; // Extension5
	byte param11; // Extension6

	int i;
	byte superval[18];
	int currentPos;
	currentPos = 0;
// gen_BuildFunc_SetSuperVals 
	@P_ASG_15_1_0_23_1_range = round(@P_ASG_15_1_0_23_1 + (0), 0.01); // slider value + min = real value
	param1 = round( (@P_ASG_15_1_0_23_1 + (0) - (0)) / (0.01), 0.01); // (slider value + min - offset) / step = busvalue
	superval[currentPos++]=param1&0x00ff;
	superval[currentPos++]=(param1&0xff00)>>8;
// gen_BuildFunc_SetSuperVals 
	param2 = getValue(P_ASG_15_1_0_23_2);
	superval[currentPos++]=param2;
// gen_BuildFunc_SetSuperVals 
	@P_ASG_15_1_0_23_3_range = round(@P_ASG_15_1_0_23_3 + (0), 0.1); // slider value + min = real value
	param3 = round( (@P_ASG_15_1_0_23_3 + (0) - (0)) / (0.1), 0.1); // (slider value + min - offset) / step = busvalue
	superval[currentPos++]= param3&0x000000ff;
	superval[currentPos++]=(param3&0x0000ff00)>>8;
	superval[currentPos++]=(param3&0x00ff0000)>>16;
	superval[currentPos++]=(param3&0xff000000)>>24;
// gen_BuildFunc_SetSuperVals 
	param4 = getValue(P_ASG_15_1_0_23_4);
	superval[currentPos++]=param4;
// gen_BuildFunc_SetSuperVals 
	@P_ASG_15_1_0_23_5_range = round(@P_ASG_15_1_0_23_5 + (0), 1.0); // slider value + min = real value
	param5 = round( (@P_ASG_15_1_0_23_5 + (0) - (0)) / (1.0), 1.0); // (slider value + min - offset) / step = busvalue
	superval[currentPos++]= param5&0x000000ff;
	superval[currentPos++]=(param5&0x0000ff00)>>8;
	superval[currentPos++]=(param5&0x00ff0000)>>16;
	superval[currentPos++]=(param5&0xff000000)>>24;
// gen_BuildFunc_SetSuperVals 
	@P_ASG_15_1_0_23_6_range = round(@P_ASG_15_1_0_23_6 + (0), 1.0); // slider value + min = real value
	param6 = 0; // underlying parameter has constant value 0.
	superval[currentPos++]=param6;
// gen_BuildFunc_SetSuperVals 
	@P_ASG_15_1_0_23_7_range = round(@P_ASG_15_1_0_23_7 + (0), 1.0); // slider value + min = real value
	param7 = 0; // underlying parameter has constant value 0.
	superval[currentPos++]=param7;
// gen_BuildFunc_SetSuperVals 
	@P_ASG_15_1_0_23_8_range = round(@P_ASG_15_1_0_23_8 + (0), 1.0); // slider value + min = real value
	param8 = 0; // underlying parameter has constant value 0.
	superval[currentPos++]=param8;
// gen_BuildFunc_SetSuperVals 
	@P_ASG_15_1_0_23_9_range = round(@P_ASG_15_1_0_23_9 + (0), 1.0); // slider value + min = real value
	param9 = 0; // underlying parameter has constant value 0.
	superval[currentPos++]=param9;
// gen_BuildFunc_SetSuperVals 
	@P_ASG_15_1_0_23_10_range = round(@P_ASG_15_1_0_23_10 + (0), 1.0); // slider value + min = real value
	param10 = 0; // underlying parameter has constant value 0.
	superval[currentPos++]=param10;
// gen_BuildFunc_SetSuperVals 
	@P_ASG_15_1_0_23_11_range = round(@P_ASG_15_1_0_23_11 + (0), 1.0); // slider value + min = real value
	param11 = 0; // underlying parameter has constant value 0.
	superval[currentPos++]=param11;
	putValue(P_ASG_15_1_0_23, superval, currentPos);
}


// Ueberwachung der Darstellungsvariable der Range.
on envVar P_ASG_15_1_0_23_1_range // ShortTermFIS2.ComfortPowerConsumption 
{
	@P_ASG_15_1_0_23_1 = @P_ASG_15_1_0_23_1_range - (0); // slider = range - min
}

on envVar P_ASG_15_1_0_23_1 // ShortTermFIS2.ComfortPowerConsumption
{
	P_ASG_15_1_0_23_BuildFct();
}

on envVar P_ASG_15_1_0_23_2 // ShortTermFIS2.ComfortPowerConsumption_Unit
{
	P_ASG_15_1_0_23_BuildFct();
}

// Ueberwachung der Darstellungsvariable der Range.
on envVar P_ASG_15_1_0_23_3_range // ShortTermFIS2.ZeroEmissionDistance_Value 
{
	@P_ASG_15_1_0_23_3 = @P_ASG_15_1_0_23_3_range - (0); // slider = range - min
}

on envVar P_ASG_15_1_0_23_3 // ShortTermFIS2.ZeroEmissionDistance_Value
{
	P_ASG_15_1_0_23_BuildFct();
}

on envVar P_ASG_15_1_0_23_4 // ShortTermFIS2.Distance_Unit
{
	P_ASG_15_1_0_23_BuildFct();
}

// Ueberwachung der Darstellungsvariable der Range.
on envVar P_ASG_15_1_0_23_5_range // ShortTermFIS2.ZeroEmissionTime_Value 
{
	@P_ASG_15_1_0_23_5 = @P_ASG_15_1_0_23_5_range - (0); // slider = range - min
}

on envVar P_ASG_15_1_0_23_5 // ShortTermFIS2.ZeroEmissionTime_Value
{
	P_ASG_15_1_0_23_BuildFct();
}

// Ueberwachung der Darstellungsvariable der Range.
on envVar P_ASG_15_1_0_23_6_range // ShortTermFIS2.Extension1 
{
	@P_ASG_15_1_0_23_6 = @P_ASG_15_1_0_23_6_range - (0); // slider = range - min
}

on envVar P_ASG_15_1_0_23_6 // ShortTermFIS2.Extension1
{
	P_ASG_15_1_0_23_BuildFct();
}

// Ueberwachung der Darstellungsvariable der Range.
on envVar P_ASG_15_1_0_23_7_range // ShortTermFIS2.Extension2 
{
	@P_ASG_15_1_0_23_7 = @P_ASG_15_1_0_23_7_range - (0); // slider = range - min
}

on envVar P_ASG_15_1_0_23_7 // ShortTermFIS2.Extension2
{
	P_ASG_15_1_0_23_BuildFct();
}

// Ueberwachung der Darstellungsvariable der Range.
on envVar P_ASG_15_1_0_23_8_range // ShortTermFIS2.Extension3 
{
	@P_ASG_15_1_0_23_8 = @P_ASG_15_1_0_23_8_range - (0); // slider = range - min
}

on envVar P_ASG_15_1_0_23_8 // ShortTermFIS2.Extension3
{
	P_ASG_15_1_0_23_BuildFct();
}

// Ueberwachung der Darstellungsvariable der Range.
on envVar P_ASG_15_1_0_23_9_range // ShortTermFIS2.Extension4 
{
	@P_ASG_15_1_0_23_9 = @P_ASG_15_1_0_23_9_range - (0); // slider = range - min
}

on envVar P_ASG_15_1_0_23_9 // ShortTermFIS2.Extension4
{
	P_ASG_15_1_0_23_BuildFct();
}

// Ueberwachung der Darstellungsvariable der Range.
on envVar P_ASG_15_1_0_23_10_range // ShortTermFIS2.Extension5 
{
	@P_ASG_15_1_0_23_10 = @P_ASG_15_1_0_23_10_range - (0); // slider = range - min
}

on envVar P_ASG_15_1_0_23_10 // ShortTermFIS2.Extension5
{
	P_ASG_15_1_0_23_BuildFct();
}

// Ueberwachung der Darstellungsvariable der Range.
on envVar P_ASG_15_1_0_23_11_range // ShortTermFIS2.Extension6 
{
	@P_ASG_15_1_0_23_11 = @P_ASG_15_1_0_23_11_range - (0); // slider = range - min
}

on envVar P_ASG_15_1_0_23_11 // ShortTermFIS2.Extension6
{
	P_ASG_15_1_0_23_BuildFct();
}

on envVar P_ASG_15_1_0_24Get_BTN
{
 if (P_ASG_15_1_0_24Get_BTN_already_pressed == 0)
  {
       putValue(P_ASG_15_1_0_24_ErrCode,0);
       SetControlBackColor(panel_name,"errField_P_ASG_15_1_0_24",MakeRGB(255,255,255));
       P_ASG_15_1_0_24Get_BTN_already_pressed = 1;
 }
 else
 {
       Request_Void(LSGID, P_ASG_15_1_0_24_ID, DataGet_REQ); 
       P_ASG_15_1_0_24Get_BTN_already_pressed = 0;
 }
}
on envVar P_ASG_15_1_0_24 // bus value of LongTermFIS1 (24).
{
	// opcodes: Error-Status
	int param1; // AverageConsumption1_Value
	byte param2; // Consumption1_Unit
	int param3; // AverageConsumption2_Value
	byte param4; // Consumption2_Unit
	word param5; // AverageSpeed_Value
	byte param6; // Speed_Unit
	dword param7; // Distance_Value
	byte param8; // Distance_Unit
	dword param9; // Time_Value
	// DATATYPE_BYTESEQUENCE / DATATYPE_FIXEDBYTESEQUENCE
	int i;
	byte superval[18];
	int currentPos;
	currentPos = 0;
	for( i = 0; i < 18; i++ ) {
		superval[i] = 0;
	}
	getValue(P_ASG_15_1_0_24, superval);
	///////// Start param1 - UINT16 /////////
	param1 = superval[currentPos++]|(superval[currentPos++]<<8);
	putValue(P_ASG_15_1_0_24_1, round((param1 * 0.1) - (-3276) + (0), 0.1));
	///////// Start param2 - UINT8 /////////
	param2 = superval[currentPos++];
	putValue(P_ASG_15_1_0_24_2, param2);
	///////// Start param3 - UINT16 /////////
	param3 = superval[currentPos++]|(superval[currentPos++]<<8);
	putValue(P_ASG_15_1_0_24_3, round((param3 * 0.1) - (-3276) + (0), 0.1));
	///////// Start param4 - UINT8 /////////
	param4 = superval[currentPos++];
	putValue(P_ASG_15_1_0_24_4, param4);
	///////// Start param5 - UINT16 /////////
	param5 = superval[currentPos++]|(superval[currentPos++]<<8);
	putValue(P_ASG_15_1_0_24_5, round((param5 * 0.1) - (0) + (0), 0.1));
	///////// Start param6 - UINT8 /////////
	param6 = superval[currentPos++];
	putValue(P_ASG_15_1_0_24_6, param6);
	///////// Start param7 - UINT32 /////////
	param7 = superval[currentPos++]|(superval[currentPos++]<<8)|(superval[currentPos++]<<16)|(superval[currentPos++]<<24);
	putValue(P_ASG_15_1_0_24_7, round((param7 * 0.1) - (0) + (0), 0.1));
	///////// Start param8 - UINT8 /////////
	param8 = superval[currentPos++];
	putValue(P_ASG_15_1_0_24_8, param8);
	///////// Start param9 - UINT32 /////////
	param9 = superval[currentPos++]|(superval[currentPos++]<<8)|(superval[currentPos++]<<16)|(superval[currentPos++]<<24);
	putValue(P_ASG_15_1_0_24_9, round((param9 * 1.0) - (0) + (0), 1.0));
}

// Updates the bus value field and other dependencies.
P_ASG_15_1_0_24_BuildFct()
{
	int param1; // AverageConsumption1_Value
	byte param2; // Consumption1_Unit
	int param3; // AverageConsumption2_Value
	byte param4; // Consumption2_Unit
	word param5; // AverageSpeed_Value
	byte param6; // Speed_Unit
	dword param7; // Distance_Value
	byte param8; // Distance_Unit
	dword param9; // Time_Value

	int i;
	byte superval[18];
	int currentPos;
	currentPos = 0;
// gen_BuildFunc_SetSuperVals 
	@P_ASG_15_1_0_24_1_range = round(@P_ASG_15_1_0_24_1 + (-3276), 0.1); // slider value + min = real value
	param1 = round( (@P_ASG_15_1_0_24_1 + (-3276) - (0)) / (0.1), 0.1); // (slider value + min - offset) / step = busvalue
	superval[currentPos++]=param1&0x00ff;
	superval[currentPos++]=(param1&0xff00)>>8;
// gen_BuildFunc_SetSuperVals 
	param2 = getValue(P_ASG_15_1_0_24_2);
	superval[currentPos++]=param2;
// gen_BuildFunc_SetSuperVals 
	@P_ASG_15_1_0_24_3_range = round(@P_ASG_15_1_0_24_3 + (-3276), 0.1); // slider value + min = real value
	param3 = round( (@P_ASG_15_1_0_24_3 + (-3276) - (0)) / (0.1), 0.1); // (slider value + min - offset) / step = busvalue
	superval[currentPos++]=param3&0x00ff;
	superval[currentPos++]=(param3&0xff00)>>8;
// gen_BuildFunc_SetSuperVals 
	param4 = getValue(P_ASG_15_1_0_24_4);
	superval[currentPos++]=param4;
// gen_BuildFunc_SetSuperVals 
	@P_ASG_15_1_0_24_5_range = round(@P_ASG_15_1_0_24_5 + (0), 0.1); // slider value + min = real value
	param5 = round( (@P_ASG_15_1_0_24_5 + (0) - (0)) / (0.1), 0.1); // (slider value + min - offset) / step = busvalue
	superval[currentPos++]=param5&0x00ff;
	superval[currentPos++]=(param5&0xff00)>>8;
// gen_BuildFunc_SetSuperVals 
	param6 = getValue(P_ASG_15_1_0_24_6);
	superval[currentPos++]=param6;
// gen_BuildFunc_SetSuperVals 
	@P_ASG_15_1_0_24_7_range = round(@P_ASG_15_1_0_24_7 + (0), 0.1); // slider value + min = real value
	param7 = round( (@P_ASG_15_1_0_24_7 + (0) - (0)) / (0.1), 0.1); // (slider value + min - offset) / step = busvalue
	superval[currentPos++]= param7&0x000000ff;
	superval[currentPos++]=(param7&0x0000ff00)>>8;
	superval[currentPos++]=(param7&0x00ff0000)>>16;
	superval[currentPos++]=(param7&0xff000000)>>24;
// gen_BuildFunc_SetSuperVals 
	param8 = getValue(P_ASG_15_1_0_24_8);
	superval[currentPos++]=param8;
// gen_BuildFunc_SetSuperVals 
	@P_ASG_15_1_0_24_9_range = round(@P_ASG_15_1_0_24_9 + (0), 1.0); // slider value + min = real value
	param9 = round( (@P_ASG_15_1_0_24_9 + (0) - (0)) / (1.0), 1.0); // (slider value + min - offset) / step = busvalue
	superval[currentPos++]= param9&0x000000ff;
	superval[currentPos++]=(param9&0x0000ff00)>>8;
	superval[currentPos++]=(param9&0x00ff0000)>>16;
	superval[currentPos++]=(param9&0xff000000)>>24;
	putValue(P_ASG_15_1_0_24, superval, currentPos);
}


// Ueberwachung der Darstellungsvariable der Range.
on envVar P_ASG_15_1_0_24_1_range // LongTermFIS1.AverageConsumption1_Value 
{
	@P_ASG_15_1_0_24_1 = @P_ASG_15_1_0_24_1_range - (-3276); // slider = range - min
}

on envVar P_ASG_15_1_0_24_1 // LongTermFIS1.AverageConsumption1_Value
{
	P_ASG_15_1_0_24_BuildFct();
}

on envVar P_ASG_15_1_0_24_2 // LongTermFIS1.Consumption1_Unit
{
	P_ASG_15_1_0_24_BuildFct();
}

// Ueberwachung der Darstellungsvariable der Range.
on envVar P_ASG_15_1_0_24_3_range // LongTermFIS1.AverageConsumption2_Value 
{
	@P_ASG_15_1_0_24_3 = @P_ASG_15_1_0_24_3_range - (-3276); // slider = range - min
}

on envVar P_ASG_15_1_0_24_3 // LongTermFIS1.AverageConsumption2_Value
{
	P_ASG_15_1_0_24_BuildFct();
}

on envVar P_ASG_15_1_0_24_4 // LongTermFIS1.Consumption2_Unit
{
	P_ASG_15_1_0_24_BuildFct();
}

// Ueberwachung der Darstellungsvariable der Range.
on envVar P_ASG_15_1_0_24_5_range // LongTermFIS1.AverageSpeed_Value 
{
	@P_ASG_15_1_0_24_5 = @P_ASG_15_1_0_24_5_range - (0); // slider = range - min
}

on envVar P_ASG_15_1_0_24_5 // LongTermFIS1.AverageSpeed_Value
{
	P_ASG_15_1_0_24_BuildFct();
}

on envVar P_ASG_15_1_0_24_6 // LongTermFIS1.Speed_Unit
{
	P_ASG_15_1_0_24_BuildFct();
}

// Ueberwachung der Darstellungsvariable der Range.
on envVar P_ASG_15_1_0_24_7_range // LongTermFIS1.Distance_Value 
{
	@P_ASG_15_1_0_24_7 = @P_ASG_15_1_0_24_7_range - (0); // slider = range - min
}

on envVar P_ASG_15_1_0_24_7 // LongTermFIS1.Distance_Value
{
	P_ASG_15_1_0_24_BuildFct();
}

on envVar P_ASG_15_1_0_24_8 // LongTermFIS1.Distance_Unit
{
	P_ASG_15_1_0_24_BuildFct();
}

// Ueberwachung der Darstellungsvariable der Range.
on envVar P_ASG_15_1_0_24_9_range // LongTermFIS1.Time_Value 
{
	@P_ASG_15_1_0_24_9 = @P_ASG_15_1_0_24_9_range - (0); // slider = range - min
}

on envVar P_ASG_15_1_0_24_9 // LongTermFIS1.Time_Value
{
	P_ASG_15_1_0_24_BuildFct();
}

on envVar P_ASG_15_1_0_25Get_BTN
{
 if (P_ASG_15_1_0_25Get_BTN_already_pressed == 0)
  {
       putValue(P_ASG_15_1_0_25_ErrCode,0);
       SetControlBackColor(panel_name,"errField_P_ASG_15_1_0_25",MakeRGB(255,255,255));
       P_ASG_15_1_0_25Get_BTN_already_pressed = 1;
 }
 else
 {
       Request_Void(LSGID, P_ASG_15_1_0_25_ID, DataGet_REQ); 
       P_ASG_15_1_0_25Get_BTN_already_pressed = 0;
 }
}
on envVar P_ASG_15_1_0_25 // bus value of LongTermFIS2 (25).
{
	// opcodes: Error-Status
	word param1; // ComfortPowerConsumption
	byte param2; // ComfortPowerConsumption_Unit
	dword param3; // ZeroEmissionDistance_Value
	byte param4; // Distance_Unit
	dword param5; // ZeroEmissionTime_Value
	byte param6; // Extension1
	byte param7; // Extension2
	byte param8; // Extension3
	byte param9; // Extension4
	byte param10; // Extension5
	byte param11; // Extension6
	// DATATYPE_BYTESEQUENCE / DATATYPE_FIXEDBYTESEQUENCE
	int i;
	byte superval[18];
	int currentPos;
	currentPos = 0;
	for( i = 0; i < 18; i++ ) {
		superval[i] = 0;
	}
	getValue(P_ASG_15_1_0_25, superval);
	///////// Start param1 - UINT16 /////////
	param1 = superval[currentPos++]|(superval[currentPos++]<<8);
	putValue(P_ASG_15_1_0_25_1, round((param1 * 0.01) - (0) + (0), 0.01));
	///////// Start param2 - UINT8 /////////
	param2 = superval[currentPos++];
	putValue(P_ASG_15_1_0_25_2, param2);
	///////// Start param3 - UINT32 /////////
	param3 = superval[currentPos++]|(superval[currentPos++]<<8)|(superval[currentPos++]<<16)|(superval[currentPos++]<<24);
	putValue(P_ASG_15_1_0_25_3, round((param3 * 0.1) - (0) + (0), 0.1));
	///////// Start param4 - UINT8 /////////
	param4 = superval[currentPos++];
	putValue(P_ASG_15_1_0_25_4, param4);
	///////// Start param5 - UINT32 /////////
	param5 = superval[currentPos++]|(superval[currentPos++]<<8)|(superval[currentPos++]<<16)|(superval[currentPos++]<<24);
	putValue(P_ASG_15_1_0_25_5, round((param5 * 1.0) - (0) + (0), 1.0));
	///////// Start param6 - UINT8 /////////
	param6 = superval[currentPos++];
	putValue(P_ASG_15_1_0_25_6, round((param6 * 1.0) - (0) + (0), 1.0));
	///////// Start param7 - UINT8 /////////
	param7 = superval[currentPos++];
	putValue(P_ASG_15_1_0_25_7, round((param7 * 1.0) - (0) + (0), 1.0));
	///////// Start param8 - UINT8 /////////
	param8 = superval[currentPos++];
	putValue(P_ASG_15_1_0_25_8, round((param8 * 1.0) - (0) + (0), 1.0));
	///////// Start param9 - UINT8 /////////
	param9 = superval[currentPos++];
	putValue(P_ASG_15_1_0_25_9, round((param9 * 1.0) - (0) + (0), 1.0));
	///////// Start param10 - UINT8 /////////
	param10 = superval[currentPos++];
	putValue(P_ASG_15_1_0_25_10, round((param10 * 1.0) - (0) + (0), 1.0));
	///////// Start param11 - UINT8 /////////
	param11 = superval[currentPos++];
	putValue(P_ASG_15_1_0_25_11, round((param11 * 1.0) - (0) + (0), 1.0));
}

// Updates the bus value field and other dependencies.
P_ASG_15_1_0_25_BuildFct()
{
	word param1; // ComfortPowerConsumption
	byte param2; // ComfortPowerConsumption_Unit
	dword param3; // ZeroEmissionDistance_Value
	byte param4; // Distance_Unit
	dword param5; // ZeroEmissionTime_Value
	byte param6; // Extension1
	byte param7; // Extension2
	byte param8; // Extension3
	byte param9; // Extension4
	byte param10; // Extension5
	byte param11; // Extension6

	int i;
	byte superval[18];
	int currentPos;
	currentPos = 0;
// gen_BuildFunc_SetSuperVals 
	@P_ASG_15_1_0_25_1_range = round(@P_ASG_15_1_0_25_1 + (0), 0.01); // slider value + min = real value
	param1 = round( (@P_ASG_15_1_0_25_1 + (0) - (0)) / (0.01), 0.01); // (slider value + min - offset) / step = busvalue
	superval[currentPos++]=param1&0x00ff;
	superval[currentPos++]=(param1&0xff00)>>8;
// gen_BuildFunc_SetSuperVals 
	param2 = getValue(P_ASG_15_1_0_25_2);
	superval[currentPos++]=param2;
// gen_BuildFunc_SetSuperVals 
	@P_ASG_15_1_0_25_3_range = round(@P_ASG_15_1_0_25_3 + (0), 0.1); // slider value + min = real value
	param3 = round( (@P_ASG_15_1_0_25_3 + (0) - (0)) / (0.1), 0.1); // (slider value + min - offset) / step = busvalue
	superval[currentPos++]= param3&0x000000ff;
	superval[currentPos++]=(param3&0x0000ff00)>>8;
	superval[currentPos++]=(param3&0x00ff0000)>>16;
	superval[currentPos++]=(param3&0xff000000)>>24;
// gen_BuildFunc_SetSuperVals 
	param4 = getValue(P_ASG_15_1_0_25_4);
	superval[currentPos++]=param4;
// gen_BuildFunc_SetSuperVals 
	@P_ASG_15_1_0_25_5_range = round(@P_ASG_15_1_0_25_5 + (0), 1.0); // slider value + min = real value
	param5 = round( (@P_ASG_15_1_0_25_5 + (0) - (0)) / (1.0), 1.0); // (slider value + min - offset) / step = busvalue
	superval[currentPos++]= param5&0x000000ff;
	superval[currentPos++]=(param5&0x0000ff00)>>8;
	superval[currentPos++]=(param5&0x00ff0000)>>16;
	superval[currentPos++]=(param5&0xff000000)>>24;
// gen_BuildFunc_SetSuperVals 
	@P_ASG_15_1_0_25_6_range = round(@P_ASG_15_1_0_25_6 + (0), 1.0); // slider value + min = real value
	param6 = 0; // underlying parameter has constant value 0.
	superval[currentPos++]=param6;
// gen_BuildFunc_SetSuperVals 
	@P_ASG_15_1_0_25_7_range = round(@P_ASG_15_1_0_25_7 + (0), 1.0); // slider value + min = real value
	param7 = 0; // underlying parameter has constant value 0.
	superval[currentPos++]=param7;
// gen_BuildFunc_SetSuperVals 
	@P_ASG_15_1_0_25_8_range = round(@P_ASG_15_1_0_25_8 + (0), 1.0); // slider value + min = real value
	param8 = 0; // underlying parameter has constant value 0.
	superval[currentPos++]=param8;
// gen_BuildFunc_SetSuperVals 
	@P_ASG_15_1_0_25_9_range = round(@P_ASG_15_1_0_25_9 + (0), 1.0); // slider value + min = real value
	param9 = 0; // underlying parameter has constant value 0.
	superval[currentPos++]=param9;
// gen_BuildFunc_SetSuperVals 
	@P_ASG_15_1_0_25_10_range = round(@P_ASG_15_1_0_25_10 + (0), 1.0); // slider value + min = real value
	param10 = 0; // underlying parameter has constant value 0.
	superval[currentPos++]=param10;
// gen_BuildFunc_SetSuperVals 
	@P_ASG_15_1_0_25_11_range = round(@P_ASG_15_1_0_25_11 + (0), 1.0); // slider value + min = real value
	param11 = 0; // underlying parameter has constant value 0.
	superval[currentPos++]=param11;
	putValue(P_ASG_15_1_0_25, superval, currentPos);
}


// Ueberwachung der Darstellungsvariable der Range.
on envVar P_ASG_15_1_0_25_1_range // LongTermFIS2.ComfortPowerConsumption 
{
	@P_ASG_15_1_0_25_1 = @P_ASG_15_1_0_25_1_range - (0); // slider = range - min
}

on envVar P_ASG_15_1_0_25_1 // LongTermFIS2.ComfortPowerConsumption
{
	P_ASG_15_1_0_25_BuildFct();
}

on envVar P_ASG_15_1_0_25_2 // LongTermFIS2.ComfortPowerConsumption_Unit
{
	P_ASG_15_1_0_25_BuildFct();
}

// Ueberwachung der Darstellungsvariable der Range.
on envVar P_ASG_15_1_0_25_3_range // LongTermFIS2.ZeroEmissionDistance_Value 
{
	@P_ASG_15_1_0_25_3 = @P_ASG_15_1_0_25_3_range - (0); // slider = range - min
}

on envVar P_ASG_15_1_0_25_3 // LongTermFIS2.ZeroEmissionDistance_Value
{
	P_ASG_15_1_0_25_BuildFct();
}

on envVar P_ASG_15_1_0_25_4 // LongTermFIS2.Distance_Unit
{
	P_ASG_15_1_0_25_BuildFct();
}

// Ueberwachung der Darstellungsvariable der Range.
on envVar P_ASG_15_1_0_25_5_range // LongTermFIS2.ZeroEmissionTime_Value 
{
	@P_ASG_15_1_0_25_5 = @P_ASG_15_1_0_25_5_range - (0); // slider = range - min
}

on envVar P_ASG_15_1_0_25_5 // LongTermFIS2.ZeroEmissionTime_Value
{
	P_ASG_15_1_0_25_BuildFct();
}

// Ueberwachung der Darstellungsvariable der Range.
on envVar P_ASG_15_1_0_25_6_range // LongTermFIS2.Extension1 
{
	@P_ASG_15_1_0_25_6 = @P_ASG_15_1_0_25_6_range - (0); // slider = range - min
}

on envVar P_ASG_15_1_0_25_6 // LongTermFIS2.Extension1
{
	P_ASG_15_1_0_25_BuildFct();
}

// Ueberwachung der Darstellungsvariable der Range.
on envVar P_ASG_15_1_0_25_7_range // LongTermFIS2.Extension2 
{
	@P_ASG_15_1_0_25_7 = @P_ASG_15_1_0_25_7_range - (0); // slider = range - min
}

on envVar P_ASG_15_1_0_25_7 // LongTermFIS2.Extension2
{
	P_ASG_15_1_0_25_BuildFct();
}

// Ueberwachung der Darstellungsvariable der Range.
on envVar P_ASG_15_1_0_25_8_range // LongTermFIS2.Extension3 
{
	@P_ASG_15_1_0_25_8 = @P_ASG_15_1_0_25_8_range - (0); // slider = range - min
}

on envVar P_ASG_15_1_0_25_8 // LongTermFIS2.Extension3
{
	P_ASG_15_1_0_25_BuildFct();
}

// Ueberwachung der Darstellungsvariable der Range.
on envVar P_ASG_15_1_0_25_9_range // LongTermFIS2.Extension4 
{
	@P_ASG_15_1_0_25_9 = @P_ASG_15_1_0_25_9_range - (0); // slider = range - min
}

on envVar P_ASG_15_1_0_25_9 // LongTermFIS2.Extension4
{
	P_ASG_15_1_0_25_BuildFct();
}

// Ueberwachung der Darstellungsvariable der Range.
on envVar P_ASG_15_1_0_25_10_range // LongTermFIS2.Extension5 
{
	@P_ASG_15_1_0_25_10 = @P_ASG_15_1_0_25_10_range - (0); // slider = range - min
}

on envVar P_ASG_15_1_0_25_10 // LongTermFIS2.Extension5
{
	P_ASG_15_1_0_25_BuildFct();
}

// Ueberwachung der Darstellungsvariable der Range.
on envVar P_ASG_15_1_0_25_11_range // LongTermFIS2.Extension6 
{
	@P_ASG_15_1_0_25_11 = @P_ASG_15_1_0_25_11_range - (0); // slider = range - min
}

on envVar P_ASG_15_1_0_25_11 // LongTermFIS2.Extension6
{
	P_ASG_15_1_0_25_BuildFct();
}

on envVar P_ASG_15_1_0_26Get_BTN
{
 if (P_ASG_15_1_0_26Get_BTN_already_pressed == 0)
  {
       putValue(P_ASG_15_1_0_26_ErrCode,0);
       SetControlBackColor(panel_name,"errField_P_ASG_15_1_0_26",MakeRGB(255,255,255));
       P_ASG_15_1_0_26Get_BTN_already_pressed = 1;
 }
 else
 {
       Request_Void(LSGID, P_ASG_15_1_0_26_ID, DataGet_REQ); 
       P_ASG_15_1_0_26Get_BTN_already_pressed = 0;
 }
}
on envVar P_ASG_15_1_0_26 // bus value of CycleFIS1 (26).
{
	// opcodes: Error-Status
	int param1; // AverageConsumption1_Value
	byte param2; // Consumption1_Unit
	int param3; // AverageConsumption2_Value
	byte param4; // Consumption2_Unit
	word param5; // AverageSpeed_Value
	byte param6; // Speed_Unit
	dword param7; // Distance_Value
	byte param8; // Distance_Unit
	dword param9; // Time_Value
	// DATATYPE_BYTESEQUENCE / DATATYPE_FIXEDBYTESEQUENCE
	int i;
	byte superval[18];
	int currentPos;
	currentPos = 0;
	for( i = 0; i < 18; i++ ) {
		superval[i] = 0;
	}
	getValue(P_ASG_15_1_0_26, superval);
	///////// Start param1 - UINT16 /////////
	param1 = superval[currentPos++]|(superval[currentPos++]<<8);
	putValue(P_ASG_15_1_0_26_1, round((param1 * 0.1) - (-3276) + (0), 0.1));
	///////// Start param2 - UINT8 /////////
	param2 = superval[currentPos++];
	putValue(P_ASG_15_1_0_26_2, param2);
	///////// Start param3 - UINT16 /////////
	param3 = superval[currentPos++]|(superval[currentPos++]<<8);
	putValue(P_ASG_15_1_0_26_3, round((param3 * 0.1) - (-3276) + (0), 0.1));
	///////// Start param4 - UINT8 /////////
	param4 = superval[currentPos++];
	putValue(P_ASG_15_1_0_26_4, param4);
	///////// Start param5 - UINT16 /////////
	param5 = superval[currentPos++]|(superval[currentPos++]<<8);
	putValue(P_ASG_15_1_0_26_5, round((param5 * 0.1) - (0) + (0), 0.1));
	///////// Start param6 - UINT8 /////////
	param6 = superval[currentPos++];
	putValue(P_ASG_15_1_0_26_6, param6);
	///////// Start param7 - UINT32 /////////
	param7 = superval[currentPos++]|(superval[currentPos++]<<8)|(superval[currentPos++]<<16)|(superval[currentPos++]<<24);
	putValue(P_ASG_15_1_0_26_7, round((param7 * 0.1) - (0) + (0), 0.1));
	///////// Start param8 - UINT8 /////////
	param8 = superval[currentPos++];
	putValue(P_ASG_15_1_0_26_8, param8);
	///////// Start param9 - UINT32 /////////
	param9 = superval[currentPos++]|(superval[currentPos++]<<8)|(superval[currentPos++]<<16)|(superval[currentPos++]<<24);
	putValue(P_ASG_15_1_0_26_9, round((param9 * 1.0) - (0) + (0), 1.0));
}

// Updates the bus value field and other dependencies.
P_ASG_15_1_0_26_BuildFct()
{
	int param1; // AverageConsumption1_Value
	byte param2; // Consumption1_Unit
	int param3; // AverageConsumption2_Value
	byte param4; // Consumption2_Unit
	word param5; // AverageSpeed_Value
	byte param6; // Speed_Unit
	dword param7; // Distance_Value
	byte param8; // Distance_Unit
	dword param9; // Time_Value

	int i;
	byte superval[18];
	int currentPos;
	currentPos = 0;
// gen_BuildFunc_SetSuperVals 
	@P_ASG_15_1_0_26_1_range = round(@P_ASG_15_1_0_26_1 + (-3276), 0.1); // slider value + min = real value
	param1 = round( (@P_ASG_15_1_0_26_1 + (-3276) - (0)) / (0.1), 0.1); // (slider value + min - offset) / step = busvalue
	superval[currentPos++]=param1&0x00ff;
	superval[currentPos++]=(param1&0xff00)>>8;
// gen_BuildFunc_SetSuperVals 
	param2 = getValue(P_ASG_15_1_0_26_2);
	superval[currentPos++]=param2;
// gen_BuildFunc_SetSuperVals 
	@P_ASG_15_1_0_26_3_range = round(@P_ASG_15_1_0_26_3 + (-3276), 0.1); // slider value + min = real value
	param3 = round( (@P_ASG_15_1_0_26_3 + (-3276) - (0)) / (0.1), 0.1); // (slider value + min - offset) / step = busvalue
	superval[currentPos++]=param3&0x00ff;
	superval[currentPos++]=(param3&0xff00)>>8;
// gen_BuildFunc_SetSuperVals 
	param4 = getValue(P_ASG_15_1_0_26_4);
	superval[currentPos++]=param4;
// gen_BuildFunc_SetSuperVals 
	@P_ASG_15_1_0_26_5_range = round(@P_ASG_15_1_0_26_5 + (0), 0.1); // slider value + min = real value
	param5 = round( (@P_ASG_15_1_0_26_5 + (0) - (0)) / (0.1), 0.1); // (slider value + min - offset) / step = busvalue
	superval[currentPos++]=param5&0x00ff;
	superval[currentPos++]=(param5&0xff00)>>8;
// gen_BuildFunc_SetSuperVals 
	param6 = getValue(P_ASG_15_1_0_26_6);
	superval[currentPos++]=param6;
// gen_BuildFunc_SetSuperVals 
	@P_ASG_15_1_0_26_7_range = round(@P_ASG_15_1_0_26_7 + (0), 0.1); // slider value + min = real value
	param7 = round( (@P_ASG_15_1_0_26_7 + (0) - (0)) / (0.1), 0.1); // (slider value + min - offset) / step = busvalue
	superval[currentPos++]= param7&0x000000ff;
	superval[currentPos++]=(param7&0x0000ff00)>>8;
	superval[currentPos++]=(param7&0x00ff0000)>>16;
	superval[currentPos++]=(param7&0xff000000)>>24;
// gen_BuildFunc_SetSuperVals 
	param8 = getValue(P_ASG_15_1_0_26_8);
	superval[currentPos++]=param8;
// gen_BuildFunc_SetSuperVals 
	@P_ASG_15_1_0_26_9_range = round(@P_ASG_15_1_0_26_9 + (0), 1.0); // slider value + min = real value
	param9 = round( (@P_ASG_15_1_0_26_9 + (0) - (0)) / (1.0), 1.0); // (slider value + min - offset) / step = busvalue
	superval[currentPos++]= param9&0x000000ff;
	superval[currentPos++]=(param9&0x0000ff00)>>8;
	superval[currentPos++]=(param9&0x00ff0000)>>16;
	superval[currentPos++]=(param9&0xff000000)>>24;
	putValue(P_ASG_15_1_0_26, superval, currentPos);
}


// Ueberwachung der Darstellungsvariable der Range.
on envVar P_ASG_15_1_0_26_1_range // CycleFIS1.AverageConsumption1_Value 
{
	@P_ASG_15_1_0_26_1 = @P_ASG_15_1_0_26_1_range - (-3276); // slider = range - min
}

on envVar P_ASG_15_1_0_26_1 // CycleFIS1.AverageConsumption1_Value
{
	P_ASG_15_1_0_26_BuildFct();
}

on envVar P_ASG_15_1_0_26_2 // CycleFIS1.Consumption1_Unit
{
	P_ASG_15_1_0_26_BuildFct();
}

// Ueberwachung der Darstellungsvariable der Range.
on envVar P_ASG_15_1_0_26_3_range // CycleFIS1.AverageConsumption2_Value 
{
	@P_ASG_15_1_0_26_3 = @P_ASG_15_1_0_26_3_range - (-3276); // slider = range - min
}

on envVar P_ASG_15_1_0_26_3 // CycleFIS1.AverageConsumption2_Value
{
	P_ASG_15_1_0_26_BuildFct();
}

on envVar P_ASG_15_1_0_26_4 // CycleFIS1.Consumption2_Unit
{
	P_ASG_15_1_0_26_BuildFct();
}

// Ueberwachung der Darstellungsvariable der Range.
on envVar P_ASG_15_1_0_26_5_range // CycleFIS1.AverageSpeed_Value 
{
	@P_ASG_15_1_0_26_5 = @P_ASG_15_1_0_26_5_range - (0); // slider = range - min
}

on envVar P_ASG_15_1_0_26_5 // CycleFIS1.AverageSpeed_Value
{
	P_ASG_15_1_0_26_BuildFct();
}

on envVar P_ASG_15_1_0_26_6 // CycleFIS1.Speed_Unit
{
	P_ASG_15_1_0_26_BuildFct();
}

// Ueberwachung der Darstellungsvariable der Range.
on envVar P_ASG_15_1_0_26_7_range // CycleFIS1.Distance_Value 
{
	@P_ASG_15_1_0_26_7 = @P_ASG_15_1_0_26_7_range - (0); // slider = range - min
}

on envVar P_ASG_15_1_0_26_7 // CycleFIS1.Distance_Value
{
	P_ASG_15_1_0_26_BuildFct();
}

on envVar P_ASG_15_1_0_26_8 // CycleFIS1.Distance_Unit
{
	P_ASG_15_1_0_26_BuildFct();
}

// Ueberwachung der Darstellungsvariable der Range.
on envVar P_ASG_15_1_0_26_9_range // CycleFIS1.Time_Value 
{
	@P_ASG_15_1_0_26_9 = @P_ASG_15_1_0_26_9_range - (0); // slider = range - min
}

on envVar P_ASG_15_1_0_26_9 // CycleFIS1.Time_Value
{
	P_ASG_15_1_0_26_BuildFct();
}

on envVar P_ASG_15_1_0_27Get_BTN
{
 if (P_ASG_15_1_0_27Get_BTN_already_pressed == 0)
  {
       putValue(P_ASG_15_1_0_27_ErrCode,0);
       SetControlBackColor(panel_name,"errField_P_ASG_15_1_0_27",MakeRGB(255,255,255));
       P_ASG_15_1_0_27Get_BTN_already_pressed = 1;
 }
 else
 {
       Request_Void(LSGID, P_ASG_15_1_0_27_ID, DataGet_REQ); 
       P_ASG_15_1_0_27Get_BTN_already_pressed = 0;
 }
}
on envVar P_ASG_15_1_0_27 // bus value of CycleFIS2 (27).
{
	// opcodes: Error-Status
	word param1; // ComfortPowerConsumption
	byte param2; // ComfortPowerConsumption_Unit
	dword param3; // ZeroEmissionDistance_Value
	byte param4; // Distance_Unit
	dword param5; // ZeroEmissionTime_Value
	byte param6; // Extension1
	byte param7; // Extension2
	byte param8; // Extension3
	byte param9; // Extension4
	byte param10; // Extension5
	byte param11; // Extension6
	// DATATYPE_BYTESEQUENCE / DATATYPE_FIXEDBYTESEQUENCE
	int i;
	byte superval[18];
	int currentPos;
	currentPos = 0;
	for( i = 0; i < 18; i++ ) {
		superval[i] = 0;
	}
	getValue(P_ASG_15_1_0_27, superval);
	///////// Start param1 - UINT16 /////////
	param1 = superval[currentPos++]|(superval[currentPos++]<<8);
	putValue(P_ASG_15_1_0_27_1, round((param1 * 0.01) - (0) + (0), 0.01));
	///////// Start param2 - UINT8 /////////
	param2 = superval[currentPos++];
	putValue(P_ASG_15_1_0_27_2, param2);
	///////// Start param3 - UINT32 /////////
	param3 = superval[currentPos++]|(superval[currentPos++]<<8)|(superval[currentPos++]<<16)|(superval[currentPos++]<<24);
	putValue(P_ASG_15_1_0_27_3, round((param3 * 0.1) - (0) + (0), 0.1));
	///////// Start param4 - UINT8 /////////
	param4 = superval[currentPos++];
	putValue(P_ASG_15_1_0_27_4, param4);
	///////// Start param5 - UINT32 /////////
	param5 = superval[currentPos++]|(superval[currentPos++]<<8)|(superval[currentPos++]<<16)|(superval[currentPos++]<<24);
	putValue(P_ASG_15_1_0_27_5, round((param5 * 1.0) - (0) + (0), 1.0));
	///////// Start param6 - UINT8 /////////
	param6 = superval[currentPos++];
	putValue(P_ASG_15_1_0_27_6, round((param6 * 1.0) - (0) + (0), 1.0));
	///////// Start param7 - UINT8 /////////
	param7 = superval[currentPos++];
	putValue(P_ASG_15_1_0_27_7, round((param7 * 1.0) - (0) + (0), 1.0));
	///////// Start param8 - UINT8 /////////
	param8 = superval[currentPos++];
	putValue(P_ASG_15_1_0_27_8, round((param8 * 1.0) - (0) + (0), 1.0));
	///////// Start param9 - UINT8 /////////
	param9 = superval[currentPos++];
	putValue(P_ASG_15_1_0_27_9, round((param9 * 1.0) - (0) + (0), 1.0));
	///////// Start param10 - UINT8 /////////
	param10 = superval[currentPos++];
	putValue(P_ASG_15_1_0_27_10, round((param10 * 1.0) - (0) + (0), 1.0));
	///////// Start param11 - UINT8 /////////
	param11 = superval[currentPos++];
	putValue(P_ASG_15_1_0_27_11, round((param11 * 1.0) - (0) + (0), 1.0));
}

// Updates the bus value field and other dependencies.
P_ASG_15_1_0_27_BuildFct()
{
	word param1; // ComfortPowerConsumption
	byte param2; // ComfortPowerConsumption_Unit
	dword param3; // ZeroEmissionDistance_Value
	byte param4; // Distance_Unit
	dword param5; // ZeroEmissionTime_Value
	byte param6; // Extension1
	byte param7; // Extension2
	byte param8; // Extension3
	byte param9; // Extension4
	byte param10; // Extension5
	byte param11; // Extension6

	int i;
	byte superval[18];
	int currentPos;
	currentPos = 0;
// gen_BuildFunc_SetSuperVals 
	@P_ASG_15_1_0_27_1_range = round(@P_ASG_15_1_0_27_1 + (0), 0.01); // slider value + min = real value
	param1 = round( (@P_ASG_15_1_0_27_1 + (0) - (0)) / (0.01), 0.01); // (slider value + min - offset) / step = busvalue
	superval[currentPos++]=param1&0x00ff;
	superval[currentPos++]=(param1&0xff00)>>8;
// gen_BuildFunc_SetSuperVals 
	param2 = getValue(P_ASG_15_1_0_27_2);
	superval[currentPos++]=param2;
// gen_BuildFunc_SetSuperVals 
	@P_ASG_15_1_0_27_3_range = round(@P_ASG_15_1_0_27_3 + (0), 0.1); // slider value + min = real value
	param3 = round( (@P_ASG_15_1_0_27_3 + (0) - (0)) / (0.1), 0.1); // (slider value + min - offset) / step = busvalue
	superval[currentPos++]= param3&0x000000ff;
	superval[currentPos++]=(param3&0x0000ff00)>>8;
	superval[currentPos++]=(param3&0x00ff0000)>>16;
	superval[currentPos++]=(param3&0xff000000)>>24;
// gen_BuildFunc_SetSuperVals 
	param4 = getValue(P_ASG_15_1_0_27_4);
	superval[currentPos++]=param4;
// gen_BuildFunc_SetSuperVals 
	@P_ASG_15_1_0_27_5_range = round(@P_ASG_15_1_0_27_5 + (0), 1.0); // slider value + min = real value
	param5 = round( (@P_ASG_15_1_0_27_5 + (0) - (0)) / (1.0), 1.0); // (slider value + min - offset) / step = busvalue
	superval[currentPos++]= param5&0x000000ff;
	superval[currentPos++]=(param5&0x0000ff00)>>8;
	superval[currentPos++]=(param5&0x00ff0000)>>16;
	superval[currentPos++]=(param5&0xff000000)>>24;
// gen_BuildFunc_SetSuperVals 
	@P_ASG_15_1_0_27_6_range = round(@P_ASG_15_1_0_27_6 + (0), 1.0); // slider value + min = real value
	param6 = 0; // underlying parameter has constant value 0.
	superval[currentPos++]=param6;
// gen_BuildFunc_SetSuperVals 
	@P_ASG_15_1_0_27_7_range = round(@P_ASG_15_1_0_27_7 + (0), 1.0); // slider value + min = real value
	param7 = 0; // underlying parameter has constant value 0.
	superval[currentPos++]=param7;
// gen_BuildFunc_SetSuperVals 
	@P_ASG_15_1_0_27_8_range = round(@P_ASG_15_1_0_27_8 + (0), 1.0); // slider value + min = real value
	param8 = 0; // underlying parameter has constant value 0.
	superval[currentPos++]=param8;
// gen_BuildFunc_SetSuperVals 
	@P_ASG_15_1_0_27_9_range = round(@P_ASG_15_1_0_27_9 + (0), 1.0); // slider value + min = real value
	param9 = 0; // underlying parameter has constant value 0.
	superval[currentPos++]=param9;
// gen_BuildFunc_SetSuperVals 
	@P_ASG_15_1_0_27_10_range = round(@P_ASG_15_1_0_27_10 + (0), 1.0); // slider value + min = real value
	param10 = 0; // underlying parameter has constant value 0.
	superval[currentPos++]=param10;
// gen_BuildFunc_SetSuperVals 
	@P_ASG_15_1_0_27_11_range = round(@P_ASG_15_1_0_27_11 + (0), 1.0); // slider value + min = real value
	param11 = 0; // underlying parameter has constant value 0.
	superval[currentPos++]=param11;
	putValue(P_ASG_15_1_0_27, superval, currentPos);
}


// Ueberwachung der Darstellungsvariable der Range.
on envVar P_ASG_15_1_0_27_1_range // CycleFIS2.ComfortPowerConsumption 
{
	@P_ASG_15_1_0_27_1 = @P_ASG_15_1_0_27_1_range - (0); // slider = range - min
}

on envVar P_ASG_15_1_0_27_1 // CycleFIS2.ComfortPowerConsumption
{
	P_ASG_15_1_0_27_BuildFct();
}

on envVar P_ASG_15_1_0_27_2 // CycleFIS2.ComfortPowerConsumption_Unit
{
	P_ASG_15_1_0_27_BuildFct();
}

// Ueberwachung der Darstellungsvariable der Range.
on envVar P_ASG_15_1_0_27_3_range // CycleFIS2.ZeroEmissionDistance_Value 
{
	@P_ASG_15_1_0_27_3 = @P_ASG_15_1_0_27_3_range - (0); // slider = range - min
}

on envVar P_ASG_15_1_0_27_3 // CycleFIS2.ZeroEmissionDistance_Value
{
	P_ASG_15_1_0_27_BuildFct();
}

on envVar P_ASG_15_1_0_27_4 // CycleFIS2.Distance_Unit
{
	P_ASG_15_1_0_27_BuildFct();
}

// Ueberwachung der Darstellungsvariable der Range.
on envVar P_ASG_15_1_0_27_5_range // CycleFIS2.ZeroEmissionTime_Value 
{
	@P_ASG_15_1_0_27_5 = @P_ASG_15_1_0_27_5_range - (0); // slider = range - min
}

on envVar P_ASG_15_1_0_27_5 // CycleFIS2.ZeroEmissionTime_Value
{
	P_ASG_15_1_0_27_BuildFct();
}

// Ueberwachung der Darstellungsvariable der Range.
on envVar P_ASG_15_1_0_27_6_range // CycleFIS2.Extension1 
{
	@P_ASG_15_1_0_27_6 = @P_ASG_15_1_0_27_6_range - (0); // slider = range - min
}

on envVar P_ASG_15_1_0_27_6 // CycleFIS2.Extension1
{
	P_ASG_15_1_0_27_BuildFct();
}

// Ueberwachung der Darstellungsvariable der Range.
on envVar P_ASG_15_1_0_27_7_range // CycleFIS2.Extension2 
{
	@P_ASG_15_1_0_27_7 = @P_ASG_15_1_0_27_7_range - (0); // slider = range - min
}

on envVar P_ASG_15_1_0_27_7 // CycleFIS2.Extension2
{
	P_ASG_15_1_0_27_BuildFct();
}

// Ueberwachung der Darstellungsvariable der Range.
on envVar P_ASG_15_1_0_27_8_range // CycleFIS2.Extension3 
{
	@P_ASG_15_1_0_27_8 = @P_ASG_15_1_0_27_8_range - (0); // slider = range - min
}

on envVar P_ASG_15_1_0_27_8 // CycleFIS2.Extension3
{
	P_ASG_15_1_0_27_BuildFct();
}

// Ueberwachung der Darstellungsvariable der Range.
on envVar P_ASG_15_1_0_27_9_range // CycleFIS2.Extension4 
{
	@P_ASG_15_1_0_27_9 = @P_ASG_15_1_0_27_9_range - (0); // slider = range - min
}

on envVar P_ASG_15_1_0_27_9 // CycleFIS2.Extension4
{
	P_ASG_15_1_0_27_BuildFct();
}

// Ueberwachung der Darstellungsvariable der Range.
on envVar P_ASG_15_1_0_27_10_range // CycleFIS2.Extension5 
{
	@P_ASG_15_1_0_27_10 = @P_ASG_15_1_0_27_10_range - (0); // slider = range - min
}

on envVar P_ASG_15_1_0_27_10 // CycleFIS2.Extension5
{
	P_ASG_15_1_0_27_BuildFct();
}

// Ueberwachung der Darstellungsvariable der Range.
on envVar P_ASG_15_1_0_27_11_range // CycleFIS2.Extension6 
{
	@P_ASG_15_1_0_27_11 = @P_ASG_15_1_0_27_11_range - (0); // slider = range - min
}

on envVar P_ASG_15_1_0_27_11 // CycleFIS2.Extension6
{
	P_ASG_15_1_0_27_BuildFct();
}

on envVar P_ASG_15_1_0_28Get_BTN
{
 if (P_ASG_15_1_0_28Get_BTN_already_pressed == 0)
  {
       putValue(P_ASG_15_1_0_28_ErrCode,0);
       SetControlBackColor(panel_name,"errField_P_ASG_15_1_0_28",MakeRGB(255,255,255));
       P_ASG_15_1_0_28Get_BTN_already_pressed = 1;
 }
 else
 {
       Request_Void(LSGID, P_ASG_15_1_0_28_ID, DataGet_REQ); 
       P_ASG_15_1_0_28Get_BTN_already_pressed = 0;
 }
}
on envVar P_ASG_15_1_0_28 // bus value of ResetTimeStampsFIS (28).
{
	// opcodes: Error-Status
	byte param1[5]; //Record: ShortTermResetTimeStamp
	byte param2[5]; //Record: LongTermResetTimeStamp
	byte param3[5]; //Record: CycleResetTimeStamp
	// DATATYPE_BYTESEQUENCE / DATATYPE_FIXEDBYTESEQUENCE
	int i;
	byte superval[15];
	int currentPos;
	currentPos = 0;
	for( i = 0; i < 15; i++ ) {
		superval[i] = 0;
	}
	getValue(P_ASG_15_1_0_28, superval);
	///////// Start param1 - Record /////////
	for( i = 0; i < 5; i++ )
	{
		param1[i] = superval[currentPos++];
	}
	putValue(P_ASG_15_1_0_28_1, param1);
	///////// Start param2 - Record /////////
	for( i = 0; i < 5; i++ )
	{
		param2[i] = superval[currentPos++];
	}
	putValue(P_ASG_15_1_0_28_2, param2);
	///////// Start param3 - Record /////////
	for( i = 0; i < 5; i++ )
	{
		param3[i] = superval[currentPos++];
	}
	putValue(P_ASG_15_1_0_28_3, param3);
}

// Updates the bus value field and other dependencies.
P_ASG_15_1_0_28_BuildFct()
{
	byte param1[5]; //Record: ShortTermResetTimeStamp
	byte param2[5]; //Record: LongTermResetTimeStamp
	byte param3[5]; //Record: CycleResetTimeStamp

	int i;
	byte superval[15];
	int currentPos;
	currentPos = 0;
// gen_BuildFunc_SetSuperVals 
	//Record:ShortTermResetTimeStamp
	getValue(P_ASG_15_1_0_28_1, param1);
	for( i = 0; i < 5; i++)
	{
	 superval[currentPos++] = param1[i];
	}
// gen_BuildFunc_SetSuperVals 
	//Record:LongTermResetTimeStamp
	getValue(P_ASG_15_1_0_28_2, param2);
	for( i = 0; i < 5; i++)
	{
	 superval[currentPos++] = param2[i];
	}
// gen_BuildFunc_SetSuperVals 
	//Record:CycleResetTimeStamp
	getValue(P_ASG_15_1_0_28_3, param3);
	for( i = 0; i < 5; i++)
	{
	 superval[currentPos++] = param3[i];
	}
	putValue(P_ASG_15_1_0_28, superval, currentPos);
}


//Record: ShortTermResetTimeStamp, Element: Year
// Ueberwachung der Darstellungsvariable der Range.
on envVar P_ASG_15_1_0_28_1_Year_range // ResetTimeStampsFIS.Year 
{
	@P_ASG_15_1_0_28_1_Year = @P_ASG_15_1_0_28_1_Year_range - (0); // slider = range - min
}

on envVar P_ASG_15_1_0_28_1_Year // ShortTermResetTimeStamp.Year
{
	byte superval[5];

	//Update Childvalue (Number)
	byte thisval; // Year
	float slider_value;

	slider_value = round(@P_ASG_15_1_0_28_1_Year, 1.0);
	@P_ASG_15_1_0_28_1_Year_range = slider_value + (0); // real value := slider value + range min.
	thisval = (byte)round((slider_value + (0) - (0)) / (1.0), 1); // bus value := (slider value + min - offset) / step.

    // Update superval
	getValue(P_ASG_15_1_0_28_1, superval);
	superval[0]=thisval;
	putValue(P_ASG_15_1_0_28_1,superval);
}

//Record: ShortTermResetTimeStamp, Element: Month
// Ueberwachung der Darstellungsvariable der Range.
on envVar P_ASG_15_1_0_28_1_Month_range // ResetTimeStampsFIS.Month 
{
	@P_ASG_15_1_0_28_1_Month = @P_ASG_15_1_0_28_1_Month_range - (1); // slider = range - min
}

on envVar P_ASG_15_1_0_28_1_Month // ShortTermResetTimeStamp.Month
{
	byte superval[5];

	//Update Childvalue (Number)
	byte thisval; // Month
	float slider_value;

	slider_value = round(@P_ASG_15_1_0_28_1_Month, 1.0);
	@P_ASG_15_1_0_28_1_Month_range = slider_value + (1); // real value := slider value + range min.
	thisval = (byte)round((slider_value + (1) - (1)) / (1.0), 1); // bus value := (slider value + min - offset) / step.

    // Update superval
	getValue(P_ASG_15_1_0_28_1, superval);
	superval[1]=thisval;
	putValue(P_ASG_15_1_0_28_1,superval);
}

//Record: ShortTermResetTimeStamp, Element: Day
// Ueberwachung der Darstellungsvariable der Range.
on envVar P_ASG_15_1_0_28_1_Day_range // ResetTimeStampsFIS.Day 
{
	@P_ASG_15_1_0_28_1_Day = @P_ASG_15_1_0_28_1_Day_range - (1); // slider = range - min
}

on envVar P_ASG_15_1_0_28_1_Day // ShortTermResetTimeStamp.Day
{
	byte superval[5];

	//Update Childvalue (Number)
	byte thisval; // Day
	float slider_value;

	slider_value = round(@P_ASG_15_1_0_28_1_Day, 1.0);
	@P_ASG_15_1_0_28_1_Day_range = slider_value + (1); // real value := slider value + range min.
	thisval = (byte)round((slider_value + (1) - (1)) / (1.0), 1); // bus value := (slider value + min - offset) / step.

    // Update superval
	getValue(P_ASG_15_1_0_28_1, superval);
	superval[2]=thisval;
	putValue(P_ASG_15_1_0_28_1,superval);
}

//Record: ShortTermResetTimeStamp, Element: Hour
// Ueberwachung der Darstellungsvariable der Range.
on envVar P_ASG_15_1_0_28_1_Hour_range // ResetTimeStampsFIS.Hour 
{
	@P_ASG_15_1_0_28_1_Hour = @P_ASG_15_1_0_28_1_Hour_range - (0); // slider = range - min
}

on envVar P_ASG_15_1_0_28_1_Hour // ShortTermResetTimeStamp.Hour
{
	byte superval[5];

	//Update Childvalue (Number)
	byte thisval; // Hour
	float slider_value;

	slider_value = round(@P_ASG_15_1_0_28_1_Hour, 1.0);
	@P_ASG_15_1_0_28_1_Hour_range = slider_value + (0); // real value := slider value + range min.
	thisval = (byte)round((slider_value + (0) - (0)) / (1.0), 1); // bus value := (slider value + min - offset) / step.

    // Update superval
	getValue(P_ASG_15_1_0_28_1, superval);
	superval[3]=thisval;
	putValue(P_ASG_15_1_0_28_1,superval);
}

//Record: ShortTermResetTimeStamp, Element: Minute
// Ueberwachung der Darstellungsvariable der Range.
on envVar P_ASG_15_1_0_28_1_Minute_range // ResetTimeStampsFIS.Minute 
{
	@P_ASG_15_1_0_28_1_Minute = @P_ASG_15_1_0_28_1_Minute_range - (0); // slider = range - min
}

on envVar P_ASG_15_1_0_28_1_Minute // ShortTermResetTimeStamp.Minute
{
	byte superval[5];

	//Update Childvalue (Number)
	byte thisval; // Minute
	float slider_value;

	slider_value = round(@P_ASG_15_1_0_28_1_Minute, 1.0);
	@P_ASG_15_1_0_28_1_Minute_range = slider_value + (0); // real value := slider value + range min.
	thisval = (byte)round((slider_value + (0) - (0)) / (1.0), 1); // bus value := (slider value + min - offset) / step.

    // Update superval
	getValue(P_ASG_15_1_0_28_1, superval);
	superval[4]=thisval;
	putValue(P_ASG_15_1_0_28_1,superval);
}

on envVar P_ASG_15_1_0_28_1 // ResetTimeStampsFIS.ShortTermResetTimeStamp
{
	byte recordVal[5]; //Record: ShortTermResetTimeStamp
	int currentPos;
	int i;
//UpdateChildValue for Record.
	byte param1; // Year
	byte param2; // Month
	byte param3; // Day
	byte param4; // Hour
	byte param5; // Minute

	currentPos = 0;
	getValue(P_ASG_15_1_0_28_1, recordVal);
	// DATATYPE_BYTESEQUENCE / DATATYPE_FIXEDBYTESEQUENCE
	///////// Start param1 - UINT8 /////////
	param1 = recordVal[currentPos++];
	putValue(P_ASG_15_1_0_28_1_Year, round((param1 * 1.0) - (0) + (0), 1.0));
	///////// Start param2 - UINT8 /////////
	param2 = recordVal[currentPos++];
	putValue(P_ASG_15_1_0_28_1_Month, round((param2 * 1.0) - (1) + (1), 1.0));
	///////// Start param3 - UINT8 /////////
	param3 = recordVal[currentPos++];
	putValue(P_ASG_15_1_0_28_1_Day, round((param3 * 1.0) - (1) + (1), 1.0));
	///////// Start param4 - UINT8 /////////
	param4 = recordVal[currentPos++];
	putValue(P_ASG_15_1_0_28_1_Hour, round((param4 * 1.0) - (0) + (0), 1.0));
	///////// Start param5 - UINT8 /////////
	param5 = recordVal[currentPos++];
	putValue(P_ASG_15_1_0_28_1_Minute, round((param5 * 1.0) - (0) + (0), 1.0));
	P_ASG_15_1_0_28_BuildFct();
}

//Record: LongTermResetTimeStamp, Element: Year
// Ueberwachung der Darstellungsvariable der Range.
on envVar P_ASG_15_1_0_28_2_Year_range // ResetTimeStampsFIS.Year 
{
	@P_ASG_15_1_0_28_2_Year = @P_ASG_15_1_0_28_2_Year_range - (0); // slider = range - min
}

on envVar P_ASG_15_1_0_28_2_Year // LongTermResetTimeStamp.Year
{
	byte superval[5];

	//Update Childvalue (Number)
	byte thisval; // Year
	float slider_value;

	slider_value = round(@P_ASG_15_1_0_28_2_Year, 1.0);
	@P_ASG_15_1_0_28_2_Year_range = slider_value + (0); // real value := slider value + range min.
	thisval = (byte)round((slider_value + (0) - (0)) / (1.0), 1); // bus value := (slider value + min - offset) / step.

    // Update superval
	getValue(P_ASG_15_1_0_28_2, superval);
	superval[0]=thisval;
	putValue(P_ASG_15_1_0_28_2,superval);
}

//Record: LongTermResetTimeStamp, Element: Month
// Ueberwachung der Darstellungsvariable der Range.
on envVar P_ASG_15_1_0_28_2_Month_range // ResetTimeStampsFIS.Month 
{
	@P_ASG_15_1_0_28_2_Month = @P_ASG_15_1_0_28_2_Month_range - (1); // slider = range - min
}

on envVar P_ASG_15_1_0_28_2_Month // LongTermResetTimeStamp.Month
{
	byte superval[5];

	//Update Childvalue (Number)
	byte thisval; // Month
	float slider_value;

	slider_value = round(@P_ASG_15_1_0_28_2_Month, 1.0);
	@P_ASG_15_1_0_28_2_Month_range = slider_value + (1); // real value := slider value + range min.
	thisval = (byte)round((slider_value + (1) - (1)) / (1.0), 1); // bus value := (slider value + min - offset) / step.

    // Update superval
	getValue(P_ASG_15_1_0_28_2, superval);
	superval[1]=thisval;
	putValue(P_ASG_15_1_0_28_2,superval);
}

//Record: LongTermResetTimeStamp, Element: Day
// Ueberwachung der Darstellungsvariable der Range.
on envVar P_ASG_15_1_0_28_2_Day_range // ResetTimeStampsFIS.Day 
{
	@P_ASG_15_1_0_28_2_Day = @P_ASG_15_1_0_28_2_Day_range - (1); // slider = range - min
}

on envVar P_ASG_15_1_0_28_2_Day // LongTermResetTimeStamp.Day
{
	byte superval[5];

	//Update Childvalue (Number)
	byte thisval; // Day
	float slider_value;

	slider_value = round(@P_ASG_15_1_0_28_2_Day, 1.0);
	@P_ASG_15_1_0_28_2_Day_range = slider_value + (1); // real value := slider value + range min.
	thisval = (byte)round((slider_value + (1) - (1)) / (1.0), 1); // bus value := (slider value + min - offset) / step.

    // Update superval
	getValue(P_ASG_15_1_0_28_2, superval);
	superval[2]=thisval;
	putValue(P_ASG_15_1_0_28_2,superval);
}

//Record: LongTermResetTimeStamp, Element: Hour
// Ueberwachung der Darstellungsvariable der Range.
on envVar P_ASG_15_1_0_28_2_Hour_range // ResetTimeStampsFIS.Hour 
{
	@P_ASG_15_1_0_28_2_Hour = @P_ASG_15_1_0_28_2_Hour_range - (0); // slider = range - min
}

on envVar P_ASG_15_1_0_28_2_Hour // LongTermResetTimeStamp.Hour
{
	byte superval[5];

	//Update Childvalue (Number)
	byte thisval; // Hour
	float slider_value;

	slider_value = round(@P_ASG_15_1_0_28_2_Hour, 1.0);
	@P_ASG_15_1_0_28_2_Hour_range = slider_value + (0); // real value := slider value + range min.
	thisval = (byte)round((slider_value + (0) - (0)) / (1.0), 1); // bus value := (slider value + min - offset) / step.

    // Update superval
	getValue(P_ASG_15_1_0_28_2, superval);
	superval[3]=thisval;
	putValue(P_ASG_15_1_0_28_2,superval);
}

//Record: LongTermResetTimeStamp, Element: Minute
// Ueberwachung der Darstellungsvariable der Range.
on envVar P_ASG_15_1_0_28_2_Minute_range // ResetTimeStampsFIS.Minute 
{
	@P_ASG_15_1_0_28_2_Minute = @P_ASG_15_1_0_28_2_Minute_range - (0); // slider = range - min
}

on envVar P_ASG_15_1_0_28_2_Minute // LongTermResetTimeStamp.Minute
{
	byte superval[5];

	//Update Childvalue (Number)
	byte thisval; // Minute
	float slider_value;

	slider_value = round(@P_ASG_15_1_0_28_2_Minute, 1.0);
	@P_ASG_15_1_0_28_2_Minute_range = slider_value + (0); // real value := slider value + range min.
	thisval = (byte)round((slider_value + (0) - (0)) / (1.0), 1); // bus value := (slider value + min - offset) / step.

    // Update superval
	getValue(P_ASG_15_1_0_28_2, superval);
	superval[4]=thisval;
	putValue(P_ASG_15_1_0_28_2,superval);
}

on envVar P_ASG_15_1_0_28_2 // ResetTimeStampsFIS.LongTermResetTimeStamp
{
	byte recordVal[5]; //Record: LongTermResetTimeStamp
	int currentPos;
	int i;
//UpdateChildValue for Record.
	byte param1; // Year
	byte param2; // Month
	byte param3; // Day
	byte param4; // Hour
	byte param5; // Minute

	currentPos = 0;
	getValue(P_ASG_15_1_0_28_2, recordVal);
	// DATATYPE_BYTESEQUENCE / DATATYPE_FIXEDBYTESEQUENCE
	///////// Start param1 - UINT8 /////////
	param1 = recordVal[currentPos++];
	putValue(P_ASG_15_1_0_28_2_Year, round((param1 * 1.0) - (0) + (0), 1.0));
	///////// Start param2 - UINT8 /////////
	param2 = recordVal[currentPos++];
	putValue(P_ASG_15_1_0_28_2_Month, round((param2 * 1.0) - (1) + (1), 1.0));
	///////// Start param3 - UINT8 /////////
	param3 = recordVal[currentPos++];
	putValue(P_ASG_15_1_0_28_2_Day, round((param3 * 1.0) - (1) + (1), 1.0));
	///////// Start param4 - UINT8 /////////
	param4 = recordVal[currentPos++];
	putValue(P_ASG_15_1_0_28_2_Hour, round((param4 * 1.0) - (0) + (0), 1.0));
	///////// Start param5 - UINT8 /////////
	param5 = recordVal[currentPos++];
	putValue(P_ASG_15_1_0_28_2_Minute, round((param5 * 1.0) - (0) + (0), 1.0));
	P_ASG_15_1_0_28_BuildFct();
}

//Record: CycleResetTimeStamp, Element: Year
// Ueberwachung der Darstellungsvariable der Range.
on envVar P_ASG_15_1_0_28_3_Year_range // ResetTimeStampsFIS.Year 
{
	@P_ASG_15_1_0_28_3_Year = @P_ASG_15_1_0_28_3_Year_range - (0); // slider = range - min
}

on envVar P_ASG_15_1_0_28_3_Year // CycleResetTimeStamp.Year
{
	byte superval[5];

	//Update Childvalue (Number)
	byte thisval; // Year
	float slider_value;

	slider_value = round(@P_ASG_15_1_0_28_3_Year, 1.0);
	@P_ASG_15_1_0_28_3_Year_range = slider_value + (0); // real value := slider value + range min.
	thisval = (byte)round((slider_value + (0) - (0)) / (1.0), 1); // bus value := (slider value + min - offset) / step.

    // Update superval
	getValue(P_ASG_15_1_0_28_3, superval);
	superval[0]=thisval;
	putValue(P_ASG_15_1_0_28_3,superval);
}

//Record: CycleResetTimeStamp, Element: Month
// Ueberwachung der Darstellungsvariable der Range.
on envVar P_ASG_15_1_0_28_3_Month_range // ResetTimeStampsFIS.Month 
{
	@P_ASG_15_1_0_28_3_Month = @P_ASG_15_1_0_28_3_Month_range - (1); // slider = range - min
}

on envVar P_ASG_15_1_0_28_3_Month // CycleResetTimeStamp.Month
{
	byte superval[5];

	//Update Childvalue (Number)
	byte thisval; // Month
	float slider_value;

	slider_value = round(@P_ASG_15_1_0_28_3_Month, 1.0);
	@P_ASG_15_1_0_28_3_Month_range = slider_value + (1); // real value := slider value + range min.
	thisval = (byte)round((slider_value + (1) - (1)) / (1.0), 1); // bus value := (slider value + min - offset) / step.

    // Update superval
	getValue(P_ASG_15_1_0_28_3, superval);
	superval[1]=thisval;
	putValue(P_ASG_15_1_0_28_3,superval);
}

//Record: CycleResetTimeStamp, Element: Day
// Ueberwachung der Darstellungsvariable der Range.
on envVar P_ASG_15_1_0_28_3_Day_range // ResetTimeStampsFIS.Day 
{
	@P_ASG_15_1_0_28_3_Day = @P_ASG_15_1_0_28_3_Day_range - (1); // slider = range - min
}

on envVar P_ASG_15_1_0_28_3_Day // CycleResetTimeStamp.Day
{
	byte superval[5];

	//Update Childvalue (Number)
	byte thisval; // Day
	float slider_value;

	slider_value = round(@P_ASG_15_1_0_28_3_Day, 1.0);
	@P_ASG_15_1_0_28_3_Day_range = slider_value + (1); // real value := slider value + range min.
	thisval = (byte)round((slider_value + (1) - (1)) / (1.0), 1); // bus value := (slider value + min - offset) / step.

    // Update superval
	getValue(P_ASG_15_1_0_28_3, superval);
	superval[2]=thisval;
	putValue(P_ASG_15_1_0_28_3,superval);
}

//Record: CycleResetTimeStamp, Element: Hour
// Ueberwachung der Darstellungsvariable der Range.
on envVar P_ASG_15_1_0_28_3_Hour_range // ResetTimeStampsFIS.Hour 
{
	@P_ASG_15_1_0_28_3_Hour = @P_ASG_15_1_0_28_3_Hour_range - (0); // slider = range - min
}

on envVar P_ASG_15_1_0_28_3_Hour // CycleResetTimeStamp.Hour
{
	byte superval[5];

	//Update Childvalue (Number)
	byte thisval; // Hour
	float slider_value;

	slider_value = round(@P_ASG_15_1_0_28_3_Hour, 1.0);
	@P_ASG_15_1_0_28_3_Hour_range = slider_value + (0); // real value := slider value + range min.
	thisval = (byte)round((slider_value + (0) - (0)) / (1.0), 1); // bus value := (slider value + min - offset) / step.

    // Update superval
	getValue(P_ASG_15_1_0_28_3, superval);
	superval[3]=thisval;
	putValue(P_ASG_15_1_0_28_3,superval);
}

//Record: CycleResetTimeStamp, Element: Minute
// Ueberwachung der Darstellungsvariable der Range.
on envVar P_ASG_15_1_0_28_3_Minute_range // ResetTimeStampsFIS.Minute 
{
	@P_ASG_15_1_0_28_3_Minute = @P_ASG_15_1_0_28_3_Minute_range - (0); // slider = range - min
}

on envVar P_ASG_15_1_0_28_3_Minute // CycleResetTimeStamp.Minute
{
	byte superval[5];

	//Update Childvalue (Number)
	byte thisval; // Minute
	float slider_value;

	slider_value = round(@P_ASG_15_1_0_28_3_Minute, 1.0);
	@P_ASG_15_1_0_28_3_Minute_range = slider_value + (0); // real value := slider value + range min.
	thisval = (byte)round((slider_value + (0) - (0)) / (1.0), 1); // bus value := (slider value + min - offset) / step.

    // Update superval
	getValue(P_ASG_15_1_0_28_3, superval);
	superval[4]=thisval;
	putValue(P_ASG_15_1_0_28_3,superval);
}

on envVar P_ASG_15_1_0_28_3 // ResetTimeStampsFIS.CycleResetTimeStamp
{
	byte recordVal[5]; //Record: CycleResetTimeStamp
	int currentPos;
	int i;
//UpdateChildValue for Record.
	byte param1; // Year
	byte param2; // Month
	byte param3; // Day
	byte param4; // Hour
	byte param5; // Minute

	currentPos = 0;
	getValue(P_ASG_15_1_0_28_3, recordVal);
	// DATATYPE_BYTESEQUENCE / DATATYPE_FIXEDBYTESEQUENCE
	///////// Start param1 - UINT8 /////////
	param1 = recordVal[currentPos++];
	putValue(P_ASG_15_1_0_28_3_Year, round((param1 * 1.0) - (0) + (0), 1.0));
	///////// Start param2 - UINT8 /////////
	param2 = recordVal[currentPos++];
	putValue(P_ASG_15_1_0_28_3_Month, round((param2 * 1.0) - (1) + (1), 1.0));
	///////// Start param3 - UINT8 /////////
	param3 = recordVal[currentPos++];
	putValue(P_ASG_15_1_0_28_3_Day, round((param3 * 1.0) - (1) + (1), 1.0));
	///////// Start param4 - UINT8 /////////
	param4 = recordVal[currentPos++];
	putValue(P_ASG_15_1_0_28_3_Hour, round((param4 * 1.0) - (0) + (0), 1.0));
	///////// Start param5 - UINT8 /////////
	param5 = recordVal[currentPos++];
	putValue(P_ASG_15_1_0_28_3_Minute, round((param5 * 1.0) - (0) + (0), 1.0));
	P_ASG_15_1_0_28_BuildFct();
}

on envVar P_ASG_15_1_0_29Get_BTN
{
 if (P_ASG_15_1_0_29Get_BTN_already_pressed == 0)
  {
       putValue(P_ASG_15_1_0_29_ErrCode,0);
       SetControlBackColor(panel_name,"errField_P_ASG_15_1_0_29",MakeRGB(255,255,255));
       P_ASG_15_1_0_29Get_BTN_already_pressed = 1;
 }
 else
 {
       Request_Void(LSGID, P_ASG_15_1_0_29_ID, DataGet_REQ); 
       P_ASG_15_1_0_29Get_BTN_already_pressed = 0;
 }
}
on envVar P_ASG_15_1_0_29 // bus value of TankLevel (29).
{
	// opcodes: Error-Status
	byte param1; // TankLevel1
	byte param2; // TankLevel2
	// DATATYPE_BYTESEQUENCE / DATATYPE_FIXEDBYTESEQUENCE
	int i;
	byte superval[2];
	int currentPos;
	currentPos = 0;
	for( i = 0; i < 2; i++ ) {
		superval[i] = 0;
	}
	getValue(P_ASG_15_1_0_29, superval);
	///////// Start param1 - UINT8 /////////
	param1 = superval[currentPos++];
	putValue(P_ASG_15_1_0_29_1, round((param1 * 1.0) - (0) + (0), 1.0));
	///////// Start param2 - UINT8 /////////
	param2 = superval[currentPos++];
	putValue(P_ASG_15_1_0_29_2, round((param2 * 1.0) - (0) + (0), 1.0));
}

// Ueberwachung der Darstellungsvariable der Range.
on envVar P_ASG_15_1_0_29_1_range // TankLevel.TankLevel1 
{
	@P_ASG_15_1_0_29_1 = @P_ASG_15_1_0_29_1_range - (0); // slider = range - min
}

on envVar P_ASG_15_1_0_29_1 // TankLevel.TankLevel1
{
	byte superval[2];

	//Update Childvalue (Number)
	byte thisval; // TankLevel1
	float slider_value;

	slider_value = round(@P_ASG_15_1_0_29_1, 1.0);
	@P_ASG_15_1_0_29_1_range = slider_value + (0); // real value := slider value + range min.
	thisval = (byte)round((slider_value + (0) - (0)) / (1.0), 1); // bus value := (slider value + min - offset) / step.

    // Update superval
	getValue(P_ASG_15_1_0_29, superval);
	superval[0]=thisval;
	putValue(P_ASG_15_1_0_29,superval);
}

// Ueberwachung der Darstellungsvariable der Range.
on envVar P_ASG_15_1_0_29_2_range // TankLevel.TankLevel2 
{
	@P_ASG_15_1_0_29_2 = @P_ASG_15_1_0_29_2_range - (0); // slider = range - min
}

on envVar P_ASG_15_1_0_29_2 // TankLevel.TankLevel2
{
	byte superval[2];

	//Update Childvalue (Number)
	byte thisval; // TankLevel2
	float slider_value;

	slider_value = round(@P_ASG_15_1_0_29_2, 1.0);
	@P_ASG_15_1_0_29_2_range = slider_value + (0); // real value := slider value + range min.
	thisval = (byte)round((slider_value + (0) - (0)) / (1.0), 1); // bus value := (slider value + min - offset) / step.

    // Update superval
	getValue(P_ASG_15_1_0_29, superval);
	superval[1]=thisval;
	putValue(P_ASG_15_1_0_29,superval);
}

on envVar P_ASG_15_1_0_30Get_BTN
{
 if (P_ASG_15_1_0_30Get_BTN_already_pressed == 0)
  {
       putValue(P_ASG_15_1_0_30_ErrCode,0);
       SetControlBackColor(panel_name,"errField_P_ASG_15_1_0_30",MakeRGB(255,255,255));
       P_ASG_15_1_0_30Get_BTN_already_pressed = 1;
 }
 else
 {
       Request_Void(LSGID, P_ASG_15_1_0_30_ID, DataGet_REQ); 
       P_ASG_15_1_0_30Get_BTN_already_pressed = 0;
 }
}
on envVar P_ASG_15_1_0_30 // bus value of RefuelVolume (30).
{
	// opcodes: Error-Status
	byte param1; // RefuelVolume1
	byte param2; // RefuelVolume1_Unit
	byte param3; // RefuelVolume2
	byte param4; // RefuelVolume2_Unit
	// DATATYPE_BYTESEQUENCE / DATATYPE_FIXEDBYTESEQUENCE
	int i;
	byte superval[4];
	int currentPos;
	currentPos = 0;
	for( i = 0; i < 4; i++ ) {
		superval[i] = 0;
	}
	getValue(P_ASG_15_1_0_30, superval);
	///////// Start param1 - UINT8 /////////
	param1 = superval[currentPos++];
	putValue(P_ASG_15_1_0_30_1, round((param1 * 1.0) - (0) + (0), 1.0));
	///////// Start param2 - UINT8 /////////
	param2 = superval[currentPos++];
	putValue(P_ASG_15_1_0_30_2, param2);
	///////// Start param3 - UINT8 /////////
	param3 = superval[currentPos++];
	putValue(P_ASG_15_1_0_30_3, round((param3 * 1.0) - (0) + (0), 1.0));
	///////// Start param4 - UINT8 /////////
	param4 = superval[currentPos++];
	putValue(P_ASG_15_1_0_30_4, param4);
}

// Ueberwachung der Darstellungsvariable der Range.
on envVar P_ASG_15_1_0_30_1_range // RefuelVolume.RefuelVolume1 
{
	@P_ASG_15_1_0_30_1 = @P_ASG_15_1_0_30_1_range - (0); // slider = range - min
}

on envVar P_ASG_15_1_0_30_1 // RefuelVolume.RefuelVolume1
{
	byte superval[4];

	//Update Childvalue (Number)
	byte thisval; // RefuelVolume1
	float slider_value;

	slider_value = round(@P_ASG_15_1_0_30_1, 1.0);
	@P_ASG_15_1_0_30_1_range = slider_value + (0); // real value := slider value + range min.
	thisval = (byte)round((slider_value + (0) - (0)) / (1.0), 1); // bus value := (slider value + min - offset) / step.

    // Update superval
	getValue(P_ASG_15_1_0_30, superval);
	superval[0]=thisval;
	putValue(P_ASG_15_1_0_30,superval);
}

on envVar P_ASG_15_1_0_30_2 // RefuelVolume.RefuelVolume1_Unit
{
	byte superval[4];

	//Update Childvalue (Enum)
	byte thisval; // RefuelVolume1_Unit
	thisval = getValue(this);

    // Update superval
	getValue(P_ASG_15_1_0_30, superval);
	superval[1]=thisval;
	putValue(P_ASG_15_1_0_30,superval);
}

// Ueberwachung der Darstellungsvariable der Range.
on envVar P_ASG_15_1_0_30_3_range // RefuelVolume.RefuelVolume2 
{
	@P_ASG_15_1_0_30_3 = @P_ASG_15_1_0_30_3_range - (0); // slider = range - min
}

on envVar P_ASG_15_1_0_30_3 // RefuelVolume.RefuelVolume2
{
	byte superval[4];

	//Update Childvalue (Number)
	byte thisval; // RefuelVolume2
	float slider_value;

	slider_value = round(@P_ASG_15_1_0_30_3, 1.0);
	@P_ASG_15_1_0_30_3_range = slider_value + (0); // real value := slider value + range min.
	thisval = (byte)round((slider_value + (0) - (0)) / (1.0), 1); // bus value := (slider value + min - offset) / step.

    // Update superval
	getValue(P_ASG_15_1_0_30, superval);
	superval[2]=thisval;
	putValue(P_ASG_15_1_0_30,superval);
}

on envVar P_ASG_15_1_0_30_4 // RefuelVolume.RefuelVolume2_Unit
{
	byte superval[4];

	//Update Childvalue (Enum)
	byte thisval; // RefuelVolume2_Unit
	thisval = getValue(this);

    // Update superval
	getValue(P_ASG_15_1_0_30, superval);
	superval[3]=thisval;
	putValue(P_ASG_15_1_0_30,superval);
}

on envVar A_ASG_15_1_0_31Get_BTN
{
  byte data[6]; 
  byte stringValue[6];
  byte head[5];
  int i;
  int headLength;
  long tempValue;
  word currentPos;
  word startVal;
  word elementsVal;
  byte nibbleSetted;
  if (A_ASG_15_1_0_31Get_BTN_already_pressed == 0)
  {
     putValue(A_ASG_15_1_0_31_ErrCode,0);
     SetControlBackColor(panel_name,"errField_A_ASG_15_1_0_31",MakeRGB(255,255,255));
     A_ASG_15_1_0_31Get_BTN_already_pressed = 1;
  }
  else
  {
        currentPos = 0;
        //Einzelparameter: ASG_ID
        tempValue = getValue(A_ASG_15_1_0_31_1_SetGet);
    if(nibbleSetted == 1)
    {
        //voriger Parameter war ein Nibble, => second nibble, Pos incr und Flag zuruecksetzen
        data[currentPos] = (tempValue &0x0F) | (data[currentPos] &0xF0);
        currentPos++;
        nibbleSetted = 0;
    }
    else
    {
        //first nibble, kein increment, Flag setzen
        data[currentPos] = (tempValue<<4) &0xF0;
        nibbleSetted = 1;
    }
        //Einzelparameter: TAID
        tempValue = getValue(A_ASG_15_1_0_31_2_SetGet);
    if(nibbleSetted == 1)
    {
        //voriger Parameter war ein Nibble, => second nibble, Pos incr und Flag zuruecksetzen
        data[currentPos] = (tempValue &0x0F) | (data[currentPos] &0xF0);
        currentPos++;
        nibbleSetted = 0;
    }
    else
    {
        //first nibble, kein increment, Flag setzen
        data[currentPos] = (tempValue<<4) &0xF0;
        nibbleSetted = 1;
    }
        //head Parameter
        headLength = getValueSize(A_ASG_15_1_0_31_SetGet);
        getValue(A_ASG_15_1_0_31_SetGet,head);
        for(i=0; i< headLength; i++)
        {
            data[currentPos++] = head[i];
        }

     Request_ByteSequence(LSGID, A_ASG_15_1_0_31_ID, DataGet_REQ, data, currentPos);
     if(getValue(A_ASG_15_1_0_31_IntTlgEn)) //getValue(IT))
     {
       intertelegram_err(A_ASG_15_1_0_31_ID);
     }
     if(getValue(A_ASG_15_1_0_31_SegmEn))   //getvalue(SG)
     {
         sequence_err(A_ASG_15_1_0_31_ID,getValueSize(A_ASG_15_1_0_31_SetGet));
     }
     A_ASG_15_1_0_31Get_BTN_already_pressed = 0;
  }
}
A_ASG_15_1_0_31_SetGet_GenerateSetGet()
{
    byte head[5];
    //Record Address in Byte 0 Bit 0-3 kopieren - MAX Wert = 0x0F
    if(getValue(A_ASG_15_1_0_31_SetGet_RecAdr) > 0x0F)
        putValue(A_ASG_15_1_0_31_SetGet_RecAdr , 0x0F);
    head[0] = (head[0] & 0xF0) | getValue(A_ASG_15_1_0_31_SetGet_RecAdr);
    //Shift Bit in Byte 0 Bit 4 kopieren
    if( getValue(A_ASG_15_1_0_31_SetGet_Shift) > 0) head[0] = head[0] | 0x10;
    else head[0] = head[0] & 0xEF;
    // Direction Bit in Byte 0 Bit 5 kopieren
    if( getValue(A_ASG_15_1_0_31_SetGet_Direction) > 0) head[0] = head[0] | 0x20;
    else head[0] = head[0] & 0xDF;
    // reserverd:  Byte 0 Bit 6
    if( getValue(A_ASG_15_1_0_31_SetGet_IndexSize) > 0)
    {
        // 5 Byte Header
        head[0] = head[0] | 0x80;
        head[1] =  getValue(A_ASG_15_1_0_31_SetGet_Start) & 0xFF;
        head[2] = (getValue(A_ASG_15_1_0_31_SetGet_Start) >> 8 ) & 0xFF;
        head[3] =  getValue(A_ASG_15_1_0_31_SetGet_Elements) & 0xFF;
        head[4] = (getValue(A_ASG_15_1_0_31_SetGet_Elements)  >> 8 ) & 0xFF;
        //ToDo: DATA - derzeit einfach laenge = 5
        putValue(A_ASG_15_1_0_31_SetGet, head, 5); 
    }
    else 
    {
        // 3 Byte Header
        head[0] = head[0] & 0x7F;
        head[1] = getValue(A_ASG_15_1_0_31_SetGet_Start) & 0xFF;
        head[2] = getValue(A_ASG_15_1_0_31_SetGet_Elements) & 0xFF;
        //ToDo: DATA - derzeit einfach laenge = 3
        putValue(A_ASG_15_1_0_31_SetGet, head, 3); 
    }
}

on envVar A_ASG_15_1_0_31_SetGet_RecAdr
{
    A_ASG_15_1_0_31_SetGet_GenerateSetGet();
}

on envVar A_ASG_15_1_0_31_SetGet_Shift
{
    A_ASG_15_1_0_31_SetGet_GenerateSetGet();
}

on envVar A_ASG_15_1_0_31_SetGet_Direction
{
    A_ASG_15_1_0_31_SetGet_GenerateSetGet();
}

on envVar A_ASG_15_1_0_31_SetGet_Start
{
    A_ASG_15_1_0_31_SetGet_GenerateSetGet();
}

on envVar A_ASG_15_1_0_31_SetGet_Elements
{
    A_ASG_15_1_0_31_SetGet_GenerateSetGet();
}

on envVar A_ASG_15_1_0_31_SetGet_IndexSize
{
    A_ASG_15_1_0_31_SetGet_GenerateSetGet();
}
on envVar A_ASG_15_1_0_31
{
    byte temp[6];
    byte head[5];
    getValue(A_ASG_15_1_0_31, head);
    putValue(A_ASG_15_1_0_31_RecAdr, 0x0F & head[0]); //Record Address = Bit 0-3 von Byte 0
    if ( (0x10 & head[0]) >0)
        putValue(A_ASG_15_1_0_31_Shift, 1); //Shift = Bit 4 von Byte 0
    else
        putValue(A_ASG_15_1_0_31_Shift, 0); //Shift = Bit 4 von Byte 0
    if ( (0x20 & head[0]) >0)
        putValue(A_ASG_15_1_0_31_Direction, 1); //Direction = Bit 5 von Byte 0
    else
        putValue(A_ASG_15_1_0_31_Direction, 0); //Direction = Bit 5 von Byte 0
    if ( (0x40 & head[0]) >0)
        putValue(A_ASG_15_1_0_31_TransPos, 1); //Transmission Pos = Bit 6 von Byte 0
    else
        putValue(A_ASG_15_1_0_31_TransPos, 0); //Transmission Pos = Bit 6 von Byte 0
    if ( (0x80 & head[0]) >0)
        putValue(A_ASG_15_1_0_31_IndexSize, 1); //IndexSize = Bit 7 von Byte 0
    else
        putValue(A_ASG_15_1_0_31_IndexSize, 0); //IndexSize = Bit 7 von Byte 0
    if(getValue(A_ASG_15_1_0_31_IndexSize))
    {
        putValue(A_ASG_15_1_0_31_Start, ((head[2]<<8)| head[1]) ); //Start Wert, 2 Byte lang
        putValue(A_ASG_15_1_0_31_Elements, ((head[4]<<8)| head[3]) ); //Elements Wert, 2 Byte lang
    }
    else
    {
        putValue(A_ASG_15_1_0_31_Start, head[1]); //Start Wert, 1 Byte lang
        putValue(A_ASG_15_1_0_31_Elements, head[2]); //Start Wert, 1 Byte lang
    }
}
on envVar A_ASG_15_1_0_31_Changed
{
    byte temp[360];
    getValue(A_ASG_15_1_0_31_Changed, temp);
    putValue(A_ASG_15_1_0_31_Changed_RecAdr, 0x0F & temp[0]); //Record Address = Bit 0-3 von Byte 0
    if ( (0x10 & temp[0]) >0)
        putValue(A_ASG_15_1_0_31_Changed_Shift, 1); //Shift = Bit 4 von Byte 0
    else
        putValue(A_ASG_15_1_0_31_Changed_Shift, 0); //Shift = Bit 4 von Byte 0
    if ( (0x20 & temp[0]) >0)
        putValue(A_ASG_15_1_0_31_Changed_Direction, 1); //Direction = Bit 5 von Byte 0
    else
        putValue(A_ASG_15_1_0_31_Changed_Direction, 0); //Direction = Bit 5 von Byte 0
    if ( (0x40 & temp[0]) >0)
        putValue(A_ASG_15_1_0_31_Changed_TransPos, 1); //Transmission Pos = Bit 6 von Byte 0
    else
        putValue(A_ASG_15_1_0_31_Changed_TransPos, 0); //Transmission Pos = Bit 6 von Byte 0
    if ( (0x80 & temp[0]) >0)
        putValue(A_ASG_15_1_0_31_Changed_IndexSize, 1); //IndexSize = Bit 7 von Byte 0
    else
        putValue(A_ASG_15_1_0_31_Changed_IndexSize, 0); //IndexSize = Bit 7 von Byte 0
    if(getValue(A_ASG_15_1_0_31_Changed_IndexSize))
    {
        putValue(A_ASG_15_1_0_31_Changed_Start, ((temp[2]<<8)| temp[1]) ); //Start Wert, 2 Byte lang
        putValue(A_ASG_15_1_0_31_Changed_Elements, ((temp[4]<<8)| temp[3]) ); //Elements Wert, 2 Byte lang
    }
    else
    {
        putValue(A_ASG_15_1_0_31_Changed_Start, temp[1]); //Start Wert, 1 Byte lang
        putValue(A_ASG_15_1_0_31_Changed_Elements, temp[2]); //Start Wert, 1 Byte lang
    }
}
on envVar A_ASG_15_1_0_31_SetGet
{
    byte temp[6];
    getValue(A_ASG_15_1_0_31_SetGet, temp);
    putValue(A_ASG_15_1_0_31_SetGet_RecAdr, 0x0F & temp[0]); //Record Address = Bit 0-3 von Byte 0
    if ( (0x10 & temp[0]) >0)
        putValue(A_ASG_15_1_0_31_SetGet_Shift, 1); //Shift = Bit 4 von Byte 0
    else
        putValue(A_ASG_15_1_0_31_SetGet_Shift, 0); //Shift = Bit 4 von Byte 0
    if ( (0x20 & temp[0]) >0)
        putValue(A_ASG_15_1_0_31_SetGet_Direction, 1); //Direction = Bit 5 von Byte 0
    else
        putValue(A_ASG_15_1_0_31_SetGet_Direction, 0); //Direction = Bit 5 von Byte 0
    // Bit 6 von Byte 0 = reserved
    if ( (0x80 & temp[0]) >0)
        putValue(A_ASG_15_1_0_31_SetGet_IndexSize, 1); //IndexSize = Bit 7 von Byte 0
    else
        putValue(A_ASG_15_1_0_31_SetGet_IndexSize, 0); //IndexSize = Bit 7 von Byte 0
    if(getValue(A_ASG_15_1_0_31_SetGet_IndexSize))
    {
        putValue(A_ASG_15_1_0_31_SetGet_Start, ((temp[2]<<8)| temp[1]) ); //Start Wert, 2 Byte lang
        putValue(A_ASG_15_1_0_31_SetGet_Elements, ((temp[4]<<8)| temp[3]) ); //Elements Wert, 2 Byte lang
    }
    else
    {
        putValue(A_ASG_15_1_0_31_SetGet_Start, temp[1]); //Start Wert, 1 Byte lang
        putValue(A_ASG_15_1_0_31_SetGet_Elements, temp[2]); //Start Wert, 1 Byte lang
    }
}
A_ASG_15_1_0_31_LoadArray()
{
	/********* Statische Deklarationen ***********/
	dword CSVfileHandle;
	dword filePos;
	dword paramPos;
	dword Num_of_csv_byte;
	dword element;
	dword current_CSV_line;
	byte buffer_byte[0xFFFF];
	dword i;
	dword j;
	char CSV_filename[255];

	/********* Param Puffer Deklarationen ***********/
	char temp1[25];
	char temp2[25];

	/********* Initialisierungen ***********/
	CSVfileHandle = 0;
	filePos = 0;
	paramPos = 0;
	Num_of_csv_byte = 0;
	element = 1;
	current_CSV_line = 0;
	for(i = 0; i < A_ASG_15_1_0_31_ArrayDataList_Length; i++)
	{ /* Initialisierung von den Ziel-Strukturen */
		A_ASG_15_1_0_31_ArrayDataList[i].Param1 = 0;
		A_ASG_15_1_0_31_ArrayDataList[i].Param2 = 0;
		for(j=0; j<46; j++)
			A_ASG_15_1_0_31_ArrayDataList[i].Param3[j] = 0;
		A_ASG_15_1_0_31_ArrayDataList[i].Param3_Length = 0;
		A_ASG_15_1_0_31_Data_3_LenList[i] = 0;
		for(j=0; j<302; j++)
			A_ASG_15_1_0_31_ArrayDataList[i].Param4[j] = 0;
		A_ASG_15_1_0_31_ArrayDataList[i].Param4_Length = 0;
		A_ASG_15_1_0_31_Data_4_LenList[i] = 0;
	}

	/********* Laden der CSV-Datei ***********/
	getValue(A_ASG_15_1_0_31_fileSelector, CSV_filename);
	CSVfileHandle = openFileRead(CSV_filename, 1); //open *.csv (binary-mode ->get the ASCII/UTF-8 code)

	if (CSVfileHandle!=0) //*.csv file access successful
	{
		writelineEx(gBAP_Trace, 0,"Dateizugriff auf '%s' erfolgreich", CSV_filename);    //output result
		//get data from *.csv and store the total number of byte in *.csv-file
		Num_of_csv_byte = fileGetBinaryBlock (buffer_byte, elcount(buffer_byte), CSVfileHandle);

		for (filePos = 0; filePos < Num_of_csv_byte; filePos++) //copy data into "LastDestList"
		{
			if (buffer_byte[filePos] != 0x3B) //read data if no ";" is detected
			{
				//nextline in *.csv (next "record element" in LastDestList) -> "LF" and "CR" detected -> copy (transform string -> long) data from help values in global values
				if(buffer_byte[filePos] == 0x0D && buffer_byte[filePos+1] == 0x0A)
				{
					if(current_CSV_line > 0 && current_CSV_line < 256) //ignore first line in *.csv file
					{
						A_ASG_15_1_0_31_ArrayDataList[current_CSV_line-1].Param1 = atol(temp1); //Pos
						A_ASG_15_1_0_31_ArrayDataList[current_CSV_line-1].Param2 = atol(temp2); //Warning_ID
						for(i = 0; i < 25; i++)
						{ /* Temp-Puffer Initialisierung zur Vermeidung von Nebeneffekte */
							temp1[i]=0;
							temp2[i]=0;
						}
					}
					current_CSV_line++; //next line in *.csv file
					element = 1; //start at 'POS' (first record element of "array data")
					paramPos = 0; //reset value
				}
 				//copy data from "buffer_byte" (data from *.csv file) in help values and "name" until end of line is not detected
				else if(current_CSV_line > 0 && current_CSV_line < 256)
				{
					//writelineEx(gBAP_Trace, 0, "Element %x  Index %x", element, j);
					switch (element)
					{
						case 1: //Pos
								if( paramPos >= elCount(temp1) ){
									writelineEx(gBAP_Trace, 0, "Param%x in Zeile %d in der Input CSV Datei, enthaelt mehr Zeichen als erlaubt. Bearbeitung abgebrochen!", element, current_CSV_line);
									return; //False
								}else{
									temp1[paramPos] = buffer_byte[filePos];
									paramPos++;
								}
							break;
						case 2: //Warning_ID
								if( paramPos >= elCount(temp2) ){
									writelineEx(gBAP_Trace, 0, "Param%x in Zeile %d in der Input CSV Datei, enthaelt mehr Zeichen als erlaubt. Bearbeitung abgebrochen!", element, current_CSV_line);
									return; //False
								}else{
									temp2[paramPos] = buffer_byte[filePos];
									paramPos++;
								}
							break;
						case 3: //dynamicValue
								if(paramPos < 45)
								{
									A_ASG_15_1_0_31_ArrayDataList[current_CSV_line-1].Param3[paramPos] = buffer_byte[filePos];
									A_ASG_15_1_0_31_ArrayDataList[current_CSV_line-1].Param3_Length = paramPos +1;
								}
								paramPos++;
						break;
						case 4: //alternativeText
								if(paramPos < 300)
								{
									A_ASG_15_1_0_31_ArrayDataList[current_CSV_line-1].Param4[paramPos] = buffer_byte[filePos];
									A_ASG_15_1_0_31_ArrayDataList[current_CSV_line-1].Param4_Length = paramPos +1;
								}
								paramPos++;
						break;
						default:
						break;
					}
				}
			}
			else  // ";" is detected ->next record element of "array data"
			{
				//writelineEx(gBAP_Trace, 0, "naechstes Element %d Bytes",element);
				element++;
				paramPos=0; //reset value
			}
		}

		if(fileClose (CSVfileHandle) !=0) //close *.csv file
			writelineEx(gBAP_Trace, 0,"Datei '%s' geschlossen", CSV_filename); //output result
		else
			writelineEx(gBAP_Trace, 0,"Fehler beim Schliessen der Datei '%s'", CSV_filename);//output result
	}
	else //*.csv file access not successful
	{
		writelineEx(gBAP_Trace, 0,"Fehler beim Dateizugriff auf '%s'",CSV_filename); //output result
	}
}

on envVar A_ASG_15_1_0_31_loadArray_Btn
{
	char filePath[255];
	if (A_ASG_15_1_0_31_generateData_Btn_already_pressed == 0)
	{
		A_ASG_15_1_0_31_generateData_Btn_already_pressed = 1;
	}
	else
	{
		A_ASG_15_1_0_31_generateData_Btn_already_pressed = 0;
		getValue(A_ASG_15_1_0_31_fileSelector, filePath);
		if(0 == strlen(filePath))
		{
			writelineEx(gBAP_Trace, 0, "Invalid file path!");
		}
		else
		{
			A_ASG_15_1_0_31_LoadArray();
			writelineEx(gBAP_Trace, 0, "Load array from CSV file: %s", filePath);
		}
	}
	putValue(A_ASG_15_1_0_31_Data_1, A_ASG_15_1_0_31_ArrayDataList[ getValue( A_ASG_15_1_0_31_DataIndex) ].Param1);
	putValue(A_ASG_15_1_0_31_Data_2, A_ASG_15_1_0_31_ArrayDataList[ getValue( A_ASG_15_1_0_31_DataIndex) ].Param2);
	putValue(A_ASG_15_1_0_31_Data_3, A_ASG_15_1_0_31_ArrayDataList[ getValue( A_ASG_15_1_0_31_DataIndex) ].Param3, A_ASG_15_1_0_31_ArrayDataList[getValue(A_ASG_15_1_0_31_DataIndex)].Param3_Length);
	putValue(A_ASG_15_1_0_31_Data_4, A_ASG_15_1_0_31_ArrayDataList[ getValue( A_ASG_15_1_0_31_DataIndex) ].Param4, A_ASG_15_1_0_31_ArrayDataList[getValue(A_ASG_15_1_0_31_DataIndex)].Param4_Length);
}


on envVar A_ASG_15_1_0_31_generateData_Btn
{
	word i;
	dword elementsArray[6] = {2, 2, 46, 2, 302, 2};
	byte elementsTypeArray[6] = {0, 0, 0xE, 0xF, 0xE, 0xF};
	dword elementsMaxSizeArray[6] = {65535, 0xFFFF, 0, 0, 0, 0};
	byte tempArray[90780];
	if (A_ASG_15_1_0_31_generateData_Btn_already_pressed == 0)
	{
		A_ASG_15_1_0_31_generateData_Btn_already_pressed = 1;
	}
	else
	{
		initStruct(tempArray, elementsArray, elementsTypeArray, elementsMaxSizeArray, 31, 255 );
		for(i = 0; i < 255; i++)
		{
			memcpy(A_ASG_15_1_0_31_ArrayDataList[i], tempArray, (i * 356) );
			if(A_ASG_15_1_0_31_ArrayDataList[i].Param3_Length > 127 )
				A_ASG_15_1_0_31_Data_3_CntList[i] = 1;
			if(A_ASG_15_1_0_31_ArrayDataList[i].Param4_Length > 127 )
				A_ASG_15_1_0_31_Data_4_CntList[i] = 1;
		}
		A_ASG_15_1_0_31_generateData_Btn_already_pressed = 0;
	}
	putValue(A_ASG_15_1_0_31_Data_1, A_ASG_15_1_0_31_ArrayDataList[ getValue( A_ASG_15_1_0_31_DataIndex) ].Param1);
	putValue(A_ASG_15_1_0_31_Data_2, A_ASG_15_1_0_31_ArrayDataList[ getValue( A_ASG_15_1_0_31_DataIndex) ].Param2);
	putValue(A_ASG_15_1_0_31_Data_3, A_ASG_15_1_0_31_ArrayDataList[ getValue( A_ASG_15_1_0_31_DataIndex) ].Param3, A_ASG_15_1_0_31_ArrayDataList[getValue(A_ASG_15_1_0_31_DataIndex)].Param3_Length);
	putValue(A_ASG_15_1_0_31_Data_4, A_ASG_15_1_0_31_ArrayDataList[ getValue( A_ASG_15_1_0_31_DataIndex) ].Param4, A_ASG_15_1_0_31_ArrayDataList[getValue(A_ASG_15_1_0_31_DataIndex)].Param4_Length);
}
// HME generateCaplOnEnv (3131)
on envVar A_ASG_15_1_0_31_DataIndex
{
    long index;
    long maxIndex = 255-1;
    index = getValue(this);
    if(index >= maxIndex) index = maxIndex;
    else if(index < 0) index = 0;
    putValue(this, index);
    putValue(A_ASG_15_1_0_31_Data_1, A_ASG_15_1_0_31_ArrayDataList[index].Param1);
    putValue(A_ASG_15_1_0_31_Data_2, A_ASG_15_1_0_31_ArrayDataList[index].Param2);
    putValue(A_ASG_15_1_0_31_Data_3_len, A_ASG_15_1_0_31_Data_3_LenList[index]);
    putValue(A_ASG_15_1_0_31_Data_3_cnt, A_ASG_15_1_0_31_Data_3_CntList[index]);
    putValue(A_ASG_15_1_0_31_Data_3, A_ASG_15_1_0_31_ArrayDataList[index].Param3, A_ASG_15_1_0_31_ArrayDataList[index].Param3_Length);
    putValue(A_ASG_15_1_0_31_Data_4_len, A_ASG_15_1_0_31_Data_4_LenList[index]);
    putValue(A_ASG_15_1_0_31_Data_4_cnt, A_ASG_15_1_0_31_Data_4_CntList[index]);
    putValue(A_ASG_15_1_0_31_Data_4, A_ASG_15_1_0_31_ArrayDataList[index].Param4, A_ASG_15_1_0_31_ArrayDataList[index].Param4_Length);

}
on envVar A_ASG_15_1_0_31_DataIndex_Incr
{
    long index;
    if(A_ASG_15_1_0_31_DataIndex_Incr_already_pressed == 0)
    {
        A_ASG_15_1_0_31_DataIndex_Incr_already_pressed = 1;
    }
    else
    {
        index = getValue(A_ASG_15_1_0_31_DataIndex);
        index++;
        putValue(A_ASG_15_1_0_31_DataIndex, index);
        A_ASG_15_1_0_31_DataIndex_Incr_already_pressed = 0;
    }
}
on envVar A_ASG_15_1_0_31_DataIndex_Decr
{
    long index;
    if(A_ASG_15_1_0_31_DataIndex_Decr_already_pressed == 0)
    {
        A_ASG_15_1_0_31_DataIndex_Decr_already_pressed = 1;
    }
    else
    {
        index = getValue(A_ASG_15_1_0_31_DataIndex);
        index--;
        putValue(A_ASG_15_1_0_31_DataIndex, index);
        A_ASG_15_1_0_31_DataIndex_Decr_already_pressed = 0;
    }
}
// Man darf gleichzeitig nur Checkbox fuer SegmError oder IntertelegramError aktiviert werden
on envVar A_ASG_15_1_0_31_IntTlgEn
{
       if(getValue(this)) 
       {
           putValue(A_ASG_15_1_0_31_SegmEn,0);
           intertelegram_err(A_ASG_15_1_0_31_ID);
       }
       else
       {
           intertelegram_err_off(A_ASG_15_1_0_31_ID);
       }
}
// Man darf gleichzeitig nur Checkbox fuer SegmError oder IntertelegramError aktiviert werden
on envVar A_ASG_15_1_0_31_SegmEn
{
       if(getValue(this)) 
       {
           putValue(A_ASG_15_1_0_31_IntTlgEn,0);
           sequence_err(A_ASG_15_1_0_31_ID,getValueSize(A_ASG_15_1_0_31_SegmEn));
       }
       else
       {
              sequence_err_off(A_ASG_15_1_0_31_ID);
       }
}

// [XL] Ueberwachung der CheckBox fuer AT
on envVar A_ASG_15_1_0_31_AT
{
	if(getValue(this))
	{
		EnableControl(panel_name,"panel_A_ASG_15_1_0_31_Status",0);
	}
	else
	{
   	EnableControl(panel_name,"panel_A_ASG_15_1_0_31_Status",1);
 	}
}

A_ASG_15_1_0_31_DataInd()
{
    int currentPos;
    byte head[5];
    byte stringTempValue[360];
    int i;
    int j;
    int startVal;
    int elementsVal;
    byte recordAddressVal;
    byte transmitPosVal;
    long tempValue;
    long index;
    byte nibbleSetted;
    currentPos = 0;
    nibbleSetted = 0;
    //Einzelparameter: ASG_ID
    if(nibbleSetted == 1)
    {
        //voriger Parameter war ein Nibble, => second nibble, Pos incr und Flag zuruecksetzen
        tempValue = (gBAP_Indication_data[currentPos++] &0xF);
        nibbleSetted = 0;
    }
    else
    {
        //first nibble, kein increment, Flag setzen
        tempValue = ((gBAP_Indication_data[currentPos]>>4) &0xF);
        nibbleSetted = 1;
    }
    putValue(A_ASG_15_1_0_31_1, tempValue);
    //Einzelparameter: TAID
    if(nibbleSetted == 1)
    {
        //voriger Parameter war ein Nibble, => second nibble, Pos incr und Flag zuruecksetzen
        tempValue = (gBAP_Indication_data[currentPos++] &0xF);
        nibbleSetted = 0;
    }
    else
    {
        //first nibble, kein increment, Flag setzen
        tempValue = ((gBAP_Indication_data[currentPos]>>4) &0xF);
        nibbleSetted = 1;
    }
    putValue(A_ASG_15_1_0_31_2, tempValue);
    //Einzelparameter: TotalNumListElements
    //voriger Parameter war ein first nibble, bei 2 Byte Werten Position incr
    if(nibbleSetted == 1) currentPos++;
    nibbleSetted = 0;
    tempValue =  (gBAP_Indication_data[currentPos++] & 0xFF);
    tempValue += (gBAP_Indication_data[currentPos++] & 0xFF) << 8;
    putValue(A_ASG_15_1_0_31_3, tempValue);
    //head Parameter
    if(gBAP_Indication_header[4] >= (3+currentPos))
    {
        if( (gBAP_Indication_data[currentPos] & 0x80) > 0)
            if(gBAP_Indication_header[4] >= (5+currentPos))
            {
                for(i = 0; i < 5; i++) head[i] = gBAP_Indication_data[currentPos++];
                putValue(A_ASG_15_1_0_31, head, 5);
                startVal = (head[2]<<8) | head[1];
                elementsVal = (head[4]<<8) | head[3];
            }
            else write("received Data Error");
        else
        {
            for(i = 0; i < 3; i++) head[i] = gBAP_Indication_data[currentPos++];
            putValue(A_ASG_15_1_0_31, head, 3);
                startVal = head[1];
                elementsVal = head[2];
        }
        recordAddressVal = head[0] & 0x0F;
        transmitPosVal = head[0] & 0x40;
    }
    //data Parameter
     nibbleSetted = 0;
    if( (head[0] & 0x20) == 0) { // array header: increasing indices (Direction = 0).
      if( (head[0] & 0x10) > 0) { // array header: first element is one after specified start element (Shift = 1, Direction = 0).
        startVal++;
      }
      for ( i = startVal ; i < startVal + elementsVal ; i++) {
        if ( i < 0 || i >= A_ASG_15_1_0_31_ArrayDataList_Length ) {
          write("Array index ausserhalb der Grenzen, Fct: 31");
          break;
        }
        if(nibbleSetted == 1) currentPos++;
        nibbleSetted = 0;
     if( (head[0]&0x40) == 0){ /* Transmit_Pos = 0, keine Positionsdaten */ }
     else
     {
        if( (head[0]&0x80) == 0)
        {
           //IndexSize = 0, Pos als 1 Byte Wert
           A_ASG_15_1_0_31_ArrayDataList[i].Param1 = gBAP_Indication_data[currentPos++];
        }
        else
        {
           //IndexSize = 1, Pos als 2 Byte Wert
           A_ASG_15_1_0_31_ArrayDataList[i].Param1 = ( gBAP_Indication_data[currentPos++] &0xFF) + ((gBAP_Indication_data[currentPos++] &0xFF)<<8);
        }
     }
      // 0 - es kann vorkommen, dass das if leer ist dies wuerde zum Fehler fuehren. => automatische generierung der 0
      if( 0 || 0 == recordAddressVal || 1 == recordAddressVal )
      {
        //Sollte vor einem 2 Byte Wert 1 Nibble kommen, muss der index um 1 incrementiert werden!
        if( nibbleSetted==1) currentPos++;
        nibbleSetted = 0;
        A_ASG_15_1_0_31_ArrayDataList[i].Param2 = (gBAP_Indication_data[currentPos++] & 0xFF) + ((gBAP_Indication_data[currentPos++] & 0xFF) <<8);
      }
      // 0 - es kann vorkommen, dass das if leer ist dies wuerde zum Fehler fuehren. => automatische generierung der 0
      if( 0 || 0 == recordAddressVal || 1 == recordAddressVal || 3 == recordAddressVal )
      {
        //Sollte vor einem String Wert 1 Nibble kommen, muss der index um 1 incrementiert werden!
        if( nibbleSetted==1) currentPos++;
        nibbleSetted = 0;
        if((gBAP_Indication_data[currentPos] & 0x80) >= 1)
        {
        	 A_ASG_15_1_0_31_Data_3_CntList[i] = 1;
            A_ASG_15_1_0_31_ArrayDataList[i].Param3_Length = ( (gBAP_Indication_data[currentPos++] & 0x7F) << 8) + (gBAP_Indication_data[currentPos++] & 0xFF);
        }
        else
        {
        	 A_ASG_15_1_0_31_Data_3_CntList[i] = 0;
            A_ASG_15_1_0_31_ArrayDataList[i].Param3_Length = gBAP_Indication_data[currentPos++] & 0x7F;
        }
        for(j = 0; j < A_ASG_15_1_0_31_ArrayDataList[i].Param3_Length; j++)
        {
            A_ASG_15_1_0_31_ArrayDataList[i].Param3[j] = gBAP_Indication_data[currentPos++];
        }
      }
      // 0 - es kann vorkommen, dass das if leer ist dies wuerde zum Fehler fuehren. => automatische generierung der 0
      if( 0 || 0 == recordAddressVal || 2 == recordAddressVal )
      {
        //Sollte vor einem String Wert 1 Nibble kommen, muss der index um 1 incrementiert werden!
        if( nibbleSetted==1) currentPos++;
        nibbleSetted = 0;
        if((gBAP_Indication_data[currentPos] & 0x80) >= 1)
        {
        	 A_ASG_15_1_0_31_Data_4_CntList[i] = 1;
            A_ASG_15_1_0_31_ArrayDataList[i].Param4_Length = ( (gBAP_Indication_data[currentPos++] & 0x7F) << 8) + (gBAP_Indication_data[currentPos++] & 0xFF);
        }
        else
        {
        	 A_ASG_15_1_0_31_Data_4_CntList[i] = 0;
            A_ASG_15_1_0_31_ArrayDataList[i].Param4_Length = gBAP_Indication_data[currentPos++] & 0x7F;
        }
        for(j = 0; j < A_ASG_15_1_0_31_ArrayDataList[i].Param4_Length; j++)
        {
            A_ASG_15_1_0_31_ArrayDataList[i].Param4[j] = gBAP_Indication_data[currentPos++];
        }
      }
      } // for
    } else { // array header: decreasing indices (Direction = 1).
      if( (head[0] & 0x10) > 0) { // array header: first element is one before specified start element (Shift = 1, Direction = 1).
        if(startVal != 0) {          startVal--;
        } else {
          startVal = A_ASG_15_1_0_31_ArrayDataList_Length -1;
        }
      }
      for ( i = startVal ; i > startVal - elementsVal ; i--) {
        if ( i < 0 || i >= A_ASG_15_1_0_31_ArrayDataList_Length ) {
          write("Array index ausserhalb der Grenzen, Fct: 31");
          break;
        }
        if(nibbleSetted == 1) currentPos++;
        nibbleSetted = 0;
     if( (head[0]&0x40) == 0){ /* Transmit_Pos = 0, keine Positionsdaten */ }
     else
     {
        if( (head[0]&0x80) == 0)
        {
           //IndexSize = 0, Pos als 1 Byte Wert
           A_ASG_15_1_0_31_ArrayDataList[i].Param1 = gBAP_Indication_data[currentPos++];
        }
        else
        {
           //IndexSize = 1, Pos als 2 Byte Wert
           A_ASG_15_1_0_31_ArrayDataList[i].Param1 = ( gBAP_Indication_data[currentPos++] &0xFF) + ((gBAP_Indication_data[currentPos++] &0xFF)<<8);
        }
     }
      // 0 - es kann vorkommen, dass das if leer ist dies wuerde zum Fehler fuehren. => automatische generierung der 0
      if( 0 || 0 == recordAddressVal || 1 == recordAddressVal )
      {
        //Sollte vor einem 2 Byte Wert 1 Nibble kommen, muss der index um 1 incrementiert werden!
        if( nibbleSetted==1) currentPos++;
        nibbleSetted = 0;
        A_ASG_15_1_0_31_ArrayDataList[i].Param2 = (gBAP_Indication_data[currentPos++] & 0xFF) + ((gBAP_Indication_data[currentPos++] & 0xFF) <<8);
      }
      // 0 - es kann vorkommen, dass das if leer ist dies wuerde zum Fehler fuehren. => automatische generierung der 0
      if( 0 || 0 == recordAddressVal || 1 == recordAddressVal || 3 == recordAddressVal )
      {
        //Sollte vor einem String Wert 1 Nibble kommen, muss der index um 1 incrementiert werden!
        if( nibbleSetted==1) currentPos++;
        nibbleSetted = 0;
        if((gBAP_Indication_data[currentPos] & 0x80) >= 1)
        {
        	 A_ASG_15_1_0_31_Data_3_CntList[i] = 1;
            A_ASG_15_1_0_31_ArrayDataList[i].Param3_Length = ( (gBAP_Indication_data[currentPos++] & 0x7F) << 8) + (gBAP_Indication_data[currentPos++] & 0xFF);
        }
        else
        {
        	 A_ASG_15_1_0_31_Data_3_CntList[i] = 0;
            A_ASG_15_1_0_31_ArrayDataList[i].Param3_Length = gBAP_Indication_data[currentPos++] & 0x7F;
        }
        for(j = 0; j < A_ASG_15_1_0_31_ArrayDataList[i].Param3_Length; j++)
        {
            A_ASG_15_1_0_31_ArrayDataList[i].Param3[j] = gBAP_Indication_data[currentPos++];
        }
      }
      // 0 - es kann vorkommen, dass das if leer ist dies wuerde zum Fehler fuehren. => automatische generierung der 0
      if( 0 || 0 == recordAddressVal || 2 == recordAddressVal )
      {
        //Sollte vor einem String Wert 1 Nibble kommen, muss der index um 1 incrementiert werden!
        if( nibbleSetted==1) currentPos++;
        nibbleSetted = 0;
        if((gBAP_Indication_data[currentPos] & 0x80) >= 1)
        {
        	 A_ASG_15_1_0_31_Data_4_CntList[i] = 1;
            A_ASG_15_1_0_31_ArrayDataList[i].Param4_Length = ( (gBAP_Indication_data[currentPos++] & 0x7F) << 8) + (gBAP_Indication_data[currentPos++] & 0xFF);
        }
        else
        {
        	 A_ASG_15_1_0_31_Data_4_CntList[i] = 0;
            A_ASG_15_1_0_31_ArrayDataList[i].Param4_Length = gBAP_Indication_data[currentPos++] & 0x7F;
        }
        for(j = 0; j < A_ASG_15_1_0_31_ArrayDataList[i].Param4_Length; j++)
        {
            A_ASG_15_1_0_31_ArrayDataList[i].Param4[j] = gBAP_Indication_data[currentPos++];
        }
      }
      } // for
    }
    nibbleSetted = 0;
index = getValue(A_ASG_15_1_0_31_DataIndex);
    putValue(A_ASG_15_1_0_31_Data_1, A_ASG_15_1_0_31_ArrayDataList[index].Param1);
    putValue(A_ASG_15_1_0_31_Data_2, A_ASG_15_1_0_31_ArrayDataList[index].Param2);
    putValue(A_ASG_15_1_0_31_Data_3_len, A_ASG_15_1_0_31_Data_3_LenList[index]);
    putValue(A_ASG_15_1_0_31_Data_3_cnt, A_ASG_15_1_0_31_Data_3_CntList[index]);
    putValue(A_ASG_15_1_0_31_Data_3, A_ASG_15_1_0_31_ArrayDataList[index].Param3, A_ASG_15_1_0_31_ArrayDataList[index].Param3_Length);
    putValue(A_ASG_15_1_0_31_Data_4_len, A_ASG_15_1_0_31_Data_4_LenList[index]);
    putValue(A_ASG_15_1_0_31_Data_4_cnt, A_ASG_15_1_0_31_Data_4_CntList[index]);
    putValue(A_ASG_15_1_0_31_Data_4, A_ASG_15_1_0_31_ArrayDataList[index].Param4, A_ASG_15_1_0_31_ArrayDataList[index].Param4_Length);
}

A_ASG_15_1_0_31_ChangedInd()
{
    int currentPos;
    byte head[5];
    byte stringTempValue[360];
    int i;
    int j;
    int startVal;
    int elementsVal;
    byte recordAddressVal;
    byte transmitPosVal;
    long tempValue;
    long index;
    byte nibbleSetted;
    currentPos = 0;
    nibbleSetted = 0;
    //head Parameter
    if(gBAP_Indication_header[4] >= (3+currentPos))
    {
        if( (gBAP_Indication_data[currentPos] & 0x80) > 0)
            if(gBAP_Indication_header[4] >= (5+currentPos))
            {
                for(i = 0; i < 5; i++) head[i] = gBAP_Indication_data[currentPos++];
                putValue(A_ASG_15_1_0_31_Changed, head, 5);
                startVal = (head[2]<<8) | head[1];
                elementsVal = (head[4]<<8) | head[3];
            }
            else write("received Data Error");
        else
        {
            for(i = 0; i < 3; i++) head[i] = gBAP_Indication_data[currentPos++];
            putValue(A_ASG_15_1_0_31_Changed, head, 3);
                startVal = head[1];
                elementsVal = head[2];
        }
        recordAddressVal = head[0] & 0x0F;
        transmitPosVal = head[0] & 0x40;
    }
    //data Parameter
     nibbleSetted = 0;
    if( (head[0] & 0x20) == 0) { // array header: increasing indices (Direction = 0).
      if( (head[0] & 0x10) > 0) { // array header: first element is one after specified start element (Shift = 1, Direction = 0).
        startVal++;
      }
      for ( i = startVal ; i < startVal + elementsVal ; i++) {
        if ( i < 0 || i >= A_ASG_15_1_0_31_ArrayDataList_Length ) {
          write("Array index ausserhalb der Grenzen, Fct: 31");
          break;
        }
        if(nibbleSetted == 1) currentPos++;
        nibbleSetted = 0;
      } // for
    } else { // array header: decreasing indices (Direction = 1).
      if( (head[0] & 0x10) > 0) { // array header: first element is one before specified start element (Shift = 1, Direction = 1).
        if(startVal != 0) {          startVal--;
        } else {
          startVal = A_ASG_15_1_0_31_ArrayDataList_Length -1;
        }
      }
      for ( i = startVal ; i > startVal - elementsVal ; i--) {
        if ( i < 0 || i >= A_ASG_15_1_0_31_ArrayDataList_Length ) {
          write("Array index ausserhalb der Grenzen, Fct: 31");
          break;
        }
        if(nibbleSetted == 1) currentPos++;
        nibbleSetted = 0;
      } // for
    }
    nibbleSetted = 0;
index = getValue(A_ASG_15_1_0_31_DataIndex);
}




on envVar A_ASG_15_1_0_31_1
{
	byte superval[360];

	//Update Childvalue (Enum)
	byte thisval; // ASG_ID
	thisval = 0x0f & getValue(this);
}
// Ueberwachung der Darstellungsvariable der Range.
on envVar A_ASG_15_1_0_31_2_range // VehicleState.TAID 
{
	@A_ASG_15_1_0_31_2 = @A_ASG_15_1_0_31_2_range - (0); // slider = range - min
}

on envVar A_ASG_15_1_0_31_2
{
	byte superval[360];

	//Update Childvalue (Number)
	byte thisval; // TAID
	float slider_value;

	slider_value = round(@A_ASG_15_1_0_31_2, 1.0);
	@A_ASG_15_1_0_31_2_range = slider_value + (0); // real value := slider value + range min.
	thisval = (byte)round((slider_value + (0) - (0)) / (1.0), 1); // bus value := (slider value + min - offset) / step.
}
// Ueberwachung der Darstellungsvariable der Range.
on envVar A_ASG_15_1_0_31_3_range // VehicleState.TotalNumListElements 
{
	@A_ASG_15_1_0_31_3 = @A_ASG_15_1_0_31_3_range - (0); // slider = range - min
}

on envVar A_ASG_15_1_0_31_3
{
	byte superval[360];

	//Update Childvalue (Number)
	word thisval; // TotalNumListElements
	float slider_value;

	slider_value = round(@A_ASG_15_1_0_31_3, 1.0);
	@A_ASG_15_1_0_31_3_range = slider_value + (0); // real value := slider value + range min.
	thisval = (word)round((slider_value + (0) - (0)) / (1.0), 1); // bus value := (slider value + min - offset) / step.
}
// Ueberwachung der Darstellungsvariable der Range.
on envVar A_ASG_15_1_0_31_Data_1_range // VehicleState.Pos 
{
	@A_ASG_15_1_0_31_Data_1 = @A_ASG_15_1_0_31_Data_1_range - (0); // slider = range - min
}

on envVar A_ASG_15_1_0_31_Data_1
{
	byte superval[360];

	//Update Childvalue (Number)
	word thisval; // Pos
	float slider_value;

	slider_value = round(@A_ASG_15_1_0_31_Data_1, 1.0);
	@A_ASG_15_1_0_31_Data_1_range = slider_value + (0); // real value := slider value + range min.
	thisval = (word)round((slider_value + (0) - (0)) / (1.0), 1); // bus value := (slider value + min - offset) / step.
    A_ASG_15_1_0_31_ArrayDataList[getValue(A_ASG_15_1_0_31_DataIndex)].Param1 = thisval;
}
on envVar A_ASG_15_1_0_31_Data_2
{
	byte superval[360];

	//Update Childvalue (Enum)
	word thisval; // Warning_ID
	thisval = getValue(this);
    A_ASG_15_1_0_31_ArrayDataList[getValue(A_ASG_15_1_0_31_DataIndex)].Param2 = thisval;
}

// Ueberwachung der CheckBox fuer String
on envVar  A_ASG_15_1_0_31_Data_3_cnt
{
	word len;
	byte cnt;
	len = getValue(A_ASG_15_1_0_31_Data_3_len);
	cnt = getValue(this);

    /* Cnt Wert im Array aktualisieren */
	 A_ASG_15_1_0_31_Data_3_CntList[ getValue(A_ASG_15_1_0_31_DataIndex) ] = cnt;

	/* wird nur gerufen, wenn check box deaktiviert mit Length>127*/ 
	if(cnt == 0) 
	{
		if(len > 127 )
		{
			putValue(A_ASG_15_1_0_31_Data_3_len, 127);
		}
	}

}


on envVar A_ASG_15_1_0_31_Data_3_len
{
	long thisval;
	byte cnt;
	thisval = getValue(this);
	cnt = getValue(A_ASG_15_1_0_31_Data_3_cnt);

	/* wenn die Laenge ausserhalb des erlaubten Bereich liegt, wird diese begrenzt */
	if(thisval > 45 || thisval < 0 )
	{
		writelineEx(gBAP_Trace, 0, "Eingegebene Laenge: %d von A_ASG_15_1_0_31_Data_3 ist ungueltig. Die max. erlaubte Laenge ist %d. ", thisval, 45);
		thisval = 45;
	}
	if( thisval >127)
	{
		putValue(A_ASG_15_1_0_31_Data_3_cnt, 1); /* Switch checkbox on */
	}

	A_ASG_15_1_0_31_ArrayDataList[getValue(A_ASG_15_1_0_31_DataIndex)].Param3_Length = thisval;
	A_ASG_15_1_0_31_Data_3_LenList[ getValue(A_ASG_15_1_0_31_DataIndex) ] = thisval;
	putValue(A_ASG_15_1_0_31_Data_3_len, thisval);

}

on envVar A_ASG_15_1_0_31_Data_3
{
	byte superval[360];

	//Update Childvalue (String)
	word i;
	byte thisval[46];
	getValue(this, thisval);
    for(i = 0; i < getValueSize(this); i++)
        A_ASG_15_1_0_31_ArrayDataList[getValue(A_ASG_15_1_0_31_DataIndex)].Param3[i] = thisval[i];
    A_ASG_15_1_0_31_ArrayDataList[getValue(A_ASG_15_1_0_31_DataIndex)].Param3_Length = getValueSize(this);
    A_ASG_15_1_0_31_Data_3_LenList[getValue(A_ASG_15_1_0_31_DataIndex)]= getValueSize(this);
    putValue(A_ASG_15_1_0_31_Data_3_len, getValueSize(this));
}

// Ueberwachung der CheckBox fuer String
on envVar  A_ASG_15_1_0_31_Data_4_cnt
{
	word len;
	byte cnt;
	len = getValue(A_ASG_15_1_0_31_Data_4_len);
	cnt = getValue(this);

    /* Cnt Wert im Array aktualisieren */
	 A_ASG_15_1_0_31_Data_4_CntList[ getValue(A_ASG_15_1_0_31_DataIndex) ] = cnt;

	/* wird nur gerufen, wenn check box deaktiviert mit Length>127*/ 
	if(cnt == 0) 
	{
		if(len > 127 )
		{
			putValue(A_ASG_15_1_0_31_Data_4_len, 127);
		}
	}

}


on envVar A_ASG_15_1_0_31_Data_4_len
{
	long thisval;
	byte cnt;
	thisval = getValue(this);
	cnt = getValue(A_ASG_15_1_0_31_Data_4_cnt);

	/* wenn die Laenge ausserhalb des erlaubten Bereich liegt, wird diese begrenzt */
	if(thisval > 300 || thisval < 0 )
	{
		writelineEx(gBAP_Trace, 0, "Eingegebene Laenge: %d von A_ASG_15_1_0_31_Data_4 ist ungueltig. Die max. erlaubte Laenge ist %d. ", thisval, 300);
		thisval = 300;
	}
	if( thisval >127)
	{
		putValue(A_ASG_15_1_0_31_Data_4_cnt, 1); /* Switch checkbox on */
	}

	A_ASG_15_1_0_31_ArrayDataList[getValue(A_ASG_15_1_0_31_DataIndex)].Param4_Length = thisval;
	A_ASG_15_1_0_31_Data_4_LenList[ getValue(A_ASG_15_1_0_31_DataIndex) ] = thisval;
	putValue(A_ASG_15_1_0_31_Data_4_len, thisval);

}

on envVar A_ASG_15_1_0_31_Data_4
{
	byte superval[360];

	//Update Childvalue (String)
	word i;
	byte thisval[302];
	getValue(this, thisval);
    for(i = 0; i < getValueSize(this); i++)
        A_ASG_15_1_0_31_ArrayDataList[getValue(A_ASG_15_1_0_31_DataIndex)].Param4[i] = thisval[i];
    A_ASG_15_1_0_31_ArrayDataList[getValue(A_ASG_15_1_0_31_DataIndex)].Param4_Length = getValueSize(this);
    A_ASG_15_1_0_31_Data_4_LenList[getValue(A_ASG_15_1_0_31_DataIndex)]= getValueSize(this);
    putValue(A_ASG_15_1_0_31_Data_4_len, getValueSize(this));
}
on envVar A_ASG_15_1_0_31_1_SetGet
{
	byte superval[6];

	//Update Childvalue (Enum)
	byte thisval; // ASG_ID
	thisval = 0x0f & getValue(this);
}
// Ueberwachung der Darstellungsvariable der Range.
on envVar A_ASG_15_1_0_31_2_SetGet_range // VehicleState.TAID 
{
	@A_ASG_15_1_0_31_2_SetGet = @A_ASG_15_1_0_31_2_SetGet_range - (0); // slider = range - min
}

on envVar A_ASG_15_1_0_31_2_SetGet
{
	byte superval[6];

	//Update Childvalue (Number)
	byte thisval; // TAID
	float slider_value;

	slider_value = round(@A_ASG_15_1_0_31_2_SetGet, 1.0);
	@A_ASG_15_1_0_31_2_SetGet_range = slider_value + (0); // real value := slider value + range min.
	thisval = (byte)round((slider_value + (0) - (0)) / (1.0), 1); // bus value := (slider value + min - offset) / step.
}
on envVar P_ASG_15_1_0_32Get_BTN
{
 if (P_ASG_15_1_0_32Get_BTN_already_pressed == 0)
  {
       putValue(P_ASG_15_1_0_32_ErrCode,0);
       SetControlBackColor(panel_name,"errField_P_ASG_15_1_0_32",MakeRGB(255,255,255));
       P_ASG_15_1_0_32Get_BTN_already_pressed = 1;
 }
 else
 {
       Request_Void(LSGID, P_ASG_15_1_0_32_ID, DataGet_REQ); 
       P_ASG_15_1_0_32Get_BTN_already_pressed = 0;
 }
}
on envVar P_ASG_15_1_0_32 // bus value of OutsideTemperature (32).
{
	// opcodes: Error-Status
	int param1; // Temperature_Value
	byte param2; // Temperature_Unit
	// DATATYPE_BYTESEQUENCE / DATATYPE_FIXEDBYTESEQUENCE
	int i;
	byte superval[3];
	int currentPos;
	currentPos = 0;
	for( i = 0; i < 3; i++ ) {
		superval[i] = 0;
	}
	getValue(P_ASG_15_1_0_32, superval);
	///////// Start param1 - UINT16 /////////
	param1 = superval[currentPos++]|(superval[currentPos++]<<8);
	putValue(P_ASG_15_1_0_32_1, round((param1 * 0.1) - (-58) + (0), 0.1));
	///////// Start param2 - UINT8 /////////
	param2 = superval[currentPos++];
	putValue(P_ASG_15_1_0_32_2, param2);
}

// Ueberwachung der Darstellungsvariable der Range.
on envVar P_ASG_15_1_0_32_1_range // OutsideTemperature.Temperature_Value 
{
	@P_ASG_15_1_0_32_1 = @P_ASG_15_1_0_32_1_range - (-58); // slider = range - min
}

on envVar P_ASG_15_1_0_32_1 // OutsideTemperature.Temperature_Value
{
	byte superval[3];

	//Update Childvalue (Number)
	int thisval; // Temperature_Value
	float slider_value;

	slider_value = round(@P_ASG_15_1_0_32_1, 0.1);
	@P_ASG_15_1_0_32_1_range = slider_value + (-58); // real value := slider value + range min.
	thisval = (int)round((slider_value + (-58) - (0)) / (0.1), 1); // bus value := (slider value + min - offset) / step.

    // Update superval
	getValue(P_ASG_15_1_0_32, superval);
	superval[0]=thisval&0x00ff;
	superval[1]=(thisval&0xff00)>>8;
	putValue(P_ASG_15_1_0_32,superval);
}

on envVar P_ASG_15_1_0_32_2 // OutsideTemperature.Temperature_Unit
{
	byte superval[3];

	//Update Childvalue (Enum)
	byte thisval; // Temperature_Unit
	thisval = getValue(this);

    // Update superval
	getValue(P_ASG_15_1_0_32, superval);
	superval[2]=thisval;
	putValue(P_ASG_15_1_0_32,superval);
}

on envVar P_ASG_15_1_0_33Get_BTN
{
 if (P_ASG_15_1_0_33Get_BTN_already_pressed == 0)
  {
       putValue(P_ASG_15_1_0_33_ErrCode,0);
       SetControlBackColor(panel_name,"errField_P_ASG_15_1_0_33",MakeRGB(255,255,255));
       P_ASG_15_1_0_33Get_BTN_already_pressed = 1;
 }
 else
 {
       Request_Void(LSGID, P_ASG_15_1_0_33_ID, DataGet_REQ); 
       P_ASG_15_1_0_33Get_BTN_already_pressed = 0;
 }
}
on envVar P_ASG_15_1_0_33 // bus value of OilTemperature (33).
{
	// opcodes: Error-Status
	int param1; // Temperature_Value
	byte param2; // Temperature_Unit
	// DATATYPE_BYTESEQUENCE / DATATYPE_FIXEDBYTESEQUENCE
	int i;
	byte superval[3];
	int currentPos;
	currentPos = 0;
	for( i = 0; i < 3; i++ ) {
		superval[i] = 0;
	}
	getValue(P_ASG_15_1_0_33, superval);
	///////// Start param1 - UINT16 /////////
	param1 = superval[currentPos++]|(superval[currentPos++]<<8);
	putValue(P_ASG_15_1_0_33_1, round((param1 * 0.1) - (-40) + (0), 0.1));
	///////// Start param2 - UINT8 /////////
	param2 = superval[currentPos++];
	putValue(P_ASG_15_1_0_33_2, param2);
}

// Ueberwachung der Darstellungsvariable der Range.
on envVar P_ASG_15_1_0_33_1_range // OilTemperature.Temperature_Value 
{
	@P_ASG_15_1_0_33_1 = @P_ASG_15_1_0_33_1_range - (-40); // slider = range - min
}

on envVar P_ASG_15_1_0_33_1 // OilTemperature.Temperature_Value
{
	byte superval[3];

	//Update Childvalue (Number)
	int thisval; // Temperature_Value
	float slider_value;

	slider_value = round(@P_ASG_15_1_0_33_1, 0.1);
	@P_ASG_15_1_0_33_1_range = slider_value + (-40); // real value := slider value + range min.
	thisval = (int)round((slider_value + (-40) - (0)) / (0.1), 1); // bus value := (slider value + min - offset) / step.

    // Update superval
	getValue(P_ASG_15_1_0_33, superval);
	superval[0]=thisval&0x00ff;
	superval[1]=(thisval&0xff00)>>8;
	putValue(P_ASG_15_1_0_33,superval);
}

on envVar P_ASG_15_1_0_33_2 // OilTemperature.Temperature_Unit
{
	byte superval[3];

	//Update Childvalue (Enum)
	byte thisval; // Temperature_Unit
	thisval = getValue(this);

    // Update superval
	getValue(P_ASG_15_1_0_33, superval);
	superval[2]=thisval;
	putValue(P_ASG_15_1_0_33,superval);
}

on envVar P_ASG_15_1_0_34Get_BTN
{
 if (P_ASG_15_1_0_34Get_BTN_already_pressed == 0)
  {
       putValue(P_ASG_15_1_0_34_ErrCode,0);
       SetControlBackColor(panel_name,"errField_P_ASG_15_1_0_34",MakeRGB(255,255,255));
       P_ASG_15_1_0_34Get_BTN_already_pressed = 1;
 }
 else
 {
       Request_Void(LSGID, P_ASG_15_1_0_34_ID, DataGet_REQ); 
       P_ASG_15_1_0_34Get_BTN_already_pressed = 0;
 }
}
on envVar P_ASG_15_1_0_34 // bus value of CoolantTemperature (34).
{
	// opcodes: Error-Status
	int param1; // Temperature_Value
	byte param2; // Temperature_Unit
	// DATATYPE_BYTESEQUENCE / DATATYPE_FIXEDBYTESEQUENCE
	int i;
	byte superval[3];
	int currentPos;
	currentPos = 0;
	for( i = 0; i < 3; i++ ) {
		superval[i] = 0;
	}
	getValue(P_ASG_15_1_0_34, superval);
	///////// Start param1 - UINT16 /////////
	param1 = superval[currentPos++]|(superval[currentPos++]<<8);
	putValue(P_ASG_15_1_0_34_1, round((param1 * 0.1) - (-54) + (0), 0.1));
	///////// Start param2 - UINT8 /////////
	param2 = superval[currentPos++];
	putValue(P_ASG_15_1_0_34_2, param2);
}

// Ueberwachung der Darstellungsvariable der Range.
on envVar P_ASG_15_1_0_34_1_range // CoolantTemperature.Temperature_Value 
{
	@P_ASG_15_1_0_34_1 = @P_ASG_15_1_0_34_1_range - (-54); // slider = range - min
}

on envVar P_ASG_15_1_0_34_1 // CoolantTemperature.Temperature_Value
{
	byte superval[3];

	//Update Childvalue (Number)
	int thisval; // Temperature_Value
	float slider_value;

	slider_value = round(@P_ASG_15_1_0_34_1, 0.1);
	@P_ASG_15_1_0_34_1_range = slider_value + (-54); // real value := slider value + range min.
	thisval = (int)round((slider_value + (-54) - (0)) / (0.1), 1); // bus value := (slider value + min - offset) / step.

    // Update superval
	getValue(P_ASG_15_1_0_34, superval);
	superval[0]=thisval&0x00ff;
	superval[1]=(thisval&0xff00)>>8;
	putValue(P_ASG_15_1_0_34,superval);
}

on envVar P_ASG_15_1_0_34_2 // CoolantTemperature.Temperature_Unit
{
	byte superval[3];

	//Update Childvalue (Enum)
	byte thisval; // Temperature_Unit
	thisval = getValue(this);

    // Update superval
	getValue(P_ASG_15_1_0_34, superval);
	superval[2]=thisval;
	putValue(P_ASG_15_1_0_34,superval);
}

on envVar P_ASG_15_1_0_35Get_BTN
{
 if (P_ASG_15_1_0_35Get_BTN_already_pressed == 0)
  {
       putValue(P_ASG_15_1_0_35_ErrCode,0);
       SetControlBackColor(panel_name,"errField_P_ASG_15_1_0_35",MakeRGB(255,255,255));
       P_ASG_15_1_0_35Get_BTN_already_pressed = 1;
 }
 else
 {
       Request_Void(LSGID, P_ASG_15_1_0_35_ID, DataGet_REQ); 
       P_ASG_15_1_0_35Get_BTN_already_pressed = 0;
 }
}
on envVar P_ASG_15_1_0_35 // bus value of MaxValues (35).
{
	// opcodes: Error-Status
	word param1; // MaxLeftLateralAcceleration
	word param2; // MaxRightLateralAcceleration
	byte param3; // LateralAcceleration_Unit
	word param4; // MaxPosLongitudinalAcceleration
	word param5; // MaxNegLongitudinalAcceleration
	byte param6; // LongitudinalAcceleration_Unit
	word param7; // MaxSpeed_Value
	byte param8; // Speed_Unit
	// DATATYPE_BYTESEQUENCE / DATATYPE_FIXEDBYTESEQUENCE
	int i;
	byte superval[13];
	int currentPos;
	currentPos = 0;
	for( i = 0; i < 13; i++ ) {
		superval[i] = 0;
	}
	getValue(P_ASG_15_1_0_35, superval);
	///////// Start param1 - UINT16 /////////
	param1 = superval[currentPos++]|(superval[currentPos++]<<8);
	putValue(P_ASG_15_1_0_35_1, round((param1 * 0.01) - (0) + (0), 0.01));
	///////// Start param2 - UINT16 /////////
	param2 = superval[currentPos++]|(superval[currentPos++]<<8);
	putValue(P_ASG_15_1_0_35_2, round((param2 * 0.01) - (0) + (0), 0.01));
	///////// Start param3 - UINT8 /////////
	param3 = superval[currentPos++];
	putValue(P_ASG_15_1_0_35_3, param3);
	///////// Start param4 - UINT16 /////////
	param4 = superval[currentPos++]|(superval[currentPos++]<<8);
	putValue(P_ASG_15_1_0_35_4, round((param4 * 0.01) - (0) + (0), 0.01));
	///////// Start param5 - UINT16 /////////
	param5 = superval[currentPos++]|(superval[currentPos++]<<8);
	putValue(P_ASG_15_1_0_35_5, round((param5 * 0.01) - (0) + (0), 0.01));
	///////// Start param6 - UINT8 /////////
	param6 = superval[currentPos++];
	putValue(P_ASG_15_1_0_35_6, param6);
	///////// Start param7 - UINT16 /////////
	param7 = superval[currentPos++]|(superval[currentPos++]<<8);
	putValue(P_ASG_15_1_0_35_7, round((param7 * 0.01) - (0) + (0), 0.01));
	///////// Start param8 - UINT8 /////////
	param8 = superval[currentPos++];
	putValue(P_ASG_15_1_0_35_8, param8);
}

// Updates the bus value field and other dependencies.
P_ASG_15_1_0_35_BuildFct()
{
	word param1; // MaxLeftLateralAcceleration
	word param2; // MaxRightLateralAcceleration
	byte param3; // LateralAcceleration_Unit
	word param4; // MaxPosLongitudinalAcceleration
	word param5; // MaxNegLongitudinalAcceleration
	byte param6; // LongitudinalAcceleration_Unit
	word param7; // MaxSpeed_Value
	byte param8; // Speed_Unit

	int i;
	byte superval[13];
	int currentPos;
	currentPos = 0;
// gen_BuildFunc_SetSuperVals 
	@P_ASG_15_1_0_35_1_range = round(@P_ASG_15_1_0_35_1 + (0), 0.01); // slider value + min = real value
	param1 = round( (@P_ASG_15_1_0_35_1 + (0) - (0)) / (0.01), 0.01); // (slider value + min - offset) / step = busvalue
	superval[currentPos++]=param1&0x00ff;
	superval[currentPos++]=(param1&0xff00)>>8;
// gen_BuildFunc_SetSuperVals 
	@P_ASG_15_1_0_35_2_range = round(@P_ASG_15_1_0_35_2 + (0), 0.01); // slider value + min = real value
	param2 = round( (@P_ASG_15_1_0_35_2 + (0) - (0)) / (0.01), 0.01); // (slider value + min - offset) / step = busvalue
	superval[currentPos++]=param2&0x00ff;
	superval[currentPos++]=(param2&0xff00)>>8;
// gen_BuildFunc_SetSuperVals 
	param3 = getValue(P_ASG_15_1_0_35_3);
	superval[currentPos++]=param3;
// gen_BuildFunc_SetSuperVals 
	@P_ASG_15_1_0_35_4_range = round(@P_ASG_15_1_0_35_4 + (0), 0.01); // slider value + min = real value
	param4 = round( (@P_ASG_15_1_0_35_4 + (0) - (0)) / (0.01), 0.01); // (slider value + min - offset) / step = busvalue
	superval[currentPos++]=param4&0x00ff;
	superval[currentPos++]=(param4&0xff00)>>8;
// gen_BuildFunc_SetSuperVals 
	@P_ASG_15_1_0_35_5_range = round(@P_ASG_15_1_0_35_5 + (0), 0.01); // slider value + min = real value
	param5 = round( (@P_ASG_15_1_0_35_5 + (0) - (0)) / (0.01), 0.01); // (slider value + min - offset) / step = busvalue
	superval[currentPos++]=param5&0x00ff;
	superval[currentPos++]=(param5&0xff00)>>8;
// gen_BuildFunc_SetSuperVals 
	param6 = getValue(P_ASG_15_1_0_35_6);
	superval[currentPos++]=param6;
// gen_BuildFunc_SetSuperVals 
	@P_ASG_15_1_0_35_7_range = round(@P_ASG_15_1_0_35_7 + (0), 0.01); // slider value + min = real value
	param7 = round( (@P_ASG_15_1_0_35_7 + (0) - (0)) / (0.01), 0.01); // (slider value + min - offset) / step = busvalue
	superval[currentPos++]=param7&0x00ff;
	superval[currentPos++]=(param7&0xff00)>>8;
// gen_BuildFunc_SetSuperVals 
	param8 = getValue(P_ASG_15_1_0_35_8);
	superval[currentPos++]=param8;
	putValue(P_ASG_15_1_0_35, superval, currentPos);
}


// Ueberwachung der Darstellungsvariable der Range.
on envVar P_ASG_15_1_0_35_1_range // MaxValues.MaxLeftLateralAcceleration 
{
	@P_ASG_15_1_0_35_1 = @P_ASG_15_1_0_35_1_range - (0); // slider = range - min
}

on envVar P_ASG_15_1_0_35_1 // MaxValues.MaxLeftLateralAcceleration
{
	P_ASG_15_1_0_35_BuildFct();
}

// Ueberwachung der Darstellungsvariable der Range.
on envVar P_ASG_15_1_0_35_2_range // MaxValues.MaxRightLateralAcceleration 
{
	@P_ASG_15_1_0_35_2 = @P_ASG_15_1_0_35_2_range - (0); // slider = range - min
}

on envVar P_ASG_15_1_0_35_2 // MaxValues.MaxRightLateralAcceleration
{
	P_ASG_15_1_0_35_BuildFct();
}

on envVar P_ASG_15_1_0_35_3 // MaxValues.LateralAcceleration_Unit
{
	P_ASG_15_1_0_35_BuildFct();
}

// Ueberwachung der Darstellungsvariable der Range.
on envVar P_ASG_15_1_0_35_4_range // MaxValues.MaxPosLongitudinalAcceleration 
{
	@P_ASG_15_1_0_35_4 = @P_ASG_15_1_0_35_4_range - (0); // slider = range - min
}

on envVar P_ASG_15_1_0_35_4 // MaxValues.MaxPosLongitudinalAcceleration
{
	P_ASG_15_1_0_35_BuildFct();
}

// Ueberwachung der Darstellungsvariable der Range.
on envVar P_ASG_15_1_0_35_5_range // MaxValues.MaxNegLongitudinalAcceleration 
{
	@P_ASG_15_1_0_35_5 = @P_ASG_15_1_0_35_5_range - (0); // slider = range - min
}

on envVar P_ASG_15_1_0_35_5 // MaxValues.MaxNegLongitudinalAcceleration
{
	P_ASG_15_1_0_35_BuildFct();
}

on envVar P_ASG_15_1_0_35_6 // MaxValues.LongitudinalAcceleration_Unit
{
	P_ASG_15_1_0_35_BuildFct();
}

// Ueberwachung der Darstellungsvariable der Range.
on envVar P_ASG_15_1_0_35_7_range // MaxValues.MaxSpeed_Value 
{
	@P_ASG_15_1_0_35_7 = @P_ASG_15_1_0_35_7_range - (0); // slider = range - min
}

on envVar P_ASG_15_1_0_35_7 // MaxValues.MaxSpeed_Value
{
	P_ASG_15_1_0_35_BuildFct();
}

on envVar P_ASG_15_1_0_35_8 // MaxValues.Speed_Unit
{
	P_ASG_15_1_0_35_BuildFct();
}

on envVar A_ASG_15_1_0_36Get_BTN
{
  byte data[255];//[163]; 
  byte stringValue[255];//[163]; 
  byte head[5];
  int i;
  int headLength;
  long tempValue;
  word currentPos;
  word startVal;
  word elementsVal;
  byte nibbleSetted;
  if (A_ASG_15_1_0_36Get_BTN_already_pressed == 0)
  {
     putValue(A_ASG_15_1_0_36_ErrCode,0);
     SetControlBackColor(panel_name,"errField_A_ASG_15_1_0_36",MakeRGB(255,255,255));
     A_ASG_15_1_0_36Get_BTN_already_pressed = 1;
  }
  else
  {
        currentPos = 0;
        //Einzelparameter: Operation
        tempValue = getValue(A_ASG_15_1_0_36_1_SetGet);
        //voriger Parameter war ein first nibble, bei 1 Byte Werten Position incr
        if(nibbleSetted == 1) currentPos++;
        nibbleSetted = 0;
        data[currentPos++] = tempValue;
        //Einzelparameter: Type
        tempValue = getValue(A_ASG_15_1_0_36_2_SetGet);
        //voriger Parameter war ein first nibble, bei 1 Byte Werten Position incr
        if(nibbleSetted == 1) currentPos++;
        nibbleSetted = 0;
        data[currentPos++] = tempValue;
        //Einzelparameter: Slot
        tempValue = getValue(A_ASG_15_1_0_36_3_SetGet);
        //voriger Parameter war ein first nibble, bei 1 Byte Werten Position incr
        if(nibbleSetted == 1) currentPos++;
        nibbleSetted = 0;
        data[currentPos++] = tempValue;
        //Einzelparameter: ASG_ID
        tempValue = getValue(A_ASG_15_1_0_36_4_SetGet);
    if(nibbleSetted == 1)
    {
        //voriger Parameter war ein Nibble, => second nibble, Pos incr und Flag zuruecksetzen
        data[currentPos] = (tempValue &0x0F) | (data[currentPos] &0xF0);
        currentPos++;
        nibbleSetted = 0;
    }
    else
    {
        //first nibble, kein increment, Flag setzen
        data[currentPos] = (tempValue<<4) &0xF0;
        nibbleSetted = 1;
    }
        //Einzelparameter: TAID
        tempValue = getValue(A_ASG_15_1_0_36_5_SetGet);
    if(nibbleSetted == 1)
    {
        //voriger Parameter war ein Nibble, => second nibble, Pos incr und Flag zuruecksetzen
        data[currentPos] = (tempValue &0x0F) | (data[currentPos] &0xF0);
        currentPos++;
        nibbleSetted = 0;
    }
    else
    {
        //first nibble, kein increment, Flag setzen
        data[currentPos] = (tempValue<<4) &0xF0;
        nibbleSetted = 1;
    }
        //head Parameter
        headLength = getValueSize(A_ASG_15_1_0_36_SetGet);
        getValue(A_ASG_15_1_0_36_SetGet,head);
        for(i=0; i< headLength; i++)
        {
            data[currentPos++] = head[i];
        }

     Request_ByteSequence(LSGID, A_ASG_15_1_0_36_ID, DataGet_REQ, data, currentPos);
     if(getValue(A_ASG_15_1_0_36_IntTlgEn)) //getValue(IT))
     {
       intertelegram_err(A_ASG_15_1_0_36_ID);
     }
     if(getValue(A_ASG_15_1_0_36_SegmEn))   //getvalue(SG)
     {
         sequence_err(A_ASG_15_1_0_36_ID,getValueSize(A_ASG_15_1_0_36_SetGet));
     }
     A_ASG_15_1_0_36Get_BTN_already_pressed = 0;
  }
}
A_ASG_15_1_0_36_SetGet_GenerateSetGet()
{
    byte head[5];
    //Record Address in Byte 0 Bit 0-3 kopieren - MAX Wert = 0x0F
    if(getValue(A_ASG_15_1_0_36_SetGet_RecAdr) > 0x0F)
        putValue(A_ASG_15_1_0_36_SetGet_RecAdr , 0x0F);
    head[0] = (head[0] & 0xF0) | getValue(A_ASG_15_1_0_36_SetGet_RecAdr);
    //Shift Bit in Byte 0 Bit 4 kopieren
    if( getValue(A_ASG_15_1_0_36_SetGet_Shift) > 0) head[0] = head[0] | 0x10;
    else head[0] = head[0] & 0xEF;
    // Direction Bit in Byte 0 Bit 5 kopieren
    if( getValue(A_ASG_15_1_0_36_SetGet_Direction) > 0) head[0] = head[0] | 0x20;
    else head[0] = head[0] & 0xDF;
    // reserverd:  Byte 0 Bit 6
    if( getValue(A_ASG_15_1_0_36_SetGet_IndexSize) > 0)
    {
        // 5 Byte Header
        head[0] = head[0] | 0x80;
        head[1] =  getValue(A_ASG_15_1_0_36_SetGet_Start) & 0xFF;
        head[2] = (getValue(A_ASG_15_1_0_36_SetGet_Start) >> 8 ) & 0xFF;
        head[3] =  getValue(A_ASG_15_1_0_36_SetGet_Elements) & 0xFF;
        head[4] = (getValue(A_ASG_15_1_0_36_SetGet_Elements)  >> 8 ) & 0xFF;
        //ToDo: DATA - derzeit einfach laenge = 5
        putValue(A_ASG_15_1_0_36_SetGet, head, 5); 
    }
    else 
    {
        // 3 Byte Header
        head[0] = head[0] & 0x7F;
        head[1] = getValue(A_ASG_15_1_0_36_SetGet_Start) & 0xFF;
        head[2] = getValue(A_ASG_15_1_0_36_SetGet_Elements) & 0xFF;
        //ToDo: DATA - derzeit einfach laenge = 3
        putValue(A_ASG_15_1_0_36_SetGet, head, 3); 
    }
}

on envVar A_ASG_15_1_0_36_SetGet_RecAdr
{
    A_ASG_15_1_0_36_SetGet_GenerateSetGet();
}

on envVar A_ASG_15_1_0_36_SetGet_Shift
{
    A_ASG_15_1_0_36_SetGet_GenerateSetGet();
}

on envVar A_ASG_15_1_0_36_SetGet_Direction
{
    A_ASG_15_1_0_36_SetGet_GenerateSetGet();
}

on envVar A_ASG_15_1_0_36_SetGet_Start
{
    A_ASG_15_1_0_36_SetGet_GenerateSetGet();
}

on envVar A_ASG_15_1_0_36_SetGet_Elements
{
    A_ASG_15_1_0_36_SetGet_GenerateSetGet();
}

on envVar A_ASG_15_1_0_36_SetGet_IndexSize
{
    A_ASG_15_1_0_36_SetGet_GenerateSetGet();
}
on envVar A_ASG_15_1_0_36SetGet_BTN
{
  byte data[400];//[163]; 
  byte stringValue[400];//[163]; 
  byte head[5];
  int i;
  int j = 0;
  long StringLength = 0;
  int headLength;
  long tempValue;
  word currentPos;
  word startVal;
  word elementsVal;
  byte nibbleSetted;
  if (A_ASG_15_1_0_36SetGet_BTN_already_pressed == 0)
  {
     putValue(A_ASG_15_1_0_36_ErrCode,0);
     SetControlBackColor(panel_name,"errField_A_ASG_15_1_0_36",MakeRGB(255,255,255));
     A_ASG_15_1_0_36SetGet_BTN_already_pressed = 1;
  }
  else
  {
        currentPos = 0;
        //Einzelparameter: Operation
        tempValue = getValue(A_ASG_15_1_0_36_1_SetGet);
        //voriger Parameter war ein first nibble, bei 1 Byte Werten Position incr
        if(nibbleSetted == 1) currentPos++;
        nibbleSetted = 0;
        data[currentPos++] = tempValue;
        //Einzelparameter: Type
        tempValue = getValue(A_ASG_15_1_0_36_2_SetGet);
        //voriger Parameter war ein first nibble, bei 1 Byte Werten Position incr
        if(nibbleSetted == 1) currentPos++;
        nibbleSetted = 0;
        data[currentPos++] = tempValue;
        //Einzelparameter: Slot
        tempValue = getValue(A_ASG_15_1_0_36_3_SetGet);
        //voriger Parameter war ein first nibble, bei 1 Byte Werten Position incr
        if(nibbleSetted == 1) currentPos++;
        nibbleSetted = 0;
        data[currentPos++] = tempValue;
        //Einzelparameter: ASG_ID
        tempValue = getValue(A_ASG_15_1_0_36_4_SetGet);
    if(nibbleSetted == 1)
    {
        //voriger Parameter war ein Nibble, => second nibble, Pos incr und Flag zuruecksetzen
        data[currentPos] = (tempValue &0x0F) | (data[currentPos] &0xF0);
        currentPos++;
        nibbleSetted = 0;
    }
    else
    {
        //first nibble, kein increment, Flag setzen
        data[currentPos] = (tempValue<<4) &0xF0;
        nibbleSetted = 1;
    }
        //Einzelparameter: TAID
        tempValue = getValue(A_ASG_15_1_0_36_5_SetGet);
    if(nibbleSetted == 1)
    {
        //voriger Parameter war ein Nibble, => second nibble, Pos incr und Flag zuruecksetzen
        data[currentPos] = (tempValue &0x0F) | (data[currentPos] &0xF0);
        currentPos++;
        nibbleSetted = 0;
    }
    else
    {
        //first nibble, kein increment, Flag setzen
        data[currentPos] = (tempValue<<4) &0xF0;
        nibbleSetted = 1;
    }
        //head Parameter
        headLength = getValueSize(A_ASG_15_1_0_36_SetGet);
        getValue(A_ASG_15_1_0_36_SetGet,head);
        for(i=0; i< headLength; i++)
        {
            data[currentPos++] = head[i];
        }
    //data Parameter
     startVal = getValue(A_ASG_15_1_0_36_SetGet_Start);
     elementsVal = getValue(A_ASG_15_1_0_36_SetGet_Elements);
     nibbleSetted = 0;
    if( (head[0]&0x20) == 0)
    {
     if( (head[0] & 0x10) > 0)
     {
        startVal++;
     }
     for( i = startVal ; i < startVal + elementsVal ; i++)
     {
       if( i < 0 || i >= A_ASG_15_1_0_36_ArrayDataList_Length )
       {
         write("Array index ausserhalb der Grenzen, Fct: 36");
         break;
       }
      if(nibbleSetted == 1) currentPos++;
      nibbleSetted = 0;
     if( (head[0]&0x40) == 0){ /* Transmit_Pos = 0, keine Positionsdaten */ }
     else
     {
        if( (head[0]&0x80) == 0)
        {
           //IndexSize = 0, Pos als 1 Byte Wert
           //Kein POS definiert
        }
        else
        {
           //IndexSize = 1, Pos als 2 Byte Wert
           //Kein POS definiert
        }
     }
      // Check if the current value of RecAdr enables the variable Parameter_ID:
      if( 0 || 1 == getValue( A_ASG_15_1_0_36_SetGet_RecAdr ) || 2 == getValue( A_ASG_15_1_0_36_SetGet_RecAdr ) || 3 == getValue( A_ASG_15_1_0_36_SetGet_RecAdr ) )
      {
        //Sollte vor einem 4 Byte Wert 1 Nibble kommen, muss der index um 1 incrementiert werden!
        if( nibbleSetted==1) currentPos++;
        nibbleSetted = 0;
        data[currentPos++] = (A_ASG_15_1_0_36_ArrayDataList[i].Param1      ) & 0xFF;
        data[currentPos++] = (A_ASG_15_1_0_36_ArrayDataList[i].Param1 >>  8) & 0xFF;
        data[currentPos++] = (A_ASG_15_1_0_36_ArrayDataList[i].Param1 >> 16) & 0xFF;
        data[currentPos++] = (A_ASG_15_1_0_36_ArrayDataList[i].Param1 >> 24) & 0xFF;
       }
      // Check if the current value of RecAdr enables the variable DataDescription:
      if( 0 || 1 == getValue( A_ASG_15_1_0_36_SetGet_RecAdr ) || 2 == getValue( A_ASG_15_1_0_36_SetGet_RecAdr ) || 3 == getValue( A_ASG_15_1_0_36_SetGet_RecAdr ) )
      {
        //Sollte vor einem 1 Byte Wert 1 Nibble kommen, muss der index um 1 incrementiert werden!
        if( nibbleSetted==1) currentPos++;
        nibbleSetted = 0;
        data[currentPos++] = (A_ASG_15_1_0_36_ArrayDataList[i].Param2 ) & 0xFF;
       }
      // Check if the current value of RecAdr enables the variable DataTag:
      if( 0 || 2 == getValue( A_ASG_15_1_0_36_SetGet_RecAdr ) || 3 == getValue( A_ASG_15_1_0_36_SetGet_RecAdr ) )
      {
        //Sollte vor einem 1 Byte Wert 1 Nibble kommen, muss der index um 1 incrementiert werden!
        if( nibbleSetted==1) currentPos++;
        nibbleSetted = 0;
        data[currentPos++] = (A_ASG_15_1_0_36_ArrayDataList[i].Param3 ) & 0xFF;
       }
      // Check if the current value of RecAdr enables the variable DataLength:
      if( 0 || 3 == getValue( A_ASG_15_1_0_36_SetGet_RecAdr ) )
      {
        //Sollte vor einem 4 Byte Wert 1 Nibble kommen, muss der index um 1 incrementiert werden!
        if( nibbleSetted==1) currentPos++;
        nibbleSetted = 0;
        data[currentPos++] = (A_ASG_15_1_0_36_ArrayDataList[i].Param4      ) & 0xFF;
        data[currentPos++] = (A_ASG_15_1_0_36_ArrayDataList[i].Param4 >>  8) & 0xFF;
        data[currentPos++] = (A_ASG_15_1_0_36_ArrayDataList[i].Param4 >> 16) & 0xFF;
        data[currentPos++] = (A_ASG_15_1_0_36_ArrayDataList[i].Param4 >> 24) & 0xFF;
       }
      // Check if the current value of RecAdr enables the variable Data:
      if( 0 || 3 == getValue( A_ASG_15_1_0_36_SetGet_RecAdr ) )
      {
        //Sollte vor einem String Wert 1 Nibble kommen, muss der index um 1 incrementiert werden!
        if( nibbleSetted==1) currentPos++;
        nibbleSetted = 0;
        StringLength =A_ASG_15_1_0_36_ArrayDataList[i].Param5_Length;
		/* Pruefung ob die Laenge-Checkbox aktiv ist */
		if (1 == A_ASG_15_1_0_36_Data_5_CntList[i] && 0)
		{
			if(StringLength >= 0 && StringLength <= 32767 /*&& StringLength <= 1-2*/)
			{
				data[currentPos++] = ( (StringLength >> 8) & 0x7F ) | 0x80; //2Byte Flag (Bit 8) setzen + HighByte (erste 7 bit)
				data[currentPos++] = StringLength &0xFF;
			}
			else
			{
				writelineEx(gBAP_Trace, 0, "Eingegebene Laenge: %d von A_ASG_15_1_0_36_Data_5 mit Record Nr. %d ist ungueltig. Die max. erlaubte Laenge ist %d.", StringLength, i, 1-2);
				return;
			}
		}
		else if(0 == A_ASG_15_1_0_36_Data_5_CntList[i] && 0) /*check box deaktiviert*/
		{
			//if(StringLength >= 0 && StringLength <= 255 /*127 && StringLength <= 1-1*/)
			if (StringLength <= 1)
			{
				//if (StringLength == 0)
                data[currentPos++] = 0; //StringLength & 0x7F; //Bit 8 = 0   // CG PSO Anpassung 
			}
			else
			{
				writelineEx(gBAP_Trace, 0, "Eingegebene Laenge: %d von A_ASG_15_1_0_36_Data_5 mit Record Nr. %d ist ungueltig. Die max. erlaubte Laenge ist %d. ", StringLength, i, 1-1);
				return;
			}
		}
        for(j=0; j < StringLength ; j++)
        { //writelineex(4,0,"j: %d // StringLength: %d // currentPos: %d",j,StringLength,currentPos);
            data[currentPos++] = A_ASG_15_1_0_36_ArrayDataList[i].Param5[j];
        }
       }
    //sollte der letzte Parameter ein first nibble gewesen sein, muss noch 1 increment durchgefuehrt werden
    if( nibbleSetted==1) currentPos++;
    nibbleSetted = 0;
     }
    }
    else
    {
     if( (head[0] & 0x10) > 0)
     {
        if(startVal != 0) startVal--;
        else
        {
           startVal = A_ASG_15_1_0_36_ArrayDataList_Length -1;
        }
     }
     for( i = startVal ; i > startVal - elementsVal ; i--)
     {
       if( i < 0 || i >= A_ASG_15_1_0_36_ArrayDataList_Length )
       {
         write("Array index ausserhalb der Grenzen, Fct: 36");
         break;
       }
      if(nibbleSetted == 1) currentPos++;
      nibbleSetted = 0;
     if( (head[0]&0x40) == 0){ /* Transmit_Pos = 0, keine Positionsdaten */ }
     else
     {
        if( (head[0]&0x80) == 0)
        {
           //IndexSize = 0, Pos als 1 Byte Wert
           //Kein POS definiert
        }
        else
        {
           //IndexSize = 1, Pos als 2 Byte Wert
           //Kein POS definiert
        }
     }
      // Check if the current value of RecAdr enables the variable Parameter_ID:
      if( 0 || 1 == getValue( A_ASG_15_1_0_36_SetGet_RecAdr ) || 2 == getValue( A_ASG_15_1_0_36_SetGet_RecAdr ) || 3 == getValue( A_ASG_15_1_0_36_SetGet_RecAdr ) )
      {
        //Sollte vor einem 4 Byte Wert 1 Nibble kommen, muss der index um 1 incrementiert werden!
        if( nibbleSetted==1) currentPos++;
        nibbleSetted = 0;
        data[currentPos++] = (A_ASG_15_1_0_36_ArrayDataList[i].Param1      ) & 0xFF;
        data[currentPos++] = (A_ASG_15_1_0_36_ArrayDataList[i].Param1 >>  8) & 0xFF;
        data[currentPos++] = (A_ASG_15_1_0_36_ArrayDataList[i].Param1 >> 16) & 0xFF;
        data[currentPos++] = (A_ASG_15_1_0_36_ArrayDataList[i].Param1 >> 24) & 0xFF;
       }
      // Check if the current value of RecAdr enables the variable DataDescription:
      if( 0 || 1 == getValue( A_ASG_15_1_0_36_SetGet_RecAdr ) || 2 == getValue( A_ASG_15_1_0_36_SetGet_RecAdr ) || 3 == getValue( A_ASG_15_1_0_36_SetGet_RecAdr ) )
      {
        //Sollte vor einem 1 Byte Wert 1 Nibble kommen, muss der index um 1 incrementiert werden!
        if( nibbleSetted==1) currentPos++;
        nibbleSetted = 0;
        data[currentPos++] = (A_ASG_15_1_0_36_ArrayDataList[i].Param2 ) & 0xFF;
       }
      // Check if the current value of RecAdr enables the variable DataTag:
      if( 0 || 2 == getValue( A_ASG_15_1_0_36_SetGet_RecAdr ) || 3 == getValue( A_ASG_15_1_0_36_SetGet_RecAdr ) )
      {
        //Sollte vor einem 1 Byte Wert 1 Nibble kommen, muss der index um 1 incrementiert werden!
        if( nibbleSetted==1) currentPos++;
        nibbleSetted = 0;
        data[currentPos++] = (A_ASG_15_1_0_36_ArrayDataList[i].Param3 ) & 0xFF;
       }
      // Check if the current value of RecAdr enables the variable DataLength:
      if( 0 || 3 == getValue( A_ASG_15_1_0_36_SetGet_RecAdr ) )
      {
        //Sollte vor einem 4 Byte Wert 1 Nibble kommen, muss der index um 1 incrementiert werden!
        if( nibbleSetted==1) currentPos++;
        nibbleSetted = 0;
        data[currentPos++] = (A_ASG_15_1_0_36_ArrayDataList[i].Param4      ) & 0xFF;
        data[currentPos++] = (A_ASG_15_1_0_36_ArrayDataList[i].Param4 >>  8) & 0xFF;
        data[currentPos++] = (A_ASG_15_1_0_36_ArrayDataList[i].Param4 >> 16) & 0xFF;
        data[currentPos++] = (A_ASG_15_1_0_36_ArrayDataList[i].Param4 >> 24) & 0xFF;
       }
      // Check if the current value of RecAdr enables the variable Data:
      if( 0 || 3 == getValue( A_ASG_15_1_0_36_SetGet_RecAdr ) )
      {
        //Sollte vor einem String Wert 1 Nibble kommen, muss der index um 1 incrementiert werden!
        if( nibbleSetted==1) currentPos++;
        nibbleSetted = 0;
        StringLength =A_ASG_15_1_0_36_ArrayDataList[i].Param5_Length;
		/* Pruefung ob die Laenge-Checkbox aktiv ist */
		if (1 == A_ASG_15_1_0_36_Data_5_CntList[i] && 0)
		{
			if(StringLength >= 0 && StringLength <= 32767 /*&& StringLength <= 1-2*/)
			{
				data[currentPos++] = ( (StringLength >> 8) & 0x7F ) | 0x80; //2Byte Flag (Bit 8) setzen + HighByte (erste 7 bit)
				data[currentPos++] = StringLength &0xFF;
			}
			else
			{
				writelineEx(gBAP_Trace, 0, "Eingegebene Laenge: %d von A_ASG_15_1_0_36_Data_5 mit Record Nr. %d ist ungueltig. Die max. erlaubte Laenge ist %d.", StringLength, i, 1-2);
				return;
			}
		}
		else if(0 == A_ASG_15_1_0_36_Data_5_CntList[i] && 0) /*check box deaktiviert*/
		{
			if(StringLength >= 0 && StringLength <= 127 /*&& StringLength <= 1-1*/)
			{
				data[currentPos++] = StringLength & 0x7F; //Bit 8 = 0
			}
			else
			{
				writelineEx(gBAP_Trace, 0, "Eingegebene Laenge: %d von A_ASG_15_1_0_36_Data_5 mit Record Nr. %d ist ungueltig. Die max. erlaubte Laenge ist %d. ", StringLength, i, 1-1);
				return;
			}
		}
        for(j=0; j < StringLength ; j++)
        {
            data[currentPos++] = A_ASG_15_1_0_36_ArrayDataList[i].Param5[j];
        }
       }
    //sollte der letzte Parameter ein first nibble gewesen sein, muss noch 1 increment durchgefuehrt werden
    if( nibbleSetted==1) currentPos++;
    nibbleSetted = 0;
     }
    }

     Request_ByteSequence(LSGID, A_ASG_15_1_0_36_ID, DataSetGet_REQ, data, currentPos);
     if(getValue(A_ASG_15_1_0_36_IntTlgEn)) //getValue(IT))
     {
           intertelegram_err(A_ASG_15_1_0_36_ID);
     }
     if(getValue(A_ASG_15_1_0_36_SegmEn))   //getvalue(SG)
     {
             sequence_err(A_ASG_15_1_0_36_ID,getValueSize(A_ASG_15_1_0_36_SetGet));
     }
     A_ASG_15_1_0_36SetGet_BTN_already_pressed = 0;
  }
}
on envVar A_ASG_15_1_0_36
{
    byte temp[255];//[163]; 
    byte head[5];
    getValue(A_ASG_15_1_0_36, head);
    putValue(A_ASG_15_1_0_36_RecAdr, 0x0F & head[0]); //Record Address = Bit 0-3 von Byte 0
    if ( (0x10 & head[0]) >0)
        putValue(A_ASG_15_1_0_36_Shift, 1); //Shift = Bit 4 von Byte 0
    else
        putValue(A_ASG_15_1_0_36_Shift, 0); //Shift = Bit 4 von Byte 0
    if ( (0x20 & head[0]) >0)
        putValue(A_ASG_15_1_0_36_Direction, 1); //Direction = Bit 5 von Byte 0
    else
        putValue(A_ASG_15_1_0_36_Direction, 0); //Direction = Bit 5 von Byte 0
    if ( (0x40 & head[0]) >0)
        putValue(A_ASG_15_1_0_36_TransPos, 1); //Transmission Pos = Bit 6 von Byte 0
    else
        putValue(A_ASG_15_1_0_36_TransPos, 0); //Transmission Pos = Bit 6 von Byte 0
    if ( (0x80 & head[0]) >0)
        putValue(A_ASG_15_1_0_36_IndexSize, 1); //IndexSize = Bit 7 von Byte 0
    else
        putValue(A_ASG_15_1_0_36_IndexSize, 0); //IndexSize = Bit 7 von Byte 0
    if(getValue(A_ASG_15_1_0_36_IndexSize))
    {
        putValue(A_ASG_15_1_0_36_Start, ((head[2]<<8)| head[1]) ); //Start Wert, 2 Byte lang
        putValue(A_ASG_15_1_0_36_Elements, ((head[4]<<8)| head[3]) ); //Elements Wert, 2 Byte lang
    }
    else
    {
        putValue(A_ASG_15_1_0_36_Start, head[1]); //Start Wert, 1 Byte lang
        putValue(A_ASG_15_1_0_36_Elements, head[2]); //Start Wert, 1 Byte lang
    }
}
on envVar A_ASG_15_1_0_36_Changed
{
    byte temp[166];
    getValue(A_ASG_15_1_0_36_Changed, temp);
    putValue(A_ASG_15_1_0_36_Changed_RecAdr, 0x0F & temp[0]); //Record Address = Bit 0-3 von Byte 0
    if ( (0x10 & temp[0]) >0)
        putValue(A_ASG_15_1_0_36_Changed_Shift, 1); //Shift = Bit 4 von Byte 0
    else
        putValue(A_ASG_15_1_0_36_Changed_Shift, 0); //Shift = Bit 4 von Byte 0
    if ( (0x20 & temp[0]) >0)
        putValue(A_ASG_15_1_0_36_Changed_Direction, 1); //Direction = Bit 5 von Byte 0
    else
        putValue(A_ASG_15_1_0_36_Changed_Direction, 0); //Direction = Bit 5 von Byte 0
    if ( (0x40 & temp[0]) >0)
        putValue(A_ASG_15_1_0_36_Changed_TransPos, 1); //Transmission Pos = Bit 6 von Byte 0
    else
        putValue(A_ASG_15_1_0_36_Changed_TransPos, 0); //Transmission Pos = Bit 6 von Byte 0
    if ( (0x80 & temp[0]) >0)
        putValue(A_ASG_15_1_0_36_Changed_IndexSize, 1); //IndexSize = Bit 7 von Byte 0
    else
        putValue(A_ASG_15_1_0_36_Changed_IndexSize, 0); //IndexSize = Bit 7 von Byte 0
    if(getValue(A_ASG_15_1_0_36_Changed_IndexSize))
    {
        putValue(A_ASG_15_1_0_36_Changed_Start, ((temp[2]<<8)| temp[1]) ); //Start Wert, 2 Byte lang
        putValue(A_ASG_15_1_0_36_Changed_Elements, ((temp[4]<<8)| temp[3]) ); //Elements Wert, 2 Byte lang
    }
    else
    {
        putValue(A_ASG_15_1_0_36_Changed_Start, temp[1]); //Start Wert, 1 Byte lang
        putValue(A_ASG_15_1_0_36_Changed_Elements, temp[2]); //Start Wert, 1 Byte lang
    }
}
on envVar A_ASG_15_1_0_36_SetGet
{
    byte temp[255];//[163]; 
    getValue(A_ASG_15_1_0_36_SetGet, temp);
    putValue(A_ASG_15_1_0_36_SetGet_RecAdr, 0x0F & temp[0]); //Record Address = Bit 0-3 von Byte 0
    if ( (0x10 & temp[0]) >0)
        putValue(A_ASG_15_1_0_36_SetGet_Shift, 1); //Shift = Bit 4 von Byte 0
    else
        putValue(A_ASG_15_1_0_36_SetGet_Shift, 0); //Shift = Bit 4 von Byte 0
    if ( (0x20 & temp[0]) >0)
        putValue(A_ASG_15_1_0_36_SetGet_Direction, 1); //Direction = Bit 5 von Byte 0
    else
        putValue(A_ASG_15_1_0_36_SetGet_Direction, 0); //Direction = Bit 5 von Byte 0
    // Bit 6 von Byte 0 = reserved
    if ( (0x80 & temp[0]) >0)
        putValue(A_ASG_15_1_0_36_SetGet_IndexSize, 1); //IndexSize = Bit 7 von Byte 0
    else
        putValue(A_ASG_15_1_0_36_SetGet_IndexSize, 0); //IndexSize = Bit 7 von Byte 0
    if(getValue(A_ASG_15_1_0_36_SetGet_IndexSize))
    {
        putValue(A_ASG_15_1_0_36_SetGet_Start, ((temp[2]<<8)| temp[1]) ); //Start Wert, 2 Byte lang
        putValue(A_ASG_15_1_0_36_SetGet_Elements, ((temp[4]<<8)| temp[3]) ); //Elements Wert, 2 Byte lang
    }
    else
    {
        putValue(A_ASG_15_1_0_36_SetGet_Start, temp[1]); //Start Wert, 1 Byte lang
        putValue(A_ASG_15_1_0_36_SetGet_Elements, temp[2]); //Start Wert, 1 Byte lang
    }
}
A_ASG_15_1_0_36_LoadArray()
{
	/********* Statische Deklarationen ***********/
	dword CSVfileHandle;
	dword filePos;
	dword paramPos;
	dword Num_of_csv_byte;
	dword element;
	dword current_CSV_line;
	byte buffer_byte[0xFFFF];
	dword i;
	dword j;
	char CSV_filename[255];
  char CSV_filepath[255];
  char temp[255];
  byte pos;
  byte offset = 0;
  byte high_nibble, low_nibble;
  byte length;

	/********* Param Puffer Deklarationen ***********/
	char temp1[25];
	char temp2[25];
	char temp3[25];
	char temp4[25];

	/********* Initialisierungen ***********/
	CSVfileHandle = 0;
	filePos = 0;
	paramPos = 0;
	Num_of_csv_byte = 0;
	element = 1;
	current_CSV_line = 0;
	for(i = 0; i < A_ASG_15_1_0_36_ArrayDataList_Length; i++)
	{ /* Initialisierung von den Ziel-Strukturen */
		A_ASG_15_1_0_36_ArrayDataList[i].Param1 = 0;
		A_ASG_15_1_0_36_ArrayDataList[i].Param2 = 0;
		A_ASG_15_1_0_36_ArrayDataList[i].Param3 = 0;
		A_ASG_15_1_0_36_ArrayDataList[i].Param4 = 0;
		for(j=0; j<1; j++)
			A_ASG_15_1_0_36_ArrayDataList[i].Param5[j] = 0;
		A_ASG_15_1_0_36_ArrayDataList[i].Param5_Length = 0;
		A_ASG_15_1_0_36_Data_5_LenList[i] = 0;
	}

	/********* Laden der CSV-Datei ***********/
	getValue(A_ASG_15_1_0_36_fileSelector, temp);
  
  for (i = 0; i < strlen(temp); i++)
  {
    if (temp[i] == '\\' )
      pos = i;
  }
  
  // Strings l?schen
  str_replace(CSV_filepath, CSV_filepath, "");
  str_replace(CSV_filename, CSV_filename, "");
 
  // Strings aufteilen
  substr_cpy(CSV_filepath, temp, 0, pos, elcount(CSV_filepath)); 
  substr_cpy(CSV_filename, temp, (pos+1), -1, elcount(CSV_filename)); 
 
  setFilePath(CSV_filepath,0);
  CSVfileHandle = openFileRead(CSV_filename, 1); //open *.csv (binary-mode ->get the ASCII/UTF-8 code)

	if (CSVfileHandle!=0) //*.csv file access successful
	{
		writelineEx(gBAP_Trace, 0,"Dateizugriff auf '%s' erfolgreich", CSV_filename);    //output result
		//get data from *.csv and store the total number of byte in *.csv-file
		Num_of_csv_byte = fileGetBinaryBlock (buffer_byte, elcount(buffer_byte), CSVfileHandle);

		for (filePos = 0; filePos < Num_of_csv_byte; filePos++) //copy data into "LastDestList"
		{
			if (buffer_byte[filePos] != 0x3B) //read data if no ";" is detected
			{
				//nextline in *.csv (next "record element" in LastDestList) -> "LF" and "CR" detected -> copy (transform string -> long) data from help values in global values
				if(buffer_byte[filePos] == 0x0D && buffer_byte[filePos+1] == 0x0A)
				{
					if(current_CSV_line > 0 && current_CSV_line < 71) //ignore first line in *.csv file
					{
            offset=0;
            A_ASG_15_1_0_36_ArrayDataList[current_CSV_line-1].Param5_Length = A_ASG_15_1_0_36_ArrayDataList[current_CSV_line-1].Param5_Length/2;
            
						A_ASG_15_1_0_36_ArrayDataList[current_CSV_line-1].Param1 = atol(temp1); //Parameter_ID
						A_ASG_15_1_0_36_ArrayDataList[current_CSV_line-1].Param2 = atol(temp2); //DataDescription
						A_ASG_15_1_0_36_ArrayDataList[current_CSV_line-1].Param3 = atol(temp3); //DataTag
						A_ASG_15_1_0_36_ArrayDataList[current_CSV_line-1].Param4 = atol(temp4); //DataLength
						for(i = 0; i < 25; i++)
						{ /* Temp-Puffer Initialisierung zur Vermeidung von Nebeneffekte */
							temp1[i]=0;
							temp2[i]=0;
							temp3[i]=0;
							temp4[i]=0;
						}
					}
					current_CSV_line++; //next line in *.csv file
					element = 1; //start at 'POS' (first record element of "array data")
					paramPos = 0; //reset value
				}
 				//copy data from "buffer_byte" (data from *.csv file) in help values and "name" until end of line is not detected
				else if(current_CSV_line > 0 && current_CSV_line < 71)
				{
					//writelineEx(gBAP_Trace, 0, "Element %x  Index %x", element, j);
					switch (element)
					{
						case 1: //Parameter_ID
								if( paramPos >= elCount(temp1) ){
									writelineEx(gBAP_Trace, 0, "Param%x in Zeile %d in der Input CSV Datei, enthaelt mehr Zeichen als erlaubt. Bearbeitung abgebrochen!", element, current_CSV_line);
									return; //False
								}else{
									temp1[paramPos] = buffer_byte[filePos];
									paramPos++;
								}
							break;
						case 2: //DataDescription
								if( paramPos >= elCount(temp2) ){
									writelineEx(gBAP_Trace, 0, "Param%x in Zeile %d in der Input CSV Datei, enthaelt mehr Zeichen als erlaubt. Bearbeitung abgebrochen!", element, current_CSV_line);
									return; //False
								}else{
									temp2[paramPos] = buffer_byte[filePos];
									paramPos++;
								}
							break;
						case 3: //DataTag
								if( paramPos >= elCount(temp3) ){
									writelineEx(gBAP_Trace, 0, "Param%x in Zeile %d in der Input CSV Datei, enthaelt mehr Zeichen als erlaubt. Bearbeitung abgebrochen!", element, current_CSV_line);
									return; //False
								}else{
									temp3[paramPos] = buffer_byte[filePos];
									paramPos++;
								}
							break;
						case 4: //DataLength
								if( paramPos >= elCount(temp4) ){
									writelineEx(gBAP_Trace, 0, "Param%x in Zeile %d in der Input CSV Datei, enthaelt mehr Zeichen als erlaubt. Bearbeitung abgebrochen!", element, current_CSV_line);
									return; //False
								}else{
									temp4[paramPos] = buffer_byte[filePos];
									paramPos++;
								}
							break;
						case 5: //Data
								if(paramPos < 20) // CG: Anpassung PSO + Verdopplung zwecks anderer Auswertug
								{
                  A_ASG_15_1_0_36_ArrayDataList[current_CSV_line-1].Param5_Length = paramPos + 1;

                  if (A_ASG_15_1_0_36_ArrayDataList[current_CSV_line-1].Param5_Length != 0 && (paramPos+2)%2 == 0) // gerade Stellen
                  {
                    if (buffer_byte[filePos] >= 0x30 && buffer_byte[filePos] <= 0x39) // High Nibble 0...9
                      high_nibble = buffer_byte[filePos]-48;
                    
                    if (buffer_byte[filePos] >= 0x41 && buffer_byte[filePos] <= 0x46) // High Nibble Byte A...F
                      high_nibble = buffer_byte[filePos]-55;
                    
                    if (buffer_byte[filePos] >= 0x61 && buffer_byte[filePos] <= 0x66) // High Nibble Byte a...f
                      high_nibble = buffer_byte[filePos]-87;
                  }
                  
                  if (A_ASG_15_1_0_36_ArrayDataList[current_CSV_line-1].Param5_Length != 0 && (paramPos+2)%2 == 1) // ungerade Stellen
                  {
                    if (buffer_byte[filePos] >= 0x30 && buffer_byte[filePos] <= 0x39) // Low Nibble 0...9
                      low_nibble = buffer_byte[filePos]-48;
                    
                    if (buffer_byte[filePos] >= 0x41 && buffer_byte[filePos] <= 0x46) // Low Nibble Byte A...F
                      low_nibble = buffer_byte[filePos]-55;
                    
                    if (buffer_byte[filePos] >= 0x61 && buffer_byte[filePos] <= 0x66) // Low Nibble Byte a...f
                      low_nibble = buffer_byte[filePos]-87;
                    
                    offset++;
                    A_ASG_15_1_0_36_ArrayDataList[current_CSV_line-1].Param5[paramPos-offset] = high_nibble*16 + low_nibble;
                  }
                }
								paramPos++;
						break;
						default:
						break;
					}
				}
			}
			else  // ";" is detected ->next record element of "array data"
			{
				//writelineEx(gBAP_Trace, 0, "naechstes Element %d Bytes",element);
				element++;
				paramPos=0; //reset value
			}
		}

		if(fileClose (CSVfileHandle) !=0) //close *.csv file
			writelineEx(gBAP_Trace, 0,"Datei '%s' geschlossen", CSV_filename); //output result
		else
			writelineEx(gBAP_Trace, 0,"Fehler beim Schliessen der Datei '%s'", CSV_filename);//output result
	}
	else //*.csv file access not successful
	{
		writelineEx(gBAP_Trace, 0,"Fehler beim Dateizugriff auf '%s'",CSV_filename); //output result
	}
}

on envVar A_ASG_15_1_0_36_loadArray_Btn
{
	char filePath[255];
	if (A_ASG_15_1_0_36_generateData_Btn_already_pressed == 0)
	{
		A_ASG_15_1_0_36_generateData_Btn_already_pressed = 1;
	}
	else
	{
		A_ASG_15_1_0_36_generateData_Btn_already_pressed = 0;
		getValue(A_ASG_15_1_0_36_fileSelector, filePath);
		if(0 == strlen(filePath))
		{
			writelineEx(gBAP_Trace, 0, "Invalid file path!");
		}
		else
		{
			A_ASG_15_1_0_36_LoadArray();
			writelineEx(gBAP_Trace, 0, "Load array from CSV file: %s", filePath);
		}
	}
  // CG: Anpassung PSO
	putValue(A_ASG_15_1_0_36_Data_1_SetGet, A_ASG_15_1_0_36_ArrayDataList[ getValue( A_ASG_15_1_0_36_DataIndex_SetGet) ].Param1);
	putValue(A_ASG_15_1_0_36_Data_2_SetGet, A_ASG_15_1_0_36_ArrayDataList[ getValue( A_ASG_15_1_0_36_DataIndex_SetGet) ].Param2);
	putValue(A_ASG_15_1_0_36_Data_3_SetGet, A_ASG_15_1_0_36_ArrayDataList[ getValue( A_ASG_15_1_0_36_DataIndex_SetGet) ].Param3);
	putValue(A_ASG_15_1_0_36_Data_4_SetGet, A_ASG_15_1_0_36_ArrayDataList[ getValue( A_ASG_15_1_0_36_DataIndex_SetGet) ].Param4);
	putValue(A_ASG_15_1_0_36_Data_5_SetGet, A_ASG_15_1_0_36_ArrayDataList[ getValue( A_ASG_15_1_0_36_DataIndex_SetGet) ].Param5, A_ASG_15_1_0_36_ArrayDataList[getValue(A_ASG_15_1_0_36_DataIndex_SetGet)].Param5_Length);
}


on envVar A_ASG_15_1_0_36_generateData_Btn
{
	word i;
	dword elementsArray[6] = {4, 1, 1, 4, 1, 2};
	byte elementsTypeArray[6] = {0, 0, 0, 0, 0xE, 0xF};
	dword elementsMaxSizeArray[6] = {4294967295LL, 255, 0xFF, 1, 0, 0};
	byte tempArray[910];
	if (A_ASG_15_1_0_36_generateData_Btn_already_pressed == 0)
	{
		A_ASG_15_1_0_36_generateData_Btn_already_pressed = 1;
	}
	else
	{
		initStruct(tempArray, elementsArray, elementsTypeArray, elementsMaxSizeArray, 36, 70 );
		for(i = 0; i < 70; i++)
		{
			memcpy(A_ASG_15_1_0_36_ArrayDataList[i], tempArray, (i * 13) );
			if(A_ASG_15_1_0_36_ArrayDataList[i].Param5_Length > 127 )
				A_ASG_15_1_0_36_Data_5_CntList[i] = 1;
		}
		A_ASG_15_1_0_36_generateData_Btn_already_pressed = 0;
	}
	putValue(A_ASG_15_1_0_36_Data_1, A_ASG_15_1_0_36_ArrayDataList[ getValue( A_ASG_15_1_0_36_DataIndex) ].Param1);
	putValue(A_ASG_15_1_0_36_Data_2, A_ASG_15_1_0_36_ArrayDataList[ getValue( A_ASG_15_1_0_36_DataIndex) ].Param2);
	putValue(A_ASG_15_1_0_36_Data_3, A_ASG_15_1_0_36_ArrayDataList[ getValue( A_ASG_15_1_0_36_DataIndex) ].Param3);
	putValue(A_ASG_15_1_0_36_Data_4, A_ASG_15_1_0_36_ArrayDataList[ getValue( A_ASG_15_1_0_36_DataIndex) ].Param4);
	putValue(A_ASG_15_1_0_36_Data_5, A_ASG_15_1_0_36_ArrayDataList[ getValue( A_ASG_15_1_0_36_DataIndex) ].Param5, A_ASG_15_1_0_36_ArrayDataList[getValue(A_ASG_15_1_0_36_DataIndex)].Param5_Length);
}
// HME generateCaplOnEnv (3131)
on envVar A_ASG_15_1_0_36_DataIndex
{
    long index;
    long maxIndex = 70-1;
    byte data_dummy[1];
    index = getValue(this);
    if(index >= maxIndex) index = maxIndex;
    else if(index < 0) index = 0;
    putValue(this, index);
    
    // CG: Anpassung PSO (String rücksetzen, da bei gleichem Wert keine Länge berechent wird)
    putValue(A_ASG_15_1_0_36_Data_5, data_dummy, 0);
    
    putValue(A_ASG_15_1_0_36_Data_1, A_ASG_15_1_0_36_ArrayDataList[index].Param1);
    putValue(A_ASG_15_1_0_36_Data_2, A_ASG_15_1_0_36_ArrayDataList[index].Param2);
    putValue(A_ASG_15_1_0_36_Data_3, A_ASG_15_1_0_36_ArrayDataList[index].Param3);
    putValue(A_ASG_15_1_0_36_Data_4, A_ASG_15_1_0_36_ArrayDataList[index].Param4);
    putValue(A_ASG_15_1_0_36_Data_5_len, A_ASG_15_1_0_36_Data_5_LenList[index]);
    putValue(A_ASG_15_1_0_36_Data_5_cnt, A_ASG_15_1_0_36_Data_5_CntList[index]);
    putValue(A_ASG_15_1_0_36_Data_5, A_ASG_15_1_0_36_ArrayDataList[index].Param5, A_ASG_15_1_0_36_ArrayDataList[index].Param5_Length);
}

on envVar A_ASG_15_1_0_36_DataIndex_Incr
{
    long index;
    if(A_ASG_15_1_0_36_DataIndex_Incr_already_pressed == 0)
    {
        A_ASG_15_1_0_36_DataIndex_Incr_already_pressed = 1;
    }
    else
    {
        index = getValue(A_ASG_15_1_0_36_DataIndex);
        index++;
        putValue(A_ASG_15_1_0_36_DataIndex, index);
        A_ASG_15_1_0_36_DataIndex_Incr_already_pressed = 0;
    }
}
on envVar A_ASG_15_1_0_36_DataIndex_Decr
{
    long index;
    if(A_ASG_15_1_0_36_DataIndex_Decr_already_pressed == 0)
    {
        A_ASG_15_1_0_36_DataIndex_Decr_already_pressed = 1;
    }
    else
    {
        index = getValue(A_ASG_15_1_0_36_DataIndex);
        index--;
        putValue(A_ASG_15_1_0_36_DataIndex, index);
        A_ASG_15_1_0_36_DataIndex_Decr_already_pressed = 0;
    }
}
// HME generateCaplOnEnv (3160)
on envVar A_ASG_15_1_0_36_DataIndex_SetGet
{
    long index;
    long maxIndex = 70-1;
    byte data_dummy[1];
    index = getValue(this);
    if(index >= maxIndex) index = maxIndex;
    else if(index < 0) index = 0;
    putValue(this, index);
    
    // CG: Anpassung PSO (String rücksetzen, da bei gleichem Wert keine Länge berechent wird)
    putValue(A_ASG_15_1_0_36_Data_5_SetGet, data_dummy, 0);
    
    putValue(A_ASG_15_1_0_36_Data_1_SetGet, A_ASG_15_1_0_36_ArrayDataList[index].Param1);
    putValue(A_ASG_15_1_0_36_Data_2_SetGet, A_ASG_15_1_0_36_ArrayDataList[index].Param2);
    putValue(A_ASG_15_1_0_36_Data_3_SetGet, A_ASG_15_1_0_36_ArrayDataList[index].Param3);
    putValue(A_ASG_15_1_0_36_Data_4_SetGet, A_ASG_15_1_0_36_ArrayDataList[index].Param4);
    putValue(A_ASG_15_1_0_36_Data_5_SetGet_len, A_ASG_15_1_0_36_Data_5_SetGet_LenList[index]);
    putValue(A_ASG_15_1_0_36_Data_5_SetGet_cnt, A_ASG_15_1_0_36_Data_5_SetGet_CntList[index]);
    putValue(A_ASG_15_1_0_36_Data_5_SetGet, A_ASG_15_1_0_36_ArrayDataList[index].Param5, A_ASG_15_1_0_36_ArrayDataList[index].Param5_Length);

}
on envVar A_ASG_15_1_0_36_DataIndex_SetGet_Incr
{
    long index;
    if(A_ASG_15_1_0_36_DataIndex_SetGet_Incr_already_pressed == 0)
    {
        A_ASG_15_1_0_36_DataIndex_SetGet_Incr_already_pressed = 1;
    }
    else
    {
        index = getValue(A_ASG_15_1_0_36_DataIndex_SetGet);
        index++;
        putValue(A_ASG_15_1_0_36_DataIndex_SetGet, index);
        A_ASG_15_1_0_36_DataIndex_SetGet_Incr_already_pressed = 0;
    }
}
on envVar A_ASG_15_1_0_36_DataIndex_SetGet_Decr
{
    long index;
    if(A_ASG_15_1_0_36_DataIndex_SetGet_Decr_already_pressed == 0)
    {
        A_ASG_15_1_0_36_DataIndex_SetGet_Decr_already_pressed = 1;
    }
    else
    {
        index = getValue(A_ASG_15_1_0_36_DataIndex_SetGet);
        index--;
        putValue(A_ASG_15_1_0_36_DataIndex_SetGet, index);
        A_ASG_15_1_0_36_DataIndex_SetGet_Decr_already_pressed = 0;
    }
}
// Man darf gleichzeitig nur Checkbox fuer SegmError oder IntertelegramError aktiviert werden
on envVar A_ASG_15_1_0_36_IntTlgEn
{
       if(getValue(this)) 
       {
           putValue(A_ASG_15_1_0_36_SegmEn,0);
           intertelegram_err(A_ASG_15_1_0_36_ID);
       }
       else
       {
           intertelegram_err_off(A_ASG_15_1_0_36_ID);
       }
}
// Man darf gleichzeitig nur Checkbox fuer SegmError oder IntertelegramError aktiviert werden
on envVar A_ASG_15_1_0_36_SegmEn
{
       if(getValue(this)) 
       {
           putValue(A_ASG_15_1_0_36_IntTlgEn,0);
           sequence_err(A_ASG_15_1_0_36_ID,getValueSize(A_ASG_15_1_0_36_SegmEn));
       }
       else
       {
              sequence_err_off(A_ASG_15_1_0_36_ID);
       }
}

// [XL] Ueberwachung der CheckBox fuer AT
on envVar A_ASG_15_1_0_36_AT
{
	if(getValue(this))
	{
		EnableControl(panel_name,"panel_A_ASG_15_1_0_36_Status",0);
	}
	else
	{
   	EnableControl(panel_name,"panel_A_ASG_15_1_0_36_Status",1);
 	}
}

A_ASG_15_1_0_36_DataInd()
{
    int currentPos;
    byte head[5];
    byte stringTempValue[166];
    int i;
    int j;
    int startVal;
    int elementsVal;
    byte recordAddressVal;
    byte transmitPosVal;
    long tempValue;
    long index;
    byte nibbleSetted;
    currentPos = 0;
    nibbleSetted = 0;
    //Einzelparameter: Operation
    //voriger Parameter war ein first nibble, bei 1 Byte Werten Position incr
    if(nibbleSetted == 1) currentPos++;
    nibbleSetted = 0;
    tempValue = gBAP_Indication_data[currentPos++];
    putValue(A_ASG_15_1_0_36_1, tempValue);
    //Einzelparameter: Type
    //voriger Parameter war ein first nibble, bei 1 Byte Werten Position incr
    if(nibbleSetted == 1) currentPos++;
    nibbleSetted = 0;
    tempValue = gBAP_Indication_data[currentPos++];
    putValue(A_ASG_15_1_0_36_2, tempValue);
    //Einzelparameter: Slot
    //voriger Parameter war ein first nibble, bei 1 Byte Werten Position incr
    if(nibbleSetted == 1) currentPos++;
    nibbleSetted = 0;
    tempValue = gBAP_Indication_data[currentPos++];
    putValue(A_ASG_15_1_0_36_3, tempValue);
    //Einzelparameter: State
    //voriger Parameter war ein first nibble, bei 1 Byte Werten Position incr
    if(nibbleSetted == 1) currentPos++;
    nibbleSetted = 0;
    tempValue = gBAP_Indication_data[currentPos++];
    putValue(A_ASG_15_1_0_36_4, tempValue);
    //Einzelparameter: ASG_ID
    if(nibbleSetted == 1)
    {
        //voriger Parameter war ein Nibble, => second nibble, Pos incr und Flag zuruecksetzen
        tempValue = (gBAP_Indication_data[currentPos++] &0xF);
        nibbleSetted = 0;
    }
    else
    {
        //first nibble, kein increment, Flag setzen
        tempValue = ((gBAP_Indication_data[currentPos]>>4) &0xF);
        nibbleSetted = 1;
    }
    putValue(A_ASG_15_1_0_36_5, tempValue);
    //Einzelparameter: TAID
    if(nibbleSetted == 1)
    {
        //voriger Parameter war ein Nibble, => second nibble, Pos incr und Flag zuruecksetzen
        tempValue = (gBAP_Indication_data[currentPos++] &0xF);
        nibbleSetted = 0;
    }
    else
    {
        //first nibble, kein increment, Flag setzen
        tempValue = ((gBAP_Indication_data[currentPos]>>4) &0xF);
        nibbleSetted = 1;
    }
    putValue(A_ASG_15_1_0_36_6, tempValue);
    //Einzelparameter: TotalNumListElements
    //voriger Parameter war ein first nibble, bei 2 Byte Werten Position incr
    if(nibbleSetted == 1) currentPos++;
    nibbleSetted = 0;
    tempValue =  (gBAP_Indication_data[currentPos++] & 0xFF);
    tempValue += (gBAP_Indication_data[currentPos++] & 0xFF) << 8;
    putValue(A_ASG_15_1_0_36_7, tempValue);
    //head Parameter
    if(gBAP_Indication_header[4] >= (3+currentPos))
    {
        if( (gBAP_Indication_data[currentPos] & 0x80) > 0)
            if(gBAP_Indication_header[4] >= (5+currentPos))
            {
                for(i = 0; i < 5; i++) head[i] = gBAP_Indication_data[currentPos++];
                putValue(A_ASG_15_1_0_36, head, 5);
                startVal = (head[2]<<8) | head[1];
                elementsVal = (head[4]<<8) | head[3];
            }
            else write("received Data Error");
        else
        {
            for(i = 0; i < 3; i++) head[i] = gBAP_Indication_data[currentPos++];
            putValue(A_ASG_15_1_0_36, head, 3);
                startVal = head[1];
                elementsVal = head[2];
        }
        recordAddressVal = head[0] & 0x0F;
        transmitPosVal = head[0] & 0x40;
    }
    //data Parameter
     nibbleSetted = 0;
    if( (head[0] & 0x20) == 0) { // array header: increasing indices (Direction = 0).
      if( (head[0] & 0x10) > 0) { // array header: first element is one after specified start element (Shift = 1, Direction = 0).
        startVal++;
      }
      for ( i = startVal ; i < startVal + elementsVal ; i++)
      {
        if ( i < 0 || i >= A_ASG_15_1_0_36_ArrayDataList_Length )
        {
          write("Array index ausserhalb der Grenzen, Fct: 36");
          break;
        }
        
        if(nibbleSetted == 1) currentPos++;
          nibbleSetted = 0;
        
        if ( (head[0]&0x40) == 0){ /* Transmit_Pos = 0, keine Positionsdaten */ }
        
         else
         {
            if( (head[0]&0x80) == 0)
            {
               //IndexSize = 0, Pos als 1 Byte Wert
               //Kein POS definiert
            }
            else
            {
               //IndexSize = 1, Pos als 2 Byte Wert
               //Kein POS definiert
            }
          }
        
          // 0 - es kann vorkommen, dass das if leer ist dies wuerde zum Fehler fuehren. => automatische generierung der 0
          if( 0 || 1 == recordAddressVal || 2 == recordAddressVal || 3 == recordAddressVal )
          {
            //Sollte vor einem 4 Byte Wert 1 Nibble kommen, muss der index um 1 incrementiert werden!
            if( nibbleSetted==1) currentPos++;
            nibbleSetted = 0;
            A_ASG_15_1_0_36_ArrayDataList[i].Param1 = (gBAP_Indication_data[currentPos++] & 0xFF) + ((gBAP_Indication_data[currentPos++] & 0xFF) <<8) + ((gBAP_Indication_data[currentPos++] & 0xFF) <<16) + ((gBAP_Indication_data[currentPos++] & 0xFF) <<24);
          }
          
          // 0 - es kann vorkommen, dass das if leer ist dies wuerde zum Fehler fuehren. => automatische generierung der 0
          if( 0 || 1 == recordAddressVal || 2 == recordAddressVal || 3 == recordAddressVal )
          {
            //Sollte vor einem 1 Byte Wert 1 Nibble kommen, muss der index um 1 incrementiert werden!
            if( nibbleSetted==1) currentPos++;
            nibbleSetted = 0;
            A_ASG_15_1_0_36_ArrayDataList[i].Param2 = (gBAP_Indication_data[currentPos++] & 0xFF);
          }
          
          // 0 - es kann vorkommen, dass das if leer ist dies wuerde zum Fehler fuehren. => automatische generierung der 0
          if( 0 || 2 == recordAddressVal || 3 == recordAddressVal )
          {
            //Sollte vor einem 1 Byte Wert 1 Nibble kommen, muss der index um 1 incrementiert werden!
            if( nibbleSetted==1) currentPos++;
            nibbleSetted = 0;
            A_ASG_15_1_0_36_ArrayDataList[i].Param3 = (gBAP_Indication_data[currentPos++] & 0xFF);
          }
          
          // 0 - es kann vorkommen, dass das if leer ist dies wuerde zum Fehler fuehren. => automatische generierung der 0
          if( 0 || 3 == recordAddressVal )
          {
            //Sollte vor einem 4 Byte Wert 1 Nibble kommen, muss der index um 1 incrementiert werden!
            if( nibbleSetted==1) currentPos++;
            nibbleSetted = 0;
            A_ASG_15_1_0_36_ArrayDataList[i].Param4 = (gBAP_Indication_data[currentPos++] & 0xFF) + ((gBAP_Indication_data[currentPos++] & 0xFF) <<8) + ((gBAP_Indication_data[currentPos++] & 0xFF) <<16) + ((gBAP_Indication_data[currentPos++] & 0xFF) <<24);
          }
          
          // 0 - es kann vorkommen, dass das if leer ist dies wuerde zum Fehler fuehren. => automatische generierung der 0
          if( (0 || 3 == recordAddressVal) &&  (A_ASG_15_1_0_36_ArrayDataList[i].Param4 != 0) )
          {
            //Sollte vor einem String Wert 1 Nibble kommen, muss der index um 1 incrementiert werden!
            /*if( nibbleSetted==1) currentPos++;
            nibbleSetted = 0;
            if((gBAP_Indication_data[currentPos] & 0x80) >= 1) // CG Anpassung fuer PSO
            {
            	 A_ASG_15_1_0_36_Data_5_CntList[i] = 0;//1;
               A_ASG_15_1_0_36_ArrayDataList[i].Param5_Length = 1;//( (gBAP_Indication_data[currentPos++] & 0x7F) << 8) + (gBAP_Indication_data[currentPos++] & 0xFF);
            }
            else
            {
            	 A_ASG_15_1_0_36_Data_5_CntList[i] = 0;
               A_ASG_15_1_0_36_ArrayDataList[i].Param5_Length = 1;//gBAP_Indication_data[currentPos++] & 0x7F;
            }
            for(j = 0; j < A_ASG_15_1_0_36_ArrayDataList[i].Param5_Length; j++)
            {
                A_ASG_15_1_0_36_ArrayDataList[i].Param5[j] = gBAP_Indication_data[currentPos++];
            }*/
			if( nibbleSetted==1) currentPos++;
            nibbleSetted = 0;
            if((gBAP_Indication_data[currentPos] & 0x80) >= 1) // CG Anpassung fuer PSO
            {
            	 A_ASG_15_1_0_36_Data_5_CntList[i] = 0;//1;
               A_ASG_15_1_0_36_ArrayDataList[i].Param5_Length = 1;//( (gBAP_Indication_data[currentPos++] & 0x7F) << 8) + (gBAP_Indication_data[currentPos++] & 0xFF);
            }
            else
            {
            	 A_ASG_15_1_0_36_Data_5_CntList[i] = 0;
               A_ASG_15_1_0_36_ArrayDataList[i].Param5_Length = 1;//gBAP_Indication_data[currentPos++] & 0x7F;
            }
            for(j = 0; j < A_ASG_15_1_0_36_ArrayDataList[i].Param5_Length; j++)
            {
                A_ASG_15_1_0_36_ArrayDataList[i].Param5[j] = gBAP_Indication_data[currentPos++];
            }
          }
        } // end for
      } // end if
    
    else { // array header: decreasing indices (Direction = 1).
      if( (head[0] & 0x10) > 0) { // array header: first element is one before specified start element (Shift = 1, Direction = 1).
        if(startVal != 0) {          startVal--;
        } else {
          startVal = A_ASG_15_1_0_36_ArrayDataList_Length -1;
        }
      }
      for ( i = startVal ; i > startVal - elementsVal ; i--) {
        if ( i < 0 || i >= A_ASG_15_1_0_36_ArrayDataList_Length ) {
          write("Array index ausserhalb der Grenzen, Fct: 36");
          break;
        }
        if(nibbleSetted == 1) currentPos++;
        nibbleSetted = 0;
     if( (head[0]&0x40) == 0){ /* Transmit_Pos = 0, keine Positionsdaten */ }
     else
     {
        if( (head[0]&0x80) == 0)
        {
           //IndexSize = 0, Pos als 1 Byte Wert
           //Kein POS definiert
        }
        else
        {
           //IndexSize = 1, Pos als 2 Byte Wert
           //Kein POS definiert
        }
     }
      // 0 - es kann vorkommen, dass das if leer ist dies wuerde zum Fehler fuehren. => automatische generierung der 0
      if( 0 || 1 == recordAddressVal || 2 == recordAddressVal || 3 == recordAddressVal )
      {
        //Sollte vor einem 4 Byte Wert 1 Nibble kommen, muss der index um 1 incrementiert werden!
        if( nibbleSetted==1) currentPos++;
        nibbleSetted = 0;
        A_ASG_15_1_0_36_ArrayDataList[i].Param1 = (gBAP_Indication_data[currentPos++] & 0xFF) + ((gBAP_Indication_data[currentPos++] & 0xFF) <<8) + ((gBAP_Indication_data[currentPos++] & 0xFF) <<16) + ((gBAP_Indication_data[currentPos++] & 0xFF) <<24);
      }
      // 0 - es kann vorkommen, dass das if leer ist dies wuerde zum Fehler fuehren. => automatische generierung der 0
      if( 0 || 1 == recordAddressVal || 2 == recordAddressVal || 3 == recordAddressVal )
      {
        //Sollte vor einem 1 Byte Wert 1 Nibble kommen, muss der index um 1 incrementiert werden!
        if( nibbleSetted==1) currentPos++;
        nibbleSetted = 0;
        A_ASG_15_1_0_36_ArrayDataList[i].Param2 = (gBAP_Indication_data[currentPos++] & 0xFF);
      }
      // 0 - es kann vorkommen, dass das if leer ist dies wuerde zum Fehler fuehren. => automatische generierung der 0
      if( 0 || 2 == recordAddressVal || 3 == recordAddressVal )
      {
        //Sollte vor einem 1 Byte Wert 1 Nibble kommen, muss der index um 1 incrementiert werden!
        if( nibbleSetted==1) currentPos++;
        nibbleSetted = 0;
        A_ASG_15_1_0_36_ArrayDataList[i].Param3 = (gBAP_Indication_data[currentPos++] & 0xFF);
      }
      // 0 - es kann vorkommen, dass das if leer ist dies wuerde zum Fehler fuehren. => automatische generierung der 0
      if( 0 || 3 == recordAddressVal )
      {
        //Sollte vor einem 4 Byte Wert 1 Nibble kommen, muss der index um 1 incrementiert werden!
        if( nibbleSetted==1) currentPos++;
        nibbleSetted = 0;
        A_ASG_15_1_0_36_ArrayDataList[i].Param4 = (gBAP_Indication_data[currentPos++] & 0xFF) + ((gBAP_Indication_data[currentPos++] & 0xFF) <<8) + ((gBAP_Indication_data[currentPos++] & 0xFF) <<16) + ((gBAP_Indication_data[currentPos++] & 0xFF) <<24);
      }
      // 0 - es kann vorkommen, dass das if leer ist dies wuerde zum Fehler fuehren. => automatische generierung der 0
      if( (0 || 3 == recordAddressVal) && (A_ASG_15_1_0_36_ArrayDataList[i].Param4 != 0) )
      {
        //Sollte vor einem String Wert 1 Nibble kommen, muss der index um 1 incrementiert werden!
        if( nibbleSetted==1) currentPos++;
        nibbleSetted = 0;
        if((gBAP_Indication_data[currentPos] & 0x80) >= 1) // CG Anpassung fuer PSO
        {
        	 A_ASG_15_1_0_36_Data_5_CntList[i] = 0; //1;
           A_ASG_15_1_0_36_ArrayDataList[i].Param5_Length = 1; //( (gBAP_Indication_data[currentPos++] & 0x7F) << 8) + (gBAP_Indication_data[currentPos++] & 0xFF);
        }
        else
        {
        	 A_ASG_15_1_0_36_Data_5_CntList[i] = 0;
           A_ASG_15_1_0_36_ArrayDataList[i].Param5_Length = 1; //gBAP_Indication_data[currentPos++] & 0x7F;
        }
        for(j = 0; j < A_ASG_15_1_0_36_ArrayDataList[i].Param5_Length; j++)
        {
            A_ASG_15_1_0_36_ArrayDataList[i].Param5[j] = gBAP_Indication_data[currentPos++];
        }
      }
      } // for
    }
    nibbleSetted = 0;
    index = getValue(A_ASG_15_1_0_36_DataIndex);
    putValue(A_ASG_15_1_0_36_Data_1, A_ASG_15_1_0_36_ArrayDataList[index].Param1);
    putValue(A_ASG_15_1_0_36_Data_2, A_ASG_15_1_0_36_ArrayDataList[index].Param2);
    putValue(A_ASG_15_1_0_36_Data_3, A_ASG_15_1_0_36_ArrayDataList[index].Param3);
    putValue(A_ASG_15_1_0_36_Data_4, A_ASG_15_1_0_36_ArrayDataList[index].Param4);
    putValue(A_ASG_15_1_0_36_Data_5_len, A_ASG_15_1_0_36_Data_5_LenList[index]);
    putValue(A_ASG_15_1_0_36_Data_5_cnt, A_ASG_15_1_0_36_Data_5_CntList[index]);
    putValue(A_ASG_15_1_0_36_Data_5, A_ASG_15_1_0_36_ArrayDataList[index].Param5, A_ASG_15_1_0_36_ArrayDataList[index].Param5_Length);
}

A_ASG_15_1_0_36_ChangedInd()
{
    int currentPos;
    byte head[5];
    byte stringTempValue[166];
    int i;
    int j;
    int startVal;
    int elementsVal;
    byte recordAddressVal;
    byte transmitPosVal;
    long tempValue;
    long index;
    byte nibbleSetted;
    currentPos = 0;
    nibbleSetted = 0;
    //Einzelparameter: Operation
    //voriger Parameter war ein first nibble, bei 1 Byte Werten Position incr
    if(nibbleSetted == 1) currentPos++;
    nibbleSetted = 0;
    tempValue = gBAP_Indication_data[currentPos++];
    putValue(A_ASG_15_1_0_36_1_Changed, tempValue);
    //Einzelparameter: Type
    //voriger Parameter war ein first nibble, bei 1 Byte Werten Position incr
    if(nibbleSetted == 1) currentPos++;
    nibbleSetted = 0;
    tempValue = gBAP_Indication_data[currentPos++];
    putValue(A_ASG_15_1_0_36_2_Changed, tempValue);
    //Einzelparameter: Slot
    //voriger Parameter war ein first nibble, bei 1 Byte Werten Position incr
    if(nibbleSetted == 1) currentPos++;
    nibbleSetted = 0;
    tempValue = gBAP_Indication_data[currentPos++];
    putValue(A_ASG_15_1_0_36_3_Changed, tempValue);
    //head Parameter
    if(gBAP_Indication_header[4] >= (3+currentPos))
    {
        if( (gBAP_Indication_data[currentPos] & 0x80) > 0)
            if(gBAP_Indication_header[4] >= (5+currentPos))
            {
                for(i = 0; i < 5; i++) head[i] = gBAP_Indication_data[currentPos++];
                putValue(A_ASG_15_1_0_36_Changed, head, 5);
                startVal = (head[2]<<8) | head[1];
                elementsVal = (head[4]<<8) | head[3];
            }
            else write("received Data Error");
        else
        {
            for(i = 0; i < 3; i++) head[i] = gBAP_Indication_data[currentPos++];
            putValue(A_ASG_15_1_0_36_Changed, head, 3);
                startVal = head[1];
                elementsVal = head[2];
        }
        recordAddressVal = head[0] & 0x0F;
        transmitPosVal = head[0] & 0x40;
    }
}




on envVar A_ASG_15_1_0_36_1
{
	byte superval[166];

	//Update Childvalue (Enum)
	byte thisval; // Operation
	thisval = getValue(this);
}
on envVar A_ASG_15_1_0_36_2
{
	byte superval[166];

	//Update Childvalue (Enum)
	byte thisval; // Type
	thisval = getValue(this);
}
// Ueberwachung der Darstellungsvariable der Range.
on envVar A_ASG_15_1_0_36_3_range // PSO_ImExport.Slot 
{
	@A_ASG_15_1_0_36_3 = @A_ASG_15_1_0_36_3_range - (0); // slider = range - min
}

on envVar A_ASG_15_1_0_36_3
{
	byte superval[166];

	//Update Childvalue (Number)
	byte thisval; // Slot
	float slider_value;

	slider_value = round(@A_ASG_15_1_0_36_3, 1.0);
	@A_ASG_15_1_0_36_3_range = slider_value + (0); // real value := slider value + range min.
	thisval = (byte)round((slider_value + (0) - (0)) / (1.0), 1); // bus value := (slider value + min - offset) / step.
}
on envVar A_ASG_15_1_0_36_4_0
{
	byte bitval;
	//thisval steht hier fuer den bitfield-wert, 
	//aus Generierungsgruenden hier keine einheitliche Bezeichnung moeglich.
	byte thisval; // State
	bitval= getValue(this);
	thisval = getValue(A_ASG_15_1_0_36_4);
	thisval = thisval&~(1<<0)|(bitval<<0);
	putValue(A_ASG_15_1_0_36_4,thisval);
}

on envVar A_ASG_15_1_0_36_4_1
{
	byte bitval;
	//thisval steht hier fuer den bitfield-wert, 
	//aus Generierungsgruenden hier keine einheitliche Bezeichnung moeglich.
	byte thisval; // State
	bitval= getValue(this);
	thisval = getValue(A_ASG_15_1_0_36_4);
	thisval = thisval&~(1<<1)|(bitval<<1);
	putValue(A_ASG_15_1_0_36_4,thisval);
}

on envVar A_ASG_15_1_0_36_4_2
{
	byte bitval;
	//thisval steht hier fuer den bitfield-wert, 
	//aus Generierungsgruenden hier keine einheitliche Bezeichnung moeglich.
	byte thisval; // State
	bitval= getValue(this);
	thisval = getValue(A_ASG_15_1_0_36_4);
	thisval = thisval&~(1<<2)|(bitval<<2);
	putValue(A_ASG_15_1_0_36_4,thisval);
}

on envVar A_ASG_15_1_0_36_4
{
	byte superval[166];

	//Update Childvalue (BitField)
	byte mask=0x01;
	int i = 0;
	byte thisval; // State
	thisval = getValue(this);
	if(thisval&(mask<<0))
		putValue(A_ASG_15_1_0_36_4_0, 1);
	else
		putValue(A_ASG_15_1_0_36_4_0, 0);
	if(thisval&(mask<<1))
		putValue(A_ASG_15_1_0_36_4_1, 1);
	else
		putValue(A_ASG_15_1_0_36_4_1, 0);
	if(thisval&(mask<<2))
		putValue(A_ASG_15_1_0_36_4_2, 1);
	else
		putValue(A_ASG_15_1_0_36_4_2, 0);
}
on envVar A_ASG_15_1_0_36_5
{
	byte superval[166];

	//Update Childvalue (Enum)
	byte thisval; // ASG_ID
	thisval = 0x0f & getValue(this);
}
// Ueberwachung der Darstellungsvariable der Range.
on envVar A_ASG_15_1_0_36_6_range // PSO_ImExport.TAID 
{
	@A_ASG_15_1_0_36_6 = @A_ASG_15_1_0_36_6_range - (0); // slider = range - min
}

on envVar A_ASG_15_1_0_36_6
{
	byte superval[166];

	//Update Childvalue (Number)
	byte thisval; // TAID
	float slider_value;

	slider_value = round(@A_ASG_15_1_0_36_6, 1.0);
	@A_ASG_15_1_0_36_6_range = slider_value + (0); // real value := slider value + range min.
	thisval = (byte)round((slider_value + (0) - (0)) / (1.0), 1); // bus value := (slider value + min - offset) / step.
}
// Ueberwachung der Darstellungsvariable der Range.
on envVar A_ASG_15_1_0_36_7_range // PSO_ImExport.TotalNumListElements 
{
	@A_ASG_15_1_0_36_7 = @A_ASG_15_1_0_36_7_range - (0); // slider = range - min
}

on envVar A_ASG_15_1_0_36_7
{
	byte superval[166];

	//Update Childvalue (Number)
	word thisval; // TotalNumListElements
	float slider_value;

	slider_value = round(@A_ASG_15_1_0_36_7, 1.0);
	@A_ASG_15_1_0_36_7_range = slider_value + (0); // real value := slider value + range min.
	thisval = (word)round((slider_value + (0) - (0)) / (1.0), 1); // bus value := (slider value + min - offset) / step.
}
// Ueberwachung der Darstellungsvariable der Range.
on envVar A_ASG_15_1_0_36_Data_1_range // PSO_ImExport.Parameter_ID 
{
	@A_ASG_15_1_0_36_Data_1 = @A_ASG_15_1_0_36_Data_1_range - (0); // slider = range - min
}

on envVar A_ASG_15_1_0_36_Data_1
{
	byte superval[166];

	//Update Childvalue (Number)
	dword thisval; // Parameter_ID
	float slider_value;

	slider_value = round(@A_ASG_15_1_0_36_Data_1, 1.0);
	@A_ASG_15_1_0_36_Data_1_range = slider_value + (0); // real value := slider value + range min.
	thisval = (dword)round((slider_value + (0) - (0)) / (1.0), 1); // bus value := (slider value + min - offset) / step.
    A_ASG_15_1_0_36_ArrayDataList[getValue(A_ASG_15_1_0_36_DataIndex)].Param1 = thisval;
}
// Ueberwachung der Darstellungsvariable der Range.
on envVar A_ASG_15_1_0_36_Data_2_range // PSO_ImExport.DataDescription 
{
	@A_ASG_15_1_0_36_Data_2 = @A_ASG_15_1_0_36_Data_2_range - (0); // slider = range - min
}

on envVar A_ASG_15_1_0_36_Data_2
{
	byte superval[166];

	//Update Childvalue (Number)
	byte thisval; // DataDescription
	float slider_value;

	slider_value = round(@A_ASG_15_1_0_36_Data_2, 1.0);
	@A_ASG_15_1_0_36_Data_2_range = slider_value + (0); // real value := slider value + range min.
	thisval = (byte)round((slider_value + (0) - (0)) / (1.0), 1); // bus value := (slider value + min - offset) / step.
    A_ASG_15_1_0_36_ArrayDataList[getValue(A_ASG_15_1_0_36_DataIndex)].Param2 = thisval;
}
on envVar A_ASG_15_1_0_36_Data_3_0
{
	byte bitval;
	//thisval steht hier fuer den bitfield-wert, 
	//aus Generierungsgruenden hier keine einheitliche Bezeichnung moeglich.
	byte thisval; // DataTag
	bitval= getValue(this);
	thisval = getValue(A_ASG_15_1_0_36_Data_3);
	thisval = thisval&~(1<<0)|(bitval<<0);
	putValue(A_ASG_15_1_0_36_Data_3,thisval);
}

on envVar A_ASG_15_1_0_36_Data_3_4
{
	byte bitval;
	//thisval steht hier fuer den bitfield-wert, 
	//aus Generierungsgruenden hier keine einheitliche Bezeichnung moeglich.
	byte thisval; // DataTag
	bitval= getValue(this);
	thisval = getValue(A_ASG_15_1_0_36_Data_3);
	thisval = thisval&~(1<<4)|(bitval<<4);
	putValue(A_ASG_15_1_0_36_Data_3,thisval);
}

on envVar A_ASG_15_1_0_36_Data_3_5
{
	byte bitval;
	//thisval steht hier fuer den bitfield-wert, 
	//aus Generierungsgruenden hier keine einheitliche Bezeichnung moeglich.
	byte thisval; // DataTag
	bitval= getValue(this);
	thisval = getValue(A_ASG_15_1_0_36_Data_3);
	thisval = thisval&~(1<<5)|(bitval<<5);
	putValue(A_ASG_15_1_0_36_Data_3,thisval);
}

on envVar A_ASG_15_1_0_36_Data_3_6
{
	byte bitval;
	//thisval steht hier fuer den bitfield-wert, 
	//aus Generierungsgruenden hier keine einheitliche Bezeichnung moeglich.
	byte thisval; // DataTag
	bitval= getValue(this);
	thisval = getValue(A_ASG_15_1_0_36_Data_3);
	thisval = thisval&~(1<<6)|(bitval<<6);
	putValue(A_ASG_15_1_0_36_Data_3,thisval);
}

on envVar A_ASG_15_1_0_36_Data_3_7
{
	byte bitval;
	//thisval steht hier fuer den bitfield-wert, 
	//aus Generierungsgruenden hier keine einheitliche Bezeichnung moeglich.
	byte thisval; // DataTag
	bitval= getValue(this);
	thisval = getValue(A_ASG_15_1_0_36_Data_3);
	thisval = thisval&~(1<<7)|(bitval<<7);
	putValue(A_ASG_15_1_0_36_Data_3,thisval);
}

on envVar A_ASG_15_1_0_36_Data_3
{
	byte superval[166];

	//Update Childvalue (BitField)
	byte mask=0x01;
	int i = 0;
	byte thisval; // DataTag
	thisval = getValue(this);
	if(thisval&(mask<<0))
		putValue(A_ASG_15_1_0_36_Data_3_0, 1);
	else
		putValue(A_ASG_15_1_0_36_Data_3_0, 0);
	if(thisval&(mask<<4))
		putValue(A_ASG_15_1_0_36_Data_3_4, 1);
	else
		putValue(A_ASG_15_1_0_36_Data_3_4, 0);
	if(thisval&(mask<<5))
		putValue(A_ASG_15_1_0_36_Data_3_5, 1);
	else
		putValue(A_ASG_15_1_0_36_Data_3_5, 0);
	if(thisval&(mask<<6))
		putValue(A_ASG_15_1_0_36_Data_3_6, 1);
	else
		putValue(A_ASG_15_1_0_36_Data_3_6, 0);
	if(thisval&(mask<<7))
		putValue(A_ASG_15_1_0_36_Data_3_7, 1);
	else
		putValue(A_ASG_15_1_0_36_Data_3_7, 0);
    A_ASG_15_1_0_36_ArrayDataList[getValue(A_ASG_15_1_0_36_DataIndex)].Param3 = thisval;
}
// Ueberwachung der Darstellungsvariable der Range.
on envVar A_ASG_15_1_0_36_Data_4_range // PSO_ImExport.DataLength 
{
	@A_ASG_15_1_0_36_Data_4 = @A_ASG_15_1_0_36_Data_4_range - (0); // slider = range - min
}

on envVar A_ASG_15_1_0_36_Data_4
{
	byte superval[166];

	//Update Childvalue (Number)
	dword thisval; // DataLength
	float slider_value;

	slider_value = round(@A_ASG_15_1_0_36_Data_4, 1.0);
	@A_ASG_15_1_0_36_Data_4_range = slider_value + (0); // real value := slider value + range min.
	thisval = (dword)round((slider_value + (0) - (0)) / (1.0), 1); // bus value := (slider value + min - offset) / step.
    A_ASG_15_1_0_36_ArrayDataList[getValue(A_ASG_15_1_0_36_DataIndex)].Param4 = thisval;
}

// Ueberwachung der CheckBox fuer String
on envVar  A_ASG_15_1_0_36_Data_5_cnt
{
	word len;
	byte cnt;
	len = getValue(A_ASG_15_1_0_36_Data_5_len);
	cnt = getValue(this);

    /* Cnt Wert im Array aktualisieren */
	 A_ASG_15_1_0_36_Data_5_CntList[ getValue(A_ASG_15_1_0_36_DataIndex) ] = cnt;

	/* wird nur gerufen, wenn check box deaktiviert mit Length>127*/ 
	if(cnt == 0) 
	{
		if(len > 127 )
		{
			putValue(A_ASG_15_1_0_36_Data_5_len, 127);
		}
	}

}


on envVar A_ASG_15_1_0_36_Data_5_len
{
	long thisval;
	byte cnt;
	thisval = getValue(this);
	cnt = getValue(A_ASG_15_1_0_36_Data_5_cnt);

	/* wenn die Laenge ausserhalb des erlaubten Bereich liegt, wird diese begrenzt */
	if(thisval > 1 ) //if(thisval > 0 || thisval < 1 )
	{
		writelineEx(gBAP_Trace, 0, "Eingegebene Laenge: %d von A_ASG_15_1_0_36_Data_5 ist ungueltig. Die max. erlaubte Laenge ist %d. ", thisval, 1);
		thisval = 1;
	}
	if( thisval >127)
	{
		putValue(A_ASG_15_1_0_36_Data_5_cnt, 1); /* Switch checkbox on */
	}

	A_ASG_15_1_0_36_ArrayDataList[getValue(A_ASG_15_1_0_36_DataIndex)].Param5_Length = thisval;
	A_ASG_15_1_0_36_Data_5_LenList[ getValue(A_ASG_15_1_0_36_DataIndex) ] = thisval;
	putValue(A_ASG_15_1_0_36_Data_5_len, thisval);

}

on envVar A_ASG_15_1_0_36_Data_5
{
	byte superval[166];

	//Update Childvalue (String)
	word i;
	byte thisval[255];//[2];
	getValue(this, thisval);
    for(i = 0; i < getValueSize(this); i++)
        A_ASG_15_1_0_36_ArrayDataList[getValue(A_ASG_15_1_0_36_DataIndex)].Param5[i] = thisval[i];
    A_ASG_15_1_0_36_ArrayDataList[getValue(A_ASG_15_1_0_36_DataIndex)].Param5_Length = getValueSize(this);
    A_ASG_15_1_0_36_Data_5_LenList[getValue(A_ASG_15_1_0_36_DataIndex)]= getValueSize(this);
    putValue(A_ASG_15_1_0_36_Data_5_len, getValueSize(this));
}
on envVar A_ASG_15_1_0_36_1_Changed
{
	byte superval[166];

	//Update Childvalue (Enum)
	byte thisval; // Operation
	thisval = getValue(this);
}
on envVar A_ASG_15_1_0_36_2_Changed
{
	byte superval[166];

	//Update Childvalue (Enum)
	byte thisval; // Type
	thisval = getValue(this);
}
// Ueberwachung der Darstellungsvariable der Range.
on envVar A_ASG_15_1_0_36_3_Changed_range // PSO_ImExport.Slot 
{
	@A_ASG_15_1_0_36_3_Changed = @A_ASG_15_1_0_36_3_Changed_range - (0); // slider = range - min
}

on envVar A_ASG_15_1_0_36_3_Changed
{
	byte superval[166];

	//Update Childvalue (Number)
	byte thisval; // Slot
	float slider_value;

	slider_value = round(@A_ASG_15_1_0_36_3_Changed, 1.0);
	@A_ASG_15_1_0_36_3_Changed_range = slider_value + (0); // real value := slider value + range min.
	thisval = (byte)round((slider_value + (0) - (0)) / (1.0), 1); // bus value := (slider value + min - offset) / step.
}
on envVar A_ASG_15_1_0_36_1_SetGet
{
	byte superval[255];//[163]; 

	//Update Childvalue (Enum)
	byte thisval; // Operation
	thisval = getValue(this);
}
on envVar A_ASG_15_1_0_36_2_SetGet
{
	byte superval[255];//[163]; 

	//Update Childvalue (Enum)
	byte thisval; // Type
	thisval = getValue(this);
}
// Ueberwachung der Darstellungsvariable der Range.
on envVar A_ASG_15_1_0_36_3_SetGet_range // PSO_ImExport.Slot 
{
	@A_ASG_15_1_0_36_3_SetGet = @A_ASG_15_1_0_36_3_SetGet_range - (0); // slider = range - min
}

on envVar A_ASG_15_1_0_36_3_SetGet
{
	byte superval[255];//[163]; 

	//Update Childvalue (Number)
	byte thisval; // Slot
	float slider_value;

	slider_value = round(@A_ASG_15_1_0_36_3_SetGet, 1.0);
	@A_ASG_15_1_0_36_3_SetGet_range = slider_value + (0); // real value := slider value + range min.
	thisval = (byte)round((slider_value + (0) - (0)) / (1.0), 1); // bus value := (slider value + min - offset) / step.
}
on envVar A_ASG_15_1_0_36_4_SetGet
{
	byte superval[255];//[163]; 

	//Update Childvalue (Enum)
	byte thisval; // ASG_ID
	thisval = 0x0f & getValue(this);
}
// Ueberwachung der Darstellungsvariable der Range.
on envVar A_ASG_15_1_0_36_5_SetGet_range // PSO_ImExport.TAID 
{
	@A_ASG_15_1_0_36_5_SetGet = @A_ASG_15_1_0_36_5_SetGet_range - (0); // slider = range - min
}

on envVar A_ASG_15_1_0_36_5_SetGet
{
	byte superval[255];//[163]; 

	//Update Childvalue (Number)
	byte thisval; // TAID
	float slider_value;

	slider_value = round(@A_ASG_15_1_0_36_5_SetGet, 1.0);
	@A_ASG_15_1_0_36_5_SetGet_range = slider_value + (0); // real value := slider value + range min.
	thisval = (byte)round((slider_value + (0) - (0)) / (1.0), 1); // bus value := (slider value + min - offset) / step.
}
// Ueberwachung der Darstellungsvariable der Range.
on envVar A_ASG_15_1_0_36_Data_1_SetGet_range // PSO_ImExport.Parameter_ID 
{
	@A_ASG_15_1_0_36_Data_1_SetGet = @A_ASG_15_1_0_36_Data_1_SetGet_range - (0); // slider = range - min
}

on envVar A_ASG_15_1_0_36_Data_1_SetGet
{
	byte superval[255];//[163]; 

	//Update Childvalue (Number)
	dword thisval; // Parameter_ID
	float slider_value;

	slider_value = round(@A_ASG_15_1_0_36_Data_1_SetGet, 1.0);
	@A_ASG_15_1_0_36_Data_1_SetGet_range = slider_value + (0); // real value := slider value + range min.
	thisval = (dword)round((slider_value + (0) - (0)) / (1.0), 1); // bus value := (slider value + min - offset) / step.
    A_ASG_15_1_0_36_ArrayDataList[getValue(A_ASG_15_1_0_36_DataIndex_SetGet)].Param1 = thisval;
}
// Ueberwachung der Darstellungsvariable der Range.
on envVar A_ASG_15_1_0_36_Data_2_SetGet_range // PSO_ImExport.DataDescription 
{
	@A_ASG_15_1_0_36_Data_2_SetGet = @A_ASG_15_1_0_36_Data_2_SetGet_range - (0); // slider = range - min
}

on envVar A_ASG_15_1_0_36_Data_2_SetGet
{
	byte superval[255];//[163]; 

	//Update Childvalue (Number)
	byte thisval; // DataDescription
	float slider_value;

	slider_value = round(@A_ASG_15_1_0_36_Data_2_SetGet, 1.0);
	@A_ASG_15_1_0_36_Data_2_SetGet_range = slider_value + (0); // real value := slider value + range min.
	thisval = (byte)round((slider_value + (0) - (0)) / (1.0), 1); // bus value := (slider value + min - offset) / step.
    A_ASG_15_1_0_36_ArrayDataList[getValue(A_ASG_15_1_0_36_DataIndex_SetGet)].Param2 = thisval;
}
on envVar A_ASG_15_1_0_36_Data_3_SetGet_0
{
	byte bitval;
	//thisval steht hier fuer den bitfield-wert, 
	//aus Generierungsgruenden hier keine einheitliche Bezeichnung moeglich.
	byte thisval; // DataTag
	bitval= getValue(this);
	thisval = getValue(A_ASG_15_1_0_36_Data_3_SetGet);
	thisval = thisval&~(1<<0)|(bitval<<0);
	putValue(A_ASG_15_1_0_36_Data_3_SetGet,thisval);
}

on envVar A_ASG_15_1_0_36_Data_3_SetGet_4
{
	byte bitval;
	//thisval steht hier fuer den bitfield-wert, 
	//aus Generierungsgruenden hier keine einheitliche Bezeichnung moeglich.
	byte thisval; // DataTag
	bitval= getValue(this);
	thisval = getValue(A_ASG_15_1_0_36_Data_3_SetGet);
	thisval = thisval&~(1<<4)|(bitval<<4);
	putValue(A_ASG_15_1_0_36_Data_3_SetGet,thisval);
}

on envVar A_ASG_15_1_0_36_Data_3_SetGet_5
{
	byte bitval;
	//thisval steht hier fuer den bitfield-wert, 
	//aus Generierungsgruenden hier keine einheitliche Bezeichnung moeglich.
	byte thisval; // DataTag
	bitval= getValue(this);
	thisval = getValue(A_ASG_15_1_0_36_Data_3_SetGet);
	thisval = thisval&~(1<<5)|(bitval<<5);
	putValue(A_ASG_15_1_0_36_Data_3_SetGet,thisval);
}

on envVar A_ASG_15_1_0_36_Data_3_SetGet_6
{
	byte bitval;
	//thisval steht hier fuer den bitfield-wert, 
	//aus Generierungsgruenden hier keine einheitliche Bezeichnung moeglich.
	byte thisval; // DataTag
	bitval= getValue(this);
	thisval = getValue(A_ASG_15_1_0_36_Data_3_SetGet);
	thisval = thisval&~(1<<6)|(bitval<<6);
	putValue(A_ASG_15_1_0_36_Data_3_SetGet,thisval);
}

on envVar A_ASG_15_1_0_36_Data_3_SetGet_7
{
	byte bitval;
	//thisval steht hier fuer den bitfield-wert, 
	//aus Generierungsgruenden hier keine einheitliche Bezeichnung moeglich.
	byte thisval; // DataTag
	bitval= getValue(this);
	thisval = getValue(A_ASG_15_1_0_36_Data_3_SetGet);
	thisval = thisval&~(1<<7)|(bitval<<7);
	putValue(A_ASG_15_1_0_36_Data_3_SetGet,thisval);
}

on envVar A_ASG_15_1_0_36_Data_3_SetGet
{
	byte superval[255];//[163]; 

	//Update Childvalue (BitField)
	byte mask=0x01;
	int i = 0;
	byte thisval; // DataTag
	thisval = getValue(this);
	if(thisval&(mask<<0))
		putValue(A_ASG_15_1_0_36_Data_3_SetGet_0, 1);
	else
		putValue(A_ASG_15_1_0_36_Data_3_SetGet_0, 0);
	if(thisval&(mask<<4))
		putValue(A_ASG_15_1_0_36_Data_3_SetGet_4, 1);
	else
		putValue(A_ASG_15_1_0_36_Data_3_SetGet_4, 0);
	if(thisval&(mask<<5))
		putValue(A_ASG_15_1_0_36_Data_3_SetGet_5, 1);
	else
		putValue(A_ASG_15_1_0_36_Data_3_SetGet_5, 0);
	if(thisval&(mask<<6))
		putValue(A_ASG_15_1_0_36_Data_3_SetGet_6, 1);
	else
		putValue(A_ASG_15_1_0_36_Data_3_SetGet_6, 0);
	if(thisval&(mask<<7))
		putValue(A_ASG_15_1_0_36_Data_3_SetGet_7, 1);
	else
		putValue(A_ASG_15_1_0_36_Data_3_SetGet_7, 0);
    A_ASG_15_1_0_36_ArrayDataList[getValue(A_ASG_15_1_0_36_DataIndex_SetGet)].Param3 = thisval;
}
// Ueberwachung der Darstellungsvariable der Range.
on envVar A_ASG_15_1_0_36_Data_4_SetGet_range // PSO_ImExport.DataLength 
{
	@A_ASG_15_1_0_36_Data_4_SetGet = @A_ASG_15_1_0_36_Data_4_SetGet_range - (0); // slider = range - min
}

on envVar A_ASG_15_1_0_36_Data_4_SetGet
{
	byte superval[255];//[163]; 

	//Update Childvalue (Number)
	dword thisval; // DataLength
	float slider_value;

	slider_value = round(@A_ASG_15_1_0_36_Data_4_SetGet, 1.0);
	@A_ASG_15_1_0_36_Data_4_SetGet_range = slider_value + (0); // real value := slider value + range min.
	thisval = (dword)round((slider_value + (0) - (0)) / (1.0), 1); // bus value := (slider value + min - offset) / step.
    A_ASG_15_1_0_36_ArrayDataList[getValue(A_ASG_15_1_0_36_DataIndex_SetGet)].Param4 = thisval;
}

// Ueberwachung der CheckBox fuer String
on envVar  A_ASG_15_1_0_36_Data_5_SetGet_cnt
{
	word len;
	byte cnt;
	len = getValue(A_ASG_15_1_0_36_Data_5_SetGet_len);
	cnt = getValue(this);

    /* Cnt Wert im Array aktualisieren */
	 A_ASG_15_1_0_36_Data_5_SetGet_CntList[ getValue(A_ASG_15_1_0_36_DataIndex_SetGet) ] = cnt;

	/* wird nur gerufen, wenn check box deaktiviert mit Length>127*/ 
	if(cnt == 0) 
	{
		if(len > 127 )
		{
			putValue(A_ASG_15_1_0_36_Data_5_SetGet_len, 127);
		}
	}

}


on envVar A_ASG_15_1_0_36_Data_5_SetGet_len
{
	long thisval;
	byte cnt;
	thisval = getValue(this);
	cnt = getValue(A_ASG_15_1_0_36_Data_5_SetGet_cnt);

	/* wenn die Laenge ausserhalb des erlaubten Bereich liegt, wird diese begrenzt */
	if(thisval > 1 ) //if(thisval > 0 || thisval < 1 )
	{
		writelineEx(gBAP_Trace, 0, "Eingegebene Laenge: %d von A_ASG_15_1_0_36_Data_5_SetGet ist ungueltig. Die max. erlaubte Laenge ist %d. ", thisval, 1);
		thisval = 1;
	}
	if( thisval >127)
	{
		putValue(A_ASG_15_1_0_36_Data_5_SetGet_cnt, 1); /* Switch checkbox on */
	}

	A_ASG_15_1_0_36_ArrayDataList[getValue(A_ASG_15_1_0_36_DataIndex_SetGet)].Param5_Length = thisval;
	A_ASG_15_1_0_36_Data_5_SetGet_LenList[ getValue(A_ASG_15_1_0_36_DataIndex_SetGet) ] = thisval;
	putValue(A_ASG_15_1_0_36_Data_5_SetGet_len, thisval);

}

on envVar A_ASG_15_1_0_36_Data_5_SetGet
{
	byte superval[255];//[163]; 

	//Update Childvalue (String)
	word i;
	byte thisval[255];//[2];
	getValue(this, thisval);
    for(i = 0; i < getValueSize(this); i++)
        A_ASG_15_1_0_36_ArrayDataList[getValue(A_ASG_15_1_0_36_DataIndex_SetGet)].Param5[i] = thisval[i];
    A_ASG_15_1_0_36_ArrayDataList[getValue(A_ASG_15_1_0_36_DataIndex_SetGet)].Param5_Length = getValueSize(this);
    A_ASG_15_1_0_36_Data_5_SetGet_LenList[getValue(A_ASG_15_1_0_36_DataIndex_SetGet)]= getValueSize(this);
    putValue(A_ASG_15_1_0_36_Data_5_SetGet_len, getValueSize(this));
}
on envVar P_ASG_15_1_0_37Get_BTN
{
 if (P_ASG_15_1_0_37Get_BTN_already_pressed == 0)
  {
       putValue(P_ASG_15_1_0_37_ErrCode,0);
       SetControlBackColor(panel_name,"errField_P_ASG_15_1_0_37",MakeRGB(255,255,255));
       P_ASG_15_1_0_37Get_BTN_already_pressed = 1;
 }
 else
 {
       Request_Void(LSGID, P_ASG_15_1_0_37_ID, DataGet_REQ); 
       P_ASG_15_1_0_37Get_BTN_already_pressed = 0;
 }
}
on envVar P_ASG_15_1_0_37SetGet_BTN
{
	byte BAPTemp[5];
    if (P_ASG_15_1_0_37SetGet_BTN_already_pressed == 0)
    {
       putValue(P_ASG_15_1_0_37_ErrCode,0);
       SetControlBackColor(panel_name,"errField_P_ASG_15_1_0_37",MakeRGB(255,255,255));
       P_ASG_15_1_0_37SetGet_BTN_already_pressed = 1;
    }
    else
    {
       getValue(P_ASG_15_1_0_37, BAPTemp);
       Request_ByteSequence(LSGID, P_ASG_15_1_0_37_ID, DataSetGet_REQ, BAPTemp, getValueSize(P_ASG_15_1_0_37));
       P_ASG_15_1_0_37SetGet_BTN_already_pressed = 0;
    }
}
on envVar P_ASG_15_1_0_37 // bus value of SpeedWarning2 (37).
{
	// opcodes: Error-Status
	byte param1; // State
	word param2; // Speed_Value
	byte param3; // Speed_Unit
	byte param4; // Extension1
	// DATATYPE_BYTESEQUENCE / DATATYPE_FIXEDBYTESEQUENCE
	int i;
	byte superval[5];
	int currentPos;
	currentPos = 0;
	for( i = 0; i < 5; i++ ) {
		superval[i] = 0;
	}
	getValue(P_ASG_15_1_0_37, superval);
	///////// Start param1 - UINT8 /////////
	param1 = superval[currentPos++];
	putValue(P_ASG_15_1_0_37_1, param1);
	///////// Start param2 - UINT16 /////////
	param2 = superval[currentPos++]|(superval[currentPos++]<<8);
	putValue(P_ASG_15_1_0_37_2, round((param2 * 1.0) - (0) + (0), 1.0));
	///////// Start param3 - UINT8 /////////
	param3 = superval[currentPos++];
	putValue(P_ASG_15_1_0_37_3, param3);
	///////// Start param4 - UINT8 /////////
	param4 = superval[currentPos++];
	putValue(P_ASG_15_1_0_37_4, round((param4 * 1.0) - (0) + (0), 1.0));
}

on envVar P_ASG_15_1_0_37_1_0
{
	byte bitval;
	//thisval steht hier fuer den bitfield-wert, 
	//aus Generierungsgruenden hier keine einheitliche Bezeichnung moeglich.
	byte thisval; // State
	bitval= getValue(this);
	thisval = getValue(P_ASG_15_1_0_37_1);
	thisval = thisval&~(1<<0)|(bitval<<0);
	putValue(P_ASG_15_1_0_37_1,thisval);
}

on envVar P_ASG_15_1_0_37_1 // SpeedWarning2.State
{
	byte superval[5];

	//Update Childvalue (BitField)
	byte mask=0x01;
	int i = 0;
	byte thisval; // State
	thisval = getValue(this);
	if(thisval&(mask<<0))
		putValue(P_ASG_15_1_0_37_1_0, 1);
	else
		putValue(P_ASG_15_1_0_37_1_0, 0);

    // Update superval
	getValue(P_ASG_15_1_0_37, superval);
	superval[0]=thisval;
	putValue(P_ASG_15_1_0_37,superval);
}

// Ueberwachung der Darstellungsvariable der Range.
on envVar P_ASG_15_1_0_37_2_range // SpeedWarning2.Speed_Value 
{
	@P_ASG_15_1_0_37_2 = @P_ASG_15_1_0_37_2_range - (0); // slider = range - min
}

on envVar P_ASG_15_1_0_37_2 // SpeedWarning2.Speed_Value
{
	byte superval[5];

	//Update Childvalue (Number)
	word thisval; // Speed_Value
	float slider_value;

	slider_value = round(@P_ASG_15_1_0_37_2, 1.0);
	@P_ASG_15_1_0_37_2_range = slider_value + (0); // real value := slider value + range min.
	thisval = (word)round((slider_value + (0) - (0)) / (1.0), 1); // bus value := (slider value + min - offset) / step.

    // Update superval
	getValue(P_ASG_15_1_0_37, superval);
	superval[1]=thisval&0x00ff;
	superval[2]=(thisval&0xff00)>>8;
	putValue(P_ASG_15_1_0_37,superval);
}

on envVar P_ASG_15_1_0_37_3 // SpeedWarning2.Speed_Unit
{
	byte superval[5];

	//Update Childvalue (Enum)
	byte thisval; // Speed_Unit
	thisval = getValue(this);

    // Update superval
	getValue(P_ASG_15_1_0_37, superval);
	superval[3]=thisval;
	putValue(P_ASG_15_1_0_37,superval);
}

// Ueberwachung der Darstellungsvariable der Range.
on envVar P_ASG_15_1_0_37_4_range // SpeedWarning2.Extension1 
{
	@P_ASG_15_1_0_37_4 = @P_ASG_15_1_0_37_4_range - (0); // slider = range - min
}

on envVar P_ASG_15_1_0_37_4 // SpeedWarning2.Extension1
{
	byte superval[5];

	//Update Childvalue (Number)
	byte thisval; // Extension1
	float slider_value;

	slider_value = 0; // Konstanter Parameter.
	@P_ASG_15_1_0_37_4_range = slider_value + (0); // real value := slider value + range min.
	thisval = (byte)round((slider_value + (0) - (0)) / (1.0), 1); // bus value := (slider value + min - offset) / step.

    // Update superval
	getValue(P_ASG_15_1_0_37, superval);
	superval[4]=thisval;
	putValue(P_ASG_15_1_0_37,superval);
}



/**
*
* Template-Funktion zum automatischen befuellen der Array-Daten, die in einer Arrayfunktion genutzt werden.
* Die Funktion wird durch den von BAPSimGen generierten Code aufgerufen.
*
* Parameter:
* - structArray: Muss mindestens nMax * Arraygroesse Bytes Platz haben, wird vom BAPSimGen automatisch generiert
* - structElementsSizeArray: Enthaelt die Groesseangabe jedes Array-Elements. Die Arraygroesse entspricht der Elementanzahl im Array.
*       Byte & Nibble = 1; Word = 2; usw. Bei Strings wird die maximale Stringlaenge angegeben.
* - structElementsTypeArray: Gibt den Datentyp eines Array-Elements zurueck. Die Arraygroesse entspricht der Elmentanzahl im Array.
*                               0x0 = Zahlenwert, also ein Slider, Enum, Bitfield,...
*                               0xE = String (darauf folgt immer eine 2, mit der Angabe der benutzen Bytes im String)
*                               0xF = Laenge der Nutzdaten des Strings, nur return Wert
* - fctID: Kann zur Fallunterscheidung der Funktions-IDs verwendet werden.
* - nMax: Array-Index
*
* Die Funktion kann im Switch-Case beliebig erweitert werden. Der Switch-Case wertet den Parameter fctID aus.
*           
*                    
**/
initStruct(byte structArray[], dword structElementsSizeArray[], byte structElementsTypeArray[], dword structElementsMaxSizeArray[], word fctID, word nMax )
{
    byte rand8;
    word rand16;
    word randSize;
    word index;           //indexNr die an die String Parameter angehaengt wird.
    dword destArraySize;   //groesse von structArray
    dword destStructSize;  //groesse eines "Structs" also destArraySize / Anzahl Elemente (nMax))
    dword rand32;    
    dword i;
    dword pos;    //aktuelle Position im structArray
    dword elpos;  //aktuelle Position in den structElementsXXXArray's
    
    destArraySize = elCount(structArray);
    destStructSize = destArraySize / nMax;    

    Switch(fctID){

        //Idee ist, die Arrays je nach Funcion-ID speziell initalisieren zu koennen.
        //hierbei koennten die Daten z.B. aus einer Datei eingelesen werden,
        //oder auch ueber spezielle init Funktionen mit festen Werten initialisiert werden.
        //Der Default-Fall befuellt das Array mit Random-Werten und Strings mit einem vordefinierten Wort (hier test,)

        default :
        {
            pos = 0; 
            for(i = 1; i <= nMax; i++)
            {
                //walk through the array
                
                elpos = 0;
                while(pos < (destStructSize * i) )
                {   
                    //check Element type
                    if( structElementsTypeArray[elpos] == 0x0)          
                    { //Params like int, word, etc.
                        //check element length
                        Switch(structElementsSizeArray[elpos])
                        {
                            case(1) : //byte / nibble
                                rand8 = random(structElementsMaxSizeArray[elpos]);
                                structArray[pos] = rand8;
                                pos++;
                                break;

                            case(2) : //word / int
                                rand16 = random(structElementsMaxSizeArray[elpos]);
                                int2byte(structArray, pos, rand16);
                                pos += 2;
                                break;

                            case (4) : //dword / long
                                rand32 = random(structElementsMaxSizeArray[elpos]);
                                long2byte(structArray, pos, rand32);
                                pos += 4;
                                break;                        
                         }
                    }
                    else if(structElementsTypeArray[elpos] == 0xE)          
                    { //String Params like byte[]
                        randSize = random(structElementsSizeArray[elpos]);
                        if(randSize < 2) randSize = 2; 
                        index = i-1;
                        setRandomString(structArray ,pos ,structElementsSizeArray[elpos], randSize, index);
                        pos += structElementsSizeArray[elpos];
                    }
                    else if(structElementsTypeArray[elpos] == 0xF)          
                    {
                        int2byte(structArray, pos, randSize);
                        pos += 2;
                        //write("Pos: %d Strlth: %d Type: %d ",pos-1,randSize,structElementsTypeArray[elpos]);
                    
                    }
                    elpos++;
                }
            }   
        break;
        }            
    }
}

long2Byte(byte in[], dword pos, dword value)
{
    if( (elCount(in)-pos) < 4)
        write("Array out ouf bounds - too small!");
    in[pos] = value;
    in[++pos] = (value >> 8);
    in[++pos] = (value >> 16);
    in[++pos] = (value >> 24);
}

int2byte (byte in[],dword pos,word value)
{
    if( (elCount(in)-pos) < 2 )
        write("Array out of bounds - too small!");
    in[pos] = value;
    in[++pos] = (value >> 8);        
}

setRandomString (byte in[], dword pos, word strSize, word randSize, word count)
{
    word endPos, endString, j;
    byte testString[4]={'t','e','s','t'};
    
    endPos = pos + strSize;
    endString = pos + randSize;
    j=0;
    
    int2ascii(in, pos, count);
    pos += 2;
    
    for(pos; pos < endPos ;pos ++)
    {
        if(j > 3 )
            j = 0;
        if(pos < endString)
            in[pos] = testString[j++];
        else
            in[pos] = 0x0;
    }
}

int2ascii (byte in[], dword pos, word value)
{
    //Konvertiert nur die erste und zweite Dezimalstelle, also Zahlen zw. 0 und 99.
    
    //auf 2 Stellen kuerzen
    value = value%100;
    //10er schreiben
    in[pos] = (value/10) + 48;    //  0x30 hex = 48 dez = ascii null
    //1er schreiben
    in[pos+1] = (value%10) + 48;  //  0x30 hex = 48 dez = ascii null
}

