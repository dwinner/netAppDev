/*@@var:*/
variables
{
    const FALSE             =0;
	const TRUE              =1;
    char empty_string [3]   ={0,0,0};

    mstimer Klemmen_Status_01_Timer;                //timer for CAN message 'KlemmenStatus_01'

    const Klemmen_Status_01_Timer_Time  =100;       //cycle time 100ms
    message Klemmen_Status_01 Klemmen_Status_01;    //'KlemmenStatus_01' CAN message
}
/*@@end*/

/*@@startStart:Start:*/
on start
{
    putvalue(env_ZAS_active,FALSE);
    putvalue(Env_ZAS_Text,empty_string);  
}
/*@@end*/

/*@@timer:Klemmen_Status_01_Timer:*/
on timer Klemmen_Status_01_Timer
{
    if (getvalue(env_ZAS_active))
    {
        output(Klemmen_Status_01);
        
        settimer(Klemmen_Status_01_Timer, Klemmen_Status_01_Timer_Time);
    }    
}
/*@@end*/

/*@@envVar:env_ZAS_active:*/
on envVar env_ZAS_active
{
	if(getvalue(this))
    {
        switch(getvalue(Env_ZAS))
        {
            case 0:   
                Klemmen_Status_01.ZAS_Kl_15 =0;
                Klemmen_Status_01.ZAS_Kl_S  =0;

                putvalue(Env_ZAS_Text,"Cl_15 OFF, Cl_S OFF");
            break;

            case 1:   
                Klemmen_Status_01.ZAS_Kl_15 =0;
                Klemmen_Status_01.ZAS_Kl_S  =1;

                putvalue(Env_ZAS_Text,"Cl_15 OFF, Cl_S ON");
            break;

            case 2:   
                Klemmen_Status_01.ZAS_Kl_15 =1;
                Klemmen_Status_01.ZAS_Kl_S  =1;

                putvalue(Env_ZAS_Text,"Cl_15 ON, Cl_S ON");
            break;

            default:
            break;
        }
        settimer(Klemmen_Status_01_Timer, Klemmen_Status_01_Timer_Time);
    }
    else
    {
        cancelTimer(Klemmen_Status_01_Timer);
        putvalue(Env_ZAS_Text,empty_string);  
    }


}
/*@@end*/

/*@@envVar:Env_ZAS:*/
on envVar Env_ZAS
{   
    if(getvalue(env_ZAS_active))
    {
        switch(getvalue(Env_ZAS))
        {
            case 0:  
                Klemmen_Status_01.ZAS_Kl_15 =0;
                Klemmen_Status_01.ZAS_Kl_S  =0;

                putvalue(Env_ZAS_Text,"Cl_15 OFF, Cl_S OFF");
            break;

            case 1:   
                Klemmen_Status_01.ZAS_Kl_15 =0;
                Klemmen_Status_01.ZAS_Kl_S  =1;

                putvalue(Env_ZAS_Text,"Cl_15 OFF, Cl_S ON");
            break;

            case 2:   
                Klemmen_Status_01.ZAS_Kl_15 =1;
                Klemmen_Status_01.ZAS_Kl_S  =1;

                putvalue(Env_ZAS_Text,"Cl_15 ON, Cl_S ON");
            break;

            default:
            break;
        }   
    }
}
/*@@end*/

