includes
{
  // Import required CAPL include files
  //--- begin generated part --- Block start #Hdr_Includes#; do not delete this line and do not add application code in this code block!
  /* #ChannelStart# |ETH1| #BusStart# |ETH_Cluster_MEB| */
  /* #ChannelEnd# |ETH1| #BusEnd# |ETH_Cluster_MEB| */
  //--- end generated part --- Block end #Hdr_Includes#; do not delete this line! Add application code below this line.
  //--- begin generated part --- Block start #Body_Includes#; do not delete this line and do not add application code in this code block!
  /* #ChannelStart# |ETH1| #BusStart# |ETH_Cluster_MEB| */
  #include "..\CAPL\PDU-NM-Panel-Helper_Eth1.cin"
  #include "..\CAPL\PDU-IL-KL15-Helper_Eth1.cin"
  /* #ChannelEnd# |ETH1| #BusEnd# |ETH_Cluster_MEB| */
  //--- end generated part --- Block end #Body_Includes#; do not delete this line! Add application code below this line.
}

variables
{
  // Define global variables for this CAPL file

  /*--- #GenHeader Begin# --- begin generated comment ---
  | Generated on Thursday, Oktober 24, 2019, 10:41:47
  | By ModelGenerator for VAG 1.0.0.4, ModelGeneratorVAGDLL 1.4.0.41
  | Package VAG 3.1.2
  | Target Bus: ETH_Cluster_MEB; Channel: ETH1; DB Cluster: ETH_Cluster_MEB;
  | From Database: E3_1_1_MEB_V10.06.03F_AR421_20190920_ICAS3_Sys_IVI_01.arxml
  | CANoe Version 11.0.96.0
    --- #GenHeader End  # --- end generated comment --- */

  char gECU[256] = "ICAS3_Sys_IVI_01";
  //--- begin generated part --- Block start #Hdr_GlobalVariables#; do not delete this line and do not add application code in this code block!
  /* #ChannelStart# |ETH1| #BusStart# |ETH_Cluster_MEB| */
  dword gETH1_AfterPreStart = 0;
  /* #ChannelEnd# |ETH1| #BusEnd# |ETH_Cluster_MEB| */
  //--- end generated part --- Block end #Hdr_GlobalVariables#; do not delete this line! Add application code below this line.
  //--- begin generated part --- Block start #Body_GlobalVariables#; do not delete this line and do not add application code in this code block!
  /* #ChannelStart# |ETH1| #BusStart# |ETH_Cluster_MEB| */
  char gETH1BusName[256] = "ETH_Cluster_MEB";
  int gETH1Channel = 1; //// The channel the bus is attached to

  long gETH1DisturbanceMode;
  long gETH1DisturbanceCount;
  long gETH1DisturbanceValue;
  long gETH1DisturbanceContinueMode;
  double gETH1DisturbancePeriod;
  /* #ChannelEnd# |ETH1| #BusEnd# |ETH_Cluster_MEB| */
  //--- end generated part --- Block end #Body_GlobalVariables#; do not delete this line! Add application code below this line.
}

on preStart
{
  // Initialize CAPL includes and node's modules/DLLs
  //--- begin generated part --- Block start #Hdr_OnInit#; do not delete this line and do not add application code in this code block!
  /* #ChannelStart# |ETH1| #BusStart# |ETH_Cluster_MEB| */
  /* #ChannelEnd# |ETH1| #BusEnd# |ETH_Cluster_MEB| */
  //--- end generated part --- Block end #Hdr_OnInit#; do not delete this line! Add application code below this line.
  //--- begin generated part --- Block start #Body_OnInit#; do not delete this line and do not add application code in this code block!
  /* #ChannelStart# |ETH1| #BusStart# |ETH_Cluster_MEB| */
  ILETH1_OnInit();
  AREthSetProperty("MaxUDPMessageLength", 8192);
  gETH1_AfterPreStart = 1;
  /* #ChannelEnd# |ETH1| #BusEnd# |ETH_Cluster_MEB| */
  //--- end generated part --- Block end #Body_OnInit#; do not delete this line! Add application code below this line.
}

on start
{
  // Start CAPL includes and node's modules/DLLs
  //--- begin generated part --- Block start #Hdr_OnStart#; do not delete this line and do not add application code in this code block!
  /* #ChannelStart# |ETH1| #BusStart# |ETH_Cluster_MEB| */
  /* #ChannelEnd# |ETH1| #BusEnd# |ETH_Cluster_MEB| */
  //--- end generated part --- Block end #Hdr_OnStart#; do not delete this line! Add application code below this line.
  //--- begin generated part --- Block start #Body_OnStart#; do not delete this line and do not add application code in this code block!
  /* #ChannelStart# |ETH1| #BusStart# |ETH_Cluster_MEB| */
  ILETH1_OnStart();
  /* #ChannelEnd# |ETH1| #BusEnd# |ETH_Cluster_MEB| */
  //--- end generated part --- Block end #Body_OnStart#; do not delete this line! Add application code below this line.
}

on preStop
{
  // Prepare stopping
  //--- begin generated part --- Block start #Hdr_OnStopping#; do not delete this line and do not add application code in this code block!
  /* #ChannelStart# |ETH1| #BusStart# |ETH_Cluster_MEB| */
  /* #ChannelEnd# |ETH1| #BusEnd# |ETH_Cluster_MEB| */
  //--- end generated part --- Block end #Hdr_OnStopping#; do not delete this line! Add application code below this line.
  //--- begin generated part --- Block start #Body_OnStopping#; do not delete this line and do not add application code in this code block!
  /* #ChannelStart# |ETH1| #BusStart# |ETH_Cluster_MEB| */
  /* #ChannelEnd# |ETH1| #BusEnd# |ETH_Cluster_MEB| */
  //--- end generated part --- Block end #Body_OnStopping#; do not delete this line! Add application code below this line.
}

on stopMeasurement
{
  // Stop actions
  //--- begin generated part --- Block start #Hdr_OnStop#; do not delete this line and do not add application code in this code block!
  /* #ChannelStart# |ETH1| #BusStart# |ETH_Cluster_MEB| */
  /* #ChannelEnd# |ETH1| #BusEnd# |ETH_Cluster_MEB| */
  //--- end generated part --- Block end #Hdr_OnStop#; do not delete this line! Add application code below this line.
  //--- begin generated part --- Block start #Body_OnStop#; do not delete this line and do not add application code in this code block!
  /* #ChannelStart# |ETH1| #BusStart# |ETH_Cluster_MEB| */
  /* #ChannelEnd# |ETH1| #BusEnd# |ETH_Cluster_MEB| */
  //--- end generated part --- Block end #Body_OnStop#; do not delete this line! Add application code below this line.
}

void StartSim(dword busContext, int busActive, int mode)
{
  // Called when ... due to ...
  //   mode == 1: ILControlResume
  //   mode == 2: ILControlStart
  //   mode == 3: ILControlSimulationOn
  //--- begin generated part --- Block start #Hdr_StartSim#; do not delete this line and do not add application code in this code block!
  /* #ChannelStart# |ETH1| #BusStart# |ETH_Cluster_MEB| */
  /* #ChannelEnd# |ETH1| #BusEnd# |ETH_Cluster_MEB| */
  //--- end generated part --- Block end #Hdr_StartSim#; do not delete this line! Add application code below this line.
  //write("[%.6f %NODE_NAME%] StartSim(0x%X, %d, %d)", TimeNowNS()/1e9, busContext, busActive, mode);
  //--- begin generated part --- Block start #Body_StartSim#; do not delete this line and do not add application code in this code block!
  /* #ChannelStart# |ETH1| #BusStart# |ETH_Cluster_MEB| */
  /* #ChannelEnd# |ETH1| #BusEnd# |ETH_Cluster_MEB| */
  //--- end generated part --- Block end #Body_StartSim#; do not delete this line! Add application code below this line.
}

void StopSim(dword busContext, int busActive, int mode)
{
  // Called when ... due to ...
  //   mode == 1: ILControlWait
  //   mode == 2: ILControlStop
  //   mode == 3: ILControlSimulationOff
  //--- begin generated part --- Block start #Hdr_StopSim#; do not delete this line and do not add application code in this code block!
  /* #ChannelStart# |ETH1| #BusStart# |ETH_Cluster_MEB| */
  /* #ChannelEnd# |ETH1| #BusEnd# |ETH_Cluster_MEB| */
  //--- end generated part --- Block end #Hdr_StopSim#; do not delete this line! Add application code below this line.
  //write("[%.6f %NODE_NAME%] StopSim(0x%X, %d, %d)", TimeNowNS()/1e9, busContext, busActive, mode);
  //--- begin generated part --- Block start #Body_StopSim#; do not delete this line and do not add application code in this code block!
  /* #ChannelStart# |ETH1| #BusStart# |ETH_Cluster_MEB| */
  /* #ChannelEnd# |ETH1| #BusEnd# |ETH_Cluster_MEB| */
  //--- end generated part --- Block end #Body_StopSim#; do not delete this line! Add application code below this line.
}

on envVar EnvKlemme15
{
  // Handle system state variable
  //--- begin generated part --- Block start #Hdr_KL15_EnvKlemme15#; do not delete this line and do not add application code in this code block!
  /* #ChannelStart# |ETH1| #BusStart# |ETH_Cluster_MEB| */
  /* #ChannelEnd# |ETH1| #BusEnd# |ETH_Cluster_MEB| */
  //--- end generated part --- Block end #Hdr_KL15_EnvKlemme15#; do not delete this line! Add application code below this line.
  //--- begin generated part --- Block start #Body_KL15_EnvKlemme15#; do not delete this line and do not add application code in this code block!
  /* #ChannelStart# |ETH1| #BusStart# |ETH_Cluster_MEB| */
  ILETH1_OnEnvKlemme15(@this);
  /* #ChannelEnd# |ETH1| #BusEnd# |ETH_Cluster_MEB| */
  //--- end generated part --- Block end #Body_KL15_EnvKlemme15#; do not delete this line! Add application code below this line.
}

on envVar EnvStartWithoutSending
{
  // Handle system state variable
  //--- begin generated part --- Block start #Hdr_StartManner_EnvStartWithoutSending#; do not delete this line and do not add application code in this code block!
  /* #ChannelStart# |ETH1| #BusStart# |ETH_Cluster_MEB| */
  /* #ChannelEnd# |ETH1| #BusEnd# |ETH_Cluster_MEB| */
  //--- end generated part --- Block end #Hdr_StartManner_EnvStartWithoutSending#; do not delete this line! Add application code below this line.
  //--- begin generated part --- Block start #Body_StartManner_EnvStartWithoutSending#; do not delete this line and do not add application code in this code block!
  /* #ChannelStart# |ETH1| #BusStart# |ETH_Cluster_MEB| */
  ILETH1_OnEnvStartWithoutSending(@this);
  /* #ChannelEnd# |ETH1| #BusEnd# |ETH_Cluster_MEB| */
  //--- end generated part --- Block end #Body_StartManner_EnvStartWithoutSending#; do not delete this line! Add application code below this line.
}

on EthernetStatus *
{
  // Possibly propagate Ethernet status
  //--- begin generated part --- Block start #Hdr_OnEthernetStatus#; do not delete this line and do not add application code in this code block!
  /* #ChannelStart# |ETH1| #BusStart# |ETH_Cluster_MEB| */
  /* #ChannelEnd# |ETH1| #BusEnd# |ETH_Cluster_MEB| */
  //--- end generated part --- Block end #Hdr_OnEthernetStatus#; do not delete this line! Add application code below this line.
  //--- begin generated part --- Block start #Body_OnEthernetStatus#; do not delete this line and do not add application code in this code block!
  /* #ChannelStart# |ETH1| #BusStart# |ETH_Cluster_MEB| */
  /* #ChannelEnd# |ETH1| #BusEnd# |ETH_Cluster_MEB| */
  //--- end generated part --- Block end #Body_OnEthernetStatus#; do not delete this line! Add application code below this line.
}

on EthernetPacket *
{
  // Possibly propagate any received Ethernet packet
  //--- begin generated part --- Block start #Hdr_OnEthernetPacket#; do not delete this line and do not add application code in this code block!
  /* #ChannelStart# |ETH1| #BusStart# |ETH_Cluster_MEB| */
  /* #ChannelEnd# |ETH1| #BusEnd# |ETH_Cluster_MEB| */
  //--- end generated part --- Block end #Hdr_OnEthernetPacket#; do not delete this line! Add application code below this line.
  //--- begin generated part --- Block start #Body_OnEthernetPacket#; do not delete this line and do not add application code in this code block!
  /* #ChannelStart# |ETH1| #BusStart# |ETH_Cluster_MEB| */
  /* #ChannelEnd# |ETH1| #BusEnd# |ETH_Cluster_MEB| */
  //--- end generated part --- Block end #Body_OnEthernetPacket#; do not delete this line! Add application code below this line.
}

dword applPDUILTxPending(dword busContext, dword shortId, dword longId, char name[], dword& aPDULength, byte data[])
{
  dword ret = 1;
  //--- begin generated part --- Block start #Hdr_applPDUILTxPending#; do not delete this line and do not add application code in this code block!
  /* #ChannelStart# |ETH1| #BusStart# |ETH_Cluster_MEB| */
  /* #ChannelEnd# |ETH1| #BusEnd# |ETH_Cluster_MEB| */
  //--- end generated part --- Block end #Hdr_applPDUILTxPending#; do not delete this line! Add application code below this line.
  //write("[%.6f %NODE_NAME%] applPDUILTxPending(0x%X, 0x%X, 0x%X, %s, %d, %d)", TimeNowNS()/1e9, busContext, shortId, longId, name, aPDULength, elcount(data));
  //--- begin generated part --- Block start #Body_applPDUILTxPending#; do not delete this line and do not add application code in this code block!
  /* #ChannelStart# |ETH1| #BusStart# |ETH_Cluster_MEB| */
  /* #ChannelEnd# |ETH1| #BusEnd# |ETH_Cluster_MEB| */
  //--- end generated part --- Block end #Body_applPDUILTxPending#; do not delete this line! Add application code below this line.
  return ret;
}

dword applPDUILStart(dword busContext, dword busActive, dword mode)
{
  dword ret = 1;
  //--- begin generated part --- Block start #Hdr_applPDUILStart#; do not delete this line and do not add application code in this code block!
  /* #ChannelStart# |ETH1| #BusStart# |ETH_Cluster_MEB| */
  /* #ChannelEnd# |ETH1| #BusEnd# |ETH_Cluster_MEB| */
  //--- end generated part --- Block end #Hdr_applPDUILStart#; do not delete this line! Add application code below this line.
  //write("[%.6f %NODE_NAME%] applPDUILStart(0x%X, %d, %d)", TimeNowNS()/1e9, busContext, busActive, mode);
  //--- begin generated part --- Block start #Body_applPDUILStart#; do not delete this line and do not add application code in this code block!
  /* #ChannelStart# |ETH1| #BusStart# |ETH_Cluster_MEB| */
  if (((mode == 2) || (mode == 3)) && (gILETH1_CtrlServiceIL > 0) && (busContext == gILETH1_BusContext)) AREthILControlStart();
  if ((mode == 1) && (gILETH1_CtrlServiceIL > 0) && (busContext == gILETH1_BusContext)) AREthILControlResume();
  /* #ChannelEnd# |ETH1| #BusEnd# |ETH_Cluster_MEB| */
  //--- end generated part --- Block end #Body_applPDUILStart#; do not delete this line! Add application code below this line.
  //--- begin generated part --- Block start #Footer_applPDUILStart#; do not delete this line and do not add application code in this code block!
  /* #ChannelStart# |ETH1| #BusStart# |ETH_Cluster_MEB| */
  StartSim(busContext, busActive, mode);
  /* #ChannelEnd# |ETH1| #BusEnd# |ETH_Cluster_MEB| */
  //--- end generated part --- Block end #Footer_applPDUILStart#; do not delete this line! Add application code below this line.
  return ret;
}

dword applPDUILStop(dword busContext, dword busActive, dword mode)
{
  dword ret = 1;
  //--- begin generated part --- Block start #Hdr_applPDUILStop#; do not delete this line and do not add application code in this code block!
  /* #ChannelStart# |ETH1| #BusStart# |ETH_Cluster_MEB| */
  /* #ChannelEnd# |ETH1| #BusEnd# |ETH_Cluster_MEB| */
  //--- end generated part --- Block end #Hdr_applPDUILStop#; do not delete this line! Add application code below this line.
  //write("[%.6f %NODE_NAME%] applPDUILStop(0x%X, %d, %d)", TimeNowNS()/1e9, busContext, busActive, mode);
  //--- begin generated part --- Block start #Body_applPDUILStop#; do not delete this line and do not add application code in this code block!
  /* #ChannelStart# |ETH1| #BusStart# |ETH_Cluster_MEB| */
  StopSim(busContext, busActive, mode);
  /* #ChannelEnd# |ETH1| #BusEnd# |ETH_Cluster_MEB| */
  //--- end generated part --- Block end #Body_applPDUILStop#; do not delete this line! Add application code below this line.
  //--- begin generated part --- Block start #Footer_applPDUILStop#; do not delete this line and do not add application code in this code block!
  /* #ChannelStart# |ETH1| #BusStart# |ETH_Cluster_MEB| */
  if ((mode == 1) && (gILETH1_CtrlServiceIL > 0) && (busContext == gILETH1_BusContext)) AREthILControlWait();
  if (((mode == 2) || (mode == 3)) && (gILETH1_CtrlServiceIL > 0) && (busContext == gILETH1_BusContext)) AREthILControlStop();
  /* #ChannelEnd# |ETH1| #BusEnd# |ETH_Cluster_MEB| */
  //--- end generated part --- Block end #Footer_applPDUILStop#; do not delete this line! Add application code below this line.
  return ret;
}

//--- begin generated part --- Block start <#Helper_Functions#> do not delete this line and do not add application code in this code block!
/* #ChannelStart# |ETH1| #BusStart# |ETH_Cluster_MEB| */
/* #ChannelEnd# |ETH1| #BusEnd# |ETH_Cluster_MEB| */
//--- end generated part --- Block end <#Helper_Functions#> do not delete this line! Add application code below this line.

//--- begin generated part --- Block start <#SysVar_Handler#> do not delete this line and do not add application code in this code block!
/* #ChannelStart# |ETH1| #BusStart# |ETH_Cluster_MEB| */
on sysvar sysvar::NM_ETH1::StateControl::WakeupValidPulseCount
{
  // Handle valid wakeup pulse count
  if (@EnvStartWithoutSending != 0)
  {
    // Allow wakeup when "StartWithoutSending" is active. Thus, enable NM and IL:
    @EnvStartWithoutSending = 0;
    ILETH1_OnEnvStartWithoutSending(0); // defined in the IL-Helper include file
  }
  // Start the IL:
  ILETH1_StartStop(1); // defined in the IL-Helper include file
  ILETH1_WaitResume(1); // defined in the IL-Helper include file
}

on sysvar_update sysvar::IL_ETH1::EnableNode::ICAS3_Sys_IVI_01
{
  ILETH1_Enable(@this && @sysvar::IL_ETH1::enable_AllNodes);
}

on sysvar_update sysvar::IL_ETH1::enable_AllNodes
{
  ILETH1_Enable(@this && @sysvar::IL_ETH1::EnableNode::ICAS3_Sys_IVI_01);
}

on sysvar_update sysvar::IL_ETH1::PDU_DisturbTimingMode::KN_ICAS3Sys01_XIX_E3V_VLAN_Infotainment
{
  if (@this == 1)
  {
    SetBusContext(gILETH1_BusContext);
    ILSetPDUAsrTXMode(ETH_Cluster_MEB::KN_ICAS3Sys01_XIX_E3V_VLAN_Infotainment, @sysvar::IL_ETH1::PDU_FITimingMode::KN_ICAS3Sys01_XIX_E3V_VLAN_Infotainment, -1, 0);
  }
  else
  {
    SetBusContext(gILETH1_BusContext);
    ILResetPDUAsrTXMode(ETH_Cluster_MEB::KN_ICAS3Sys01_XIX_E3V_VLAN_Infotainment);
  }
}

on sysvar_update sysvar::IL_ETH1::PDU_FITimingMode::KN_ICAS3Sys01_XIX_E3V_VLAN_Infotainment
{
  if (@sysvar::IL_ETH1::PDU_DisturbTimingMode::KN_ICAS3Sys01_XIX_E3V_VLAN_Infotainment == 1)
  {
    SetBusContext(gILETH1_BusContext);
    ILSetPDUAsrTXMode(ETH_Cluster_MEB::KN_ICAS3Sys01_XIX_E3V_VLAN_Infotainment, @sysvar::IL_ETH1::PDU_FITimingMode::KN_ICAS3Sys01_XIX_E3V_VLAN_Infotainment, -1, 0);
  }
}

on sysvar_update sysvar::IL_ETH1::PDU_DisturbTrueCyclicTiming::KN_ICAS3Sys01_XIX_E3V_VLAN_Infotainment
{
  if (@this == 1)
  {
    SetBusContext(gILETH1_BusContext);
    ILSetPDUTimingCyclic(ETH_Cluster_MEB::KN_ICAS3Sys01_XIX_E3V_VLAN_Infotainment, 1, 0, @sysvar::IL_ETH1::PDU_FITrueCyclicPeriod::KN_ICAS3Sys01_XIX_E3V_VLAN_Infotainment, -1, 0);
  }
  else
  {
    SetBusContext(gILETH1_BusContext);
    ILResetPDUTimingCyclic(ETH_Cluster_MEB::KN_ICAS3Sys01_XIX_E3V_VLAN_Infotainment, 1);
  }
}

on sysvar_update sysvar::IL_ETH1::PDU_FITrueCyclicPeriod::KN_ICAS3Sys01_XIX_E3V_VLAN_Infotainment
{
  if (@sysvar::IL_ETH1::PDU_DisturbTrueCyclicTiming::KN_ICAS3Sys01_XIX_E3V_VLAN_Infotainment == 1)
  {
    SetBusContext(gILETH1_BusContext);
    ILSetPDUTimingCyclic(ETH_Cluster_MEB::KN_ICAS3Sys01_XIX_E3V_VLAN_Infotainment, 1, 0, @sysvar::IL_ETH1::PDU_FITrueCyclicPeriod::KN_ICAS3Sys01_XIX_E3V_VLAN_Infotainment, -1, 0);
  }
}

on sysvar_update sysvar::IL_ETH1::PDU_DisturbFalseCyclicTiming::KN_ICAS3Sys01_XIX_E3V_VLAN_Infotainment
{
  if (@this == 1)
  {
    SetBusContext(gILETH1_BusContext);
    ILSetPDUTimingCyclic(ETH_Cluster_MEB::KN_ICAS3Sys01_XIX_E3V_VLAN_Infotainment, 0, 0, @sysvar::IL_ETH1::PDU_FIFalseCyclicPeriod::KN_ICAS3Sys01_XIX_E3V_VLAN_Infotainment, -1, 0);
  }
  else
  {
    SetBusContext(gILETH1_BusContext);
    ILResetPDUTimingCyclic(ETH_Cluster_MEB::KN_ICAS3Sys01_XIX_E3V_VLAN_Infotainment, 0);
  }
}

on sysvar_update sysvar::IL_ETH1::PDU_FIFalseCyclicPeriod::KN_ICAS3Sys01_XIX_E3V_VLAN_Infotainment
{
  if (@sysvar::IL_ETH1::PDU_DisturbFalseCyclicTiming::KN_ICAS3Sys01_XIX_E3V_VLAN_Infotainment == 1)
  {
    SetBusContext(gILETH1_BusContext);
    ILSetPDUTimingCyclic(ETH_Cluster_MEB::KN_ICAS3Sys01_XIX_E3V_VLAN_Infotainment, 1, 0, @sysvar::IL_ETH1::PDU_FITrueCyclicPeriod::KN_ICAS3Sys01_XIX_E3V_VLAN_Infotainment, -1, 0);
  }
}

on sysvar_update sysvar::IL_ETH1::PDU_SendOnce::KN_ICAS3Sys01_XIX_E3V_VLAN_Infotainment
{
  if (@this == 1)
  {
    SetBusContext(gILETH1_BusContext);
    ILSetPDUEvent(ETH_Cluster_MEB::KN_ICAS3Sys01_XIX_E3V_VLAN_Infotainment);
  }
}

on sysvar_update sysvar::IL_ETH1::PDU_DisturbTrueEventTiming::KN_ICAS3Sys01_XIX_E3V_VLAN_Infotainment
{
  if (@this == 1)
  {
    SetBusContext(gILETH1_BusContext);
    ILSetPDUTimingEvent(ETH_Cluster_MEB::KN_ICAS3Sys01_XIX_E3V_VLAN_Infotainment, 1, @sysvar::IL_ETH1::PDU_FITrueEventEnable::KN_ICAS3Sys01_XIX_E3V_VLAN_Infotainment, @sysvar::IL_ETH1::PDU_FITrueEventRepCount::KN_ICAS3Sys01_XIX_E3V_VLAN_Infotainment, @sysvar::IL_ETH1::PDU_FITrueEventRepPeriod::KN_ICAS3Sys01_XIX_E3V_VLAN_Infotainment, @sysvar::IL_ETH1::PDU_FIEventDebounceDelay::KN_ICAS3Sys01_XIX_E3V_VLAN_Infotainment, -1, 0);
  }
  else
  {
    SetBusContext(gILETH1_BusContext);
    ILResetPDUTimingEvent(ETH_Cluster_MEB::KN_ICAS3Sys01_XIX_E3V_VLAN_Infotainment, 1);
  }
}

on sysvar_update sysvar::IL_ETH1::PDU_FITrueEventEnable::KN_ICAS3Sys01_XIX_E3V_VLAN_Infotainment
{
  if (@sysvar::IL_ETH1::PDU_DisturbTrueEventTiming::KN_ICAS3Sys01_XIX_E3V_VLAN_Infotainment == 1)
  {
    SetBusContext(gILETH1_BusContext);
    ILSetPDUTimingEvent(ETH_Cluster_MEB::KN_ICAS3Sys01_XIX_E3V_VLAN_Infotainment, 1, @sysvar::IL_ETH1::PDU_FITrueEventEnable::KN_ICAS3Sys01_XIX_E3V_VLAN_Infotainment, @sysvar::IL_ETH1::PDU_FITrueEventRepCount::KN_ICAS3Sys01_XIX_E3V_VLAN_Infotainment, @sysvar::IL_ETH1::PDU_FITrueEventRepPeriod::KN_ICAS3Sys01_XIX_E3V_VLAN_Infotainment, @sysvar::IL_ETH1::PDU_FIEventDebounceDelay::KN_ICAS3Sys01_XIX_E3V_VLAN_Infotainment, -1, 0);
  }
}

on sysvar_update sysvar::IL_ETH1::PDU_FITrueEventRepCount::KN_ICAS3Sys01_XIX_E3V_VLAN_Infotainment
{
  if (@sysvar::IL_ETH1::PDU_DisturbTrueEventTiming::KN_ICAS3Sys01_XIX_E3V_VLAN_Infotainment == 1)
  {
    SetBusContext(gILETH1_BusContext);
    ILSetPDUTimingEvent(ETH_Cluster_MEB::KN_ICAS3Sys01_XIX_E3V_VLAN_Infotainment, 1, @sysvar::IL_ETH1::PDU_FITrueEventEnable::KN_ICAS3Sys01_XIX_E3V_VLAN_Infotainment, @sysvar::IL_ETH1::PDU_FITrueEventRepCount::KN_ICAS3Sys01_XIX_E3V_VLAN_Infotainment, @sysvar::IL_ETH1::PDU_FITrueEventRepPeriod::KN_ICAS3Sys01_XIX_E3V_VLAN_Infotainment, @sysvar::IL_ETH1::PDU_FIEventDebounceDelay::KN_ICAS3Sys01_XIX_E3V_VLAN_Infotainment, -1, 0);
  }
}

on sysvar_update sysvar::IL_ETH1::PDU_FITrueEventRepPeriod::KN_ICAS3Sys01_XIX_E3V_VLAN_Infotainment
{
  if (@sysvar::IL_ETH1::PDU_DisturbTrueEventTiming::KN_ICAS3Sys01_XIX_E3V_VLAN_Infotainment == 1)
  {
    SetBusContext(gILETH1_BusContext);
    ILSetPDUTimingEvent(ETH_Cluster_MEB::KN_ICAS3Sys01_XIX_E3V_VLAN_Infotainment, 1, @sysvar::IL_ETH1::PDU_FITrueEventEnable::KN_ICAS3Sys01_XIX_E3V_VLAN_Infotainment, @sysvar::IL_ETH1::PDU_FITrueEventRepCount::KN_ICAS3Sys01_XIX_E3V_VLAN_Infotainment, @sysvar::IL_ETH1::PDU_FITrueEventRepPeriod::KN_ICAS3Sys01_XIX_E3V_VLAN_Infotainment, @sysvar::IL_ETH1::PDU_FIEventDebounceDelay::KN_ICAS3Sys01_XIX_E3V_VLAN_Infotainment, -1, 0);
  }
}

on sysvar_update sysvar::IL_ETH1::PDU_FIEventDebounceDelay::KN_ICAS3Sys01_XIX_E3V_VLAN_Infotainment
{
  if (@sysvar::IL_ETH1::PDU_DisturbTrueEventTiming::KN_ICAS3Sys01_XIX_E3V_VLAN_Infotainment == 1)
  {
    SetBusContext(gILETH1_BusContext);
    ILSetPDUTimingEvent(ETH_Cluster_MEB::KN_ICAS3Sys01_XIX_E3V_VLAN_Infotainment, 1, @sysvar::IL_ETH1::PDU_FITrueEventEnable::KN_ICAS3Sys01_XIX_E3V_VLAN_Infotainment, @sysvar::IL_ETH1::PDU_FITrueEventRepCount::KN_ICAS3Sys01_XIX_E3V_VLAN_Infotainment, @sysvar::IL_ETH1::PDU_FITrueEventRepPeriod::KN_ICAS3Sys01_XIX_E3V_VLAN_Infotainment, @sysvar::IL_ETH1::PDU_FIEventDebounceDelay::KN_ICAS3Sys01_XIX_E3V_VLAN_Infotainment, -1, 0);
  }
  if (@sysvar::IL_ETH1::PDU_DisturbFalseEventTiming::KN_ICAS3Sys01_XIX_E3V_VLAN_Infotainment == 1)
  {
    SetBusContext(gILETH1_BusContext);
    ILSetPDUTimingEvent(ETH_Cluster_MEB::KN_ICAS3Sys01_XIX_E3V_VLAN_Infotainment, 0, @sysvar::IL_ETH1::PDU_FIFalseEventEnable::KN_ICAS3Sys01_XIX_E3V_VLAN_Infotainment, @sysvar::IL_ETH1::PDU_FIFalseEventRepCount::KN_ICAS3Sys01_XIX_E3V_VLAN_Infotainment, @sysvar::IL_ETH1::PDU_FIFalseEventRepPeriod::KN_ICAS3Sys01_XIX_E3V_VLAN_Infotainment, @sysvar::IL_ETH1::PDU_FIEventDebounceDelay::KN_ICAS3Sys01_XIX_E3V_VLAN_Infotainment, -1, 0);
  }
}

on sysvar_update sysvar::IL_ETH1::PDU_DisturbFalseEventTiming::KN_ICAS3Sys01_XIX_E3V_VLAN_Infotainment
{
  if (@this == 1)
  {
    SetBusContext(gILETH1_BusContext);
    ILSetPDUTimingEvent(ETH_Cluster_MEB::KN_ICAS3Sys01_XIX_E3V_VLAN_Infotainment, 0, @sysvar::IL_ETH1::PDU_FIFalseEventEnable::KN_ICAS3Sys01_XIX_E3V_VLAN_Infotainment, @sysvar::IL_ETH1::PDU_FIFalseEventRepCount::KN_ICAS3Sys01_XIX_E3V_VLAN_Infotainment, @sysvar::IL_ETH1::PDU_FIFalseEventRepPeriod::KN_ICAS3Sys01_XIX_E3V_VLAN_Infotainment, @sysvar::IL_ETH1::PDU_FIEventDebounceDelay::KN_ICAS3Sys01_XIX_E3V_VLAN_Infotainment, -1, 0);
  }
  else
  {
    SetBusContext(gILETH1_BusContext);
    ILResetPDUTimingEvent(ETH_Cluster_MEB::KN_ICAS3Sys01_XIX_E3V_VLAN_Infotainment, 0);
  }
}

on sysvar_update sysvar::IL_ETH1::PDU_FIFalseEventEnable::KN_ICAS3Sys01_XIX_E3V_VLAN_Infotainment
{
  if (@sysvar::IL_ETH1::PDU_DisturbFalseEventTiming::KN_ICAS3Sys01_XIX_E3V_VLAN_Infotainment == 1)
  {
    SetBusContext(gILETH1_BusContext);
    ILSetPDUTimingEvent(ETH_Cluster_MEB::KN_ICAS3Sys01_XIX_E3V_VLAN_Infotainment, 0, @sysvar::IL_ETH1::PDU_FIFalseEventEnable::KN_ICAS3Sys01_XIX_E3V_VLAN_Infotainment, @sysvar::IL_ETH1::PDU_FIFalseEventRepCount::KN_ICAS3Sys01_XIX_E3V_VLAN_Infotainment, @sysvar::IL_ETH1::PDU_FIFalseEventRepPeriod::KN_ICAS3Sys01_XIX_E3V_VLAN_Infotainment, @sysvar::IL_ETH1::PDU_FIEventDebounceDelay::KN_ICAS3Sys01_XIX_E3V_VLAN_Infotainment, -1, 0);
  }
}

on sysvar_update sysvar::IL_ETH1::PDU_FIFalseEventRepCount::KN_ICAS3Sys01_XIX_E3V_VLAN_Infotainment
{
  if (@sysvar::IL_ETH1::PDU_DisturbFalseEventTiming::KN_ICAS3Sys01_XIX_E3V_VLAN_Infotainment == 1)
  {
    SetBusContext(gILETH1_BusContext);
    ILSetPDUTimingEvent(ETH_Cluster_MEB::KN_ICAS3Sys01_XIX_E3V_VLAN_Infotainment, 0, @sysvar::IL_ETH1::PDU_FIFalseEventEnable::KN_ICAS3Sys01_XIX_E3V_VLAN_Infotainment, @sysvar::IL_ETH1::PDU_FIFalseEventRepCount::KN_ICAS3Sys01_XIX_E3V_VLAN_Infotainment, @sysvar::IL_ETH1::PDU_FIFalseEventRepPeriod::KN_ICAS3Sys01_XIX_E3V_VLAN_Infotainment, @sysvar::IL_ETH1::PDU_FIEventDebounceDelay::KN_ICAS3Sys01_XIX_E3V_VLAN_Infotainment, -1, 0);
  }
}

on sysvar_update sysvar::IL_ETH1::PDU_FIFalseEventRepPeriod::KN_ICAS3Sys01_XIX_E3V_VLAN_Infotainment
{
  if (@sysvar::IL_ETH1::PDU_DisturbFalseEventTiming::KN_ICAS3Sys01_XIX_E3V_VLAN_Infotainment == 1)
  {
    SetBusContext(gILETH1_BusContext);
    ILSetPDUTimingEvent(ETH_Cluster_MEB::KN_ICAS3Sys01_XIX_E3V_VLAN_Infotainment, 0, @sysvar::IL_ETH1::PDU_FIFalseEventEnable::KN_ICAS3Sys01_XIX_E3V_VLAN_Infotainment, @sysvar::IL_ETH1::PDU_FIFalseEventRepCount::KN_ICAS3Sys01_XIX_E3V_VLAN_Infotainment, @sysvar::IL_ETH1::PDU_FIFalseEventRepPeriod::KN_ICAS3Sys01_XIX_E3V_VLAN_Infotainment, @sysvar::IL_ETH1::PDU_FIEventDebounceDelay::KN_ICAS3Sys01_XIX_E3V_VLAN_Infotainment, -1, 0);
  }
}

on sysvar_update sysvar::IL_ETH1::PDU_DisturbTimingMode::L2TP_ICAS3Sys01_eCall_XIX_E3V_VLAN_Infotainment
{
  if (@this == 1)
  {
    SetBusContext(gILETH1_BusContext);
    ILSetPDUAsrTXMode(ETH_Cluster_MEB::L2TP_ICAS3Sys01_eCall_XIX_E3V_VLAN_Infotainment, @sysvar::IL_ETH1::PDU_FITimingMode::L2TP_ICAS3Sys01_eCall_XIX_E3V_VLAN_Infotainment, -1, 0);
  }
  else
  {
    SetBusContext(gILETH1_BusContext);
    ILResetPDUAsrTXMode(ETH_Cluster_MEB::L2TP_ICAS3Sys01_eCall_XIX_E3V_VLAN_Infotainment);
  }
}

on sysvar_update sysvar::IL_ETH1::PDU_FITimingMode::L2TP_ICAS3Sys01_eCall_XIX_E3V_VLAN_Infotainment
{
  if (@sysvar::IL_ETH1::PDU_DisturbTimingMode::L2TP_ICAS3Sys01_eCall_XIX_E3V_VLAN_Infotainment == 1)
  {
    SetBusContext(gILETH1_BusContext);
    ILSetPDUAsrTXMode(ETH_Cluster_MEB::L2TP_ICAS3Sys01_eCall_XIX_E3V_VLAN_Infotainment, @sysvar::IL_ETH1::PDU_FITimingMode::L2TP_ICAS3Sys01_eCall_XIX_E3V_VLAN_Infotainment, -1, 0);
  }
}

on sysvar_update sysvar::IL_ETH1::PDU_DisturbTrueCyclicTiming::L2TP_ICAS3Sys01_eCall_XIX_E3V_VLAN_Infotainment
{
  if (@this == 1)
  {
    SetBusContext(gILETH1_BusContext);
    ILSetPDUTimingCyclic(ETH_Cluster_MEB::L2TP_ICAS3Sys01_eCall_XIX_E3V_VLAN_Infotainment, 1, 0, @sysvar::IL_ETH1::PDU_FITrueCyclicPeriod::L2TP_ICAS3Sys01_eCall_XIX_E3V_VLAN_Infotainment, -1, 0);
  }
  else
  {
    SetBusContext(gILETH1_BusContext);
    ILResetPDUTimingCyclic(ETH_Cluster_MEB::L2TP_ICAS3Sys01_eCall_XIX_E3V_VLAN_Infotainment, 1);
  }
}

on sysvar_update sysvar::IL_ETH1::PDU_FITrueCyclicPeriod::L2TP_ICAS3Sys01_eCall_XIX_E3V_VLAN_Infotainment
{
  if (@sysvar::IL_ETH1::PDU_DisturbTrueCyclicTiming::L2TP_ICAS3Sys01_eCall_XIX_E3V_VLAN_Infotainment == 1)
  {
    SetBusContext(gILETH1_BusContext);
    ILSetPDUTimingCyclic(ETH_Cluster_MEB::L2TP_ICAS3Sys01_eCall_XIX_E3V_VLAN_Infotainment, 1, 0, @sysvar::IL_ETH1::PDU_FITrueCyclicPeriod::L2TP_ICAS3Sys01_eCall_XIX_E3V_VLAN_Infotainment, -1, 0);
  }
}

on sysvar_update sysvar::IL_ETH1::PDU_DisturbFalseCyclicTiming::L2TP_ICAS3Sys01_eCall_XIX_E3V_VLAN_Infotainment
{
  if (@this == 1)
  {
    SetBusContext(gILETH1_BusContext);
    ILSetPDUTimingCyclic(ETH_Cluster_MEB::L2TP_ICAS3Sys01_eCall_XIX_E3V_VLAN_Infotainment, 0, 0, @sysvar::IL_ETH1::PDU_FIFalseCyclicPeriod::L2TP_ICAS3Sys01_eCall_XIX_E3V_VLAN_Infotainment, -1, 0);
  }
  else
  {
    SetBusContext(gILETH1_BusContext);
    ILResetPDUTimingCyclic(ETH_Cluster_MEB::L2TP_ICAS3Sys01_eCall_XIX_E3V_VLAN_Infotainment, 0);
  }
}

on sysvar_update sysvar::IL_ETH1::PDU_FIFalseCyclicPeriod::L2TP_ICAS3Sys01_eCall_XIX_E3V_VLAN_Infotainment
{
  if (@sysvar::IL_ETH1::PDU_DisturbFalseCyclicTiming::L2TP_ICAS3Sys01_eCall_XIX_E3V_VLAN_Infotainment == 1)
  {
    SetBusContext(gILETH1_BusContext);
    ILSetPDUTimingCyclic(ETH_Cluster_MEB::L2TP_ICAS3Sys01_eCall_XIX_E3V_VLAN_Infotainment, 1, 0, @sysvar::IL_ETH1::PDU_FITrueCyclicPeriod::L2TP_ICAS3Sys01_eCall_XIX_E3V_VLAN_Infotainment, -1, 0);
  }
}

on sysvar_update sysvar::IL_ETH1::PDU_SendOnce::L2TP_ICAS3Sys01_eCall_XIX_E3V_VLAN_Infotainment
{
  if (@this == 1)
  {
    SetBusContext(gILETH1_BusContext);
    ILSetPDUEvent(ETH_Cluster_MEB::L2TP_ICAS3Sys01_eCall_XIX_E3V_VLAN_Infotainment);
  }
}

on sysvar_update sysvar::IL_ETH1::PDU_DisturbTrueEventTiming::L2TP_ICAS3Sys01_eCall_XIX_E3V_VLAN_Infotainment
{
  if (@this == 1)
  {
    SetBusContext(gILETH1_BusContext);
    ILSetPDUTimingEvent(ETH_Cluster_MEB::L2TP_ICAS3Sys01_eCall_XIX_E3V_VLAN_Infotainment, 1, @sysvar::IL_ETH1::PDU_FITrueEventEnable::L2TP_ICAS3Sys01_eCall_XIX_E3V_VLAN_Infotainment, @sysvar::IL_ETH1::PDU_FITrueEventRepCount::L2TP_ICAS3Sys01_eCall_XIX_E3V_VLAN_Infotainment, @sysvar::IL_ETH1::PDU_FITrueEventRepPeriod::L2TP_ICAS3Sys01_eCall_XIX_E3V_VLAN_Infotainment, @sysvar::IL_ETH1::PDU_FIEventDebounceDelay::L2TP_ICAS3Sys01_eCall_XIX_E3V_VLAN_Infotainment, -1, 0);
  }
  else
  {
    SetBusContext(gILETH1_BusContext);
    ILResetPDUTimingEvent(ETH_Cluster_MEB::L2TP_ICAS3Sys01_eCall_XIX_E3V_VLAN_Infotainment, 1);
  }
}

on sysvar_update sysvar::IL_ETH1::PDU_FITrueEventEnable::L2TP_ICAS3Sys01_eCall_XIX_E3V_VLAN_Infotainment
{
  if (@sysvar::IL_ETH1::PDU_DisturbTrueEventTiming::L2TP_ICAS3Sys01_eCall_XIX_E3V_VLAN_Infotainment == 1)
  {
    SetBusContext(gILETH1_BusContext);
    ILSetPDUTimingEvent(ETH_Cluster_MEB::L2TP_ICAS3Sys01_eCall_XIX_E3V_VLAN_Infotainment, 1, @sysvar::IL_ETH1::PDU_FITrueEventEnable::L2TP_ICAS3Sys01_eCall_XIX_E3V_VLAN_Infotainment, @sysvar::IL_ETH1::PDU_FITrueEventRepCount::L2TP_ICAS3Sys01_eCall_XIX_E3V_VLAN_Infotainment, @sysvar::IL_ETH1::PDU_FITrueEventRepPeriod::L2TP_ICAS3Sys01_eCall_XIX_E3V_VLAN_Infotainment, @sysvar::IL_ETH1::PDU_FIEventDebounceDelay::L2TP_ICAS3Sys01_eCall_XIX_E3V_VLAN_Infotainment, -1, 0);
  }
}

on sysvar_update sysvar::IL_ETH1::PDU_FITrueEventRepCount::L2TP_ICAS3Sys01_eCall_XIX_E3V_VLAN_Infotainment
{
  if (@sysvar::IL_ETH1::PDU_DisturbTrueEventTiming::L2TP_ICAS3Sys01_eCall_XIX_E3V_VLAN_Infotainment == 1)
  {
    SetBusContext(gILETH1_BusContext);
    ILSetPDUTimingEvent(ETH_Cluster_MEB::L2TP_ICAS3Sys01_eCall_XIX_E3V_VLAN_Infotainment, 1, @sysvar::IL_ETH1::PDU_FITrueEventEnable::L2TP_ICAS3Sys01_eCall_XIX_E3V_VLAN_Infotainment, @sysvar::IL_ETH1::PDU_FITrueEventRepCount::L2TP_ICAS3Sys01_eCall_XIX_E3V_VLAN_Infotainment, @sysvar::IL_ETH1::PDU_FITrueEventRepPeriod::L2TP_ICAS3Sys01_eCall_XIX_E3V_VLAN_Infotainment, @sysvar::IL_ETH1::PDU_FIEventDebounceDelay::L2TP_ICAS3Sys01_eCall_XIX_E3V_VLAN_Infotainment, -1, 0);
  }
}

on sysvar_update sysvar::IL_ETH1::PDU_FITrueEventRepPeriod::L2TP_ICAS3Sys01_eCall_XIX_E3V_VLAN_Infotainment
{
  if (@sysvar::IL_ETH1::PDU_DisturbTrueEventTiming::L2TP_ICAS3Sys01_eCall_XIX_E3V_VLAN_Infotainment == 1)
  {
    SetBusContext(gILETH1_BusContext);
    ILSetPDUTimingEvent(ETH_Cluster_MEB::L2TP_ICAS3Sys01_eCall_XIX_E3V_VLAN_Infotainment, 1, @sysvar::IL_ETH1::PDU_FITrueEventEnable::L2TP_ICAS3Sys01_eCall_XIX_E3V_VLAN_Infotainment, @sysvar::IL_ETH1::PDU_FITrueEventRepCount::L2TP_ICAS3Sys01_eCall_XIX_E3V_VLAN_Infotainment, @sysvar::IL_ETH1::PDU_FITrueEventRepPeriod::L2TP_ICAS3Sys01_eCall_XIX_E3V_VLAN_Infotainment, @sysvar::IL_ETH1::PDU_FIEventDebounceDelay::L2TP_ICAS3Sys01_eCall_XIX_E3V_VLAN_Infotainment, -1, 0);
  }
}

on sysvar_update sysvar::IL_ETH1::PDU_FIEventDebounceDelay::L2TP_ICAS3Sys01_eCall_XIX_E3V_VLAN_Infotainment
{
  if (@sysvar::IL_ETH1::PDU_DisturbTrueEventTiming::L2TP_ICAS3Sys01_eCall_XIX_E3V_VLAN_Infotainment == 1)
  {
    SetBusContext(gILETH1_BusContext);
    ILSetPDUTimingEvent(ETH_Cluster_MEB::L2TP_ICAS3Sys01_eCall_XIX_E3V_VLAN_Infotainment, 1, @sysvar::IL_ETH1::PDU_FITrueEventEnable::L2TP_ICAS3Sys01_eCall_XIX_E3V_VLAN_Infotainment, @sysvar::IL_ETH1::PDU_FITrueEventRepCount::L2TP_ICAS3Sys01_eCall_XIX_E3V_VLAN_Infotainment, @sysvar::IL_ETH1::PDU_FITrueEventRepPeriod::L2TP_ICAS3Sys01_eCall_XIX_E3V_VLAN_Infotainment, @sysvar::IL_ETH1::PDU_FIEventDebounceDelay::L2TP_ICAS3Sys01_eCall_XIX_E3V_VLAN_Infotainment, -1, 0);
  }
  if (@sysvar::IL_ETH1::PDU_DisturbFalseEventTiming::L2TP_ICAS3Sys01_eCall_XIX_E3V_VLAN_Infotainment == 1)
  {
    SetBusContext(gILETH1_BusContext);
    ILSetPDUTimingEvent(ETH_Cluster_MEB::L2TP_ICAS3Sys01_eCall_XIX_E3V_VLAN_Infotainment, 0, @sysvar::IL_ETH1::PDU_FIFalseEventEnable::L2TP_ICAS3Sys01_eCall_XIX_E3V_VLAN_Infotainment, @sysvar::IL_ETH1::PDU_FIFalseEventRepCount::L2TP_ICAS3Sys01_eCall_XIX_E3V_VLAN_Infotainment, @sysvar::IL_ETH1::PDU_FIFalseEventRepPeriod::L2TP_ICAS3Sys01_eCall_XIX_E3V_VLAN_Infotainment, @sysvar::IL_ETH1::PDU_FIEventDebounceDelay::L2TP_ICAS3Sys01_eCall_XIX_E3V_VLAN_Infotainment, -1, 0);
  }
}

on sysvar_update sysvar::IL_ETH1::PDU_DisturbFalseEventTiming::L2TP_ICAS3Sys01_eCall_XIX_E3V_VLAN_Infotainment
{
  if (@this == 1)
  {
    SetBusContext(gILETH1_BusContext);
    ILSetPDUTimingEvent(ETH_Cluster_MEB::L2TP_ICAS3Sys01_eCall_XIX_E3V_VLAN_Infotainment, 0, @sysvar::IL_ETH1::PDU_FIFalseEventEnable::L2TP_ICAS3Sys01_eCall_XIX_E3V_VLAN_Infotainment, @sysvar::IL_ETH1::PDU_FIFalseEventRepCount::L2TP_ICAS3Sys01_eCall_XIX_E3V_VLAN_Infotainment, @sysvar::IL_ETH1::PDU_FIFalseEventRepPeriod::L2TP_ICAS3Sys01_eCall_XIX_E3V_VLAN_Infotainment, @sysvar::IL_ETH1::PDU_FIEventDebounceDelay::L2TP_ICAS3Sys01_eCall_XIX_E3V_VLAN_Infotainment, -1, 0);
  }
  else
  {
    SetBusContext(gILETH1_BusContext);
    ILResetPDUTimingEvent(ETH_Cluster_MEB::L2TP_ICAS3Sys01_eCall_XIX_E3V_VLAN_Infotainment, 0);
  }
}

on sysvar_update sysvar::IL_ETH1::PDU_FIFalseEventEnable::L2TP_ICAS3Sys01_eCall_XIX_E3V_VLAN_Infotainment
{
  if (@sysvar::IL_ETH1::PDU_DisturbFalseEventTiming::L2TP_ICAS3Sys01_eCall_XIX_E3V_VLAN_Infotainment == 1)
  {
    SetBusContext(gILETH1_BusContext);
    ILSetPDUTimingEvent(ETH_Cluster_MEB::L2TP_ICAS3Sys01_eCall_XIX_E3V_VLAN_Infotainment, 0, @sysvar::IL_ETH1::PDU_FIFalseEventEnable::L2TP_ICAS3Sys01_eCall_XIX_E3V_VLAN_Infotainment, @sysvar::IL_ETH1::PDU_FIFalseEventRepCount::L2TP_ICAS3Sys01_eCall_XIX_E3V_VLAN_Infotainment, @sysvar::IL_ETH1::PDU_FIFalseEventRepPeriod::L2TP_ICAS3Sys01_eCall_XIX_E3V_VLAN_Infotainment, @sysvar::IL_ETH1::PDU_FIEventDebounceDelay::L2TP_ICAS3Sys01_eCall_XIX_E3V_VLAN_Infotainment, -1, 0);
  }
}

on sysvar_update sysvar::IL_ETH1::PDU_FIFalseEventRepCount::L2TP_ICAS3Sys01_eCall_XIX_E3V_VLAN_Infotainment
{
  if (@sysvar::IL_ETH1::PDU_DisturbFalseEventTiming::L2TP_ICAS3Sys01_eCall_XIX_E3V_VLAN_Infotainment == 1)
  {
    SetBusContext(gILETH1_BusContext);
    ILSetPDUTimingEvent(ETH_Cluster_MEB::L2TP_ICAS3Sys01_eCall_XIX_E3V_VLAN_Infotainment, 0, @sysvar::IL_ETH1::PDU_FIFalseEventEnable::L2TP_ICAS3Sys01_eCall_XIX_E3V_VLAN_Infotainment, @sysvar::IL_ETH1::PDU_FIFalseEventRepCount::L2TP_ICAS3Sys01_eCall_XIX_E3V_VLAN_Infotainment, @sysvar::IL_ETH1::PDU_FIFalseEventRepPeriod::L2TP_ICAS3Sys01_eCall_XIX_E3V_VLAN_Infotainment, @sysvar::IL_ETH1::PDU_FIEventDebounceDelay::L2TP_ICAS3Sys01_eCall_XIX_E3V_VLAN_Infotainment, -1, 0);
  }
}

on sysvar_update sysvar::IL_ETH1::PDU_FIFalseEventRepPeriod::L2TP_ICAS3Sys01_eCall_XIX_E3V_VLAN_Infotainment
{
  if (@sysvar::IL_ETH1::PDU_DisturbFalseEventTiming::L2TP_ICAS3Sys01_eCall_XIX_E3V_VLAN_Infotainment == 1)
  {
    SetBusContext(gILETH1_BusContext);
    ILSetPDUTimingEvent(ETH_Cluster_MEB::L2TP_ICAS3Sys01_eCall_XIX_E3V_VLAN_Infotainment, 0, @sysvar::IL_ETH1::PDU_FIFalseEventEnable::L2TP_ICAS3Sys01_eCall_XIX_E3V_VLAN_Infotainment, @sysvar::IL_ETH1::PDU_FIFalseEventRepCount::L2TP_ICAS3Sys01_eCall_XIX_E3V_VLAN_Infotainment, @sysvar::IL_ETH1::PDU_FIFalseEventRepPeriod::L2TP_ICAS3Sys01_eCall_XIX_E3V_VLAN_Infotainment, @sysvar::IL_ETH1::PDU_FIEventDebounceDelay::L2TP_ICAS3Sys01_eCall_XIX_E3V_VLAN_Infotainment, -1, 0);
  }
}

on sysvar_update sysvar::IL_ETH1::PDU_DisturbTimingMode::RTCP_Announcement_Info_El_XIX_E3V_VLAN_Infotainment
{
  if (@this == 1)
  {
    SetBusContext(gILETH1_BusContext);
    ILSetPDUAsrTXMode(ETH_Cluster_MEB::RTCP_Announcement_Info_El_XIX_E3V_VLAN_Infotainment, @sysvar::IL_ETH1::PDU_FITimingMode::RTCP_Announcement_Info_El_XIX_E3V_VLAN_Infotainment, -1, 0);
  }
  else
  {
    SetBusContext(gILETH1_BusContext);
    ILResetPDUAsrTXMode(ETH_Cluster_MEB::RTCP_Announcement_Info_El_XIX_E3V_VLAN_Infotainment);
  }
}

on sysvar_update sysvar::IL_ETH1::PDU_FITimingMode::RTCP_Announcement_Info_El_XIX_E3V_VLAN_Infotainment
{
  if (@sysvar::IL_ETH1::PDU_DisturbTimingMode::RTCP_Announcement_Info_El_XIX_E3V_VLAN_Infotainment == 1)
  {
    SetBusContext(gILETH1_BusContext);
    ILSetPDUAsrTXMode(ETH_Cluster_MEB::RTCP_Announcement_Info_El_XIX_E3V_VLAN_Infotainment, @sysvar::IL_ETH1::PDU_FITimingMode::RTCP_Announcement_Info_El_XIX_E3V_VLAN_Infotainment, -1, 0);
  }
}

on sysvar_update sysvar::IL_ETH1::PDU_DisturbTrueCyclicTiming::RTCP_Announcement_Info_El_XIX_E3V_VLAN_Infotainment
{
  if (@this == 1)
  {
    SetBusContext(gILETH1_BusContext);
    ILSetPDUTimingCyclic(ETH_Cluster_MEB::RTCP_Announcement_Info_El_XIX_E3V_VLAN_Infotainment, 1, 0, @sysvar::IL_ETH1::PDU_FITrueCyclicPeriod::RTCP_Announcement_Info_El_XIX_E3V_VLAN_Infotainment, -1, 0);
  }
  else
  {
    SetBusContext(gILETH1_BusContext);
    ILResetPDUTimingCyclic(ETH_Cluster_MEB::RTCP_Announcement_Info_El_XIX_E3V_VLAN_Infotainment, 1);
  }
}

on sysvar_update sysvar::IL_ETH1::PDU_FITrueCyclicPeriod::RTCP_Announcement_Info_El_XIX_E3V_VLAN_Infotainment
{
  if (@sysvar::IL_ETH1::PDU_DisturbTrueCyclicTiming::RTCP_Announcement_Info_El_XIX_E3V_VLAN_Infotainment == 1)
  {
    SetBusContext(gILETH1_BusContext);
    ILSetPDUTimingCyclic(ETH_Cluster_MEB::RTCP_Announcement_Info_El_XIX_E3V_VLAN_Infotainment, 1, 0, @sysvar::IL_ETH1::PDU_FITrueCyclicPeriod::RTCP_Announcement_Info_El_XIX_E3V_VLAN_Infotainment, -1, 0);
  }
}

on sysvar_update sysvar::IL_ETH1::PDU_DisturbFalseCyclicTiming::RTCP_Announcement_Info_El_XIX_E3V_VLAN_Infotainment
{
  if (@this == 1)
  {
    SetBusContext(gILETH1_BusContext);
    ILSetPDUTimingCyclic(ETH_Cluster_MEB::RTCP_Announcement_Info_El_XIX_E3V_VLAN_Infotainment, 0, 0, @sysvar::IL_ETH1::PDU_FIFalseCyclicPeriod::RTCP_Announcement_Info_El_XIX_E3V_VLAN_Infotainment, -1, 0);
  }
  else
  {
    SetBusContext(gILETH1_BusContext);
    ILResetPDUTimingCyclic(ETH_Cluster_MEB::RTCP_Announcement_Info_El_XIX_E3V_VLAN_Infotainment, 0);
  }
}

on sysvar_update sysvar::IL_ETH1::PDU_FIFalseCyclicPeriod::RTCP_Announcement_Info_El_XIX_E3V_VLAN_Infotainment
{
  if (@sysvar::IL_ETH1::PDU_DisturbFalseCyclicTiming::RTCP_Announcement_Info_El_XIX_E3V_VLAN_Infotainment == 1)
  {
    SetBusContext(gILETH1_BusContext);
    ILSetPDUTimingCyclic(ETH_Cluster_MEB::RTCP_Announcement_Info_El_XIX_E3V_VLAN_Infotainment, 1, 0, @sysvar::IL_ETH1::PDU_FITrueCyclicPeriod::RTCP_Announcement_Info_El_XIX_E3V_VLAN_Infotainment, -1, 0);
  }
}

on sysvar_update sysvar::IL_ETH1::PDU_SendOnce::RTCP_Announcement_Info_El_XIX_E3V_VLAN_Infotainment
{
  if (@this == 1)
  {
    SetBusContext(gILETH1_BusContext);
    ILSetPDUEvent(ETH_Cluster_MEB::RTCP_Announcement_Info_El_XIX_E3V_VLAN_Infotainment);
  }
}

on sysvar_update sysvar::IL_ETH1::PDU_DisturbTrueEventTiming::RTCP_Announcement_Info_El_XIX_E3V_VLAN_Infotainment
{
  if (@this == 1)
  {
    SetBusContext(gILETH1_BusContext);
    ILSetPDUTimingEvent(ETH_Cluster_MEB::RTCP_Announcement_Info_El_XIX_E3V_VLAN_Infotainment, 1, @sysvar::IL_ETH1::PDU_FITrueEventEnable::RTCP_Announcement_Info_El_XIX_E3V_VLAN_Infotainment, @sysvar::IL_ETH1::PDU_FITrueEventRepCount::RTCP_Announcement_Info_El_XIX_E3V_VLAN_Infotainment, @sysvar::IL_ETH1::PDU_FITrueEventRepPeriod::RTCP_Announcement_Info_El_XIX_E3V_VLAN_Infotainment, @sysvar::IL_ETH1::PDU_FIEventDebounceDelay::RTCP_Announcement_Info_El_XIX_E3V_VLAN_Infotainment, -1, 0);
  }
  else
  {
    SetBusContext(gILETH1_BusContext);
    ILResetPDUTimingEvent(ETH_Cluster_MEB::RTCP_Announcement_Info_El_XIX_E3V_VLAN_Infotainment, 1);
  }
}

on sysvar_update sysvar::IL_ETH1::PDU_FITrueEventEnable::RTCP_Announcement_Info_El_XIX_E3V_VLAN_Infotainment
{
  if (@sysvar::IL_ETH1::PDU_DisturbTrueEventTiming::RTCP_Announcement_Info_El_XIX_E3V_VLAN_Infotainment == 1)
  {
    SetBusContext(gILETH1_BusContext);
    ILSetPDUTimingEvent(ETH_Cluster_MEB::RTCP_Announcement_Info_El_XIX_E3V_VLAN_Infotainment, 1, @sysvar::IL_ETH1::PDU_FITrueEventEnable::RTCP_Announcement_Info_El_XIX_E3V_VLAN_Infotainment, @sysvar::IL_ETH1::PDU_FITrueEventRepCount::RTCP_Announcement_Info_El_XIX_E3V_VLAN_Infotainment, @sysvar::IL_ETH1::PDU_FITrueEventRepPeriod::RTCP_Announcement_Info_El_XIX_E3V_VLAN_Infotainment, @sysvar::IL_ETH1::PDU_FIEventDebounceDelay::RTCP_Announcement_Info_El_XIX_E3V_VLAN_Infotainment, -1, 0);
  }
}

on sysvar_update sysvar::IL_ETH1::PDU_FITrueEventRepCount::RTCP_Announcement_Info_El_XIX_E3V_VLAN_Infotainment
{
  if (@sysvar::IL_ETH1::PDU_DisturbTrueEventTiming::RTCP_Announcement_Info_El_XIX_E3V_VLAN_Infotainment == 1)
  {
    SetBusContext(gILETH1_BusContext);
    ILSetPDUTimingEvent(ETH_Cluster_MEB::RTCP_Announcement_Info_El_XIX_E3V_VLAN_Infotainment, 1, @sysvar::IL_ETH1::PDU_FITrueEventEnable::RTCP_Announcement_Info_El_XIX_E3V_VLAN_Infotainment, @sysvar::IL_ETH1::PDU_FITrueEventRepCount::RTCP_Announcement_Info_El_XIX_E3V_VLAN_Infotainment, @sysvar::IL_ETH1::PDU_FITrueEventRepPeriod::RTCP_Announcement_Info_El_XIX_E3V_VLAN_Infotainment, @sysvar::IL_ETH1::PDU_FIEventDebounceDelay::RTCP_Announcement_Info_El_XIX_E3V_VLAN_Infotainment, -1, 0);
  }
}

on sysvar_update sysvar::IL_ETH1::PDU_FITrueEventRepPeriod::RTCP_Announcement_Info_El_XIX_E3V_VLAN_Infotainment
{
  if (@sysvar::IL_ETH1::PDU_DisturbTrueEventTiming::RTCP_Announcement_Info_El_XIX_E3V_VLAN_Infotainment == 1)
  {
    SetBusContext(gILETH1_BusContext);
    ILSetPDUTimingEvent(ETH_Cluster_MEB::RTCP_Announcement_Info_El_XIX_E3V_VLAN_Infotainment, 1, @sysvar::IL_ETH1::PDU_FITrueEventEnable::RTCP_Announcement_Info_El_XIX_E3V_VLAN_Infotainment, @sysvar::IL_ETH1::PDU_FITrueEventRepCount::RTCP_Announcement_Info_El_XIX_E3V_VLAN_Infotainment, @sysvar::IL_ETH1::PDU_FITrueEventRepPeriod::RTCP_Announcement_Info_El_XIX_E3V_VLAN_Infotainment, @sysvar::IL_ETH1::PDU_FIEventDebounceDelay::RTCP_Announcement_Info_El_XIX_E3V_VLAN_Infotainment, -1, 0);
  }
}

on sysvar_update sysvar::IL_ETH1::PDU_FIEventDebounceDelay::RTCP_Announcement_Info_El_XIX_E3V_VLAN_Infotainment
{
  if (@sysvar::IL_ETH1::PDU_DisturbTrueEventTiming::RTCP_Announcement_Info_El_XIX_E3V_VLAN_Infotainment == 1)
  {
    SetBusContext(gILETH1_BusContext);
    ILSetPDUTimingEvent(ETH_Cluster_MEB::RTCP_Announcement_Info_El_XIX_E3V_VLAN_Infotainment, 1, @sysvar::IL_ETH1::PDU_FITrueEventEnable::RTCP_Announcement_Info_El_XIX_E3V_VLAN_Infotainment, @sysvar::IL_ETH1::PDU_FITrueEventRepCount::RTCP_Announcement_Info_El_XIX_E3V_VLAN_Infotainment, @sysvar::IL_ETH1::PDU_FITrueEventRepPeriod::RTCP_Announcement_Info_El_XIX_E3V_VLAN_Infotainment, @sysvar::IL_ETH1::PDU_FIEventDebounceDelay::RTCP_Announcement_Info_El_XIX_E3V_VLAN_Infotainment, -1, 0);
  }
  if (@sysvar::IL_ETH1::PDU_DisturbFalseEventTiming::RTCP_Announcement_Info_El_XIX_E3V_VLAN_Infotainment == 1)
  {
    SetBusContext(gILETH1_BusContext);
    ILSetPDUTimingEvent(ETH_Cluster_MEB::RTCP_Announcement_Info_El_XIX_E3V_VLAN_Infotainment, 0, @sysvar::IL_ETH1::PDU_FIFalseEventEnable::RTCP_Announcement_Info_El_XIX_E3V_VLAN_Infotainment, @sysvar::IL_ETH1::PDU_FIFalseEventRepCount::RTCP_Announcement_Info_El_XIX_E3V_VLAN_Infotainment, @sysvar::IL_ETH1::PDU_FIFalseEventRepPeriod::RTCP_Announcement_Info_El_XIX_E3V_VLAN_Infotainment, @sysvar::IL_ETH1::PDU_FIEventDebounceDelay::RTCP_Announcement_Info_El_XIX_E3V_VLAN_Infotainment, -1, 0);
  }
}

on sysvar_update sysvar::IL_ETH1::PDU_DisturbFalseEventTiming::RTCP_Announcement_Info_El_XIX_E3V_VLAN_Infotainment
{
  if (@this == 1)
  {
    SetBusContext(gILETH1_BusContext);
    ILSetPDUTimingEvent(ETH_Cluster_MEB::RTCP_Announcement_Info_El_XIX_E3V_VLAN_Infotainment, 0, @sysvar::IL_ETH1::PDU_FIFalseEventEnable::RTCP_Announcement_Info_El_XIX_E3V_VLAN_Infotainment, @sysvar::IL_ETH1::PDU_FIFalseEventRepCount::RTCP_Announcement_Info_El_XIX_E3V_VLAN_Infotainment, @sysvar::IL_ETH1::PDU_FIFalseEventRepPeriod::RTCP_Announcement_Info_El_XIX_E3V_VLAN_Infotainment, @sysvar::IL_ETH1::PDU_FIEventDebounceDelay::RTCP_Announcement_Info_El_XIX_E3V_VLAN_Infotainment, -1, 0);
  }
  else
  {
    SetBusContext(gILETH1_BusContext);
    ILResetPDUTimingEvent(ETH_Cluster_MEB::RTCP_Announcement_Info_El_XIX_E3V_VLAN_Infotainment, 0);
  }
}

on sysvar_update sysvar::IL_ETH1::PDU_FIFalseEventEnable::RTCP_Announcement_Info_El_XIX_E3V_VLAN_Infotainment
{
  if (@sysvar::IL_ETH1::PDU_DisturbFalseEventTiming::RTCP_Announcement_Info_El_XIX_E3V_VLAN_Infotainment == 1)
  {
    SetBusContext(gILETH1_BusContext);
    ILSetPDUTimingEvent(ETH_Cluster_MEB::RTCP_Announcement_Info_El_XIX_E3V_VLAN_Infotainment, 0, @sysvar::IL_ETH1::PDU_FIFalseEventEnable::RTCP_Announcement_Info_El_XIX_E3V_VLAN_Infotainment, @sysvar::IL_ETH1::PDU_FIFalseEventRepCount::RTCP_Announcement_Info_El_XIX_E3V_VLAN_Infotainment, @sysvar::IL_ETH1::PDU_FIFalseEventRepPeriod::RTCP_Announcement_Info_El_XIX_E3V_VLAN_Infotainment, @sysvar::IL_ETH1::PDU_FIEventDebounceDelay::RTCP_Announcement_Info_El_XIX_E3V_VLAN_Infotainment, -1, 0);
  }
}

on sysvar_update sysvar::IL_ETH1::PDU_FIFalseEventRepCount::RTCP_Announcement_Info_El_XIX_E3V_VLAN_Infotainment
{
  if (@sysvar::IL_ETH1::PDU_DisturbFalseEventTiming::RTCP_Announcement_Info_El_XIX_E3V_VLAN_Infotainment == 1)
  {
    SetBusContext(gILETH1_BusContext);
    ILSetPDUTimingEvent(ETH_Cluster_MEB::RTCP_Announcement_Info_El_XIX_E3V_VLAN_Infotainment, 0, @sysvar::IL_ETH1::PDU_FIFalseEventEnable::RTCP_Announcement_Info_El_XIX_E3V_VLAN_Infotainment, @sysvar::IL_ETH1::PDU_FIFalseEventRepCount::RTCP_Announcement_Info_El_XIX_E3V_VLAN_Infotainment, @sysvar::IL_ETH1::PDU_FIFalseEventRepPeriod::RTCP_Announcement_Info_El_XIX_E3V_VLAN_Infotainment, @sysvar::IL_ETH1::PDU_FIEventDebounceDelay::RTCP_Announcement_Info_El_XIX_E3V_VLAN_Infotainment, -1, 0);
  }
}

on sysvar_update sysvar::IL_ETH1::PDU_FIFalseEventRepPeriod::RTCP_Announcement_Info_El_XIX_E3V_VLAN_Infotainment
{
  if (@sysvar::IL_ETH1::PDU_DisturbFalseEventTiming::RTCP_Announcement_Info_El_XIX_E3V_VLAN_Infotainment == 1)
  {
    SetBusContext(gILETH1_BusContext);
    ILSetPDUTimingEvent(ETH_Cluster_MEB::RTCP_Announcement_Info_El_XIX_E3V_VLAN_Infotainment, 0, @sysvar::IL_ETH1::PDU_FIFalseEventEnable::RTCP_Announcement_Info_El_XIX_E3V_VLAN_Infotainment, @sysvar::IL_ETH1::PDU_FIFalseEventRepCount::RTCP_Announcement_Info_El_XIX_E3V_VLAN_Infotainment, @sysvar::IL_ETH1::PDU_FIFalseEventRepPeriod::RTCP_Announcement_Info_El_XIX_E3V_VLAN_Infotainment, @sysvar::IL_ETH1::PDU_FIEventDebounceDelay::RTCP_Announcement_Info_El_XIX_E3V_VLAN_Infotainment, -1, 0);
  }
}

on sysvar_update sysvar::IL_ETH1::PDU_DisturbTimingMode::RTCP_Entertainment_Info_El_XIX_E3V_VLAN_Infotainment
{
  if (@this == 1)
  {
    SetBusContext(gILETH1_BusContext);
    ILSetPDUAsrTXMode(ETH_Cluster_MEB::RTCP_Entertainment_Info_El_XIX_E3V_VLAN_Infotainment, @sysvar::IL_ETH1::PDU_FITimingMode::RTCP_Entertainment_Info_El_XIX_E3V_VLAN_Infotainment, -1, 0);
  }
  else
  {
    SetBusContext(gILETH1_BusContext);
    ILResetPDUAsrTXMode(ETH_Cluster_MEB::RTCP_Entertainment_Info_El_XIX_E3V_VLAN_Infotainment);
  }
}

on sysvar_update sysvar::IL_ETH1::PDU_FITimingMode::RTCP_Entertainment_Info_El_XIX_E3V_VLAN_Infotainment
{
  if (@sysvar::IL_ETH1::PDU_DisturbTimingMode::RTCP_Entertainment_Info_El_XIX_E3V_VLAN_Infotainment == 1)
  {
    SetBusContext(gILETH1_BusContext);
    ILSetPDUAsrTXMode(ETH_Cluster_MEB::RTCP_Entertainment_Info_El_XIX_E3V_VLAN_Infotainment, @sysvar::IL_ETH1::PDU_FITimingMode::RTCP_Entertainment_Info_El_XIX_E3V_VLAN_Infotainment, -1, 0);
  }
}

on sysvar_update sysvar::IL_ETH1::PDU_DisturbTrueCyclicTiming::RTCP_Entertainment_Info_El_XIX_E3V_VLAN_Infotainment
{
  if (@this == 1)
  {
    SetBusContext(gILETH1_BusContext);
    ILSetPDUTimingCyclic(ETH_Cluster_MEB::RTCP_Entertainment_Info_El_XIX_E3V_VLAN_Infotainment, 1, 0, @sysvar::IL_ETH1::PDU_FITrueCyclicPeriod::RTCP_Entertainment_Info_El_XIX_E3V_VLAN_Infotainment, -1, 0);
  }
  else
  {
    SetBusContext(gILETH1_BusContext);
    ILResetPDUTimingCyclic(ETH_Cluster_MEB::RTCP_Entertainment_Info_El_XIX_E3V_VLAN_Infotainment, 1);
  }
}

on sysvar_update sysvar::IL_ETH1::PDU_FITrueCyclicPeriod::RTCP_Entertainment_Info_El_XIX_E3V_VLAN_Infotainment
{
  if (@sysvar::IL_ETH1::PDU_DisturbTrueCyclicTiming::RTCP_Entertainment_Info_El_XIX_E3V_VLAN_Infotainment == 1)
  {
    SetBusContext(gILETH1_BusContext);
    ILSetPDUTimingCyclic(ETH_Cluster_MEB::RTCP_Entertainment_Info_El_XIX_E3V_VLAN_Infotainment, 1, 0, @sysvar::IL_ETH1::PDU_FITrueCyclicPeriod::RTCP_Entertainment_Info_El_XIX_E3V_VLAN_Infotainment, -1, 0);
  }
}

on sysvar_update sysvar::IL_ETH1::PDU_DisturbFalseCyclicTiming::RTCP_Entertainment_Info_El_XIX_E3V_VLAN_Infotainment
{
  if (@this == 1)
  {
    SetBusContext(gILETH1_BusContext);
    ILSetPDUTimingCyclic(ETH_Cluster_MEB::RTCP_Entertainment_Info_El_XIX_E3V_VLAN_Infotainment, 0, 0, @sysvar::IL_ETH1::PDU_FIFalseCyclicPeriod::RTCP_Entertainment_Info_El_XIX_E3V_VLAN_Infotainment, -1, 0);
  }
  else
  {
    SetBusContext(gILETH1_BusContext);
    ILResetPDUTimingCyclic(ETH_Cluster_MEB::RTCP_Entertainment_Info_El_XIX_E3V_VLAN_Infotainment, 0);
  }
}

on sysvar_update sysvar::IL_ETH1::PDU_FIFalseCyclicPeriod::RTCP_Entertainment_Info_El_XIX_E3V_VLAN_Infotainment
{
  if (@sysvar::IL_ETH1::PDU_DisturbFalseCyclicTiming::RTCP_Entertainment_Info_El_XIX_E3V_VLAN_Infotainment == 1)
  {
    SetBusContext(gILETH1_BusContext);
    ILSetPDUTimingCyclic(ETH_Cluster_MEB::RTCP_Entertainment_Info_El_XIX_E3V_VLAN_Infotainment, 1, 0, @sysvar::IL_ETH1::PDU_FITrueCyclicPeriod::RTCP_Entertainment_Info_El_XIX_E3V_VLAN_Infotainment, -1, 0);
  }
}

on sysvar_update sysvar::IL_ETH1::PDU_SendOnce::RTCP_Entertainment_Info_El_XIX_E3V_VLAN_Infotainment
{
  if (@this == 1)
  {
    SetBusContext(gILETH1_BusContext);
    ILSetPDUEvent(ETH_Cluster_MEB::RTCP_Entertainment_Info_El_XIX_E3V_VLAN_Infotainment);
  }
}

on sysvar_update sysvar::IL_ETH1::PDU_DisturbTrueEventTiming::RTCP_Entertainment_Info_El_XIX_E3V_VLAN_Infotainment
{
  if (@this == 1)
  {
    SetBusContext(gILETH1_BusContext);
    ILSetPDUTimingEvent(ETH_Cluster_MEB::RTCP_Entertainment_Info_El_XIX_E3V_VLAN_Infotainment, 1, @sysvar::IL_ETH1::PDU_FITrueEventEnable::RTCP_Entertainment_Info_El_XIX_E3V_VLAN_Infotainment, @sysvar::IL_ETH1::PDU_FITrueEventRepCount::RTCP_Entertainment_Info_El_XIX_E3V_VLAN_Infotainment, @sysvar::IL_ETH1::PDU_FITrueEventRepPeriod::RTCP_Entertainment_Info_El_XIX_E3V_VLAN_Infotainment, @sysvar::IL_ETH1::PDU_FIEventDebounceDelay::RTCP_Entertainment_Info_El_XIX_E3V_VLAN_Infotainment, -1, 0);
  }
  else
  {
    SetBusContext(gILETH1_BusContext);
    ILResetPDUTimingEvent(ETH_Cluster_MEB::RTCP_Entertainment_Info_El_XIX_E3V_VLAN_Infotainment, 1);
  }
}

on sysvar_update sysvar::IL_ETH1::PDU_FITrueEventEnable::RTCP_Entertainment_Info_El_XIX_E3V_VLAN_Infotainment
{
  if (@sysvar::IL_ETH1::PDU_DisturbTrueEventTiming::RTCP_Entertainment_Info_El_XIX_E3V_VLAN_Infotainment == 1)
  {
    SetBusContext(gILETH1_BusContext);
    ILSetPDUTimingEvent(ETH_Cluster_MEB::RTCP_Entertainment_Info_El_XIX_E3V_VLAN_Infotainment, 1, @sysvar::IL_ETH1::PDU_FITrueEventEnable::RTCP_Entertainment_Info_El_XIX_E3V_VLAN_Infotainment, @sysvar::IL_ETH1::PDU_FITrueEventRepCount::RTCP_Entertainment_Info_El_XIX_E3V_VLAN_Infotainment, @sysvar::IL_ETH1::PDU_FITrueEventRepPeriod::RTCP_Entertainment_Info_El_XIX_E3V_VLAN_Infotainment, @sysvar::IL_ETH1::PDU_FIEventDebounceDelay::RTCP_Entertainment_Info_El_XIX_E3V_VLAN_Infotainment, -1, 0);
  }
}

on sysvar_update sysvar::IL_ETH1::PDU_FITrueEventRepCount::RTCP_Entertainment_Info_El_XIX_E3V_VLAN_Infotainment
{
  if (@sysvar::IL_ETH1::PDU_DisturbTrueEventTiming::RTCP_Entertainment_Info_El_XIX_E3V_VLAN_Infotainment == 1)
  {
    SetBusContext(gILETH1_BusContext);
    ILSetPDUTimingEvent(ETH_Cluster_MEB::RTCP_Entertainment_Info_El_XIX_E3V_VLAN_Infotainment, 1, @sysvar::IL_ETH1::PDU_FITrueEventEnable::RTCP_Entertainment_Info_El_XIX_E3V_VLAN_Infotainment, @sysvar::IL_ETH1::PDU_FITrueEventRepCount::RTCP_Entertainment_Info_El_XIX_E3V_VLAN_Infotainment, @sysvar::IL_ETH1::PDU_FITrueEventRepPeriod::RTCP_Entertainment_Info_El_XIX_E3V_VLAN_Infotainment, @sysvar::IL_ETH1::PDU_FIEventDebounceDelay::RTCP_Entertainment_Info_El_XIX_E3V_VLAN_Infotainment, -1, 0);
  }
}

on sysvar_update sysvar::IL_ETH1::PDU_FITrueEventRepPeriod::RTCP_Entertainment_Info_El_XIX_E3V_VLAN_Infotainment
{
  if (@sysvar::IL_ETH1::PDU_DisturbTrueEventTiming::RTCP_Entertainment_Info_El_XIX_E3V_VLAN_Infotainment == 1)
  {
    SetBusContext(gILETH1_BusContext);
    ILSetPDUTimingEvent(ETH_Cluster_MEB::RTCP_Entertainment_Info_El_XIX_E3V_VLAN_Infotainment, 1, @sysvar::IL_ETH1::PDU_FITrueEventEnable::RTCP_Entertainment_Info_El_XIX_E3V_VLAN_Infotainment, @sysvar::IL_ETH1::PDU_FITrueEventRepCount::RTCP_Entertainment_Info_El_XIX_E3V_VLAN_Infotainment, @sysvar::IL_ETH1::PDU_FITrueEventRepPeriod::RTCP_Entertainment_Info_El_XIX_E3V_VLAN_Infotainment, @sysvar::IL_ETH1::PDU_FIEventDebounceDelay::RTCP_Entertainment_Info_El_XIX_E3V_VLAN_Infotainment, -1, 0);
  }
}

on sysvar_update sysvar::IL_ETH1::PDU_FIEventDebounceDelay::RTCP_Entertainment_Info_El_XIX_E3V_VLAN_Infotainment
{
  if (@sysvar::IL_ETH1::PDU_DisturbTrueEventTiming::RTCP_Entertainment_Info_El_XIX_E3V_VLAN_Infotainment == 1)
  {
    SetBusContext(gILETH1_BusContext);
    ILSetPDUTimingEvent(ETH_Cluster_MEB::RTCP_Entertainment_Info_El_XIX_E3V_VLAN_Infotainment, 1, @sysvar::IL_ETH1::PDU_FITrueEventEnable::RTCP_Entertainment_Info_El_XIX_E3V_VLAN_Infotainment, @sysvar::IL_ETH1::PDU_FITrueEventRepCount::RTCP_Entertainment_Info_El_XIX_E3V_VLAN_Infotainment, @sysvar::IL_ETH1::PDU_FITrueEventRepPeriod::RTCP_Entertainment_Info_El_XIX_E3V_VLAN_Infotainment, @sysvar::IL_ETH1::PDU_FIEventDebounceDelay::RTCP_Entertainment_Info_El_XIX_E3V_VLAN_Infotainment, -1, 0);
  }
  if (@sysvar::IL_ETH1::PDU_DisturbFalseEventTiming::RTCP_Entertainment_Info_El_XIX_E3V_VLAN_Infotainment == 1)
  {
    SetBusContext(gILETH1_BusContext);
    ILSetPDUTimingEvent(ETH_Cluster_MEB::RTCP_Entertainment_Info_El_XIX_E3V_VLAN_Infotainment, 0, @sysvar::IL_ETH1::PDU_FIFalseEventEnable::RTCP_Entertainment_Info_El_XIX_E3V_VLAN_Infotainment, @sysvar::IL_ETH1::PDU_FIFalseEventRepCount::RTCP_Entertainment_Info_El_XIX_E3V_VLAN_Infotainment, @sysvar::IL_ETH1::PDU_FIFalseEventRepPeriod::RTCP_Entertainment_Info_El_XIX_E3V_VLAN_Infotainment, @sysvar::IL_ETH1::PDU_FIEventDebounceDelay::RTCP_Entertainment_Info_El_XIX_E3V_VLAN_Infotainment, -1, 0);
  }
}

on sysvar_update sysvar::IL_ETH1::PDU_DisturbFalseEventTiming::RTCP_Entertainment_Info_El_XIX_E3V_VLAN_Infotainment
{
  if (@this == 1)
  {
    SetBusContext(gILETH1_BusContext);
    ILSetPDUTimingEvent(ETH_Cluster_MEB::RTCP_Entertainment_Info_El_XIX_E3V_VLAN_Infotainment, 0, @sysvar::IL_ETH1::PDU_FIFalseEventEnable::RTCP_Entertainment_Info_El_XIX_E3V_VLAN_Infotainment, @sysvar::IL_ETH1::PDU_FIFalseEventRepCount::RTCP_Entertainment_Info_El_XIX_E3V_VLAN_Infotainment, @sysvar::IL_ETH1::PDU_FIFalseEventRepPeriod::RTCP_Entertainment_Info_El_XIX_E3V_VLAN_Infotainment, @sysvar::IL_ETH1::PDU_FIEventDebounceDelay::RTCP_Entertainment_Info_El_XIX_E3V_VLAN_Infotainment, -1, 0);
  }
  else
  {
    SetBusContext(gILETH1_BusContext);
    ILResetPDUTimingEvent(ETH_Cluster_MEB::RTCP_Entertainment_Info_El_XIX_E3V_VLAN_Infotainment, 0);
  }
}

on sysvar_update sysvar::IL_ETH1::PDU_FIFalseEventEnable::RTCP_Entertainment_Info_El_XIX_E3V_VLAN_Infotainment
{
  if (@sysvar::IL_ETH1::PDU_DisturbFalseEventTiming::RTCP_Entertainment_Info_El_XIX_E3V_VLAN_Infotainment == 1)
  {
    SetBusContext(gILETH1_BusContext);
    ILSetPDUTimingEvent(ETH_Cluster_MEB::RTCP_Entertainment_Info_El_XIX_E3V_VLAN_Infotainment, 0, @sysvar::IL_ETH1::PDU_FIFalseEventEnable::RTCP_Entertainment_Info_El_XIX_E3V_VLAN_Infotainment, @sysvar::IL_ETH1::PDU_FIFalseEventRepCount::RTCP_Entertainment_Info_El_XIX_E3V_VLAN_Infotainment, @sysvar::IL_ETH1::PDU_FIFalseEventRepPeriod::RTCP_Entertainment_Info_El_XIX_E3V_VLAN_Infotainment, @sysvar::IL_ETH1::PDU_FIEventDebounceDelay::RTCP_Entertainment_Info_El_XIX_E3V_VLAN_Infotainment, -1, 0);
  }
}

on sysvar_update sysvar::IL_ETH1::PDU_FIFalseEventRepCount::RTCP_Entertainment_Info_El_XIX_E3V_VLAN_Infotainment
{
  if (@sysvar::IL_ETH1::PDU_DisturbFalseEventTiming::RTCP_Entertainment_Info_El_XIX_E3V_VLAN_Infotainment == 1)
  {
    SetBusContext(gILETH1_BusContext);
    ILSetPDUTimingEvent(ETH_Cluster_MEB::RTCP_Entertainment_Info_El_XIX_E3V_VLAN_Infotainment, 0, @sysvar::IL_ETH1::PDU_FIFalseEventEnable::RTCP_Entertainment_Info_El_XIX_E3V_VLAN_Infotainment, @sysvar::IL_ETH1::PDU_FIFalseEventRepCount::RTCP_Entertainment_Info_El_XIX_E3V_VLAN_Infotainment, @sysvar::IL_ETH1::PDU_FIFalseEventRepPeriod::RTCP_Entertainment_Info_El_XIX_E3V_VLAN_Infotainment, @sysvar::IL_ETH1::PDU_FIEventDebounceDelay::RTCP_Entertainment_Info_El_XIX_E3V_VLAN_Infotainment, -1, 0);
  }
}

on sysvar_update sysvar::IL_ETH1::PDU_FIFalseEventRepPeriod::RTCP_Entertainment_Info_El_XIX_E3V_VLAN_Infotainment
{
  if (@sysvar::IL_ETH1::PDU_DisturbFalseEventTiming::RTCP_Entertainment_Info_El_XIX_E3V_VLAN_Infotainment == 1)
  {
    SetBusContext(gILETH1_BusContext);
    ILSetPDUTimingEvent(ETH_Cluster_MEB::RTCP_Entertainment_Info_El_XIX_E3V_VLAN_Infotainment, 0, @sysvar::IL_ETH1::PDU_FIFalseEventEnable::RTCP_Entertainment_Info_El_XIX_E3V_VLAN_Infotainment, @sysvar::IL_ETH1::PDU_FIFalseEventRepCount::RTCP_Entertainment_Info_El_XIX_E3V_VLAN_Infotainment, @sysvar::IL_ETH1::PDU_FIFalseEventRepPeriod::RTCP_Entertainment_Info_El_XIX_E3V_VLAN_Infotainment, @sysvar::IL_ETH1::PDU_FIEventDebounceDelay::RTCP_Entertainment_Info_El_XIX_E3V_VLAN_Infotainment, -1, 0);
  }
}

on sysvar_update sysvar::IL_ETH1::PDU_DisturbTimingMode::RTP_Announcement_Info_El_XIX_E3V_VLAN_Infotainment
{
  if (@this == 1)
  {
    SetBusContext(gILETH1_BusContext);
    ILSetPDUAsrTXMode(ETH_Cluster_MEB::RTP_Announcement_Info_El_XIX_E3V_VLAN_Infotainment, @sysvar::IL_ETH1::PDU_FITimingMode::RTP_Announcement_Info_El_XIX_E3V_VLAN_Infotainment, -1, 0);
  }
  else
  {
    SetBusContext(gILETH1_BusContext);
    ILResetPDUAsrTXMode(ETH_Cluster_MEB::RTP_Announcement_Info_El_XIX_E3V_VLAN_Infotainment);
  }
}

on sysvar_update sysvar::IL_ETH1::PDU_FITimingMode::RTP_Announcement_Info_El_XIX_E3V_VLAN_Infotainment
{
  if (@sysvar::IL_ETH1::PDU_DisturbTimingMode::RTP_Announcement_Info_El_XIX_E3V_VLAN_Infotainment == 1)
  {
    SetBusContext(gILETH1_BusContext);
    ILSetPDUAsrTXMode(ETH_Cluster_MEB::RTP_Announcement_Info_El_XIX_E3V_VLAN_Infotainment, @sysvar::IL_ETH1::PDU_FITimingMode::RTP_Announcement_Info_El_XIX_E3V_VLAN_Infotainment, -1, 0);
  }
}

on sysvar_update sysvar::IL_ETH1::PDU_DisturbTrueCyclicTiming::RTP_Announcement_Info_El_XIX_E3V_VLAN_Infotainment
{
  if (@this == 1)
  {
    SetBusContext(gILETH1_BusContext);
    ILSetPDUTimingCyclic(ETH_Cluster_MEB::RTP_Announcement_Info_El_XIX_E3V_VLAN_Infotainment, 1, 0, @sysvar::IL_ETH1::PDU_FITrueCyclicPeriod::RTP_Announcement_Info_El_XIX_E3V_VLAN_Infotainment, -1, 0);
  }
  else
  {
    SetBusContext(gILETH1_BusContext);
    ILResetPDUTimingCyclic(ETH_Cluster_MEB::RTP_Announcement_Info_El_XIX_E3V_VLAN_Infotainment, 1);
  }
}

on sysvar_update sysvar::IL_ETH1::PDU_FITrueCyclicPeriod::RTP_Announcement_Info_El_XIX_E3V_VLAN_Infotainment
{
  if (@sysvar::IL_ETH1::PDU_DisturbTrueCyclicTiming::RTP_Announcement_Info_El_XIX_E3V_VLAN_Infotainment == 1)
  {
    SetBusContext(gILETH1_BusContext);
    ILSetPDUTimingCyclic(ETH_Cluster_MEB::RTP_Announcement_Info_El_XIX_E3V_VLAN_Infotainment, 1, 0, @sysvar::IL_ETH1::PDU_FITrueCyclicPeriod::RTP_Announcement_Info_El_XIX_E3V_VLAN_Infotainment, -1, 0);
  }
}

on sysvar_update sysvar::IL_ETH1::PDU_DisturbFalseCyclicTiming::RTP_Announcement_Info_El_XIX_E3V_VLAN_Infotainment
{
  if (@this == 1)
  {
    SetBusContext(gILETH1_BusContext);
    ILSetPDUTimingCyclic(ETH_Cluster_MEB::RTP_Announcement_Info_El_XIX_E3V_VLAN_Infotainment, 0, 0, @sysvar::IL_ETH1::PDU_FIFalseCyclicPeriod::RTP_Announcement_Info_El_XIX_E3V_VLAN_Infotainment, -1, 0);
  }
  else
  {
    SetBusContext(gILETH1_BusContext);
    ILResetPDUTimingCyclic(ETH_Cluster_MEB::RTP_Announcement_Info_El_XIX_E3V_VLAN_Infotainment, 0);
  }
}

on sysvar_update sysvar::IL_ETH1::PDU_FIFalseCyclicPeriod::RTP_Announcement_Info_El_XIX_E3V_VLAN_Infotainment
{
  if (@sysvar::IL_ETH1::PDU_DisturbFalseCyclicTiming::RTP_Announcement_Info_El_XIX_E3V_VLAN_Infotainment == 1)
  {
    SetBusContext(gILETH1_BusContext);
    ILSetPDUTimingCyclic(ETH_Cluster_MEB::RTP_Announcement_Info_El_XIX_E3V_VLAN_Infotainment, 1, 0, @sysvar::IL_ETH1::PDU_FITrueCyclicPeriod::RTP_Announcement_Info_El_XIX_E3V_VLAN_Infotainment, -1, 0);
  }
}

on sysvar_update sysvar::IL_ETH1::PDU_SendOnce::RTP_Announcement_Info_El_XIX_E3V_VLAN_Infotainment
{
  if (@this == 1)
  {
    SetBusContext(gILETH1_BusContext);
    ILSetPDUEvent(ETH_Cluster_MEB::RTP_Announcement_Info_El_XIX_E3V_VLAN_Infotainment);
  }
}

on sysvar_update sysvar::IL_ETH1::PDU_DisturbTrueEventTiming::RTP_Announcement_Info_El_XIX_E3V_VLAN_Infotainment
{
  if (@this == 1)
  {
    SetBusContext(gILETH1_BusContext);
    ILSetPDUTimingEvent(ETH_Cluster_MEB::RTP_Announcement_Info_El_XIX_E3V_VLAN_Infotainment, 1, @sysvar::IL_ETH1::PDU_FITrueEventEnable::RTP_Announcement_Info_El_XIX_E3V_VLAN_Infotainment, @sysvar::IL_ETH1::PDU_FITrueEventRepCount::RTP_Announcement_Info_El_XIX_E3V_VLAN_Infotainment, @sysvar::IL_ETH1::PDU_FITrueEventRepPeriod::RTP_Announcement_Info_El_XIX_E3V_VLAN_Infotainment, @sysvar::IL_ETH1::PDU_FIEventDebounceDelay::RTP_Announcement_Info_El_XIX_E3V_VLAN_Infotainment, -1, 0);
  }
  else
  {
    SetBusContext(gILETH1_BusContext);
    ILResetPDUTimingEvent(ETH_Cluster_MEB::RTP_Announcement_Info_El_XIX_E3V_VLAN_Infotainment, 1);
  }
}

on sysvar_update sysvar::IL_ETH1::PDU_FITrueEventEnable::RTP_Announcement_Info_El_XIX_E3V_VLAN_Infotainment
{
  if (@sysvar::IL_ETH1::PDU_DisturbTrueEventTiming::RTP_Announcement_Info_El_XIX_E3V_VLAN_Infotainment == 1)
  {
    SetBusContext(gILETH1_BusContext);
    ILSetPDUTimingEvent(ETH_Cluster_MEB::RTP_Announcement_Info_El_XIX_E3V_VLAN_Infotainment, 1, @sysvar::IL_ETH1::PDU_FITrueEventEnable::RTP_Announcement_Info_El_XIX_E3V_VLAN_Infotainment, @sysvar::IL_ETH1::PDU_FITrueEventRepCount::RTP_Announcement_Info_El_XIX_E3V_VLAN_Infotainment, @sysvar::IL_ETH1::PDU_FITrueEventRepPeriod::RTP_Announcement_Info_El_XIX_E3V_VLAN_Infotainment, @sysvar::IL_ETH1::PDU_FIEventDebounceDelay::RTP_Announcement_Info_El_XIX_E3V_VLAN_Infotainment, -1, 0);
  }
}

on sysvar_update sysvar::IL_ETH1::PDU_FITrueEventRepCount::RTP_Announcement_Info_El_XIX_E3V_VLAN_Infotainment
{
  if (@sysvar::IL_ETH1::PDU_DisturbTrueEventTiming::RTP_Announcement_Info_El_XIX_E3V_VLAN_Infotainment == 1)
  {
    SetBusContext(gILETH1_BusContext);
    ILSetPDUTimingEvent(ETH_Cluster_MEB::RTP_Announcement_Info_El_XIX_E3V_VLAN_Infotainment, 1, @sysvar::IL_ETH1::PDU_FITrueEventEnable::RTP_Announcement_Info_El_XIX_E3V_VLAN_Infotainment, @sysvar::IL_ETH1::PDU_FITrueEventRepCount::RTP_Announcement_Info_El_XIX_E3V_VLAN_Infotainment, @sysvar::IL_ETH1::PDU_FITrueEventRepPeriod::RTP_Announcement_Info_El_XIX_E3V_VLAN_Infotainment, @sysvar::IL_ETH1::PDU_FIEventDebounceDelay::RTP_Announcement_Info_El_XIX_E3V_VLAN_Infotainment, -1, 0);
  }
}

on sysvar_update sysvar::IL_ETH1::PDU_FITrueEventRepPeriod::RTP_Announcement_Info_El_XIX_E3V_VLAN_Infotainment
{
  if (@sysvar::IL_ETH1::PDU_DisturbTrueEventTiming::RTP_Announcement_Info_El_XIX_E3V_VLAN_Infotainment == 1)
  {
    SetBusContext(gILETH1_BusContext);
    ILSetPDUTimingEvent(ETH_Cluster_MEB::RTP_Announcement_Info_El_XIX_E3V_VLAN_Infotainment, 1, @sysvar::IL_ETH1::PDU_FITrueEventEnable::RTP_Announcement_Info_El_XIX_E3V_VLAN_Infotainment, @sysvar::IL_ETH1::PDU_FITrueEventRepCount::RTP_Announcement_Info_El_XIX_E3V_VLAN_Infotainment, @sysvar::IL_ETH1::PDU_FITrueEventRepPeriod::RTP_Announcement_Info_El_XIX_E3V_VLAN_Infotainment, @sysvar::IL_ETH1::PDU_FIEventDebounceDelay::RTP_Announcement_Info_El_XIX_E3V_VLAN_Infotainment, -1, 0);
  }
}

on sysvar_update sysvar::IL_ETH1::PDU_FIEventDebounceDelay::RTP_Announcement_Info_El_XIX_E3V_VLAN_Infotainment
{
  if (@sysvar::IL_ETH1::PDU_DisturbTrueEventTiming::RTP_Announcement_Info_El_XIX_E3V_VLAN_Infotainment == 1)
  {
    SetBusContext(gILETH1_BusContext);
    ILSetPDUTimingEvent(ETH_Cluster_MEB::RTP_Announcement_Info_El_XIX_E3V_VLAN_Infotainment, 1, @sysvar::IL_ETH1::PDU_FITrueEventEnable::RTP_Announcement_Info_El_XIX_E3V_VLAN_Infotainment, @sysvar::IL_ETH1::PDU_FITrueEventRepCount::RTP_Announcement_Info_El_XIX_E3V_VLAN_Infotainment, @sysvar::IL_ETH1::PDU_FITrueEventRepPeriod::RTP_Announcement_Info_El_XIX_E3V_VLAN_Infotainment, @sysvar::IL_ETH1::PDU_FIEventDebounceDelay::RTP_Announcement_Info_El_XIX_E3V_VLAN_Infotainment, -1, 0);
  }
  if (@sysvar::IL_ETH1::PDU_DisturbFalseEventTiming::RTP_Announcement_Info_El_XIX_E3V_VLAN_Infotainment == 1)
  {
    SetBusContext(gILETH1_BusContext);
    ILSetPDUTimingEvent(ETH_Cluster_MEB::RTP_Announcement_Info_El_XIX_E3V_VLAN_Infotainment, 0, @sysvar::IL_ETH1::PDU_FIFalseEventEnable::RTP_Announcement_Info_El_XIX_E3V_VLAN_Infotainment, @sysvar::IL_ETH1::PDU_FIFalseEventRepCount::RTP_Announcement_Info_El_XIX_E3V_VLAN_Infotainment, @sysvar::IL_ETH1::PDU_FIFalseEventRepPeriod::RTP_Announcement_Info_El_XIX_E3V_VLAN_Infotainment, @sysvar::IL_ETH1::PDU_FIEventDebounceDelay::RTP_Announcement_Info_El_XIX_E3V_VLAN_Infotainment, -1, 0);
  }
}

on sysvar_update sysvar::IL_ETH1::PDU_DisturbFalseEventTiming::RTP_Announcement_Info_El_XIX_E3V_VLAN_Infotainment
{
  if (@this == 1)
  {
    SetBusContext(gILETH1_BusContext);
    ILSetPDUTimingEvent(ETH_Cluster_MEB::RTP_Announcement_Info_El_XIX_E3V_VLAN_Infotainment, 0, @sysvar::IL_ETH1::PDU_FIFalseEventEnable::RTP_Announcement_Info_El_XIX_E3V_VLAN_Infotainment, @sysvar::IL_ETH1::PDU_FIFalseEventRepCount::RTP_Announcement_Info_El_XIX_E3V_VLAN_Infotainment, @sysvar::IL_ETH1::PDU_FIFalseEventRepPeriod::RTP_Announcement_Info_El_XIX_E3V_VLAN_Infotainment, @sysvar::IL_ETH1::PDU_FIEventDebounceDelay::RTP_Announcement_Info_El_XIX_E3V_VLAN_Infotainment, -1, 0);
  }
  else
  {
    SetBusContext(gILETH1_BusContext);
    ILResetPDUTimingEvent(ETH_Cluster_MEB::RTP_Announcement_Info_El_XIX_E3V_VLAN_Infotainment, 0);
  }
}

on sysvar_update sysvar::IL_ETH1::PDU_FIFalseEventEnable::RTP_Announcement_Info_El_XIX_E3V_VLAN_Infotainment
{
  if (@sysvar::IL_ETH1::PDU_DisturbFalseEventTiming::RTP_Announcement_Info_El_XIX_E3V_VLAN_Infotainment == 1)
  {
    SetBusContext(gILETH1_BusContext);
    ILSetPDUTimingEvent(ETH_Cluster_MEB::RTP_Announcement_Info_El_XIX_E3V_VLAN_Infotainment, 0, @sysvar::IL_ETH1::PDU_FIFalseEventEnable::RTP_Announcement_Info_El_XIX_E3V_VLAN_Infotainment, @sysvar::IL_ETH1::PDU_FIFalseEventRepCount::RTP_Announcement_Info_El_XIX_E3V_VLAN_Infotainment, @sysvar::IL_ETH1::PDU_FIFalseEventRepPeriod::RTP_Announcement_Info_El_XIX_E3V_VLAN_Infotainment, @sysvar::IL_ETH1::PDU_FIEventDebounceDelay::RTP_Announcement_Info_El_XIX_E3V_VLAN_Infotainment, -1, 0);
  }
}

on sysvar_update sysvar::IL_ETH1::PDU_FIFalseEventRepCount::RTP_Announcement_Info_El_XIX_E3V_VLAN_Infotainment
{
  if (@sysvar::IL_ETH1::PDU_DisturbFalseEventTiming::RTP_Announcement_Info_El_XIX_E3V_VLAN_Infotainment == 1)
  {
    SetBusContext(gILETH1_BusContext);
    ILSetPDUTimingEvent(ETH_Cluster_MEB::RTP_Announcement_Info_El_XIX_E3V_VLAN_Infotainment, 0, @sysvar::IL_ETH1::PDU_FIFalseEventEnable::RTP_Announcement_Info_El_XIX_E3V_VLAN_Infotainment, @sysvar::IL_ETH1::PDU_FIFalseEventRepCount::RTP_Announcement_Info_El_XIX_E3V_VLAN_Infotainment, @sysvar::IL_ETH1::PDU_FIFalseEventRepPeriod::RTP_Announcement_Info_El_XIX_E3V_VLAN_Infotainment, @sysvar::IL_ETH1::PDU_FIEventDebounceDelay::RTP_Announcement_Info_El_XIX_E3V_VLAN_Infotainment, -1, 0);
  }
}

on sysvar_update sysvar::IL_ETH1::PDU_FIFalseEventRepPeriod::RTP_Announcement_Info_El_XIX_E3V_VLAN_Infotainment
{
  if (@sysvar::IL_ETH1::PDU_DisturbFalseEventTiming::RTP_Announcement_Info_El_XIX_E3V_VLAN_Infotainment == 1)
  {
    SetBusContext(gILETH1_BusContext);
    ILSetPDUTimingEvent(ETH_Cluster_MEB::RTP_Announcement_Info_El_XIX_E3V_VLAN_Infotainment, 0, @sysvar::IL_ETH1::PDU_FIFalseEventEnable::RTP_Announcement_Info_El_XIX_E3V_VLAN_Infotainment, @sysvar::IL_ETH1::PDU_FIFalseEventRepCount::RTP_Announcement_Info_El_XIX_E3V_VLAN_Infotainment, @sysvar::IL_ETH1::PDU_FIFalseEventRepPeriod::RTP_Announcement_Info_El_XIX_E3V_VLAN_Infotainment, @sysvar::IL_ETH1::PDU_FIEventDebounceDelay::RTP_Announcement_Info_El_XIX_E3V_VLAN_Infotainment, -1, 0);
  }
}

on sysvar_update sysvar::IL_ETH1::PDU_DisturbTimingMode::RTP_Entertainment_Info_El_XIX_E3V_VLAN_Infotainment
{
  if (@this == 1)
  {
    SetBusContext(gILETH1_BusContext);
    ILSetPDUAsrTXMode(ETH_Cluster_MEB::RTP_Entertainment_Info_El_XIX_E3V_VLAN_Infotainment, @sysvar::IL_ETH1::PDU_FITimingMode::RTP_Entertainment_Info_El_XIX_E3V_VLAN_Infotainment, -1, 0);
  }
  else
  {
    SetBusContext(gILETH1_BusContext);
    ILResetPDUAsrTXMode(ETH_Cluster_MEB::RTP_Entertainment_Info_El_XIX_E3V_VLAN_Infotainment);
  }
}

on sysvar_update sysvar::IL_ETH1::PDU_FITimingMode::RTP_Entertainment_Info_El_XIX_E3V_VLAN_Infotainment
{
  if (@sysvar::IL_ETH1::PDU_DisturbTimingMode::RTP_Entertainment_Info_El_XIX_E3V_VLAN_Infotainment == 1)
  {
    SetBusContext(gILETH1_BusContext);
    ILSetPDUAsrTXMode(ETH_Cluster_MEB::RTP_Entertainment_Info_El_XIX_E3V_VLAN_Infotainment, @sysvar::IL_ETH1::PDU_FITimingMode::RTP_Entertainment_Info_El_XIX_E3V_VLAN_Infotainment, -1, 0);
  }
}

on sysvar_update sysvar::IL_ETH1::PDU_DisturbTrueCyclicTiming::RTP_Entertainment_Info_El_XIX_E3V_VLAN_Infotainment
{
  if (@this == 1)
  {
    SetBusContext(gILETH1_BusContext);
    ILSetPDUTimingCyclic(ETH_Cluster_MEB::RTP_Entertainment_Info_El_XIX_E3V_VLAN_Infotainment, 1, 0, @sysvar::IL_ETH1::PDU_FITrueCyclicPeriod::RTP_Entertainment_Info_El_XIX_E3V_VLAN_Infotainment, -1, 0);
  }
  else
  {
    SetBusContext(gILETH1_BusContext);
    ILResetPDUTimingCyclic(ETH_Cluster_MEB::RTP_Entertainment_Info_El_XIX_E3V_VLAN_Infotainment, 1);
  }
}

on sysvar_update sysvar::IL_ETH1::PDU_FITrueCyclicPeriod::RTP_Entertainment_Info_El_XIX_E3V_VLAN_Infotainment
{
  if (@sysvar::IL_ETH1::PDU_DisturbTrueCyclicTiming::RTP_Entertainment_Info_El_XIX_E3V_VLAN_Infotainment == 1)
  {
    SetBusContext(gILETH1_BusContext);
    ILSetPDUTimingCyclic(ETH_Cluster_MEB::RTP_Entertainment_Info_El_XIX_E3V_VLAN_Infotainment, 1, 0, @sysvar::IL_ETH1::PDU_FITrueCyclicPeriod::RTP_Entertainment_Info_El_XIX_E3V_VLAN_Infotainment, -1, 0);
  }
}

on sysvar_update sysvar::IL_ETH1::PDU_DisturbFalseCyclicTiming::RTP_Entertainment_Info_El_XIX_E3V_VLAN_Infotainment
{
  if (@this == 1)
  {
    SetBusContext(gILETH1_BusContext);
    ILSetPDUTimingCyclic(ETH_Cluster_MEB::RTP_Entertainment_Info_El_XIX_E3V_VLAN_Infotainment, 0, 0, @sysvar::IL_ETH1::PDU_FIFalseCyclicPeriod::RTP_Entertainment_Info_El_XIX_E3V_VLAN_Infotainment, -1, 0);
  }
  else
  {
    SetBusContext(gILETH1_BusContext);
    ILResetPDUTimingCyclic(ETH_Cluster_MEB::RTP_Entertainment_Info_El_XIX_E3V_VLAN_Infotainment, 0);
  }
}

on sysvar_update sysvar::IL_ETH1::PDU_FIFalseCyclicPeriod::RTP_Entertainment_Info_El_XIX_E3V_VLAN_Infotainment
{
  if (@sysvar::IL_ETH1::PDU_DisturbFalseCyclicTiming::RTP_Entertainment_Info_El_XIX_E3V_VLAN_Infotainment == 1)
  {
    SetBusContext(gILETH1_BusContext);
    ILSetPDUTimingCyclic(ETH_Cluster_MEB::RTP_Entertainment_Info_El_XIX_E3V_VLAN_Infotainment, 1, 0, @sysvar::IL_ETH1::PDU_FITrueCyclicPeriod::RTP_Entertainment_Info_El_XIX_E3V_VLAN_Infotainment, -1, 0);
  }
}

on sysvar_update sysvar::IL_ETH1::PDU_SendOnce::RTP_Entertainment_Info_El_XIX_E3V_VLAN_Infotainment
{
  if (@this == 1)
  {
    SetBusContext(gILETH1_BusContext);
    ILSetPDUEvent(ETH_Cluster_MEB::RTP_Entertainment_Info_El_XIX_E3V_VLAN_Infotainment);
  }
}

on sysvar_update sysvar::IL_ETH1::PDU_DisturbTrueEventTiming::RTP_Entertainment_Info_El_XIX_E3V_VLAN_Infotainment
{
  if (@this == 1)
  {
    SetBusContext(gILETH1_BusContext);
    ILSetPDUTimingEvent(ETH_Cluster_MEB::RTP_Entertainment_Info_El_XIX_E3V_VLAN_Infotainment, 1, @sysvar::IL_ETH1::PDU_FITrueEventEnable::RTP_Entertainment_Info_El_XIX_E3V_VLAN_Infotainment, @sysvar::IL_ETH1::PDU_FITrueEventRepCount::RTP_Entertainment_Info_El_XIX_E3V_VLAN_Infotainment, @sysvar::IL_ETH1::PDU_FITrueEventRepPeriod::RTP_Entertainment_Info_El_XIX_E3V_VLAN_Infotainment, @sysvar::IL_ETH1::PDU_FIEventDebounceDelay::RTP_Entertainment_Info_El_XIX_E3V_VLAN_Infotainment, -1, 0);
  }
  else
  {
    SetBusContext(gILETH1_BusContext);
    ILResetPDUTimingEvent(ETH_Cluster_MEB::RTP_Entertainment_Info_El_XIX_E3V_VLAN_Infotainment, 1);
  }
}

on sysvar_update sysvar::IL_ETH1::PDU_FITrueEventEnable::RTP_Entertainment_Info_El_XIX_E3V_VLAN_Infotainment
{
  if (@sysvar::IL_ETH1::PDU_DisturbTrueEventTiming::RTP_Entertainment_Info_El_XIX_E3V_VLAN_Infotainment == 1)
  {
    SetBusContext(gILETH1_BusContext);
    ILSetPDUTimingEvent(ETH_Cluster_MEB::RTP_Entertainment_Info_El_XIX_E3V_VLAN_Infotainment, 1, @sysvar::IL_ETH1::PDU_FITrueEventEnable::RTP_Entertainment_Info_El_XIX_E3V_VLAN_Infotainment, @sysvar::IL_ETH1::PDU_FITrueEventRepCount::RTP_Entertainment_Info_El_XIX_E3V_VLAN_Infotainment, @sysvar::IL_ETH1::PDU_FITrueEventRepPeriod::RTP_Entertainment_Info_El_XIX_E3V_VLAN_Infotainment, @sysvar::IL_ETH1::PDU_FIEventDebounceDelay::RTP_Entertainment_Info_El_XIX_E3V_VLAN_Infotainment, -1, 0);
  }
}

on sysvar_update sysvar::IL_ETH1::PDU_FITrueEventRepCount::RTP_Entertainment_Info_El_XIX_E3V_VLAN_Infotainment
{
  if (@sysvar::IL_ETH1::PDU_DisturbTrueEventTiming::RTP_Entertainment_Info_El_XIX_E3V_VLAN_Infotainment == 1)
  {
    SetBusContext(gILETH1_BusContext);
    ILSetPDUTimingEvent(ETH_Cluster_MEB::RTP_Entertainment_Info_El_XIX_E3V_VLAN_Infotainment, 1, @sysvar::IL_ETH1::PDU_FITrueEventEnable::RTP_Entertainment_Info_El_XIX_E3V_VLAN_Infotainment, @sysvar::IL_ETH1::PDU_FITrueEventRepCount::RTP_Entertainment_Info_El_XIX_E3V_VLAN_Infotainment, @sysvar::IL_ETH1::PDU_FITrueEventRepPeriod::RTP_Entertainment_Info_El_XIX_E3V_VLAN_Infotainment, @sysvar::IL_ETH1::PDU_FIEventDebounceDelay::RTP_Entertainment_Info_El_XIX_E3V_VLAN_Infotainment, -1, 0);
  }
}

on sysvar_update sysvar::IL_ETH1::PDU_FITrueEventRepPeriod::RTP_Entertainment_Info_El_XIX_E3V_VLAN_Infotainment
{
  if (@sysvar::IL_ETH1::PDU_DisturbTrueEventTiming::RTP_Entertainment_Info_El_XIX_E3V_VLAN_Infotainment == 1)
  {
    SetBusContext(gILETH1_BusContext);
    ILSetPDUTimingEvent(ETH_Cluster_MEB::RTP_Entertainment_Info_El_XIX_E3V_VLAN_Infotainment, 1, @sysvar::IL_ETH1::PDU_FITrueEventEnable::RTP_Entertainment_Info_El_XIX_E3V_VLAN_Infotainment, @sysvar::IL_ETH1::PDU_FITrueEventRepCount::RTP_Entertainment_Info_El_XIX_E3V_VLAN_Infotainment, @sysvar::IL_ETH1::PDU_FITrueEventRepPeriod::RTP_Entertainment_Info_El_XIX_E3V_VLAN_Infotainment, @sysvar::IL_ETH1::PDU_FIEventDebounceDelay::RTP_Entertainment_Info_El_XIX_E3V_VLAN_Infotainment, -1, 0);
  }
}

on sysvar_update sysvar::IL_ETH1::PDU_FIEventDebounceDelay::RTP_Entertainment_Info_El_XIX_E3V_VLAN_Infotainment
{
  if (@sysvar::IL_ETH1::PDU_DisturbTrueEventTiming::RTP_Entertainment_Info_El_XIX_E3V_VLAN_Infotainment == 1)
  {
    SetBusContext(gILETH1_BusContext);
    ILSetPDUTimingEvent(ETH_Cluster_MEB::RTP_Entertainment_Info_El_XIX_E3V_VLAN_Infotainment, 1, @sysvar::IL_ETH1::PDU_FITrueEventEnable::RTP_Entertainment_Info_El_XIX_E3V_VLAN_Infotainment, @sysvar::IL_ETH1::PDU_FITrueEventRepCount::RTP_Entertainment_Info_El_XIX_E3V_VLAN_Infotainment, @sysvar::IL_ETH1::PDU_FITrueEventRepPeriod::RTP_Entertainment_Info_El_XIX_E3V_VLAN_Infotainment, @sysvar::IL_ETH1::PDU_FIEventDebounceDelay::RTP_Entertainment_Info_El_XIX_E3V_VLAN_Infotainment, -1, 0);
  }
  if (@sysvar::IL_ETH1::PDU_DisturbFalseEventTiming::RTP_Entertainment_Info_El_XIX_E3V_VLAN_Infotainment == 1)
  {
    SetBusContext(gILETH1_BusContext);
    ILSetPDUTimingEvent(ETH_Cluster_MEB::RTP_Entertainment_Info_El_XIX_E3V_VLAN_Infotainment, 0, @sysvar::IL_ETH1::PDU_FIFalseEventEnable::RTP_Entertainment_Info_El_XIX_E3V_VLAN_Infotainment, @sysvar::IL_ETH1::PDU_FIFalseEventRepCount::RTP_Entertainment_Info_El_XIX_E3V_VLAN_Infotainment, @sysvar::IL_ETH1::PDU_FIFalseEventRepPeriod::RTP_Entertainment_Info_El_XIX_E3V_VLAN_Infotainment, @sysvar::IL_ETH1::PDU_FIEventDebounceDelay::RTP_Entertainment_Info_El_XIX_E3V_VLAN_Infotainment, -1, 0);
  }
}

on sysvar_update sysvar::IL_ETH1::PDU_DisturbFalseEventTiming::RTP_Entertainment_Info_El_XIX_E3V_VLAN_Infotainment
{
  if (@this == 1)
  {
    SetBusContext(gILETH1_BusContext);
    ILSetPDUTimingEvent(ETH_Cluster_MEB::RTP_Entertainment_Info_El_XIX_E3V_VLAN_Infotainment, 0, @sysvar::IL_ETH1::PDU_FIFalseEventEnable::RTP_Entertainment_Info_El_XIX_E3V_VLAN_Infotainment, @sysvar::IL_ETH1::PDU_FIFalseEventRepCount::RTP_Entertainment_Info_El_XIX_E3V_VLAN_Infotainment, @sysvar::IL_ETH1::PDU_FIFalseEventRepPeriod::RTP_Entertainment_Info_El_XIX_E3V_VLAN_Infotainment, @sysvar::IL_ETH1::PDU_FIEventDebounceDelay::RTP_Entertainment_Info_El_XIX_E3V_VLAN_Infotainment, -1, 0);
  }
  else
  {
    SetBusContext(gILETH1_BusContext);
    ILResetPDUTimingEvent(ETH_Cluster_MEB::RTP_Entertainment_Info_El_XIX_E3V_VLAN_Infotainment, 0);
  }
}

on sysvar_update sysvar::IL_ETH1::PDU_FIFalseEventEnable::RTP_Entertainment_Info_El_XIX_E3V_VLAN_Infotainment
{
  if (@sysvar::IL_ETH1::PDU_DisturbFalseEventTiming::RTP_Entertainment_Info_El_XIX_E3V_VLAN_Infotainment == 1)
  {
    SetBusContext(gILETH1_BusContext);
    ILSetPDUTimingEvent(ETH_Cluster_MEB::RTP_Entertainment_Info_El_XIX_E3V_VLAN_Infotainment, 0, @sysvar::IL_ETH1::PDU_FIFalseEventEnable::RTP_Entertainment_Info_El_XIX_E3V_VLAN_Infotainment, @sysvar::IL_ETH1::PDU_FIFalseEventRepCount::RTP_Entertainment_Info_El_XIX_E3V_VLAN_Infotainment, @sysvar::IL_ETH1::PDU_FIFalseEventRepPeriod::RTP_Entertainment_Info_El_XIX_E3V_VLAN_Infotainment, @sysvar::IL_ETH1::PDU_FIEventDebounceDelay::RTP_Entertainment_Info_El_XIX_E3V_VLAN_Infotainment, -1, 0);
  }
}

on sysvar_update sysvar::IL_ETH1::PDU_FIFalseEventRepCount::RTP_Entertainment_Info_El_XIX_E3V_VLAN_Infotainment
{
  if (@sysvar::IL_ETH1::PDU_DisturbFalseEventTiming::RTP_Entertainment_Info_El_XIX_E3V_VLAN_Infotainment == 1)
  {
    SetBusContext(gILETH1_BusContext);
    ILSetPDUTimingEvent(ETH_Cluster_MEB::RTP_Entertainment_Info_El_XIX_E3V_VLAN_Infotainment, 0, @sysvar::IL_ETH1::PDU_FIFalseEventEnable::RTP_Entertainment_Info_El_XIX_E3V_VLAN_Infotainment, @sysvar::IL_ETH1::PDU_FIFalseEventRepCount::RTP_Entertainment_Info_El_XIX_E3V_VLAN_Infotainment, @sysvar::IL_ETH1::PDU_FIFalseEventRepPeriod::RTP_Entertainment_Info_El_XIX_E3V_VLAN_Infotainment, @sysvar::IL_ETH1::PDU_FIEventDebounceDelay::RTP_Entertainment_Info_El_XIX_E3V_VLAN_Infotainment, -1, 0);
  }
}

on sysvar_update sysvar::IL_ETH1::PDU_FIFalseEventRepPeriod::RTP_Entertainment_Info_El_XIX_E3V_VLAN_Infotainment
{
  if (@sysvar::IL_ETH1::PDU_DisturbFalseEventTiming::RTP_Entertainment_Info_El_XIX_E3V_VLAN_Infotainment == 1)
  {
    SetBusContext(gILETH1_BusContext);
    ILSetPDUTimingEvent(ETH_Cluster_MEB::RTP_Entertainment_Info_El_XIX_E3V_VLAN_Infotainment, 0, @sysvar::IL_ETH1::PDU_FIFalseEventEnable::RTP_Entertainment_Info_El_XIX_E3V_VLAN_Infotainment, @sysvar::IL_ETH1::PDU_FIFalseEventRepCount::RTP_Entertainment_Info_El_XIX_E3V_VLAN_Infotainment, @sysvar::IL_ETH1::PDU_FIFalseEventRepPeriod::RTP_Entertainment_Info_El_XIX_E3V_VLAN_Infotainment, @sysvar::IL_ETH1::PDU_FIEventDebounceDelay::RTP_Entertainment_Info_El_XIX_E3V_VLAN_Infotainment, -1, 0);
  }
}

on sysvar_update sysvar::IL_ETH1::PDU_DisturbTimingMode::ServiceDiscoverySomeIP_ICAS3IVI_XIX_E3V_VLAN_Infotainment
{
  if (@this == 1)
  {
    SetBusContext(gILETH1_BusContext);
    ILSetPDUAsrTXMode(ETH_Cluster_MEB::ServiceDiscoverySomeIP_ICAS3IVI_XIX_E3V_VLAN_Infotainment, @sysvar::IL_ETH1::PDU_FITimingMode::ServiceDiscoverySomeIP_ICAS3IVI_XIX_E3V_VLAN_Infotainment, -1, 0);
  }
  else
  {
    SetBusContext(gILETH1_BusContext);
    ILResetPDUAsrTXMode(ETH_Cluster_MEB::ServiceDiscoverySomeIP_ICAS3IVI_XIX_E3V_VLAN_Infotainment);
  }
}

on sysvar_update sysvar::IL_ETH1::PDU_FITimingMode::ServiceDiscoverySomeIP_ICAS3IVI_XIX_E3V_VLAN_Infotainment
{
  if (@sysvar::IL_ETH1::PDU_DisturbTimingMode::ServiceDiscoverySomeIP_ICAS3IVI_XIX_E3V_VLAN_Infotainment == 1)
  {
    SetBusContext(gILETH1_BusContext);
    ILSetPDUAsrTXMode(ETH_Cluster_MEB::ServiceDiscoverySomeIP_ICAS3IVI_XIX_E3V_VLAN_Infotainment, @sysvar::IL_ETH1::PDU_FITimingMode::ServiceDiscoverySomeIP_ICAS3IVI_XIX_E3V_VLAN_Infotainment, -1, 0);
  }
}

on sysvar_update sysvar::IL_ETH1::PDU_DisturbTrueCyclicTiming::ServiceDiscoverySomeIP_ICAS3IVI_XIX_E3V_VLAN_Infotainment
{
  if (@this == 1)
  {
    SetBusContext(gILETH1_BusContext);
    ILSetPDUTimingCyclic(ETH_Cluster_MEB::ServiceDiscoverySomeIP_ICAS3IVI_XIX_E3V_VLAN_Infotainment, 1, 0, @sysvar::IL_ETH1::PDU_FITrueCyclicPeriod::ServiceDiscoverySomeIP_ICAS3IVI_XIX_E3V_VLAN_Infotainment, -1, 0);
  }
  else
  {
    SetBusContext(gILETH1_BusContext);
    ILResetPDUTimingCyclic(ETH_Cluster_MEB::ServiceDiscoverySomeIP_ICAS3IVI_XIX_E3V_VLAN_Infotainment, 1);
  }
}

on sysvar_update sysvar::IL_ETH1::PDU_FITrueCyclicPeriod::ServiceDiscoverySomeIP_ICAS3IVI_XIX_E3V_VLAN_Infotainment
{
  if (@sysvar::IL_ETH1::PDU_DisturbTrueCyclicTiming::ServiceDiscoverySomeIP_ICAS3IVI_XIX_E3V_VLAN_Infotainment == 1)
  {
    SetBusContext(gILETH1_BusContext);
    ILSetPDUTimingCyclic(ETH_Cluster_MEB::ServiceDiscoverySomeIP_ICAS3IVI_XIX_E3V_VLAN_Infotainment, 1, 0, @sysvar::IL_ETH1::PDU_FITrueCyclicPeriod::ServiceDiscoverySomeIP_ICAS3IVI_XIX_E3V_VLAN_Infotainment, -1, 0);
  }
}

on sysvar_update sysvar::IL_ETH1::PDU_DisturbFalseCyclicTiming::ServiceDiscoverySomeIP_ICAS3IVI_XIX_E3V_VLAN_Infotainment
{
  if (@this == 1)
  {
    SetBusContext(gILETH1_BusContext);
    ILSetPDUTimingCyclic(ETH_Cluster_MEB::ServiceDiscoverySomeIP_ICAS3IVI_XIX_E3V_VLAN_Infotainment, 0, 0, @sysvar::IL_ETH1::PDU_FIFalseCyclicPeriod::ServiceDiscoverySomeIP_ICAS3IVI_XIX_E3V_VLAN_Infotainment, -1, 0);
  }
  else
  {
    SetBusContext(gILETH1_BusContext);
    ILResetPDUTimingCyclic(ETH_Cluster_MEB::ServiceDiscoverySomeIP_ICAS3IVI_XIX_E3V_VLAN_Infotainment, 0);
  }
}

on sysvar_update sysvar::IL_ETH1::PDU_FIFalseCyclicPeriod::ServiceDiscoverySomeIP_ICAS3IVI_XIX_E3V_VLAN_Infotainment
{
  if (@sysvar::IL_ETH1::PDU_DisturbFalseCyclicTiming::ServiceDiscoverySomeIP_ICAS3IVI_XIX_E3V_VLAN_Infotainment == 1)
  {
    SetBusContext(gILETH1_BusContext);
    ILSetPDUTimingCyclic(ETH_Cluster_MEB::ServiceDiscoverySomeIP_ICAS3IVI_XIX_E3V_VLAN_Infotainment, 1, 0, @sysvar::IL_ETH1::PDU_FITrueCyclicPeriod::ServiceDiscoverySomeIP_ICAS3IVI_XIX_E3V_VLAN_Infotainment, -1, 0);
  }
}

on sysvar_update sysvar::IL_ETH1::PDU_SendOnce::ServiceDiscoverySomeIP_ICAS3IVI_XIX_E3V_VLAN_Infotainment
{
  if (@this == 1)
  {
    SetBusContext(gILETH1_BusContext);
    ILSetPDUEvent(ETH_Cluster_MEB::ServiceDiscoverySomeIP_ICAS3IVI_XIX_E3V_VLAN_Infotainment);
  }
}

on sysvar_update sysvar::IL_ETH1::PDU_DisturbTrueEventTiming::ServiceDiscoverySomeIP_ICAS3IVI_XIX_E3V_VLAN_Infotainment
{
  if (@this == 1)
  {
    SetBusContext(gILETH1_BusContext);
    ILSetPDUTimingEvent(ETH_Cluster_MEB::ServiceDiscoverySomeIP_ICAS3IVI_XIX_E3V_VLAN_Infotainment, 1, @sysvar::IL_ETH1::PDU_FITrueEventEnable::ServiceDiscoverySomeIP_ICAS3IVI_XIX_E3V_VLAN_Infotainment, @sysvar::IL_ETH1::PDU_FITrueEventRepCount::ServiceDiscoverySomeIP_ICAS3IVI_XIX_E3V_VLAN_Infotainment, @sysvar::IL_ETH1::PDU_FITrueEventRepPeriod::ServiceDiscoverySomeIP_ICAS3IVI_XIX_E3V_VLAN_Infotainment, @sysvar::IL_ETH1::PDU_FIEventDebounceDelay::ServiceDiscoverySomeIP_ICAS3IVI_XIX_E3V_VLAN_Infotainment, -1, 0);
  }
  else
  {
    SetBusContext(gILETH1_BusContext);
    ILResetPDUTimingEvent(ETH_Cluster_MEB::ServiceDiscoverySomeIP_ICAS3IVI_XIX_E3V_VLAN_Infotainment, 1);
  }
}

on sysvar_update sysvar::IL_ETH1::PDU_FITrueEventEnable::ServiceDiscoverySomeIP_ICAS3IVI_XIX_E3V_VLAN_Infotainment
{
  if (@sysvar::IL_ETH1::PDU_DisturbTrueEventTiming::ServiceDiscoverySomeIP_ICAS3IVI_XIX_E3V_VLAN_Infotainment == 1)
  {
    SetBusContext(gILETH1_BusContext);
    ILSetPDUTimingEvent(ETH_Cluster_MEB::ServiceDiscoverySomeIP_ICAS3IVI_XIX_E3V_VLAN_Infotainment, 1, @sysvar::IL_ETH1::PDU_FITrueEventEnable::ServiceDiscoverySomeIP_ICAS3IVI_XIX_E3V_VLAN_Infotainment, @sysvar::IL_ETH1::PDU_FITrueEventRepCount::ServiceDiscoverySomeIP_ICAS3IVI_XIX_E3V_VLAN_Infotainment, @sysvar::IL_ETH1::PDU_FITrueEventRepPeriod::ServiceDiscoverySomeIP_ICAS3IVI_XIX_E3V_VLAN_Infotainment, @sysvar::IL_ETH1::PDU_FIEventDebounceDelay::ServiceDiscoverySomeIP_ICAS3IVI_XIX_E3V_VLAN_Infotainment, -1, 0);
  }
}

on sysvar_update sysvar::IL_ETH1::PDU_FITrueEventRepCount::ServiceDiscoverySomeIP_ICAS3IVI_XIX_E3V_VLAN_Infotainment
{
  if (@sysvar::IL_ETH1::PDU_DisturbTrueEventTiming::ServiceDiscoverySomeIP_ICAS3IVI_XIX_E3V_VLAN_Infotainment == 1)
  {
    SetBusContext(gILETH1_BusContext);
    ILSetPDUTimingEvent(ETH_Cluster_MEB::ServiceDiscoverySomeIP_ICAS3IVI_XIX_E3V_VLAN_Infotainment, 1, @sysvar::IL_ETH1::PDU_FITrueEventEnable::ServiceDiscoverySomeIP_ICAS3IVI_XIX_E3V_VLAN_Infotainment, @sysvar::IL_ETH1::PDU_FITrueEventRepCount::ServiceDiscoverySomeIP_ICAS3IVI_XIX_E3V_VLAN_Infotainment, @sysvar::IL_ETH1::PDU_FITrueEventRepPeriod::ServiceDiscoverySomeIP_ICAS3IVI_XIX_E3V_VLAN_Infotainment, @sysvar::IL_ETH1::PDU_FIEventDebounceDelay::ServiceDiscoverySomeIP_ICAS3IVI_XIX_E3V_VLAN_Infotainment, -1, 0);
  }
}

on sysvar_update sysvar::IL_ETH1::PDU_FITrueEventRepPeriod::ServiceDiscoverySomeIP_ICAS3IVI_XIX_E3V_VLAN_Infotainment
{
  if (@sysvar::IL_ETH1::PDU_DisturbTrueEventTiming::ServiceDiscoverySomeIP_ICAS3IVI_XIX_E3V_VLAN_Infotainment == 1)
  {
    SetBusContext(gILETH1_BusContext);
    ILSetPDUTimingEvent(ETH_Cluster_MEB::ServiceDiscoverySomeIP_ICAS3IVI_XIX_E3V_VLAN_Infotainment, 1, @sysvar::IL_ETH1::PDU_FITrueEventEnable::ServiceDiscoverySomeIP_ICAS3IVI_XIX_E3V_VLAN_Infotainment, @sysvar::IL_ETH1::PDU_FITrueEventRepCount::ServiceDiscoverySomeIP_ICAS3IVI_XIX_E3V_VLAN_Infotainment, @sysvar::IL_ETH1::PDU_FITrueEventRepPeriod::ServiceDiscoverySomeIP_ICAS3IVI_XIX_E3V_VLAN_Infotainment, @sysvar::IL_ETH1::PDU_FIEventDebounceDelay::ServiceDiscoverySomeIP_ICAS3IVI_XIX_E3V_VLAN_Infotainment, -1, 0);
  }
}

on sysvar_update sysvar::IL_ETH1::PDU_FIEventDebounceDelay::ServiceDiscoverySomeIP_ICAS3IVI_XIX_E3V_VLAN_Infotainment
{
  if (@sysvar::IL_ETH1::PDU_DisturbTrueEventTiming::ServiceDiscoverySomeIP_ICAS3IVI_XIX_E3V_VLAN_Infotainment == 1)
  {
    SetBusContext(gILETH1_BusContext);
    ILSetPDUTimingEvent(ETH_Cluster_MEB::ServiceDiscoverySomeIP_ICAS3IVI_XIX_E3V_VLAN_Infotainment, 1, @sysvar::IL_ETH1::PDU_FITrueEventEnable::ServiceDiscoverySomeIP_ICAS3IVI_XIX_E3V_VLAN_Infotainment, @sysvar::IL_ETH1::PDU_FITrueEventRepCount::ServiceDiscoverySomeIP_ICAS3IVI_XIX_E3V_VLAN_Infotainment, @sysvar::IL_ETH1::PDU_FITrueEventRepPeriod::ServiceDiscoverySomeIP_ICAS3IVI_XIX_E3V_VLAN_Infotainment, @sysvar::IL_ETH1::PDU_FIEventDebounceDelay::ServiceDiscoverySomeIP_ICAS3IVI_XIX_E3V_VLAN_Infotainment, -1, 0);
  }
  if (@sysvar::IL_ETH1::PDU_DisturbFalseEventTiming::ServiceDiscoverySomeIP_ICAS3IVI_XIX_E3V_VLAN_Infotainment == 1)
  {
    SetBusContext(gILETH1_BusContext);
    ILSetPDUTimingEvent(ETH_Cluster_MEB::ServiceDiscoverySomeIP_ICAS3IVI_XIX_E3V_VLAN_Infotainment, 0, @sysvar::IL_ETH1::PDU_FIFalseEventEnable::ServiceDiscoverySomeIP_ICAS3IVI_XIX_E3V_VLAN_Infotainment, @sysvar::IL_ETH1::PDU_FIFalseEventRepCount::ServiceDiscoverySomeIP_ICAS3IVI_XIX_E3V_VLAN_Infotainment, @sysvar::IL_ETH1::PDU_FIFalseEventRepPeriod::ServiceDiscoverySomeIP_ICAS3IVI_XIX_E3V_VLAN_Infotainment, @sysvar::IL_ETH1::PDU_FIEventDebounceDelay::ServiceDiscoverySomeIP_ICAS3IVI_XIX_E3V_VLAN_Infotainment, -1, 0);
  }
}

on sysvar_update sysvar::IL_ETH1::PDU_DisturbFalseEventTiming::ServiceDiscoverySomeIP_ICAS3IVI_XIX_E3V_VLAN_Infotainment
{
  if (@this == 1)
  {
    SetBusContext(gILETH1_BusContext);
    ILSetPDUTimingEvent(ETH_Cluster_MEB::ServiceDiscoverySomeIP_ICAS3IVI_XIX_E3V_VLAN_Infotainment, 0, @sysvar::IL_ETH1::PDU_FIFalseEventEnable::ServiceDiscoverySomeIP_ICAS3IVI_XIX_E3V_VLAN_Infotainment, @sysvar::IL_ETH1::PDU_FIFalseEventRepCount::ServiceDiscoverySomeIP_ICAS3IVI_XIX_E3V_VLAN_Infotainment, @sysvar::IL_ETH1::PDU_FIFalseEventRepPeriod::ServiceDiscoverySomeIP_ICAS3IVI_XIX_E3V_VLAN_Infotainment, @sysvar::IL_ETH1::PDU_FIEventDebounceDelay::ServiceDiscoverySomeIP_ICAS3IVI_XIX_E3V_VLAN_Infotainment, -1, 0);
  }
  else
  {
    SetBusContext(gILETH1_BusContext);
    ILResetPDUTimingEvent(ETH_Cluster_MEB::ServiceDiscoverySomeIP_ICAS3IVI_XIX_E3V_VLAN_Infotainment, 0);
  }
}

on sysvar_update sysvar::IL_ETH1::PDU_FIFalseEventEnable::ServiceDiscoverySomeIP_ICAS3IVI_XIX_E3V_VLAN_Infotainment
{
  if (@sysvar::IL_ETH1::PDU_DisturbFalseEventTiming::ServiceDiscoverySomeIP_ICAS3IVI_XIX_E3V_VLAN_Infotainment == 1)
  {
    SetBusContext(gILETH1_BusContext);
    ILSetPDUTimingEvent(ETH_Cluster_MEB::ServiceDiscoverySomeIP_ICAS3IVI_XIX_E3V_VLAN_Infotainment, 0, @sysvar::IL_ETH1::PDU_FIFalseEventEnable::ServiceDiscoverySomeIP_ICAS3IVI_XIX_E3V_VLAN_Infotainment, @sysvar::IL_ETH1::PDU_FIFalseEventRepCount::ServiceDiscoverySomeIP_ICAS3IVI_XIX_E3V_VLAN_Infotainment, @sysvar::IL_ETH1::PDU_FIFalseEventRepPeriod::ServiceDiscoverySomeIP_ICAS3IVI_XIX_E3V_VLAN_Infotainment, @sysvar::IL_ETH1::PDU_FIEventDebounceDelay::ServiceDiscoverySomeIP_ICAS3IVI_XIX_E3V_VLAN_Infotainment, -1, 0);
  }
}

on sysvar_update sysvar::IL_ETH1::PDU_FIFalseEventRepCount::ServiceDiscoverySomeIP_ICAS3IVI_XIX_E3V_VLAN_Infotainment
{
  if (@sysvar::IL_ETH1::PDU_DisturbFalseEventTiming::ServiceDiscoverySomeIP_ICAS3IVI_XIX_E3V_VLAN_Infotainment == 1)
  {
    SetBusContext(gILETH1_BusContext);
    ILSetPDUTimingEvent(ETH_Cluster_MEB::ServiceDiscoverySomeIP_ICAS3IVI_XIX_E3V_VLAN_Infotainment, 0, @sysvar::IL_ETH1::PDU_FIFalseEventEnable::ServiceDiscoverySomeIP_ICAS3IVI_XIX_E3V_VLAN_Infotainment, @sysvar::IL_ETH1::PDU_FIFalseEventRepCount::ServiceDiscoverySomeIP_ICAS3IVI_XIX_E3V_VLAN_Infotainment, @sysvar::IL_ETH1::PDU_FIFalseEventRepPeriod::ServiceDiscoverySomeIP_ICAS3IVI_XIX_E3V_VLAN_Infotainment, @sysvar::IL_ETH1::PDU_FIEventDebounceDelay::ServiceDiscoverySomeIP_ICAS3IVI_XIX_E3V_VLAN_Infotainment, -1, 0);
  }
}

on sysvar_update sysvar::IL_ETH1::PDU_FIFalseEventRepPeriod::ServiceDiscoverySomeIP_ICAS3IVI_XIX_E3V_VLAN_Infotainment
{
  if (@sysvar::IL_ETH1::PDU_DisturbFalseEventTiming::ServiceDiscoverySomeIP_ICAS3IVI_XIX_E3V_VLAN_Infotainment == 1)
  {
    SetBusContext(gILETH1_BusContext);
    ILSetPDUTimingEvent(ETH_Cluster_MEB::ServiceDiscoverySomeIP_ICAS3IVI_XIX_E3V_VLAN_Infotainment, 0, @sysvar::IL_ETH1::PDU_FIFalseEventEnable::ServiceDiscoverySomeIP_ICAS3IVI_XIX_E3V_VLAN_Infotainment, @sysvar::IL_ETH1::PDU_FIFalseEventRepCount::ServiceDiscoverySomeIP_ICAS3IVI_XIX_E3V_VLAN_Infotainment, @sysvar::IL_ETH1::PDU_FIFalseEventRepPeriod::ServiceDiscoverySomeIP_ICAS3IVI_XIX_E3V_VLAN_Infotainment, @sysvar::IL_ETH1::PDU_FIEventDebounceDelay::ServiceDiscoverySomeIP_ICAS3IVI_XIX_E3V_VLAN_Infotainment, -1, 0);
  }
}

on sysvar_update sysvar::IL_ETH1::PDU_DisturbTimingMode::ServiceDiscoveryViWi_ICAS3IVI_XIX_E3V_VLAN_Infotainment
{
  if (@this == 1)
  {
    SetBusContext(gILETH1_BusContext);
    ILSetPDUAsrTXMode(ETH_Cluster_MEB::ServiceDiscoveryViWi_ICAS3IVI_XIX_E3V_VLAN_Infotainment, @sysvar::IL_ETH1::PDU_FITimingMode::ServiceDiscoveryViWi_ICAS3IVI_XIX_E3V_VLAN_Infotainment, -1, 0);
  }
  else
  {
    SetBusContext(gILETH1_BusContext);
    ILResetPDUAsrTXMode(ETH_Cluster_MEB::ServiceDiscoveryViWi_ICAS3IVI_XIX_E3V_VLAN_Infotainment);
  }
}

on sysvar_update sysvar::IL_ETH1::PDU_FITimingMode::ServiceDiscoveryViWi_ICAS3IVI_XIX_E3V_VLAN_Infotainment
{
  if (@sysvar::IL_ETH1::PDU_DisturbTimingMode::ServiceDiscoveryViWi_ICAS3IVI_XIX_E3V_VLAN_Infotainment == 1)
  {
    SetBusContext(gILETH1_BusContext);
    ILSetPDUAsrTXMode(ETH_Cluster_MEB::ServiceDiscoveryViWi_ICAS3IVI_XIX_E3V_VLAN_Infotainment, @sysvar::IL_ETH1::PDU_FITimingMode::ServiceDiscoveryViWi_ICAS3IVI_XIX_E3V_VLAN_Infotainment, -1, 0);
  }
}

on sysvar_update sysvar::IL_ETH1::PDU_DisturbTrueCyclicTiming::ServiceDiscoveryViWi_ICAS3IVI_XIX_E3V_VLAN_Infotainment
{
  if (@this == 1)
  {
    SetBusContext(gILETH1_BusContext);
    ILSetPDUTimingCyclic(ETH_Cluster_MEB::ServiceDiscoveryViWi_ICAS3IVI_XIX_E3V_VLAN_Infotainment, 1, 0, @sysvar::IL_ETH1::PDU_FITrueCyclicPeriod::ServiceDiscoveryViWi_ICAS3IVI_XIX_E3V_VLAN_Infotainment, -1, 0);
  }
  else
  {
    SetBusContext(gILETH1_BusContext);
    ILResetPDUTimingCyclic(ETH_Cluster_MEB::ServiceDiscoveryViWi_ICAS3IVI_XIX_E3V_VLAN_Infotainment, 1);
  }
}

on sysvar_update sysvar::IL_ETH1::PDU_FITrueCyclicPeriod::ServiceDiscoveryViWi_ICAS3IVI_XIX_E3V_VLAN_Infotainment
{
  if (@sysvar::IL_ETH1::PDU_DisturbTrueCyclicTiming::ServiceDiscoveryViWi_ICAS3IVI_XIX_E3V_VLAN_Infotainment == 1)
  {
    SetBusContext(gILETH1_BusContext);
    ILSetPDUTimingCyclic(ETH_Cluster_MEB::ServiceDiscoveryViWi_ICAS3IVI_XIX_E3V_VLAN_Infotainment, 1, 0, @sysvar::IL_ETH1::PDU_FITrueCyclicPeriod::ServiceDiscoveryViWi_ICAS3IVI_XIX_E3V_VLAN_Infotainment, -1, 0);
  }
}

on sysvar_update sysvar::IL_ETH1::PDU_DisturbFalseCyclicTiming::ServiceDiscoveryViWi_ICAS3IVI_XIX_E3V_VLAN_Infotainment
{
  if (@this == 1)
  {
    SetBusContext(gILETH1_BusContext);
    ILSetPDUTimingCyclic(ETH_Cluster_MEB::ServiceDiscoveryViWi_ICAS3IVI_XIX_E3V_VLAN_Infotainment, 0, 0, @sysvar::IL_ETH1::PDU_FIFalseCyclicPeriod::ServiceDiscoveryViWi_ICAS3IVI_XIX_E3V_VLAN_Infotainment, -1, 0);
  }
  else
  {
    SetBusContext(gILETH1_BusContext);
    ILResetPDUTimingCyclic(ETH_Cluster_MEB::ServiceDiscoveryViWi_ICAS3IVI_XIX_E3V_VLAN_Infotainment, 0);
  }
}

on sysvar_update sysvar::IL_ETH1::PDU_FIFalseCyclicPeriod::ServiceDiscoveryViWi_ICAS3IVI_XIX_E3V_VLAN_Infotainment
{
  if (@sysvar::IL_ETH1::PDU_DisturbFalseCyclicTiming::ServiceDiscoveryViWi_ICAS3IVI_XIX_E3V_VLAN_Infotainment == 1)
  {
    SetBusContext(gILETH1_BusContext);
    ILSetPDUTimingCyclic(ETH_Cluster_MEB::ServiceDiscoveryViWi_ICAS3IVI_XIX_E3V_VLAN_Infotainment, 1, 0, @sysvar::IL_ETH1::PDU_FITrueCyclicPeriod::ServiceDiscoveryViWi_ICAS3IVI_XIX_E3V_VLAN_Infotainment, -1, 0);
  }
}

on sysvar_update sysvar::IL_ETH1::PDU_SendOnce::ServiceDiscoveryViWi_ICAS3IVI_XIX_E3V_VLAN_Infotainment
{
  if (@this == 1)
  {
    SetBusContext(gILETH1_BusContext);
    ILSetPDUEvent(ETH_Cluster_MEB::ServiceDiscoveryViWi_ICAS3IVI_XIX_E3V_VLAN_Infotainment);
  }
}

on sysvar_update sysvar::IL_ETH1::PDU_DisturbTrueEventTiming::ServiceDiscoveryViWi_ICAS3IVI_XIX_E3V_VLAN_Infotainment
{
  if (@this == 1)
  {
    SetBusContext(gILETH1_BusContext);
    ILSetPDUTimingEvent(ETH_Cluster_MEB::ServiceDiscoveryViWi_ICAS3IVI_XIX_E3V_VLAN_Infotainment, 1, @sysvar::IL_ETH1::PDU_FITrueEventEnable::ServiceDiscoveryViWi_ICAS3IVI_XIX_E3V_VLAN_Infotainment, @sysvar::IL_ETH1::PDU_FITrueEventRepCount::ServiceDiscoveryViWi_ICAS3IVI_XIX_E3V_VLAN_Infotainment, @sysvar::IL_ETH1::PDU_FITrueEventRepPeriod::ServiceDiscoveryViWi_ICAS3IVI_XIX_E3V_VLAN_Infotainment, @sysvar::IL_ETH1::PDU_FIEventDebounceDelay::ServiceDiscoveryViWi_ICAS3IVI_XIX_E3V_VLAN_Infotainment, -1, 0);
  }
  else
  {
    SetBusContext(gILETH1_BusContext);
    ILResetPDUTimingEvent(ETH_Cluster_MEB::ServiceDiscoveryViWi_ICAS3IVI_XIX_E3V_VLAN_Infotainment, 1);
  }
}

on sysvar_update sysvar::IL_ETH1::PDU_FITrueEventEnable::ServiceDiscoveryViWi_ICAS3IVI_XIX_E3V_VLAN_Infotainment
{
  if (@sysvar::IL_ETH1::PDU_DisturbTrueEventTiming::ServiceDiscoveryViWi_ICAS3IVI_XIX_E3V_VLAN_Infotainment == 1)
  {
    SetBusContext(gILETH1_BusContext);
    ILSetPDUTimingEvent(ETH_Cluster_MEB::ServiceDiscoveryViWi_ICAS3IVI_XIX_E3V_VLAN_Infotainment, 1, @sysvar::IL_ETH1::PDU_FITrueEventEnable::ServiceDiscoveryViWi_ICAS3IVI_XIX_E3V_VLAN_Infotainment, @sysvar::IL_ETH1::PDU_FITrueEventRepCount::ServiceDiscoveryViWi_ICAS3IVI_XIX_E3V_VLAN_Infotainment, @sysvar::IL_ETH1::PDU_FITrueEventRepPeriod::ServiceDiscoveryViWi_ICAS3IVI_XIX_E3V_VLAN_Infotainment, @sysvar::IL_ETH1::PDU_FIEventDebounceDelay::ServiceDiscoveryViWi_ICAS3IVI_XIX_E3V_VLAN_Infotainment, -1, 0);
  }
}

on sysvar_update sysvar::IL_ETH1::PDU_FITrueEventRepCount::ServiceDiscoveryViWi_ICAS3IVI_XIX_E3V_VLAN_Infotainment
{
  if (@sysvar::IL_ETH1::PDU_DisturbTrueEventTiming::ServiceDiscoveryViWi_ICAS3IVI_XIX_E3V_VLAN_Infotainment == 1)
  {
    SetBusContext(gILETH1_BusContext);
    ILSetPDUTimingEvent(ETH_Cluster_MEB::ServiceDiscoveryViWi_ICAS3IVI_XIX_E3V_VLAN_Infotainment, 1, @sysvar::IL_ETH1::PDU_FITrueEventEnable::ServiceDiscoveryViWi_ICAS3IVI_XIX_E3V_VLAN_Infotainment, @sysvar::IL_ETH1::PDU_FITrueEventRepCount::ServiceDiscoveryViWi_ICAS3IVI_XIX_E3V_VLAN_Infotainment, @sysvar::IL_ETH1::PDU_FITrueEventRepPeriod::ServiceDiscoveryViWi_ICAS3IVI_XIX_E3V_VLAN_Infotainment, @sysvar::IL_ETH1::PDU_FIEventDebounceDelay::ServiceDiscoveryViWi_ICAS3IVI_XIX_E3V_VLAN_Infotainment, -1, 0);
  }
}

on sysvar_update sysvar::IL_ETH1::PDU_FITrueEventRepPeriod::ServiceDiscoveryViWi_ICAS3IVI_XIX_E3V_VLAN_Infotainment
{
  if (@sysvar::IL_ETH1::PDU_DisturbTrueEventTiming::ServiceDiscoveryViWi_ICAS3IVI_XIX_E3V_VLAN_Infotainment == 1)
  {
    SetBusContext(gILETH1_BusContext);
    ILSetPDUTimingEvent(ETH_Cluster_MEB::ServiceDiscoveryViWi_ICAS3IVI_XIX_E3V_VLAN_Infotainment, 1, @sysvar::IL_ETH1::PDU_FITrueEventEnable::ServiceDiscoveryViWi_ICAS3IVI_XIX_E3V_VLAN_Infotainment, @sysvar::IL_ETH1::PDU_FITrueEventRepCount::ServiceDiscoveryViWi_ICAS3IVI_XIX_E3V_VLAN_Infotainment, @sysvar::IL_ETH1::PDU_FITrueEventRepPeriod::ServiceDiscoveryViWi_ICAS3IVI_XIX_E3V_VLAN_Infotainment, @sysvar::IL_ETH1::PDU_FIEventDebounceDelay::ServiceDiscoveryViWi_ICAS3IVI_XIX_E3V_VLAN_Infotainment, -1, 0);
  }
}

on sysvar_update sysvar::IL_ETH1::PDU_FIEventDebounceDelay::ServiceDiscoveryViWi_ICAS3IVI_XIX_E3V_VLAN_Infotainment
{
  if (@sysvar::IL_ETH1::PDU_DisturbTrueEventTiming::ServiceDiscoveryViWi_ICAS3IVI_XIX_E3V_VLAN_Infotainment == 1)
  {
    SetBusContext(gILETH1_BusContext);
    ILSetPDUTimingEvent(ETH_Cluster_MEB::ServiceDiscoveryViWi_ICAS3IVI_XIX_E3V_VLAN_Infotainment, 1, @sysvar::IL_ETH1::PDU_FITrueEventEnable::ServiceDiscoveryViWi_ICAS3IVI_XIX_E3V_VLAN_Infotainment, @sysvar::IL_ETH1::PDU_FITrueEventRepCount::ServiceDiscoveryViWi_ICAS3IVI_XIX_E3V_VLAN_Infotainment, @sysvar::IL_ETH1::PDU_FITrueEventRepPeriod::ServiceDiscoveryViWi_ICAS3IVI_XIX_E3V_VLAN_Infotainment, @sysvar::IL_ETH1::PDU_FIEventDebounceDelay::ServiceDiscoveryViWi_ICAS3IVI_XIX_E3V_VLAN_Infotainment, -1, 0);
  }
  if (@sysvar::IL_ETH1::PDU_DisturbFalseEventTiming::ServiceDiscoveryViWi_ICAS3IVI_XIX_E3V_VLAN_Infotainment == 1)
  {
    SetBusContext(gILETH1_BusContext);
    ILSetPDUTimingEvent(ETH_Cluster_MEB::ServiceDiscoveryViWi_ICAS3IVI_XIX_E3V_VLAN_Infotainment, 0, @sysvar::IL_ETH1::PDU_FIFalseEventEnable::ServiceDiscoveryViWi_ICAS3IVI_XIX_E3V_VLAN_Infotainment, @sysvar::IL_ETH1::PDU_FIFalseEventRepCount::ServiceDiscoveryViWi_ICAS3IVI_XIX_E3V_VLAN_Infotainment, @sysvar::IL_ETH1::PDU_FIFalseEventRepPeriod::ServiceDiscoveryViWi_ICAS3IVI_XIX_E3V_VLAN_Infotainment, @sysvar::IL_ETH1::PDU_FIEventDebounceDelay::ServiceDiscoveryViWi_ICAS3IVI_XIX_E3V_VLAN_Infotainment, -1, 0);
  }
}

on sysvar_update sysvar::IL_ETH1::PDU_DisturbFalseEventTiming::ServiceDiscoveryViWi_ICAS3IVI_XIX_E3V_VLAN_Infotainment
{
  if (@this == 1)
  {
    SetBusContext(gILETH1_BusContext);
    ILSetPDUTimingEvent(ETH_Cluster_MEB::ServiceDiscoveryViWi_ICAS3IVI_XIX_E3V_VLAN_Infotainment, 0, @sysvar::IL_ETH1::PDU_FIFalseEventEnable::ServiceDiscoveryViWi_ICAS3IVI_XIX_E3V_VLAN_Infotainment, @sysvar::IL_ETH1::PDU_FIFalseEventRepCount::ServiceDiscoveryViWi_ICAS3IVI_XIX_E3V_VLAN_Infotainment, @sysvar::IL_ETH1::PDU_FIFalseEventRepPeriod::ServiceDiscoveryViWi_ICAS3IVI_XIX_E3V_VLAN_Infotainment, @sysvar::IL_ETH1::PDU_FIEventDebounceDelay::ServiceDiscoveryViWi_ICAS3IVI_XIX_E3V_VLAN_Infotainment, -1, 0);
  }
  else
  {
    SetBusContext(gILETH1_BusContext);
    ILResetPDUTimingEvent(ETH_Cluster_MEB::ServiceDiscoveryViWi_ICAS3IVI_XIX_E3V_VLAN_Infotainment, 0);
  }
}

on sysvar_update sysvar::IL_ETH1::PDU_FIFalseEventEnable::ServiceDiscoveryViWi_ICAS3IVI_XIX_E3V_VLAN_Infotainment
{
  if (@sysvar::IL_ETH1::PDU_DisturbFalseEventTiming::ServiceDiscoveryViWi_ICAS3IVI_XIX_E3V_VLAN_Infotainment == 1)
  {
    SetBusContext(gILETH1_BusContext);
    ILSetPDUTimingEvent(ETH_Cluster_MEB::ServiceDiscoveryViWi_ICAS3IVI_XIX_E3V_VLAN_Infotainment, 0, @sysvar::IL_ETH1::PDU_FIFalseEventEnable::ServiceDiscoveryViWi_ICAS3IVI_XIX_E3V_VLAN_Infotainment, @sysvar::IL_ETH1::PDU_FIFalseEventRepCount::ServiceDiscoveryViWi_ICAS3IVI_XIX_E3V_VLAN_Infotainment, @sysvar::IL_ETH1::PDU_FIFalseEventRepPeriod::ServiceDiscoveryViWi_ICAS3IVI_XIX_E3V_VLAN_Infotainment, @sysvar::IL_ETH1::PDU_FIEventDebounceDelay::ServiceDiscoveryViWi_ICAS3IVI_XIX_E3V_VLAN_Infotainment, -1, 0);
  }
}

on sysvar_update sysvar::IL_ETH1::PDU_FIFalseEventRepCount::ServiceDiscoveryViWi_ICAS3IVI_XIX_E3V_VLAN_Infotainment
{
  if (@sysvar::IL_ETH1::PDU_DisturbFalseEventTiming::ServiceDiscoveryViWi_ICAS3IVI_XIX_E3V_VLAN_Infotainment == 1)
  {
    SetBusContext(gILETH1_BusContext);
    ILSetPDUTimingEvent(ETH_Cluster_MEB::ServiceDiscoveryViWi_ICAS3IVI_XIX_E3V_VLAN_Infotainment, 0, @sysvar::IL_ETH1::PDU_FIFalseEventEnable::ServiceDiscoveryViWi_ICAS3IVI_XIX_E3V_VLAN_Infotainment, @sysvar::IL_ETH1::PDU_FIFalseEventRepCount::ServiceDiscoveryViWi_ICAS3IVI_XIX_E3V_VLAN_Infotainment, @sysvar::IL_ETH1::PDU_FIFalseEventRepPeriod::ServiceDiscoveryViWi_ICAS3IVI_XIX_E3V_VLAN_Infotainment, @sysvar::IL_ETH1::PDU_FIEventDebounceDelay::ServiceDiscoveryViWi_ICAS3IVI_XIX_E3V_VLAN_Infotainment, -1, 0);
  }
}

on sysvar_update sysvar::IL_ETH1::PDU_FIFalseEventRepPeriod::ServiceDiscoveryViWi_ICAS3IVI_XIX_E3V_VLAN_Infotainment
{
  if (@sysvar::IL_ETH1::PDU_DisturbFalseEventTiming::ServiceDiscoveryViWi_ICAS3IVI_XIX_E3V_VLAN_Infotainment == 1)
  {
    SetBusContext(gILETH1_BusContext);
    ILSetPDUTimingEvent(ETH_Cluster_MEB::ServiceDiscoveryViWi_ICAS3IVI_XIX_E3V_VLAN_Infotainment, 0, @sysvar::IL_ETH1::PDU_FIFalseEventEnable::ServiceDiscoveryViWi_ICAS3IVI_XIX_E3V_VLAN_Infotainment, @sysvar::IL_ETH1::PDU_FIFalseEventRepCount::ServiceDiscoveryViWi_ICAS3IVI_XIX_E3V_VLAN_Infotainment, @sysvar::IL_ETH1::PDU_FIFalseEventRepPeriod::ServiceDiscoveryViWi_ICAS3IVI_XIX_E3V_VLAN_Infotainment, @sysvar::IL_ETH1::PDU_FIEventDebounceDelay::ServiceDiscoveryViWi_ICAS3IVI_XIX_E3V_VLAN_Infotainment, -1, 0);
  }
}

on sysvar_update sysvar::IL_ETH1::PDU_DisturbTimingMode::SomeIP_ServiceProvider_ICAS3IVI_ICAS1Sys01_UC_01_XIX_E3V_VLAN_Infotainment
{
  if (@this == 1)
  {
    SetBusContext(gILETH1_BusContext);
    ILSetPDUAsrTXMode(ETH_Cluster_MEB::SomeIP_ServiceProvider_ICAS3IVI_ICAS1Sys01_UC_01_XIX_E3V_VLAN_Infotainment, @sysvar::IL_ETH1::PDU_FITimingMode::SomeIP_ServiceProvider_ICAS3IVI_ICAS1Sys01_UC_01_XIX_E3V_VLAN_Infotainment, -1, 0);
  }
  else
  {
    SetBusContext(gILETH1_BusContext);
    ILResetPDUAsrTXMode(ETH_Cluster_MEB::SomeIP_ServiceProvider_ICAS3IVI_ICAS1Sys01_UC_01_XIX_E3V_VLAN_Infotainment);
  }
}

on sysvar_update sysvar::IL_ETH1::PDU_FITimingMode::SomeIP_ServiceProvider_ICAS3IVI_ICAS1Sys01_UC_01_XIX_E3V_VLAN_Infotainment
{
  if (@sysvar::IL_ETH1::PDU_DisturbTimingMode::SomeIP_ServiceProvider_ICAS3IVI_ICAS1Sys01_UC_01_XIX_E3V_VLAN_Infotainment == 1)
  {
    SetBusContext(gILETH1_BusContext);
    ILSetPDUAsrTXMode(ETH_Cluster_MEB::SomeIP_ServiceProvider_ICAS3IVI_ICAS1Sys01_UC_01_XIX_E3V_VLAN_Infotainment, @sysvar::IL_ETH1::PDU_FITimingMode::SomeIP_ServiceProvider_ICAS3IVI_ICAS1Sys01_UC_01_XIX_E3V_VLAN_Infotainment, -1, 0);
  }
}

on sysvar_update sysvar::IL_ETH1::PDU_DisturbTrueCyclicTiming::SomeIP_ServiceProvider_ICAS3IVI_ICAS1Sys01_UC_01_XIX_E3V_VLAN_Infotainment
{
  if (@this == 1)
  {
    SetBusContext(gILETH1_BusContext);
    ILSetPDUTimingCyclic(ETH_Cluster_MEB::SomeIP_ServiceProvider_ICAS3IVI_ICAS1Sys01_UC_01_XIX_E3V_VLAN_Infotainment, 1, 0, @sysvar::IL_ETH1::PDU_FITrueCyclicPeriod::SomeIP_ServiceProvider_ICAS3IVI_ICAS1Sys01_UC_01_XIX_E3V_VLAN_Infotainment, -1, 0);
  }
  else
  {
    SetBusContext(gILETH1_BusContext);
    ILResetPDUTimingCyclic(ETH_Cluster_MEB::SomeIP_ServiceProvider_ICAS3IVI_ICAS1Sys01_UC_01_XIX_E3V_VLAN_Infotainment, 1);
  }
}

on sysvar_update sysvar::IL_ETH1::PDU_FITrueCyclicPeriod::SomeIP_ServiceProvider_ICAS3IVI_ICAS1Sys01_UC_01_XIX_E3V_VLAN_Infotainment
{
  if (@sysvar::IL_ETH1::PDU_DisturbTrueCyclicTiming::SomeIP_ServiceProvider_ICAS3IVI_ICAS1Sys01_UC_01_XIX_E3V_VLAN_Infotainment == 1)
  {
    SetBusContext(gILETH1_BusContext);
    ILSetPDUTimingCyclic(ETH_Cluster_MEB::SomeIP_ServiceProvider_ICAS3IVI_ICAS1Sys01_UC_01_XIX_E3V_VLAN_Infotainment, 1, 0, @sysvar::IL_ETH1::PDU_FITrueCyclicPeriod::SomeIP_ServiceProvider_ICAS3IVI_ICAS1Sys01_UC_01_XIX_E3V_VLAN_Infotainment, -1, 0);
  }
}

on sysvar_update sysvar::IL_ETH1::PDU_DisturbFalseCyclicTiming::SomeIP_ServiceProvider_ICAS3IVI_ICAS1Sys01_UC_01_XIX_E3V_VLAN_Infotainment
{
  if (@this == 1)
  {
    SetBusContext(gILETH1_BusContext);
    ILSetPDUTimingCyclic(ETH_Cluster_MEB::SomeIP_ServiceProvider_ICAS3IVI_ICAS1Sys01_UC_01_XIX_E3V_VLAN_Infotainment, 0, 0, @sysvar::IL_ETH1::PDU_FIFalseCyclicPeriod::SomeIP_ServiceProvider_ICAS3IVI_ICAS1Sys01_UC_01_XIX_E3V_VLAN_Infotainment, -1, 0);
  }
  else
  {
    SetBusContext(gILETH1_BusContext);
    ILResetPDUTimingCyclic(ETH_Cluster_MEB::SomeIP_ServiceProvider_ICAS3IVI_ICAS1Sys01_UC_01_XIX_E3V_VLAN_Infotainment, 0);
  }
}

on sysvar_update sysvar::IL_ETH1::PDU_FIFalseCyclicPeriod::SomeIP_ServiceProvider_ICAS3IVI_ICAS1Sys01_UC_01_XIX_E3V_VLAN_Infotainment
{
  if (@sysvar::IL_ETH1::PDU_DisturbFalseCyclicTiming::SomeIP_ServiceProvider_ICAS3IVI_ICAS1Sys01_UC_01_XIX_E3V_VLAN_Infotainment == 1)
  {
    SetBusContext(gILETH1_BusContext);
    ILSetPDUTimingCyclic(ETH_Cluster_MEB::SomeIP_ServiceProvider_ICAS3IVI_ICAS1Sys01_UC_01_XIX_E3V_VLAN_Infotainment, 1, 0, @sysvar::IL_ETH1::PDU_FITrueCyclicPeriod::SomeIP_ServiceProvider_ICAS3IVI_ICAS1Sys01_UC_01_XIX_E3V_VLAN_Infotainment, -1, 0);
  }
}

on sysvar_update sysvar::IL_ETH1::PDU_SendOnce::SomeIP_ServiceProvider_ICAS3IVI_ICAS1Sys01_UC_01_XIX_E3V_VLAN_Infotainment
{
  if (@this == 1)
  {
    SetBusContext(gILETH1_BusContext);
    ILSetPDUEvent(ETH_Cluster_MEB::SomeIP_ServiceProvider_ICAS3IVI_ICAS1Sys01_UC_01_XIX_E3V_VLAN_Infotainment);
  }
}

on sysvar_update sysvar::IL_ETH1::PDU_DisturbTrueEventTiming::SomeIP_ServiceProvider_ICAS3IVI_ICAS1Sys01_UC_01_XIX_E3V_VLAN_Infotainment
{
  if (@this == 1)
  {
    SetBusContext(gILETH1_BusContext);
    ILSetPDUTimingEvent(ETH_Cluster_MEB::SomeIP_ServiceProvider_ICAS3IVI_ICAS1Sys01_UC_01_XIX_E3V_VLAN_Infotainment, 1, @sysvar::IL_ETH1::PDU_FITrueEventEnable::SomeIP_ServiceProvider_ICAS3IVI_ICAS1Sys01_UC_01_XIX_E3V_VLAN_Infotainment, @sysvar::IL_ETH1::PDU_FITrueEventRepCount::SomeIP_ServiceProvider_ICAS3IVI_ICAS1Sys01_UC_01_XIX_E3V_VLAN_Infotainment, @sysvar::IL_ETH1::PDU_FITrueEventRepPeriod::SomeIP_ServiceProvider_ICAS3IVI_ICAS1Sys01_UC_01_XIX_E3V_VLAN_Infotainment, @sysvar::IL_ETH1::PDU_FIEventDebounceDelay::SomeIP_ServiceProvider_ICAS3IVI_ICAS1Sys01_UC_01_XIX_E3V_VLAN_Infotainment, -1, 0);
  }
  else
  {
    SetBusContext(gILETH1_BusContext);
    ILResetPDUTimingEvent(ETH_Cluster_MEB::SomeIP_ServiceProvider_ICAS3IVI_ICAS1Sys01_UC_01_XIX_E3V_VLAN_Infotainment, 1);
  }
}

on sysvar_update sysvar::IL_ETH1::PDU_FITrueEventEnable::SomeIP_ServiceProvider_ICAS3IVI_ICAS1Sys01_UC_01_XIX_E3V_VLAN_Infotainment
{
  if (@sysvar::IL_ETH1::PDU_DisturbTrueEventTiming::SomeIP_ServiceProvider_ICAS3IVI_ICAS1Sys01_UC_01_XIX_E3V_VLAN_Infotainment == 1)
  {
    SetBusContext(gILETH1_BusContext);
    ILSetPDUTimingEvent(ETH_Cluster_MEB::SomeIP_ServiceProvider_ICAS3IVI_ICAS1Sys01_UC_01_XIX_E3V_VLAN_Infotainment, 1, @sysvar::IL_ETH1::PDU_FITrueEventEnable::SomeIP_ServiceProvider_ICAS3IVI_ICAS1Sys01_UC_01_XIX_E3V_VLAN_Infotainment, @sysvar::IL_ETH1::PDU_FITrueEventRepCount::SomeIP_ServiceProvider_ICAS3IVI_ICAS1Sys01_UC_01_XIX_E3V_VLAN_Infotainment, @sysvar::IL_ETH1::PDU_FITrueEventRepPeriod::SomeIP_ServiceProvider_ICAS3IVI_ICAS1Sys01_UC_01_XIX_E3V_VLAN_Infotainment, @sysvar::IL_ETH1::PDU_FIEventDebounceDelay::SomeIP_ServiceProvider_ICAS3IVI_ICAS1Sys01_UC_01_XIX_E3V_VLAN_Infotainment, -1, 0);
  }
}

on sysvar_update sysvar::IL_ETH1::PDU_FITrueEventRepCount::SomeIP_ServiceProvider_ICAS3IVI_ICAS1Sys01_UC_01_XIX_E3V_VLAN_Infotainment
{
  if (@sysvar::IL_ETH1::PDU_DisturbTrueEventTiming::SomeIP_ServiceProvider_ICAS3IVI_ICAS1Sys01_UC_01_XIX_E3V_VLAN_Infotainment == 1)
  {
    SetBusContext(gILETH1_BusContext);
    ILSetPDUTimingEvent(ETH_Cluster_MEB::SomeIP_ServiceProvider_ICAS3IVI_ICAS1Sys01_UC_01_XIX_E3V_VLAN_Infotainment, 1, @sysvar::IL_ETH1::PDU_FITrueEventEnable::SomeIP_ServiceProvider_ICAS3IVI_ICAS1Sys01_UC_01_XIX_E3V_VLAN_Infotainment, @sysvar::IL_ETH1::PDU_FITrueEventRepCount::SomeIP_ServiceProvider_ICAS3IVI_ICAS1Sys01_UC_01_XIX_E3V_VLAN_Infotainment, @sysvar::IL_ETH1::PDU_FITrueEventRepPeriod::SomeIP_ServiceProvider_ICAS3IVI_ICAS1Sys01_UC_01_XIX_E3V_VLAN_Infotainment, @sysvar::IL_ETH1::PDU_FIEventDebounceDelay::SomeIP_ServiceProvider_ICAS3IVI_ICAS1Sys01_UC_01_XIX_E3V_VLAN_Infotainment, -1, 0);
  }
}

on sysvar_update sysvar::IL_ETH1::PDU_FITrueEventRepPeriod::SomeIP_ServiceProvider_ICAS3IVI_ICAS1Sys01_UC_01_XIX_E3V_VLAN_Infotainment
{
  if (@sysvar::IL_ETH1::PDU_DisturbTrueEventTiming::SomeIP_ServiceProvider_ICAS3IVI_ICAS1Sys01_UC_01_XIX_E3V_VLAN_Infotainment == 1)
  {
    SetBusContext(gILETH1_BusContext);
    ILSetPDUTimingEvent(ETH_Cluster_MEB::SomeIP_ServiceProvider_ICAS3IVI_ICAS1Sys01_UC_01_XIX_E3V_VLAN_Infotainment, 1, @sysvar::IL_ETH1::PDU_FITrueEventEnable::SomeIP_ServiceProvider_ICAS3IVI_ICAS1Sys01_UC_01_XIX_E3V_VLAN_Infotainment, @sysvar::IL_ETH1::PDU_FITrueEventRepCount::SomeIP_ServiceProvider_ICAS3IVI_ICAS1Sys01_UC_01_XIX_E3V_VLAN_Infotainment, @sysvar::IL_ETH1::PDU_FITrueEventRepPeriod::SomeIP_ServiceProvider_ICAS3IVI_ICAS1Sys01_UC_01_XIX_E3V_VLAN_Infotainment, @sysvar::IL_ETH1::PDU_FIEventDebounceDelay::SomeIP_ServiceProvider_ICAS3IVI_ICAS1Sys01_UC_01_XIX_E3V_VLAN_Infotainment, -1, 0);
  }
}

on sysvar_update sysvar::IL_ETH1::PDU_FIEventDebounceDelay::SomeIP_ServiceProvider_ICAS3IVI_ICAS1Sys01_UC_01_XIX_E3V_VLAN_Infotainment
{
  if (@sysvar::IL_ETH1::PDU_DisturbTrueEventTiming::SomeIP_ServiceProvider_ICAS3IVI_ICAS1Sys01_UC_01_XIX_E3V_VLAN_Infotainment == 1)
  {
    SetBusContext(gILETH1_BusContext);
    ILSetPDUTimingEvent(ETH_Cluster_MEB::SomeIP_ServiceProvider_ICAS3IVI_ICAS1Sys01_UC_01_XIX_E3V_VLAN_Infotainment, 1, @sysvar::IL_ETH1::PDU_FITrueEventEnable::SomeIP_ServiceProvider_ICAS3IVI_ICAS1Sys01_UC_01_XIX_E3V_VLAN_Infotainment, @sysvar::IL_ETH1::PDU_FITrueEventRepCount::SomeIP_ServiceProvider_ICAS3IVI_ICAS1Sys01_UC_01_XIX_E3V_VLAN_Infotainment, @sysvar::IL_ETH1::PDU_FITrueEventRepPeriod::SomeIP_ServiceProvider_ICAS3IVI_ICAS1Sys01_UC_01_XIX_E3V_VLAN_Infotainment, @sysvar::IL_ETH1::PDU_FIEventDebounceDelay::SomeIP_ServiceProvider_ICAS3IVI_ICAS1Sys01_UC_01_XIX_E3V_VLAN_Infotainment, -1, 0);
  }
  if (@sysvar::IL_ETH1::PDU_DisturbFalseEventTiming::SomeIP_ServiceProvider_ICAS3IVI_ICAS1Sys01_UC_01_XIX_E3V_VLAN_Infotainment == 1)
  {
    SetBusContext(gILETH1_BusContext);
    ILSetPDUTimingEvent(ETH_Cluster_MEB::SomeIP_ServiceProvider_ICAS3IVI_ICAS1Sys01_UC_01_XIX_E3V_VLAN_Infotainment, 0, @sysvar::IL_ETH1::PDU_FIFalseEventEnable::SomeIP_ServiceProvider_ICAS3IVI_ICAS1Sys01_UC_01_XIX_E3V_VLAN_Infotainment, @sysvar::IL_ETH1::PDU_FIFalseEventRepCount::SomeIP_ServiceProvider_ICAS3IVI_ICAS1Sys01_UC_01_XIX_E3V_VLAN_Infotainment, @sysvar::IL_ETH1::PDU_FIFalseEventRepPeriod::SomeIP_ServiceProvider_ICAS3IVI_ICAS1Sys01_UC_01_XIX_E3V_VLAN_Infotainment, @sysvar::IL_ETH1::PDU_FIEventDebounceDelay::SomeIP_ServiceProvider_ICAS3IVI_ICAS1Sys01_UC_01_XIX_E3V_VLAN_Infotainment, -1, 0);
  }
}

on sysvar_update sysvar::IL_ETH1::PDU_DisturbFalseEventTiming::SomeIP_ServiceProvider_ICAS3IVI_ICAS1Sys01_UC_01_XIX_E3V_VLAN_Infotainment
{
  if (@this == 1)
  {
    SetBusContext(gILETH1_BusContext);
    ILSetPDUTimingEvent(ETH_Cluster_MEB::SomeIP_ServiceProvider_ICAS3IVI_ICAS1Sys01_UC_01_XIX_E3V_VLAN_Infotainment, 0, @sysvar::IL_ETH1::PDU_FIFalseEventEnable::SomeIP_ServiceProvider_ICAS3IVI_ICAS1Sys01_UC_01_XIX_E3V_VLAN_Infotainment, @sysvar::IL_ETH1::PDU_FIFalseEventRepCount::SomeIP_ServiceProvider_ICAS3IVI_ICAS1Sys01_UC_01_XIX_E3V_VLAN_Infotainment, @sysvar::IL_ETH1::PDU_FIFalseEventRepPeriod::SomeIP_ServiceProvider_ICAS3IVI_ICAS1Sys01_UC_01_XIX_E3V_VLAN_Infotainment, @sysvar::IL_ETH1::PDU_FIEventDebounceDelay::SomeIP_ServiceProvider_ICAS3IVI_ICAS1Sys01_UC_01_XIX_E3V_VLAN_Infotainment, -1, 0);
  }
  else
  {
    SetBusContext(gILETH1_BusContext);
    ILResetPDUTimingEvent(ETH_Cluster_MEB::SomeIP_ServiceProvider_ICAS3IVI_ICAS1Sys01_UC_01_XIX_E3V_VLAN_Infotainment, 0);
  }
}

on sysvar_update sysvar::IL_ETH1::PDU_FIFalseEventEnable::SomeIP_ServiceProvider_ICAS3IVI_ICAS1Sys01_UC_01_XIX_E3V_VLAN_Infotainment
{
  if (@sysvar::IL_ETH1::PDU_DisturbFalseEventTiming::SomeIP_ServiceProvider_ICAS3IVI_ICAS1Sys01_UC_01_XIX_E3V_VLAN_Infotainment == 1)
  {
    SetBusContext(gILETH1_BusContext);
    ILSetPDUTimingEvent(ETH_Cluster_MEB::SomeIP_ServiceProvider_ICAS3IVI_ICAS1Sys01_UC_01_XIX_E3V_VLAN_Infotainment, 0, @sysvar::IL_ETH1::PDU_FIFalseEventEnable::SomeIP_ServiceProvider_ICAS3IVI_ICAS1Sys01_UC_01_XIX_E3V_VLAN_Infotainment, @sysvar::IL_ETH1::PDU_FIFalseEventRepCount::SomeIP_ServiceProvider_ICAS3IVI_ICAS1Sys01_UC_01_XIX_E3V_VLAN_Infotainment, @sysvar::IL_ETH1::PDU_FIFalseEventRepPeriod::SomeIP_ServiceProvider_ICAS3IVI_ICAS1Sys01_UC_01_XIX_E3V_VLAN_Infotainment, @sysvar::IL_ETH1::PDU_FIEventDebounceDelay::SomeIP_ServiceProvider_ICAS3IVI_ICAS1Sys01_UC_01_XIX_E3V_VLAN_Infotainment, -1, 0);
  }
}

on sysvar_update sysvar::IL_ETH1::PDU_FIFalseEventRepCount::SomeIP_ServiceProvider_ICAS3IVI_ICAS1Sys01_UC_01_XIX_E3V_VLAN_Infotainment
{
  if (@sysvar::IL_ETH1::PDU_DisturbFalseEventTiming::SomeIP_ServiceProvider_ICAS3IVI_ICAS1Sys01_UC_01_XIX_E3V_VLAN_Infotainment == 1)
  {
    SetBusContext(gILETH1_BusContext);
    ILSetPDUTimingEvent(ETH_Cluster_MEB::SomeIP_ServiceProvider_ICAS3IVI_ICAS1Sys01_UC_01_XIX_E3V_VLAN_Infotainment, 0, @sysvar::IL_ETH1::PDU_FIFalseEventEnable::SomeIP_ServiceProvider_ICAS3IVI_ICAS1Sys01_UC_01_XIX_E3V_VLAN_Infotainment, @sysvar::IL_ETH1::PDU_FIFalseEventRepCount::SomeIP_ServiceProvider_ICAS3IVI_ICAS1Sys01_UC_01_XIX_E3V_VLAN_Infotainment, @sysvar::IL_ETH1::PDU_FIFalseEventRepPeriod::SomeIP_ServiceProvider_ICAS3IVI_ICAS1Sys01_UC_01_XIX_E3V_VLAN_Infotainment, @sysvar::IL_ETH1::PDU_FIEventDebounceDelay::SomeIP_ServiceProvider_ICAS3IVI_ICAS1Sys01_UC_01_XIX_E3V_VLAN_Infotainment, -1, 0);
  }
}

on sysvar_update sysvar::IL_ETH1::PDU_FIFalseEventRepPeriod::SomeIP_ServiceProvider_ICAS3IVI_ICAS1Sys01_UC_01_XIX_E3V_VLAN_Infotainment
{
  if (@sysvar::IL_ETH1::PDU_DisturbFalseEventTiming::SomeIP_ServiceProvider_ICAS3IVI_ICAS1Sys01_UC_01_XIX_E3V_VLAN_Infotainment == 1)
  {
    SetBusContext(gILETH1_BusContext);
    ILSetPDUTimingEvent(ETH_Cluster_MEB::SomeIP_ServiceProvider_ICAS3IVI_ICAS1Sys01_UC_01_XIX_E3V_VLAN_Infotainment, 0, @sysvar::IL_ETH1::PDU_FIFalseEventEnable::SomeIP_ServiceProvider_ICAS3IVI_ICAS1Sys01_UC_01_XIX_E3V_VLAN_Infotainment, @sysvar::IL_ETH1::PDU_FIFalseEventRepCount::SomeIP_ServiceProvider_ICAS3IVI_ICAS1Sys01_UC_01_XIX_E3V_VLAN_Infotainment, @sysvar::IL_ETH1::PDU_FIFalseEventRepPeriod::SomeIP_ServiceProvider_ICAS3IVI_ICAS1Sys01_UC_01_XIX_E3V_VLAN_Infotainment, @sysvar::IL_ETH1::PDU_FIEventDebounceDelay::SomeIP_ServiceProvider_ICAS3IVI_ICAS1Sys01_UC_01_XIX_E3V_VLAN_Infotainment, -1, 0);
  }
}

on sysvar_update sysvar::IL_ETH1::PDU_DisturbTimingMode::SSOA_ICAS3IVI_MC_XIX_E3V_VLAN_Infotainment
{
  if (@this == 1)
  {
    SetBusContext(gILETH1_BusContext);
    ILSetPDUAsrTXMode(ETH_Cluster_MEB::SSOA_ICAS3IVI_MC_XIX_E3V_VLAN_Infotainment, @sysvar::IL_ETH1::PDU_FITimingMode::SSOA_ICAS3IVI_MC_XIX_E3V_VLAN_Infotainment, -1, 0);
  }
  else
  {
    SetBusContext(gILETH1_BusContext);
    ILResetPDUAsrTXMode(ETH_Cluster_MEB::SSOA_ICAS3IVI_MC_XIX_E3V_VLAN_Infotainment);
  }
}

on sysvar_update sysvar::IL_ETH1::PDU_FITimingMode::SSOA_ICAS3IVI_MC_XIX_E3V_VLAN_Infotainment
{
  if (@sysvar::IL_ETH1::PDU_DisturbTimingMode::SSOA_ICAS3IVI_MC_XIX_E3V_VLAN_Infotainment == 1)
  {
    SetBusContext(gILETH1_BusContext);
    ILSetPDUAsrTXMode(ETH_Cluster_MEB::SSOA_ICAS3IVI_MC_XIX_E3V_VLAN_Infotainment, @sysvar::IL_ETH1::PDU_FITimingMode::SSOA_ICAS3IVI_MC_XIX_E3V_VLAN_Infotainment, -1, 0);
  }
}

on sysvar_update sysvar::IL_ETH1::PDU_DisturbTrueCyclicTiming::SSOA_ICAS3IVI_MC_XIX_E3V_VLAN_Infotainment
{
  if (@this == 1)
  {
    SetBusContext(gILETH1_BusContext);
    ILSetPDUTimingCyclic(ETH_Cluster_MEB::SSOA_ICAS3IVI_MC_XIX_E3V_VLAN_Infotainment, 1, 0, @sysvar::IL_ETH1::PDU_FITrueCyclicPeriod::SSOA_ICAS3IVI_MC_XIX_E3V_VLAN_Infotainment, -1, 0);
  }
  else
  {
    SetBusContext(gILETH1_BusContext);
    ILResetPDUTimingCyclic(ETH_Cluster_MEB::SSOA_ICAS3IVI_MC_XIX_E3V_VLAN_Infotainment, 1);
  }
}

on sysvar_update sysvar::IL_ETH1::PDU_FITrueCyclicPeriod::SSOA_ICAS3IVI_MC_XIX_E3V_VLAN_Infotainment
{
  if (@sysvar::IL_ETH1::PDU_DisturbTrueCyclicTiming::SSOA_ICAS3IVI_MC_XIX_E3V_VLAN_Infotainment == 1)
  {
    SetBusContext(gILETH1_BusContext);
    ILSetPDUTimingCyclic(ETH_Cluster_MEB::SSOA_ICAS3IVI_MC_XIX_E3V_VLAN_Infotainment, 1, 0, @sysvar::IL_ETH1::PDU_FITrueCyclicPeriod::SSOA_ICAS3IVI_MC_XIX_E3V_VLAN_Infotainment, -1, 0);
  }
}

on sysvar_update sysvar::IL_ETH1::PDU_DisturbFalseCyclicTiming::SSOA_ICAS3IVI_MC_XIX_E3V_VLAN_Infotainment
{
  if (@this == 1)
  {
    SetBusContext(gILETH1_BusContext);
    ILSetPDUTimingCyclic(ETH_Cluster_MEB::SSOA_ICAS3IVI_MC_XIX_E3V_VLAN_Infotainment, 0, 0, @sysvar::IL_ETH1::PDU_FIFalseCyclicPeriod::SSOA_ICAS3IVI_MC_XIX_E3V_VLAN_Infotainment, -1, 0);
  }
  else
  {
    SetBusContext(gILETH1_BusContext);
    ILResetPDUTimingCyclic(ETH_Cluster_MEB::SSOA_ICAS3IVI_MC_XIX_E3V_VLAN_Infotainment, 0);
  }
}

on sysvar_update sysvar::IL_ETH1::PDU_FIFalseCyclicPeriod::SSOA_ICAS3IVI_MC_XIX_E3V_VLAN_Infotainment
{
  if (@sysvar::IL_ETH1::PDU_DisturbFalseCyclicTiming::SSOA_ICAS3IVI_MC_XIX_E3V_VLAN_Infotainment == 1)
  {
    SetBusContext(gILETH1_BusContext);
    ILSetPDUTimingCyclic(ETH_Cluster_MEB::SSOA_ICAS3IVI_MC_XIX_E3V_VLAN_Infotainment, 1, 0, @sysvar::IL_ETH1::PDU_FITrueCyclicPeriod::SSOA_ICAS3IVI_MC_XIX_E3V_VLAN_Infotainment, -1, 0);
  }
}

on sysvar_update sysvar::IL_ETH1::PDU_SendOnce::SSOA_ICAS3IVI_MC_XIX_E3V_VLAN_Infotainment
{
  if (@this == 1)
  {
    SetBusContext(gILETH1_BusContext);
    ILSetPDUEvent(ETH_Cluster_MEB::SSOA_ICAS3IVI_MC_XIX_E3V_VLAN_Infotainment);
  }
}

on sysvar_update sysvar::IL_ETH1::PDU_DisturbTrueEventTiming::SSOA_ICAS3IVI_MC_XIX_E3V_VLAN_Infotainment
{
  if (@this == 1)
  {
    SetBusContext(gILETH1_BusContext);
    ILSetPDUTimingEvent(ETH_Cluster_MEB::SSOA_ICAS3IVI_MC_XIX_E3V_VLAN_Infotainment, 1, @sysvar::IL_ETH1::PDU_FITrueEventEnable::SSOA_ICAS3IVI_MC_XIX_E3V_VLAN_Infotainment, @sysvar::IL_ETH1::PDU_FITrueEventRepCount::SSOA_ICAS3IVI_MC_XIX_E3V_VLAN_Infotainment, @sysvar::IL_ETH1::PDU_FITrueEventRepPeriod::SSOA_ICAS3IVI_MC_XIX_E3V_VLAN_Infotainment, @sysvar::IL_ETH1::PDU_FIEventDebounceDelay::SSOA_ICAS3IVI_MC_XIX_E3V_VLAN_Infotainment, -1, 0);
  }
  else
  {
    SetBusContext(gILETH1_BusContext);
    ILResetPDUTimingEvent(ETH_Cluster_MEB::SSOA_ICAS3IVI_MC_XIX_E3V_VLAN_Infotainment, 1);
  }
}

on sysvar_update sysvar::IL_ETH1::PDU_FITrueEventEnable::SSOA_ICAS3IVI_MC_XIX_E3V_VLAN_Infotainment
{
  if (@sysvar::IL_ETH1::PDU_DisturbTrueEventTiming::SSOA_ICAS3IVI_MC_XIX_E3V_VLAN_Infotainment == 1)
  {
    SetBusContext(gILETH1_BusContext);
    ILSetPDUTimingEvent(ETH_Cluster_MEB::SSOA_ICAS3IVI_MC_XIX_E3V_VLAN_Infotainment, 1, @sysvar::IL_ETH1::PDU_FITrueEventEnable::SSOA_ICAS3IVI_MC_XIX_E3V_VLAN_Infotainment, @sysvar::IL_ETH1::PDU_FITrueEventRepCount::SSOA_ICAS3IVI_MC_XIX_E3V_VLAN_Infotainment, @sysvar::IL_ETH1::PDU_FITrueEventRepPeriod::SSOA_ICAS3IVI_MC_XIX_E3V_VLAN_Infotainment, @sysvar::IL_ETH1::PDU_FIEventDebounceDelay::SSOA_ICAS3IVI_MC_XIX_E3V_VLAN_Infotainment, -1, 0);
  }
}

on sysvar_update sysvar::IL_ETH1::PDU_FITrueEventRepCount::SSOA_ICAS3IVI_MC_XIX_E3V_VLAN_Infotainment
{
  if (@sysvar::IL_ETH1::PDU_DisturbTrueEventTiming::SSOA_ICAS3IVI_MC_XIX_E3V_VLAN_Infotainment == 1)
  {
    SetBusContext(gILETH1_BusContext);
    ILSetPDUTimingEvent(ETH_Cluster_MEB::SSOA_ICAS3IVI_MC_XIX_E3V_VLAN_Infotainment, 1, @sysvar::IL_ETH1::PDU_FITrueEventEnable::SSOA_ICAS3IVI_MC_XIX_E3V_VLAN_Infotainment, @sysvar::IL_ETH1::PDU_FITrueEventRepCount::SSOA_ICAS3IVI_MC_XIX_E3V_VLAN_Infotainment, @sysvar::IL_ETH1::PDU_FITrueEventRepPeriod::SSOA_ICAS3IVI_MC_XIX_E3V_VLAN_Infotainment, @sysvar::IL_ETH1::PDU_FIEventDebounceDelay::SSOA_ICAS3IVI_MC_XIX_E3V_VLAN_Infotainment, -1, 0);
  }
}

on sysvar_update sysvar::IL_ETH1::PDU_FITrueEventRepPeriod::SSOA_ICAS3IVI_MC_XIX_E3V_VLAN_Infotainment
{
  if (@sysvar::IL_ETH1::PDU_DisturbTrueEventTiming::SSOA_ICAS3IVI_MC_XIX_E3V_VLAN_Infotainment == 1)
  {
    SetBusContext(gILETH1_BusContext);
    ILSetPDUTimingEvent(ETH_Cluster_MEB::SSOA_ICAS3IVI_MC_XIX_E3V_VLAN_Infotainment, 1, @sysvar::IL_ETH1::PDU_FITrueEventEnable::SSOA_ICAS3IVI_MC_XIX_E3V_VLAN_Infotainment, @sysvar::IL_ETH1::PDU_FITrueEventRepCount::SSOA_ICAS3IVI_MC_XIX_E3V_VLAN_Infotainment, @sysvar::IL_ETH1::PDU_FITrueEventRepPeriod::SSOA_ICAS3IVI_MC_XIX_E3V_VLAN_Infotainment, @sysvar::IL_ETH1::PDU_FIEventDebounceDelay::SSOA_ICAS3IVI_MC_XIX_E3V_VLAN_Infotainment, -1, 0);
  }
}

on sysvar_update sysvar::IL_ETH1::PDU_FIEventDebounceDelay::SSOA_ICAS3IVI_MC_XIX_E3V_VLAN_Infotainment
{
  if (@sysvar::IL_ETH1::PDU_DisturbTrueEventTiming::SSOA_ICAS3IVI_MC_XIX_E3V_VLAN_Infotainment == 1)
  {
    SetBusContext(gILETH1_BusContext);
    ILSetPDUTimingEvent(ETH_Cluster_MEB::SSOA_ICAS3IVI_MC_XIX_E3V_VLAN_Infotainment, 1, @sysvar::IL_ETH1::PDU_FITrueEventEnable::SSOA_ICAS3IVI_MC_XIX_E3V_VLAN_Infotainment, @sysvar::IL_ETH1::PDU_FITrueEventRepCount::SSOA_ICAS3IVI_MC_XIX_E3V_VLAN_Infotainment, @sysvar::IL_ETH1::PDU_FITrueEventRepPeriod::SSOA_ICAS3IVI_MC_XIX_E3V_VLAN_Infotainment, @sysvar::IL_ETH1::PDU_FIEventDebounceDelay::SSOA_ICAS3IVI_MC_XIX_E3V_VLAN_Infotainment, -1, 0);
  }
  if (@sysvar::IL_ETH1::PDU_DisturbFalseEventTiming::SSOA_ICAS3IVI_MC_XIX_E3V_VLAN_Infotainment == 1)
  {
    SetBusContext(gILETH1_BusContext);
    ILSetPDUTimingEvent(ETH_Cluster_MEB::SSOA_ICAS3IVI_MC_XIX_E3V_VLAN_Infotainment, 0, @sysvar::IL_ETH1::PDU_FIFalseEventEnable::SSOA_ICAS3IVI_MC_XIX_E3V_VLAN_Infotainment, @sysvar::IL_ETH1::PDU_FIFalseEventRepCount::SSOA_ICAS3IVI_MC_XIX_E3V_VLAN_Infotainment, @sysvar::IL_ETH1::PDU_FIFalseEventRepPeriod::SSOA_ICAS3IVI_MC_XIX_E3V_VLAN_Infotainment, @sysvar::IL_ETH1::PDU_FIEventDebounceDelay::SSOA_ICAS3IVI_MC_XIX_E3V_VLAN_Infotainment, -1, 0);
  }
}

on sysvar_update sysvar::IL_ETH1::PDU_DisturbFalseEventTiming::SSOA_ICAS3IVI_MC_XIX_E3V_VLAN_Infotainment
{
  if (@this == 1)
  {
    SetBusContext(gILETH1_BusContext);
    ILSetPDUTimingEvent(ETH_Cluster_MEB::SSOA_ICAS3IVI_MC_XIX_E3V_VLAN_Infotainment, 0, @sysvar::IL_ETH1::PDU_FIFalseEventEnable::SSOA_ICAS3IVI_MC_XIX_E3V_VLAN_Infotainment, @sysvar::IL_ETH1::PDU_FIFalseEventRepCount::SSOA_ICAS3IVI_MC_XIX_E3V_VLAN_Infotainment, @sysvar::IL_ETH1::PDU_FIFalseEventRepPeriod::SSOA_ICAS3IVI_MC_XIX_E3V_VLAN_Infotainment, @sysvar::IL_ETH1::PDU_FIEventDebounceDelay::SSOA_ICAS3IVI_MC_XIX_E3V_VLAN_Infotainment, -1, 0);
  }
  else
  {
    SetBusContext(gILETH1_BusContext);
    ILResetPDUTimingEvent(ETH_Cluster_MEB::SSOA_ICAS3IVI_MC_XIX_E3V_VLAN_Infotainment, 0);
  }
}

on sysvar_update sysvar::IL_ETH1::PDU_FIFalseEventEnable::SSOA_ICAS3IVI_MC_XIX_E3V_VLAN_Infotainment
{
  if (@sysvar::IL_ETH1::PDU_DisturbFalseEventTiming::SSOA_ICAS3IVI_MC_XIX_E3V_VLAN_Infotainment == 1)
  {
    SetBusContext(gILETH1_BusContext);
    ILSetPDUTimingEvent(ETH_Cluster_MEB::SSOA_ICAS3IVI_MC_XIX_E3V_VLAN_Infotainment, 0, @sysvar::IL_ETH1::PDU_FIFalseEventEnable::SSOA_ICAS3IVI_MC_XIX_E3V_VLAN_Infotainment, @sysvar::IL_ETH1::PDU_FIFalseEventRepCount::SSOA_ICAS3IVI_MC_XIX_E3V_VLAN_Infotainment, @sysvar::IL_ETH1::PDU_FIFalseEventRepPeriod::SSOA_ICAS3IVI_MC_XIX_E3V_VLAN_Infotainment, @sysvar::IL_ETH1::PDU_FIEventDebounceDelay::SSOA_ICAS3IVI_MC_XIX_E3V_VLAN_Infotainment, -1, 0);
  }
}

on sysvar_update sysvar::IL_ETH1::PDU_FIFalseEventRepCount::SSOA_ICAS3IVI_MC_XIX_E3V_VLAN_Infotainment
{
  if (@sysvar::IL_ETH1::PDU_DisturbFalseEventTiming::SSOA_ICAS3IVI_MC_XIX_E3V_VLAN_Infotainment == 1)
  {
    SetBusContext(gILETH1_BusContext);
    ILSetPDUTimingEvent(ETH_Cluster_MEB::SSOA_ICAS3IVI_MC_XIX_E3V_VLAN_Infotainment, 0, @sysvar::IL_ETH1::PDU_FIFalseEventEnable::SSOA_ICAS3IVI_MC_XIX_E3V_VLAN_Infotainment, @sysvar::IL_ETH1::PDU_FIFalseEventRepCount::SSOA_ICAS3IVI_MC_XIX_E3V_VLAN_Infotainment, @sysvar::IL_ETH1::PDU_FIFalseEventRepPeriod::SSOA_ICAS3IVI_MC_XIX_E3V_VLAN_Infotainment, @sysvar::IL_ETH1::PDU_FIEventDebounceDelay::SSOA_ICAS3IVI_MC_XIX_E3V_VLAN_Infotainment, -1, 0);
  }
}

on sysvar_update sysvar::IL_ETH1::PDU_FIFalseEventRepPeriod::SSOA_ICAS3IVI_MC_XIX_E3V_VLAN_Infotainment
{
  if (@sysvar::IL_ETH1::PDU_DisturbFalseEventTiming::SSOA_ICAS3IVI_MC_XIX_E3V_VLAN_Infotainment == 1)
  {
    SetBusContext(gILETH1_BusContext);
    ILSetPDUTimingEvent(ETH_Cluster_MEB::SSOA_ICAS3IVI_MC_XIX_E3V_VLAN_Infotainment, 0, @sysvar::IL_ETH1::PDU_FIFalseEventEnable::SSOA_ICAS3IVI_MC_XIX_E3V_VLAN_Infotainment, @sysvar::IL_ETH1::PDU_FIFalseEventRepCount::SSOA_ICAS3IVI_MC_XIX_E3V_VLAN_Infotainment, @sysvar::IL_ETH1::PDU_FIFalseEventRepPeriod::SSOA_ICAS3IVI_MC_XIX_E3V_VLAN_Infotainment, @sysvar::IL_ETH1::PDU_FIEventDebounceDelay::SSOA_ICAS3IVI_MC_XIX_E3V_VLAN_Infotainment, -1, 0);
  }
}

on sysvar_update sysvar::IL_ETH1::PDU_DisturbTimingMode::TCPServer_SomeIP_01_ICAS3IVI_ICAS1Sys01_XIX_E3V_VLAN_Infotainment
{
  if (@this == 1)
  {
    SetBusContext(gILETH1_BusContext);
    ILSetPDUAsrTXMode(ETH_Cluster_MEB::TCPServer_SomeIP_01_ICAS3IVI_ICAS1Sys01_XIX_E3V_VLAN_Infotainment, @sysvar::IL_ETH1::PDU_FITimingMode::TCPServer_SomeIP_01_ICAS3IVI_ICAS1Sys01_XIX_E3V_VLAN_Infotainment, -1, 0);
  }
  else
  {
    SetBusContext(gILETH1_BusContext);
    ILResetPDUAsrTXMode(ETH_Cluster_MEB::TCPServer_SomeIP_01_ICAS3IVI_ICAS1Sys01_XIX_E3V_VLAN_Infotainment);
  }
}

on sysvar_update sysvar::IL_ETH1::PDU_FITimingMode::TCPServer_SomeIP_01_ICAS3IVI_ICAS1Sys01_XIX_E3V_VLAN_Infotainment
{
  if (@sysvar::IL_ETH1::PDU_DisturbTimingMode::TCPServer_SomeIP_01_ICAS3IVI_ICAS1Sys01_XIX_E3V_VLAN_Infotainment == 1)
  {
    SetBusContext(gILETH1_BusContext);
    ILSetPDUAsrTXMode(ETH_Cluster_MEB::TCPServer_SomeIP_01_ICAS3IVI_ICAS1Sys01_XIX_E3V_VLAN_Infotainment, @sysvar::IL_ETH1::PDU_FITimingMode::TCPServer_SomeIP_01_ICAS3IVI_ICAS1Sys01_XIX_E3V_VLAN_Infotainment, -1, 0);
  }
}

on sysvar_update sysvar::IL_ETH1::PDU_DisturbTrueCyclicTiming::TCPServer_SomeIP_01_ICAS3IVI_ICAS1Sys01_XIX_E3V_VLAN_Infotainment
{
  if (@this == 1)
  {
    SetBusContext(gILETH1_BusContext);
    ILSetPDUTimingCyclic(ETH_Cluster_MEB::TCPServer_SomeIP_01_ICAS3IVI_ICAS1Sys01_XIX_E3V_VLAN_Infotainment, 1, 0, @sysvar::IL_ETH1::PDU_FITrueCyclicPeriod::TCPServer_SomeIP_01_ICAS3IVI_ICAS1Sys01_XIX_E3V_VLAN_Infotainment, -1, 0);
  }
  else
  {
    SetBusContext(gILETH1_BusContext);
    ILResetPDUTimingCyclic(ETH_Cluster_MEB::TCPServer_SomeIP_01_ICAS3IVI_ICAS1Sys01_XIX_E3V_VLAN_Infotainment, 1);
  }
}

on sysvar_update sysvar::IL_ETH1::PDU_FITrueCyclicPeriod::TCPServer_SomeIP_01_ICAS3IVI_ICAS1Sys01_XIX_E3V_VLAN_Infotainment
{
  if (@sysvar::IL_ETH1::PDU_DisturbTrueCyclicTiming::TCPServer_SomeIP_01_ICAS3IVI_ICAS1Sys01_XIX_E3V_VLAN_Infotainment == 1)
  {
    SetBusContext(gILETH1_BusContext);
    ILSetPDUTimingCyclic(ETH_Cluster_MEB::TCPServer_SomeIP_01_ICAS3IVI_ICAS1Sys01_XIX_E3V_VLAN_Infotainment, 1, 0, @sysvar::IL_ETH1::PDU_FITrueCyclicPeriod::TCPServer_SomeIP_01_ICAS3IVI_ICAS1Sys01_XIX_E3V_VLAN_Infotainment, -1, 0);
  }
}

on sysvar_update sysvar::IL_ETH1::PDU_DisturbFalseCyclicTiming::TCPServer_SomeIP_01_ICAS3IVI_ICAS1Sys01_XIX_E3V_VLAN_Infotainment
{
  if (@this == 1)
  {
    SetBusContext(gILETH1_BusContext);
    ILSetPDUTimingCyclic(ETH_Cluster_MEB::TCPServer_SomeIP_01_ICAS3IVI_ICAS1Sys01_XIX_E3V_VLAN_Infotainment, 0, 0, @sysvar::IL_ETH1::PDU_FIFalseCyclicPeriod::TCPServer_SomeIP_01_ICAS3IVI_ICAS1Sys01_XIX_E3V_VLAN_Infotainment, -1, 0);
  }
  else
  {
    SetBusContext(gILETH1_BusContext);
    ILResetPDUTimingCyclic(ETH_Cluster_MEB::TCPServer_SomeIP_01_ICAS3IVI_ICAS1Sys01_XIX_E3V_VLAN_Infotainment, 0);
  }
}

on sysvar_update sysvar::IL_ETH1::PDU_FIFalseCyclicPeriod::TCPServer_SomeIP_01_ICAS3IVI_ICAS1Sys01_XIX_E3V_VLAN_Infotainment
{
  if (@sysvar::IL_ETH1::PDU_DisturbFalseCyclicTiming::TCPServer_SomeIP_01_ICAS3IVI_ICAS1Sys01_XIX_E3V_VLAN_Infotainment == 1)
  {
    SetBusContext(gILETH1_BusContext);
    ILSetPDUTimingCyclic(ETH_Cluster_MEB::TCPServer_SomeIP_01_ICAS3IVI_ICAS1Sys01_XIX_E3V_VLAN_Infotainment, 1, 0, @sysvar::IL_ETH1::PDU_FITrueCyclicPeriod::TCPServer_SomeIP_01_ICAS3IVI_ICAS1Sys01_XIX_E3V_VLAN_Infotainment, -1, 0);
  }
}

on sysvar_update sysvar::IL_ETH1::PDU_SendOnce::TCPServer_SomeIP_01_ICAS3IVI_ICAS1Sys01_XIX_E3V_VLAN_Infotainment
{
  if (@this == 1)
  {
    SetBusContext(gILETH1_BusContext);
    ILSetPDUEvent(ETH_Cluster_MEB::TCPServer_SomeIP_01_ICAS3IVI_ICAS1Sys01_XIX_E3V_VLAN_Infotainment);
  }
}

on sysvar_update sysvar::IL_ETH1::PDU_DisturbTrueEventTiming::TCPServer_SomeIP_01_ICAS3IVI_ICAS1Sys01_XIX_E3V_VLAN_Infotainment
{
  if (@this == 1)
  {
    SetBusContext(gILETH1_BusContext);
    ILSetPDUTimingEvent(ETH_Cluster_MEB::TCPServer_SomeIP_01_ICAS3IVI_ICAS1Sys01_XIX_E3V_VLAN_Infotainment, 1, @sysvar::IL_ETH1::PDU_FITrueEventEnable::TCPServer_SomeIP_01_ICAS3IVI_ICAS1Sys01_XIX_E3V_VLAN_Infotainment, @sysvar::IL_ETH1::PDU_FITrueEventRepCount::TCPServer_SomeIP_01_ICAS3IVI_ICAS1Sys01_XIX_E3V_VLAN_Infotainment, @sysvar::IL_ETH1::PDU_FITrueEventRepPeriod::TCPServer_SomeIP_01_ICAS3IVI_ICAS1Sys01_XIX_E3V_VLAN_Infotainment, @sysvar::IL_ETH1::PDU_FIEventDebounceDelay::TCPServer_SomeIP_01_ICAS3IVI_ICAS1Sys01_XIX_E3V_VLAN_Infotainment, -1, 0);
  }
  else
  {
    SetBusContext(gILETH1_BusContext);
    ILResetPDUTimingEvent(ETH_Cluster_MEB::TCPServer_SomeIP_01_ICAS3IVI_ICAS1Sys01_XIX_E3V_VLAN_Infotainment, 1);
  }
}

on sysvar_update sysvar::IL_ETH1::PDU_FITrueEventEnable::TCPServer_SomeIP_01_ICAS3IVI_ICAS1Sys01_XIX_E3V_VLAN_Infotainment
{
  if (@sysvar::IL_ETH1::PDU_DisturbTrueEventTiming::TCPServer_SomeIP_01_ICAS3IVI_ICAS1Sys01_XIX_E3V_VLAN_Infotainment == 1)
  {
    SetBusContext(gILETH1_BusContext);
    ILSetPDUTimingEvent(ETH_Cluster_MEB::TCPServer_SomeIP_01_ICAS3IVI_ICAS1Sys01_XIX_E3V_VLAN_Infotainment, 1, @sysvar::IL_ETH1::PDU_FITrueEventEnable::TCPServer_SomeIP_01_ICAS3IVI_ICAS1Sys01_XIX_E3V_VLAN_Infotainment, @sysvar::IL_ETH1::PDU_FITrueEventRepCount::TCPServer_SomeIP_01_ICAS3IVI_ICAS1Sys01_XIX_E3V_VLAN_Infotainment, @sysvar::IL_ETH1::PDU_FITrueEventRepPeriod::TCPServer_SomeIP_01_ICAS3IVI_ICAS1Sys01_XIX_E3V_VLAN_Infotainment, @sysvar::IL_ETH1::PDU_FIEventDebounceDelay::TCPServer_SomeIP_01_ICAS3IVI_ICAS1Sys01_XIX_E3V_VLAN_Infotainment, -1, 0);
  }
}

on sysvar_update sysvar::IL_ETH1::PDU_FITrueEventRepCount::TCPServer_SomeIP_01_ICAS3IVI_ICAS1Sys01_XIX_E3V_VLAN_Infotainment
{
  if (@sysvar::IL_ETH1::PDU_DisturbTrueEventTiming::TCPServer_SomeIP_01_ICAS3IVI_ICAS1Sys01_XIX_E3V_VLAN_Infotainment == 1)
  {
    SetBusContext(gILETH1_BusContext);
    ILSetPDUTimingEvent(ETH_Cluster_MEB::TCPServer_SomeIP_01_ICAS3IVI_ICAS1Sys01_XIX_E3V_VLAN_Infotainment, 1, @sysvar::IL_ETH1::PDU_FITrueEventEnable::TCPServer_SomeIP_01_ICAS3IVI_ICAS1Sys01_XIX_E3V_VLAN_Infotainment, @sysvar::IL_ETH1::PDU_FITrueEventRepCount::TCPServer_SomeIP_01_ICAS3IVI_ICAS1Sys01_XIX_E3V_VLAN_Infotainment, @sysvar::IL_ETH1::PDU_FITrueEventRepPeriod::TCPServer_SomeIP_01_ICAS3IVI_ICAS1Sys01_XIX_E3V_VLAN_Infotainment, @sysvar::IL_ETH1::PDU_FIEventDebounceDelay::TCPServer_SomeIP_01_ICAS3IVI_ICAS1Sys01_XIX_E3V_VLAN_Infotainment, -1, 0);
  }
}

on sysvar_update sysvar::IL_ETH1::PDU_FITrueEventRepPeriod::TCPServer_SomeIP_01_ICAS3IVI_ICAS1Sys01_XIX_E3V_VLAN_Infotainment
{
  if (@sysvar::IL_ETH1::PDU_DisturbTrueEventTiming::TCPServer_SomeIP_01_ICAS3IVI_ICAS1Sys01_XIX_E3V_VLAN_Infotainment == 1)
  {
    SetBusContext(gILETH1_BusContext);
    ILSetPDUTimingEvent(ETH_Cluster_MEB::TCPServer_SomeIP_01_ICAS3IVI_ICAS1Sys01_XIX_E3V_VLAN_Infotainment, 1, @sysvar::IL_ETH1::PDU_FITrueEventEnable::TCPServer_SomeIP_01_ICAS3IVI_ICAS1Sys01_XIX_E3V_VLAN_Infotainment, @sysvar::IL_ETH1::PDU_FITrueEventRepCount::TCPServer_SomeIP_01_ICAS3IVI_ICAS1Sys01_XIX_E3V_VLAN_Infotainment, @sysvar::IL_ETH1::PDU_FITrueEventRepPeriod::TCPServer_SomeIP_01_ICAS3IVI_ICAS1Sys01_XIX_E3V_VLAN_Infotainment, @sysvar::IL_ETH1::PDU_FIEventDebounceDelay::TCPServer_SomeIP_01_ICAS3IVI_ICAS1Sys01_XIX_E3V_VLAN_Infotainment, -1, 0);
  }
}

on sysvar_update sysvar::IL_ETH1::PDU_FIEventDebounceDelay::TCPServer_SomeIP_01_ICAS3IVI_ICAS1Sys01_XIX_E3V_VLAN_Infotainment
{
  if (@sysvar::IL_ETH1::PDU_DisturbTrueEventTiming::TCPServer_SomeIP_01_ICAS3IVI_ICAS1Sys01_XIX_E3V_VLAN_Infotainment == 1)
  {
    SetBusContext(gILETH1_BusContext);
    ILSetPDUTimingEvent(ETH_Cluster_MEB::TCPServer_SomeIP_01_ICAS3IVI_ICAS1Sys01_XIX_E3V_VLAN_Infotainment, 1, @sysvar::IL_ETH1::PDU_FITrueEventEnable::TCPServer_SomeIP_01_ICAS3IVI_ICAS1Sys01_XIX_E3V_VLAN_Infotainment, @sysvar::IL_ETH1::PDU_FITrueEventRepCount::TCPServer_SomeIP_01_ICAS3IVI_ICAS1Sys01_XIX_E3V_VLAN_Infotainment, @sysvar::IL_ETH1::PDU_FITrueEventRepPeriod::TCPServer_SomeIP_01_ICAS3IVI_ICAS1Sys01_XIX_E3V_VLAN_Infotainment, @sysvar::IL_ETH1::PDU_FIEventDebounceDelay::TCPServer_SomeIP_01_ICAS3IVI_ICAS1Sys01_XIX_E3V_VLAN_Infotainment, -1, 0);
  }
  if (@sysvar::IL_ETH1::PDU_DisturbFalseEventTiming::TCPServer_SomeIP_01_ICAS3IVI_ICAS1Sys01_XIX_E3V_VLAN_Infotainment == 1)
  {
    SetBusContext(gILETH1_BusContext);
    ILSetPDUTimingEvent(ETH_Cluster_MEB::TCPServer_SomeIP_01_ICAS3IVI_ICAS1Sys01_XIX_E3V_VLAN_Infotainment, 0, @sysvar::IL_ETH1::PDU_FIFalseEventEnable::TCPServer_SomeIP_01_ICAS3IVI_ICAS1Sys01_XIX_E3V_VLAN_Infotainment, @sysvar::IL_ETH1::PDU_FIFalseEventRepCount::TCPServer_SomeIP_01_ICAS3IVI_ICAS1Sys01_XIX_E3V_VLAN_Infotainment, @sysvar::IL_ETH1::PDU_FIFalseEventRepPeriod::TCPServer_SomeIP_01_ICAS3IVI_ICAS1Sys01_XIX_E3V_VLAN_Infotainment, @sysvar::IL_ETH1::PDU_FIEventDebounceDelay::TCPServer_SomeIP_01_ICAS3IVI_ICAS1Sys01_XIX_E3V_VLAN_Infotainment, -1, 0);
  }
}

on sysvar_update sysvar::IL_ETH1::PDU_DisturbFalseEventTiming::TCPServer_SomeIP_01_ICAS3IVI_ICAS1Sys01_XIX_E3V_VLAN_Infotainment
{
  if (@this == 1)
  {
    SetBusContext(gILETH1_BusContext);
    ILSetPDUTimingEvent(ETH_Cluster_MEB::TCPServer_SomeIP_01_ICAS3IVI_ICAS1Sys01_XIX_E3V_VLAN_Infotainment, 0, @sysvar::IL_ETH1::PDU_FIFalseEventEnable::TCPServer_SomeIP_01_ICAS3IVI_ICAS1Sys01_XIX_E3V_VLAN_Infotainment, @sysvar::IL_ETH1::PDU_FIFalseEventRepCount::TCPServer_SomeIP_01_ICAS3IVI_ICAS1Sys01_XIX_E3V_VLAN_Infotainment, @sysvar::IL_ETH1::PDU_FIFalseEventRepPeriod::TCPServer_SomeIP_01_ICAS3IVI_ICAS1Sys01_XIX_E3V_VLAN_Infotainment, @sysvar::IL_ETH1::PDU_FIEventDebounceDelay::TCPServer_SomeIP_01_ICAS3IVI_ICAS1Sys01_XIX_E3V_VLAN_Infotainment, -1, 0);
  }
  else
  {
    SetBusContext(gILETH1_BusContext);
    ILResetPDUTimingEvent(ETH_Cluster_MEB::TCPServer_SomeIP_01_ICAS3IVI_ICAS1Sys01_XIX_E3V_VLAN_Infotainment, 0);
  }
}

on sysvar_update sysvar::IL_ETH1::PDU_FIFalseEventEnable::TCPServer_SomeIP_01_ICAS3IVI_ICAS1Sys01_XIX_E3V_VLAN_Infotainment
{
  if (@sysvar::IL_ETH1::PDU_DisturbFalseEventTiming::TCPServer_SomeIP_01_ICAS3IVI_ICAS1Sys01_XIX_E3V_VLAN_Infotainment == 1)
  {
    SetBusContext(gILETH1_BusContext);
    ILSetPDUTimingEvent(ETH_Cluster_MEB::TCPServer_SomeIP_01_ICAS3IVI_ICAS1Sys01_XIX_E3V_VLAN_Infotainment, 0, @sysvar::IL_ETH1::PDU_FIFalseEventEnable::TCPServer_SomeIP_01_ICAS3IVI_ICAS1Sys01_XIX_E3V_VLAN_Infotainment, @sysvar::IL_ETH1::PDU_FIFalseEventRepCount::TCPServer_SomeIP_01_ICAS3IVI_ICAS1Sys01_XIX_E3V_VLAN_Infotainment, @sysvar::IL_ETH1::PDU_FIFalseEventRepPeriod::TCPServer_SomeIP_01_ICAS3IVI_ICAS1Sys01_XIX_E3V_VLAN_Infotainment, @sysvar::IL_ETH1::PDU_FIEventDebounceDelay::TCPServer_SomeIP_01_ICAS3IVI_ICAS1Sys01_XIX_E3V_VLAN_Infotainment, -1, 0);
  }
}

on sysvar_update sysvar::IL_ETH1::PDU_FIFalseEventRepCount::TCPServer_SomeIP_01_ICAS3IVI_ICAS1Sys01_XIX_E3V_VLAN_Infotainment
{
  if (@sysvar::IL_ETH1::PDU_DisturbFalseEventTiming::TCPServer_SomeIP_01_ICAS3IVI_ICAS1Sys01_XIX_E3V_VLAN_Infotainment == 1)
  {
    SetBusContext(gILETH1_BusContext);
    ILSetPDUTimingEvent(ETH_Cluster_MEB::TCPServer_SomeIP_01_ICAS3IVI_ICAS1Sys01_XIX_E3V_VLAN_Infotainment, 0, @sysvar::IL_ETH1::PDU_FIFalseEventEnable::TCPServer_SomeIP_01_ICAS3IVI_ICAS1Sys01_XIX_E3V_VLAN_Infotainment, @sysvar::IL_ETH1::PDU_FIFalseEventRepCount::TCPServer_SomeIP_01_ICAS3IVI_ICAS1Sys01_XIX_E3V_VLAN_Infotainment, @sysvar::IL_ETH1::PDU_FIFalseEventRepPeriod::TCPServer_SomeIP_01_ICAS3IVI_ICAS1Sys01_XIX_E3V_VLAN_Infotainment, @sysvar::IL_ETH1::PDU_FIEventDebounceDelay::TCPServer_SomeIP_01_ICAS3IVI_ICAS1Sys01_XIX_E3V_VLAN_Infotainment, -1, 0);
  }
}

on sysvar_update sysvar::IL_ETH1::PDU_FIFalseEventRepPeriod::TCPServer_SomeIP_01_ICAS3IVI_ICAS1Sys01_XIX_E3V_VLAN_Infotainment
{
  if (@sysvar::IL_ETH1::PDU_DisturbFalseEventTiming::TCPServer_SomeIP_01_ICAS3IVI_ICAS1Sys01_XIX_E3V_VLAN_Infotainment == 1)
  {
    SetBusContext(gILETH1_BusContext);
    ILSetPDUTimingEvent(ETH_Cluster_MEB::TCPServer_SomeIP_01_ICAS3IVI_ICAS1Sys01_XIX_E3V_VLAN_Infotainment, 0, @sysvar::IL_ETH1::PDU_FIFalseEventEnable::TCPServer_SomeIP_01_ICAS3IVI_ICAS1Sys01_XIX_E3V_VLAN_Infotainment, @sysvar::IL_ETH1::PDU_FIFalseEventRepCount::TCPServer_SomeIP_01_ICAS3IVI_ICAS1Sys01_XIX_E3V_VLAN_Infotainment, @sysvar::IL_ETH1::PDU_FIFalseEventRepPeriod::TCPServer_SomeIP_01_ICAS3IVI_ICAS1Sys01_XIX_E3V_VLAN_Infotainment, @sysvar::IL_ETH1::PDU_FIEventDebounceDelay::TCPServer_SomeIP_01_ICAS3IVI_ICAS1Sys01_XIX_E3V_VLAN_Infotainment, -1, 0);
  }
}

on sysvar_update sysvar::IL_ETH1::PDU_DisturbTimingMode::TCPServer_SomeIP_01_ICAS3IVI_ICAS1Sys02_XIX_E3V_VLAN_Infotainment
{
  if (@this == 1)
  {
    SetBusContext(gILETH1_BusContext);
    ILSetPDUAsrTXMode(ETH_Cluster_MEB::TCPServer_SomeIP_01_ICAS3IVI_ICAS1Sys02_XIX_E3V_VLAN_Infotainment, @sysvar::IL_ETH1::PDU_FITimingMode::TCPServer_SomeIP_01_ICAS3IVI_ICAS1Sys02_XIX_E3V_VLAN_Infotainment, -1, 0);
  }
  else
  {
    SetBusContext(gILETH1_BusContext);
    ILResetPDUAsrTXMode(ETH_Cluster_MEB::TCPServer_SomeIP_01_ICAS3IVI_ICAS1Sys02_XIX_E3V_VLAN_Infotainment);
  }
}

on sysvar_update sysvar::IL_ETH1::PDU_FITimingMode::TCPServer_SomeIP_01_ICAS3IVI_ICAS1Sys02_XIX_E3V_VLAN_Infotainment
{
  if (@sysvar::IL_ETH1::PDU_DisturbTimingMode::TCPServer_SomeIP_01_ICAS3IVI_ICAS1Sys02_XIX_E3V_VLAN_Infotainment == 1)
  {
    SetBusContext(gILETH1_BusContext);
    ILSetPDUAsrTXMode(ETH_Cluster_MEB::TCPServer_SomeIP_01_ICAS3IVI_ICAS1Sys02_XIX_E3V_VLAN_Infotainment, @sysvar::IL_ETH1::PDU_FITimingMode::TCPServer_SomeIP_01_ICAS3IVI_ICAS1Sys02_XIX_E3V_VLAN_Infotainment, -1, 0);
  }
}

on sysvar_update sysvar::IL_ETH1::PDU_DisturbTrueCyclicTiming::TCPServer_SomeIP_01_ICAS3IVI_ICAS1Sys02_XIX_E3V_VLAN_Infotainment
{
  if (@this == 1)
  {
    SetBusContext(gILETH1_BusContext);
    ILSetPDUTimingCyclic(ETH_Cluster_MEB::TCPServer_SomeIP_01_ICAS3IVI_ICAS1Sys02_XIX_E3V_VLAN_Infotainment, 1, 0, @sysvar::IL_ETH1::PDU_FITrueCyclicPeriod::TCPServer_SomeIP_01_ICAS3IVI_ICAS1Sys02_XIX_E3V_VLAN_Infotainment, -1, 0);
  }
  else
  {
    SetBusContext(gILETH1_BusContext);
    ILResetPDUTimingCyclic(ETH_Cluster_MEB::TCPServer_SomeIP_01_ICAS3IVI_ICAS1Sys02_XIX_E3V_VLAN_Infotainment, 1);
  }
}

on sysvar_update sysvar::IL_ETH1::PDU_FITrueCyclicPeriod::TCPServer_SomeIP_01_ICAS3IVI_ICAS1Sys02_XIX_E3V_VLAN_Infotainment
{
  if (@sysvar::IL_ETH1::PDU_DisturbTrueCyclicTiming::TCPServer_SomeIP_01_ICAS3IVI_ICAS1Sys02_XIX_E3V_VLAN_Infotainment == 1)
  {
    SetBusContext(gILETH1_BusContext);
    ILSetPDUTimingCyclic(ETH_Cluster_MEB::TCPServer_SomeIP_01_ICAS3IVI_ICAS1Sys02_XIX_E3V_VLAN_Infotainment, 1, 0, @sysvar::IL_ETH1::PDU_FITrueCyclicPeriod::TCPServer_SomeIP_01_ICAS3IVI_ICAS1Sys02_XIX_E3V_VLAN_Infotainment, -1, 0);
  }
}

on sysvar_update sysvar::IL_ETH1::PDU_DisturbFalseCyclicTiming::TCPServer_SomeIP_01_ICAS3IVI_ICAS1Sys02_XIX_E3V_VLAN_Infotainment
{
  if (@this == 1)
  {
    SetBusContext(gILETH1_BusContext);
    ILSetPDUTimingCyclic(ETH_Cluster_MEB::TCPServer_SomeIP_01_ICAS3IVI_ICAS1Sys02_XIX_E3V_VLAN_Infotainment, 0, 0, @sysvar::IL_ETH1::PDU_FIFalseCyclicPeriod::TCPServer_SomeIP_01_ICAS3IVI_ICAS1Sys02_XIX_E3V_VLAN_Infotainment, -1, 0);
  }
  else
  {
    SetBusContext(gILETH1_BusContext);
    ILResetPDUTimingCyclic(ETH_Cluster_MEB::TCPServer_SomeIP_01_ICAS3IVI_ICAS1Sys02_XIX_E3V_VLAN_Infotainment, 0);
  }
}

on sysvar_update sysvar::IL_ETH1::PDU_FIFalseCyclicPeriod::TCPServer_SomeIP_01_ICAS3IVI_ICAS1Sys02_XIX_E3V_VLAN_Infotainment
{
  if (@sysvar::IL_ETH1::PDU_DisturbFalseCyclicTiming::TCPServer_SomeIP_01_ICAS3IVI_ICAS1Sys02_XIX_E3V_VLAN_Infotainment == 1)
  {
    SetBusContext(gILETH1_BusContext);
    ILSetPDUTimingCyclic(ETH_Cluster_MEB::TCPServer_SomeIP_01_ICAS3IVI_ICAS1Sys02_XIX_E3V_VLAN_Infotainment, 1, 0, @sysvar::IL_ETH1::PDU_FITrueCyclicPeriod::TCPServer_SomeIP_01_ICAS3IVI_ICAS1Sys02_XIX_E3V_VLAN_Infotainment, -1, 0);
  }
}

on sysvar_update sysvar::IL_ETH1::PDU_SendOnce::TCPServer_SomeIP_01_ICAS3IVI_ICAS1Sys02_XIX_E3V_VLAN_Infotainment
{
  if (@this == 1)
  {
    SetBusContext(gILETH1_BusContext);
    ILSetPDUEvent(ETH_Cluster_MEB::TCPServer_SomeIP_01_ICAS3IVI_ICAS1Sys02_XIX_E3V_VLAN_Infotainment);
  }
}

on sysvar_update sysvar::IL_ETH1::PDU_DisturbTrueEventTiming::TCPServer_SomeIP_01_ICAS3IVI_ICAS1Sys02_XIX_E3V_VLAN_Infotainment
{
  if (@this == 1)
  {
    SetBusContext(gILETH1_BusContext);
    ILSetPDUTimingEvent(ETH_Cluster_MEB::TCPServer_SomeIP_01_ICAS3IVI_ICAS1Sys02_XIX_E3V_VLAN_Infotainment, 1, @sysvar::IL_ETH1::PDU_FITrueEventEnable::TCPServer_SomeIP_01_ICAS3IVI_ICAS1Sys02_XIX_E3V_VLAN_Infotainment, @sysvar::IL_ETH1::PDU_FITrueEventRepCount::TCPServer_SomeIP_01_ICAS3IVI_ICAS1Sys02_XIX_E3V_VLAN_Infotainment, @sysvar::IL_ETH1::PDU_FITrueEventRepPeriod::TCPServer_SomeIP_01_ICAS3IVI_ICAS1Sys02_XIX_E3V_VLAN_Infotainment, @sysvar::IL_ETH1::PDU_FIEventDebounceDelay::TCPServer_SomeIP_01_ICAS3IVI_ICAS1Sys02_XIX_E3V_VLAN_Infotainment, -1, 0);
  }
  else
  {
    SetBusContext(gILETH1_BusContext);
    ILResetPDUTimingEvent(ETH_Cluster_MEB::TCPServer_SomeIP_01_ICAS3IVI_ICAS1Sys02_XIX_E3V_VLAN_Infotainment, 1);
  }
}

on sysvar_update sysvar::IL_ETH1::PDU_FITrueEventEnable::TCPServer_SomeIP_01_ICAS3IVI_ICAS1Sys02_XIX_E3V_VLAN_Infotainment
{
  if (@sysvar::IL_ETH1::PDU_DisturbTrueEventTiming::TCPServer_SomeIP_01_ICAS3IVI_ICAS1Sys02_XIX_E3V_VLAN_Infotainment == 1)
  {
    SetBusContext(gILETH1_BusContext);
    ILSetPDUTimingEvent(ETH_Cluster_MEB::TCPServer_SomeIP_01_ICAS3IVI_ICAS1Sys02_XIX_E3V_VLAN_Infotainment, 1, @sysvar::IL_ETH1::PDU_FITrueEventEnable::TCPServer_SomeIP_01_ICAS3IVI_ICAS1Sys02_XIX_E3V_VLAN_Infotainment, @sysvar::IL_ETH1::PDU_FITrueEventRepCount::TCPServer_SomeIP_01_ICAS3IVI_ICAS1Sys02_XIX_E3V_VLAN_Infotainment, @sysvar::IL_ETH1::PDU_FITrueEventRepPeriod::TCPServer_SomeIP_01_ICAS3IVI_ICAS1Sys02_XIX_E3V_VLAN_Infotainment, @sysvar::IL_ETH1::PDU_FIEventDebounceDelay::TCPServer_SomeIP_01_ICAS3IVI_ICAS1Sys02_XIX_E3V_VLAN_Infotainment, -1, 0);
  }
}

on sysvar_update sysvar::IL_ETH1::PDU_FITrueEventRepCount::TCPServer_SomeIP_01_ICAS3IVI_ICAS1Sys02_XIX_E3V_VLAN_Infotainment
{
  if (@sysvar::IL_ETH1::PDU_DisturbTrueEventTiming::TCPServer_SomeIP_01_ICAS3IVI_ICAS1Sys02_XIX_E3V_VLAN_Infotainment == 1)
  {
    SetBusContext(gILETH1_BusContext);
    ILSetPDUTimingEvent(ETH_Cluster_MEB::TCPServer_SomeIP_01_ICAS3IVI_ICAS1Sys02_XIX_E3V_VLAN_Infotainment, 1, @sysvar::IL_ETH1::PDU_FITrueEventEnable::TCPServer_SomeIP_01_ICAS3IVI_ICAS1Sys02_XIX_E3V_VLAN_Infotainment, @sysvar::IL_ETH1::PDU_FITrueEventRepCount::TCPServer_SomeIP_01_ICAS3IVI_ICAS1Sys02_XIX_E3V_VLAN_Infotainment, @sysvar::IL_ETH1::PDU_FITrueEventRepPeriod::TCPServer_SomeIP_01_ICAS3IVI_ICAS1Sys02_XIX_E3V_VLAN_Infotainment, @sysvar::IL_ETH1::PDU_FIEventDebounceDelay::TCPServer_SomeIP_01_ICAS3IVI_ICAS1Sys02_XIX_E3V_VLAN_Infotainment, -1, 0);
  }
}

on sysvar_update sysvar::IL_ETH1::PDU_FITrueEventRepPeriod::TCPServer_SomeIP_01_ICAS3IVI_ICAS1Sys02_XIX_E3V_VLAN_Infotainment
{
  if (@sysvar::IL_ETH1::PDU_DisturbTrueEventTiming::TCPServer_SomeIP_01_ICAS3IVI_ICAS1Sys02_XIX_E3V_VLAN_Infotainment == 1)
  {
    SetBusContext(gILETH1_BusContext);
    ILSetPDUTimingEvent(ETH_Cluster_MEB::TCPServer_SomeIP_01_ICAS3IVI_ICAS1Sys02_XIX_E3V_VLAN_Infotainment, 1, @sysvar::IL_ETH1::PDU_FITrueEventEnable::TCPServer_SomeIP_01_ICAS3IVI_ICAS1Sys02_XIX_E3V_VLAN_Infotainment, @sysvar::IL_ETH1::PDU_FITrueEventRepCount::TCPServer_SomeIP_01_ICAS3IVI_ICAS1Sys02_XIX_E3V_VLAN_Infotainment, @sysvar::IL_ETH1::PDU_FITrueEventRepPeriod::TCPServer_SomeIP_01_ICAS3IVI_ICAS1Sys02_XIX_E3V_VLAN_Infotainment, @sysvar::IL_ETH1::PDU_FIEventDebounceDelay::TCPServer_SomeIP_01_ICAS3IVI_ICAS1Sys02_XIX_E3V_VLAN_Infotainment, -1, 0);
  }
}

on sysvar_update sysvar::IL_ETH1::PDU_FIEventDebounceDelay::TCPServer_SomeIP_01_ICAS3IVI_ICAS1Sys02_XIX_E3V_VLAN_Infotainment
{
  if (@sysvar::IL_ETH1::PDU_DisturbTrueEventTiming::TCPServer_SomeIP_01_ICAS3IVI_ICAS1Sys02_XIX_E3V_VLAN_Infotainment == 1)
  {
    SetBusContext(gILETH1_BusContext);
    ILSetPDUTimingEvent(ETH_Cluster_MEB::TCPServer_SomeIP_01_ICAS3IVI_ICAS1Sys02_XIX_E3V_VLAN_Infotainment, 1, @sysvar::IL_ETH1::PDU_FITrueEventEnable::TCPServer_SomeIP_01_ICAS3IVI_ICAS1Sys02_XIX_E3V_VLAN_Infotainment, @sysvar::IL_ETH1::PDU_FITrueEventRepCount::TCPServer_SomeIP_01_ICAS3IVI_ICAS1Sys02_XIX_E3V_VLAN_Infotainment, @sysvar::IL_ETH1::PDU_FITrueEventRepPeriod::TCPServer_SomeIP_01_ICAS3IVI_ICAS1Sys02_XIX_E3V_VLAN_Infotainment, @sysvar::IL_ETH1::PDU_FIEventDebounceDelay::TCPServer_SomeIP_01_ICAS3IVI_ICAS1Sys02_XIX_E3V_VLAN_Infotainment, -1, 0);
  }
  if (@sysvar::IL_ETH1::PDU_DisturbFalseEventTiming::TCPServer_SomeIP_01_ICAS3IVI_ICAS1Sys02_XIX_E3V_VLAN_Infotainment == 1)
  {
    SetBusContext(gILETH1_BusContext);
    ILSetPDUTimingEvent(ETH_Cluster_MEB::TCPServer_SomeIP_01_ICAS3IVI_ICAS1Sys02_XIX_E3V_VLAN_Infotainment, 0, @sysvar::IL_ETH1::PDU_FIFalseEventEnable::TCPServer_SomeIP_01_ICAS3IVI_ICAS1Sys02_XIX_E3V_VLAN_Infotainment, @sysvar::IL_ETH1::PDU_FIFalseEventRepCount::TCPServer_SomeIP_01_ICAS3IVI_ICAS1Sys02_XIX_E3V_VLAN_Infotainment, @sysvar::IL_ETH1::PDU_FIFalseEventRepPeriod::TCPServer_SomeIP_01_ICAS3IVI_ICAS1Sys02_XIX_E3V_VLAN_Infotainment, @sysvar::IL_ETH1::PDU_FIEventDebounceDelay::TCPServer_SomeIP_01_ICAS3IVI_ICAS1Sys02_XIX_E3V_VLAN_Infotainment, -1, 0);
  }
}

on sysvar_update sysvar::IL_ETH1::PDU_DisturbFalseEventTiming::TCPServer_SomeIP_01_ICAS3IVI_ICAS1Sys02_XIX_E3V_VLAN_Infotainment
{
  if (@this == 1)
  {
    SetBusContext(gILETH1_BusContext);
    ILSetPDUTimingEvent(ETH_Cluster_MEB::TCPServer_SomeIP_01_ICAS3IVI_ICAS1Sys02_XIX_E3V_VLAN_Infotainment, 0, @sysvar::IL_ETH1::PDU_FIFalseEventEnable::TCPServer_SomeIP_01_ICAS3IVI_ICAS1Sys02_XIX_E3V_VLAN_Infotainment, @sysvar::IL_ETH1::PDU_FIFalseEventRepCount::TCPServer_SomeIP_01_ICAS3IVI_ICAS1Sys02_XIX_E3V_VLAN_Infotainment, @sysvar::IL_ETH1::PDU_FIFalseEventRepPeriod::TCPServer_SomeIP_01_ICAS3IVI_ICAS1Sys02_XIX_E3V_VLAN_Infotainment, @sysvar::IL_ETH1::PDU_FIEventDebounceDelay::TCPServer_SomeIP_01_ICAS3IVI_ICAS1Sys02_XIX_E3V_VLAN_Infotainment, -1, 0);
  }
  else
  {
    SetBusContext(gILETH1_BusContext);
    ILResetPDUTimingEvent(ETH_Cluster_MEB::TCPServer_SomeIP_01_ICAS3IVI_ICAS1Sys02_XIX_E3V_VLAN_Infotainment, 0);
  }
}

on sysvar_update sysvar::IL_ETH1::PDU_FIFalseEventEnable::TCPServer_SomeIP_01_ICAS3IVI_ICAS1Sys02_XIX_E3V_VLAN_Infotainment
{
  if (@sysvar::IL_ETH1::PDU_DisturbFalseEventTiming::TCPServer_SomeIP_01_ICAS3IVI_ICAS1Sys02_XIX_E3V_VLAN_Infotainment == 1)
  {
    SetBusContext(gILETH1_BusContext);
    ILSetPDUTimingEvent(ETH_Cluster_MEB::TCPServer_SomeIP_01_ICAS3IVI_ICAS1Sys02_XIX_E3V_VLAN_Infotainment, 0, @sysvar::IL_ETH1::PDU_FIFalseEventEnable::TCPServer_SomeIP_01_ICAS3IVI_ICAS1Sys02_XIX_E3V_VLAN_Infotainment, @sysvar::IL_ETH1::PDU_FIFalseEventRepCount::TCPServer_SomeIP_01_ICAS3IVI_ICAS1Sys02_XIX_E3V_VLAN_Infotainment, @sysvar::IL_ETH1::PDU_FIFalseEventRepPeriod::TCPServer_SomeIP_01_ICAS3IVI_ICAS1Sys02_XIX_E3V_VLAN_Infotainment, @sysvar::IL_ETH1::PDU_FIEventDebounceDelay::TCPServer_SomeIP_01_ICAS3IVI_ICAS1Sys02_XIX_E3V_VLAN_Infotainment, -1, 0);
  }
}

on sysvar_update sysvar::IL_ETH1::PDU_FIFalseEventRepCount::TCPServer_SomeIP_01_ICAS3IVI_ICAS1Sys02_XIX_E3V_VLAN_Infotainment
{
  if (@sysvar::IL_ETH1::PDU_DisturbFalseEventTiming::TCPServer_SomeIP_01_ICAS3IVI_ICAS1Sys02_XIX_E3V_VLAN_Infotainment == 1)
  {
    SetBusContext(gILETH1_BusContext);
    ILSetPDUTimingEvent(ETH_Cluster_MEB::TCPServer_SomeIP_01_ICAS3IVI_ICAS1Sys02_XIX_E3V_VLAN_Infotainment, 0, @sysvar::IL_ETH1::PDU_FIFalseEventEnable::TCPServer_SomeIP_01_ICAS3IVI_ICAS1Sys02_XIX_E3V_VLAN_Infotainment, @sysvar::IL_ETH1::PDU_FIFalseEventRepCount::TCPServer_SomeIP_01_ICAS3IVI_ICAS1Sys02_XIX_E3V_VLAN_Infotainment, @sysvar::IL_ETH1::PDU_FIFalseEventRepPeriod::TCPServer_SomeIP_01_ICAS3IVI_ICAS1Sys02_XIX_E3V_VLAN_Infotainment, @sysvar::IL_ETH1::PDU_FIEventDebounceDelay::TCPServer_SomeIP_01_ICAS3IVI_ICAS1Sys02_XIX_E3V_VLAN_Infotainment, -1, 0);
  }
}

on sysvar_update sysvar::IL_ETH1::PDU_FIFalseEventRepPeriod::TCPServer_SomeIP_01_ICAS3IVI_ICAS1Sys02_XIX_E3V_VLAN_Infotainment
{
  if (@sysvar::IL_ETH1::PDU_DisturbFalseEventTiming::TCPServer_SomeIP_01_ICAS3IVI_ICAS1Sys02_XIX_E3V_VLAN_Infotainment == 1)
  {
    SetBusContext(gILETH1_BusContext);
    ILSetPDUTimingEvent(ETH_Cluster_MEB::TCPServer_SomeIP_01_ICAS3IVI_ICAS1Sys02_XIX_E3V_VLAN_Infotainment, 0, @sysvar::IL_ETH1::PDU_FIFalseEventEnable::TCPServer_SomeIP_01_ICAS3IVI_ICAS1Sys02_XIX_E3V_VLAN_Infotainment, @sysvar::IL_ETH1::PDU_FIFalseEventRepCount::TCPServer_SomeIP_01_ICAS3IVI_ICAS1Sys02_XIX_E3V_VLAN_Infotainment, @sysvar::IL_ETH1::PDU_FIFalseEventRepPeriod::TCPServer_SomeIP_01_ICAS3IVI_ICAS1Sys02_XIX_E3V_VLAN_Infotainment, @sysvar::IL_ETH1::PDU_FIEventDebounceDelay::TCPServer_SomeIP_01_ICAS3IVI_ICAS1Sys02_XIX_E3V_VLAN_Infotainment, -1, 0);
  }
}

on sysvar_update sysvar::IL_ETH1::PDU_DisturbTimingMode::TCPServer_SSOA_ICAS3IVI_DDA_XIX_E3V_VLAN_Infotainment
{
  if (@this == 1)
  {
    SetBusContext(gILETH1_BusContext);
    ILSetPDUAsrTXMode(ETH_Cluster_MEB::TCPServer_SSOA_ICAS3IVI_DDA_XIX_E3V_VLAN_Infotainment, @sysvar::IL_ETH1::PDU_FITimingMode::TCPServer_SSOA_ICAS3IVI_DDA_XIX_E3V_VLAN_Infotainment, -1, 0);
  }
  else
  {
    SetBusContext(gILETH1_BusContext);
    ILResetPDUAsrTXMode(ETH_Cluster_MEB::TCPServer_SSOA_ICAS3IVI_DDA_XIX_E3V_VLAN_Infotainment);
  }
}

on sysvar_update sysvar::IL_ETH1::PDU_FITimingMode::TCPServer_SSOA_ICAS3IVI_DDA_XIX_E3V_VLAN_Infotainment
{
  if (@sysvar::IL_ETH1::PDU_DisturbTimingMode::TCPServer_SSOA_ICAS3IVI_DDA_XIX_E3V_VLAN_Infotainment == 1)
  {
    SetBusContext(gILETH1_BusContext);
    ILSetPDUAsrTXMode(ETH_Cluster_MEB::TCPServer_SSOA_ICAS3IVI_DDA_XIX_E3V_VLAN_Infotainment, @sysvar::IL_ETH1::PDU_FITimingMode::TCPServer_SSOA_ICAS3IVI_DDA_XIX_E3V_VLAN_Infotainment, -1, 0);
  }
}

on sysvar_update sysvar::IL_ETH1::PDU_DisturbTrueCyclicTiming::TCPServer_SSOA_ICAS3IVI_DDA_XIX_E3V_VLAN_Infotainment
{
  if (@this == 1)
  {
    SetBusContext(gILETH1_BusContext);
    ILSetPDUTimingCyclic(ETH_Cluster_MEB::TCPServer_SSOA_ICAS3IVI_DDA_XIX_E3V_VLAN_Infotainment, 1, 0, @sysvar::IL_ETH1::PDU_FITrueCyclicPeriod::TCPServer_SSOA_ICAS3IVI_DDA_XIX_E3V_VLAN_Infotainment, -1, 0);
  }
  else
  {
    SetBusContext(gILETH1_BusContext);
    ILResetPDUTimingCyclic(ETH_Cluster_MEB::TCPServer_SSOA_ICAS3IVI_DDA_XIX_E3V_VLAN_Infotainment, 1);
  }
}

on sysvar_update sysvar::IL_ETH1::PDU_FITrueCyclicPeriod::TCPServer_SSOA_ICAS3IVI_DDA_XIX_E3V_VLAN_Infotainment
{
  if (@sysvar::IL_ETH1::PDU_DisturbTrueCyclicTiming::TCPServer_SSOA_ICAS3IVI_DDA_XIX_E3V_VLAN_Infotainment == 1)
  {
    SetBusContext(gILETH1_BusContext);
    ILSetPDUTimingCyclic(ETH_Cluster_MEB::TCPServer_SSOA_ICAS3IVI_DDA_XIX_E3V_VLAN_Infotainment, 1, 0, @sysvar::IL_ETH1::PDU_FITrueCyclicPeriod::TCPServer_SSOA_ICAS3IVI_DDA_XIX_E3V_VLAN_Infotainment, -1, 0);
  }
}

on sysvar_update sysvar::IL_ETH1::PDU_DisturbFalseCyclicTiming::TCPServer_SSOA_ICAS3IVI_DDA_XIX_E3V_VLAN_Infotainment
{
  if (@this == 1)
  {
    SetBusContext(gILETH1_BusContext);
    ILSetPDUTimingCyclic(ETH_Cluster_MEB::TCPServer_SSOA_ICAS3IVI_DDA_XIX_E3V_VLAN_Infotainment, 0, 0, @sysvar::IL_ETH1::PDU_FIFalseCyclicPeriod::TCPServer_SSOA_ICAS3IVI_DDA_XIX_E3V_VLAN_Infotainment, -1, 0);
  }
  else
  {
    SetBusContext(gILETH1_BusContext);
    ILResetPDUTimingCyclic(ETH_Cluster_MEB::TCPServer_SSOA_ICAS3IVI_DDA_XIX_E3V_VLAN_Infotainment, 0);
  }
}

on sysvar_update sysvar::IL_ETH1::PDU_FIFalseCyclicPeriod::TCPServer_SSOA_ICAS3IVI_DDA_XIX_E3V_VLAN_Infotainment
{
  if (@sysvar::IL_ETH1::PDU_DisturbFalseCyclicTiming::TCPServer_SSOA_ICAS3IVI_DDA_XIX_E3V_VLAN_Infotainment == 1)
  {
    SetBusContext(gILETH1_BusContext);
    ILSetPDUTimingCyclic(ETH_Cluster_MEB::TCPServer_SSOA_ICAS3IVI_DDA_XIX_E3V_VLAN_Infotainment, 1, 0, @sysvar::IL_ETH1::PDU_FITrueCyclicPeriod::TCPServer_SSOA_ICAS3IVI_DDA_XIX_E3V_VLAN_Infotainment, -1, 0);
  }
}

on sysvar_update sysvar::IL_ETH1::PDU_SendOnce::TCPServer_SSOA_ICAS3IVI_DDA_XIX_E3V_VLAN_Infotainment
{
  if (@this == 1)
  {
    SetBusContext(gILETH1_BusContext);
    ILSetPDUEvent(ETH_Cluster_MEB::TCPServer_SSOA_ICAS3IVI_DDA_XIX_E3V_VLAN_Infotainment);
  }
}

on sysvar_update sysvar::IL_ETH1::PDU_DisturbTrueEventTiming::TCPServer_SSOA_ICAS3IVI_DDA_XIX_E3V_VLAN_Infotainment
{
  if (@this == 1)
  {
    SetBusContext(gILETH1_BusContext);
    ILSetPDUTimingEvent(ETH_Cluster_MEB::TCPServer_SSOA_ICAS3IVI_DDA_XIX_E3V_VLAN_Infotainment, 1, @sysvar::IL_ETH1::PDU_FITrueEventEnable::TCPServer_SSOA_ICAS3IVI_DDA_XIX_E3V_VLAN_Infotainment, @sysvar::IL_ETH1::PDU_FITrueEventRepCount::TCPServer_SSOA_ICAS3IVI_DDA_XIX_E3V_VLAN_Infotainment, @sysvar::IL_ETH1::PDU_FITrueEventRepPeriod::TCPServer_SSOA_ICAS3IVI_DDA_XIX_E3V_VLAN_Infotainment, @sysvar::IL_ETH1::PDU_FIEventDebounceDelay::TCPServer_SSOA_ICAS3IVI_DDA_XIX_E3V_VLAN_Infotainment, -1, 0);
  }
  else
  {
    SetBusContext(gILETH1_BusContext);
    ILResetPDUTimingEvent(ETH_Cluster_MEB::TCPServer_SSOA_ICAS3IVI_DDA_XIX_E3V_VLAN_Infotainment, 1);
  }
}

on sysvar_update sysvar::IL_ETH1::PDU_FITrueEventEnable::TCPServer_SSOA_ICAS3IVI_DDA_XIX_E3V_VLAN_Infotainment
{
  if (@sysvar::IL_ETH1::PDU_DisturbTrueEventTiming::TCPServer_SSOA_ICAS3IVI_DDA_XIX_E3V_VLAN_Infotainment == 1)
  {
    SetBusContext(gILETH1_BusContext);
    ILSetPDUTimingEvent(ETH_Cluster_MEB::TCPServer_SSOA_ICAS3IVI_DDA_XIX_E3V_VLAN_Infotainment, 1, @sysvar::IL_ETH1::PDU_FITrueEventEnable::TCPServer_SSOA_ICAS3IVI_DDA_XIX_E3V_VLAN_Infotainment, @sysvar::IL_ETH1::PDU_FITrueEventRepCount::TCPServer_SSOA_ICAS3IVI_DDA_XIX_E3V_VLAN_Infotainment, @sysvar::IL_ETH1::PDU_FITrueEventRepPeriod::TCPServer_SSOA_ICAS3IVI_DDA_XIX_E3V_VLAN_Infotainment, @sysvar::IL_ETH1::PDU_FIEventDebounceDelay::TCPServer_SSOA_ICAS3IVI_DDA_XIX_E3V_VLAN_Infotainment, -1, 0);
  }
}

on sysvar_update sysvar::IL_ETH1::PDU_FITrueEventRepCount::TCPServer_SSOA_ICAS3IVI_DDA_XIX_E3V_VLAN_Infotainment
{
  if (@sysvar::IL_ETH1::PDU_DisturbTrueEventTiming::TCPServer_SSOA_ICAS3IVI_DDA_XIX_E3V_VLAN_Infotainment == 1)
  {
    SetBusContext(gILETH1_BusContext);
    ILSetPDUTimingEvent(ETH_Cluster_MEB::TCPServer_SSOA_ICAS3IVI_DDA_XIX_E3V_VLAN_Infotainment, 1, @sysvar::IL_ETH1::PDU_FITrueEventEnable::TCPServer_SSOA_ICAS3IVI_DDA_XIX_E3V_VLAN_Infotainment, @sysvar::IL_ETH1::PDU_FITrueEventRepCount::TCPServer_SSOA_ICAS3IVI_DDA_XIX_E3V_VLAN_Infotainment, @sysvar::IL_ETH1::PDU_FITrueEventRepPeriod::TCPServer_SSOA_ICAS3IVI_DDA_XIX_E3V_VLAN_Infotainment, @sysvar::IL_ETH1::PDU_FIEventDebounceDelay::TCPServer_SSOA_ICAS3IVI_DDA_XIX_E3V_VLAN_Infotainment, -1, 0);
  }
}

on sysvar_update sysvar::IL_ETH1::PDU_FITrueEventRepPeriod::TCPServer_SSOA_ICAS3IVI_DDA_XIX_E3V_VLAN_Infotainment
{
  if (@sysvar::IL_ETH1::PDU_DisturbTrueEventTiming::TCPServer_SSOA_ICAS3IVI_DDA_XIX_E3V_VLAN_Infotainment == 1)
  {
    SetBusContext(gILETH1_BusContext);
    ILSetPDUTimingEvent(ETH_Cluster_MEB::TCPServer_SSOA_ICAS3IVI_DDA_XIX_E3V_VLAN_Infotainment, 1, @sysvar::IL_ETH1::PDU_FITrueEventEnable::TCPServer_SSOA_ICAS3IVI_DDA_XIX_E3V_VLAN_Infotainment, @sysvar::IL_ETH1::PDU_FITrueEventRepCount::TCPServer_SSOA_ICAS3IVI_DDA_XIX_E3V_VLAN_Infotainment, @sysvar::IL_ETH1::PDU_FITrueEventRepPeriod::TCPServer_SSOA_ICAS3IVI_DDA_XIX_E3V_VLAN_Infotainment, @sysvar::IL_ETH1::PDU_FIEventDebounceDelay::TCPServer_SSOA_ICAS3IVI_DDA_XIX_E3V_VLAN_Infotainment, -1, 0);
  }
}

on sysvar_update sysvar::IL_ETH1::PDU_FIEventDebounceDelay::TCPServer_SSOA_ICAS3IVI_DDA_XIX_E3V_VLAN_Infotainment
{
  if (@sysvar::IL_ETH1::PDU_DisturbTrueEventTiming::TCPServer_SSOA_ICAS3IVI_DDA_XIX_E3V_VLAN_Infotainment == 1)
  {
    SetBusContext(gILETH1_BusContext);
    ILSetPDUTimingEvent(ETH_Cluster_MEB::TCPServer_SSOA_ICAS3IVI_DDA_XIX_E3V_VLAN_Infotainment, 1, @sysvar::IL_ETH1::PDU_FITrueEventEnable::TCPServer_SSOA_ICAS3IVI_DDA_XIX_E3V_VLAN_Infotainment, @sysvar::IL_ETH1::PDU_FITrueEventRepCount::TCPServer_SSOA_ICAS3IVI_DDA_XIX_E3V_VLAN_Infotainment, @sysvar::IL_ETH1::PDU_FITrueEventRepPeriod::TCPServer_SSOA_ICAS3IVI_DDA_XIX_E3V_VLAN_Infotainment, @sysvar::IL_ETH1::PDU_FIEventDebounceDelay::TCPServer_SSOA_ICAS3IVI_DDA_XIX_E3V_VLAN_Infotainment, -1, 0);
  }
  if (@sysvar::IL_ETH1::PDU_DisturbFalseEventTiming::TCPServer_SSOA_ICAS3IVI_DDA_XIX_E3V_VLAN_Infotainment == 1)
  {
    SetBusContext(gILETH1_BusContext);
    ILSetPDUTimingEvent(ETH_Cluster_MEB::TCPServer_SSOA_ICAS3IVI_DDA_XIX_E3V_VLAN_Infotainment, 0, @sysvar::IL_ETH1::PDU_FIFalseEventEnable::TCPServer_SSOA_ICAS3IVI_DDA_XIX_E3V_VLAN_Infotainment, @sysvar::IL_ETH1::PDU_FIFalseEventRepCount::TCPServer_SSOA_ICAS3IVI_DDA_XIX_E3V_VLAN_Infotainment, @sysvar::IL_ETH1::PDU_FIFalseEventRepPeriod::TCPServer_SSOA_ICAS3IVI_DDA_XIX_E3V_VLAN_Infotainment, @sysvar::IL_ETH1::PDU_FIEventDebounceDelay::TCPServer_SSOA_ICAS3IVI_DDA_XIX_E3V_VLAN_Infotainment, -1, 0);
  }
}

on sysvar_update sysvar::IL_ETH1::PDU_DisturbFalseEventTiming::TCPServer_SSOA_ICAS3IVI_DDA_XIX_E3V_VLAN_Infotainment
{
  if (@this == 1)
  {
    SetBusContext(gILETH1_BusContext);
    ILSetPDUTimingEvent(ETH_Cluster_MEB::TCPServer_SSOA_ICAS3IVI_DDA_XIX_E3V_VLAN_Infotainment, 0, @sysvar::IL_ETH1::PDU_FIFalseEventEnable::TCPServer_SSOA_ICAS3IVI_DDA_XIX_E3V_VLAN_Infotainment, @sysvar::IL_ETH1::PDU_FIFalseEventRepCount::TCPServer_SSOA_ICAS3IVI_DDA_XIX_E3V_VLAN_Infotainment, @sysvar::IL_ETH1::PDU_FIFalseEventRepPeriod::TCPServer_SSOA_ICAS3IVI_DDA_XIX_E3V_VLAN_Infotainment, @sysvar::IL_ETH1::PDU_FIEventDebounceDelay::TCPServer_SSOA_ICAS3IVI_DDA_XIX_E3V_VLAN_Infotainment, -1, 0);
  }
  else
  {
    SetBusContext(gILETH1_BusContext);
    ILResetPDUTimingEvent(ETH_Cluster_MEB::TCPServer_SSOA_ICAS3IVI_DDA_XIX_E3V_VLAN_Infotainment, 0);
  }
}

on sysvar_update sysvar::IL_ETH1::PDU_FIFalseEventEnable::TCPServer_SSOA_ICAS3IVI_DDA_XIX_E3V_VLAN_Infotainment
{
  if (@sysvar::IL_ETH1::PDU_DisturbFalseEventTiming::TCPServer_SSOA_ICAS3IVI_DDA_XIX_E3V_VLAN_Infotainment == 1)
  {
    SetBusContext(gILETH1_BusContext);
    ILSetPDUTimingEvent(ETH_Cluster_MEB::TCPServer_SSOA_ICAS3IVI_DDA_XIX_E3V_VLAN_Infotainment, 0, @sysvar::IL_ETH1::PDU_FIFalseEventEnable::TCPServer_SSOA_ICAS3IVI_DDA_XIX_E3V_VLAN_Infotainment, @sysvar::IL_ETH1::PDU_FIFalseEventRepCount::TCPServer_SSOA_ICAS3IVI_DDA_XIX_E3V_VLAN_Infotainment, @sysvar::IL_ETH1::PDU_FIFalseEventRepPeriod::TCPServer_SSOA_ICAS3IVI_DDA_XIX_E3V_VLAN_Infotainment, @sysvar::IL_ETH1::PDU_FIEventDebounceDelay::TCPServer_SSOA_ICAS3IVI_DDA_XIX_E3V_VLAN_Infotainment, -1, 0);
  }
}

on sysvar_update sysvar::IL_ETH1::PDU_FIFalseEventRepCount::TCPServer_SSOA_ICAS3IVI_DDA_XIX_E3V_VLAN_Infotainment
{
  if (@sysvar::IL_ETH1::PDU_DisturbFalseEventTiming::TCPServer_SSOA_ICAS3IVI_DDA_XIX_E3V_VLAN_Infotainment == 1)
  {
    SetBusContext(gILETH1_BusContext);
    ILSetPDUTimingEvent(ETH_Cluster_MEB::TCPServer_SSOA_ICAS3IVI_DDA_XIX_E3V_VLAN_Infotainment, 0, @sysvar::IL_ETH1::PDU_FIFalseEventEnable::TCPServer_SSOA_ICAS3IVI_DDA_XIX_E3V_VLAN_Infotainment, @sysvar::IL_ETH1::PDU_FIFalseEventRepCount::TCPServer_SSOA_ICAS3IVI_DDA_XIX_E3V_VLAN_Infotainment, @sysvar::IL_ETH1::PDU_FIFalseEventRepPeriod::TCPServer_SSOA_ICAS3IVI_DDA_XIX_E3V_VLAN_Infotainment, @sysvar::IL_ETH1::PDU_FIEventDebounceDelay::TCPServer_SSOA_ICAS3IVI_DDA_XIX_E3V_VLAN_Infotainment, -1, 0);
  }
}

on sysvar_update sysvar::IL_ETH1::PDU_FIFalseEventRepPeriod::TCPServer_SSOA_ICAS3IVI_DDA_XIX_E3V_VLAN_Infotainment
{
  if (@sysvar::IL_ETH1::PDU_DisturbFalseEventTiming::TCPServer_SSOA_ICAS3IVI_DDA_XIX_E3V_VLAN_Infotainment == 1)
  {
    SetBusContext(gILETH1_BusContext);
    ILSetPDUTimingEvent(ETH_Cluster_MEB::TCPServer_SSOA_ICAS3IVI_DDA_XIX_E3V_VLAN_Infotainment, 0, @sysvar::IL_ETH1::PDU_FIFalseEventEnable::TCPServer_SSOA_ICAS3IVI_DDA_XIX_E3V_VLAN_Infotainment, @sysvar::IL_ETH1::PDU_FIFalseEventRepCount::TCPServer_SSOA_ICAS3IVI_DDA_XIX_E3V_VLAN_Infotainment, @sysvar::IL_ETH1::PDU_FIFalseEventRepPeriod::TCPServer_SSOA_ICAS3IVI_DDA_XIX_E3V_VLAN_Infotainment, @sysvar::IL_ETH1::PDU_FIEventDebounceDelay::TCPServer_SSOA_ICAS3IVI_DDA_XIX_E3V_VLAN_Infotainment, -1, 0);
  }
}

on sysvar_update sysvar::IL_ETH1::PDU_DisturbTimingMode::TCPServer_SSOA_ICAS3IVI_GW_XIX_E3V_VLAN_Infotainment
{
  if (@this == 1)
  {
    SetBusContext(gILETH1_BusContext);
    ILSetPDUAsrTXMode(ETH_Cluster_MEB::TCPServer_SSOA_ICAS3IVI_GW_XIX_E3V_VLAN_Infotainment, @sysvar::IL_ETH1::PDU_FITimingMode::TCPServer_SSOA_ICAS3IVI_GW_XIX_E3V_VLAN_Infotainment, -1, 0);
  }
  else
  {
    SetBusContext(gILETH1_BusContext);
    ILResetPDUAsrTXMode(ETH_Cluster_MEB::TCPServer_SSOA_ICAS3IVI_GW_XIX_E3V_VLAN_Infotainment);
  }
}

on sysvar_update sysvar::IL_ETH1::PDU_FITimingMode::TCPServer_SSOA_ICAS3IVI_GW_XIX_E3V_VLAN_Infotainment
{
  if (@sysvar::IL_ETH1::PDU_DisturbTimingMode::TCPServer_SSOA_ICAS3IVI_GW_XIX_E3V_VLAN_Infotainment == 1)
  {
    SetBusContext(gILETH1_BusContext);
    ILSetPDUAsrTXMode(ETH_Cluster_MEB::TCPServer_SSOA_ICAS3IVI_GW_XIX_E3V_VLAN_Infotainment, @sysvar::IL_ETH1::PDU_FITimingMode::TCPServer_SSOA_ICAS3IVI_GW_XIX_E3V_VLAN_Infotainment, -1, 0);
  }
}

on sysvar_update sysvar::IL_ETH1::PDU_DisturbTrueCyclicTiming::TCPServer_SSOA_ICAS3IVI_GW_XIX_E3V_VLAN_Infotainment
{
  if (@this == 1)
  {
    SetBusContext(gILETH1_BusContext);
    ILSetPDUTimingCyclic(ETH_Cluster_MEB::TCPServer_SSOA_ICAS3IVI_GW_XIX_E3V_VLAN_Infotainment, 1, 0, @sysvar::IL_ETH1::PDU_FITrueCyclicPeriod::TCPServer_SSOA_ICAS3IVI_GW_XIX_E3V_VLAN_Infotainment, -1, 0);
  }
  else
  {
    SetBusContext(gILETH1_BusContext);
    ILResetPDUTimingCyclic(ETH_Cluster_MEB::TCPServer_SSOA_ICAS3IVI_GW_XIX_E3V_VLAN_Infotainment, 1);
  }
}

on sysvar_update sysvar::IL_ETH1::PDU_FITrueCyclicPeriod::TCPServer_SSOA_ICAS3IVI_GW_XIX_E3V_VLAN_Infotainment
{
  if (@sysvar::IL_ETH1::PDU_DisturbTrueCyclicTiming::TCPServer_SSOA_ICAS3IVI_GW_XIX_E3V_VLAN_Infotainment == 1)
  {
    SetBusContext(gILETH1_BusContext);
    ILSetPDUTimingCyclic(ETH_Cluster_MEB::TCPServer_SSOA_ICAS3IVI_GW_XIX_E3V_VLAN_Infotainment, 1, 0, @sysvar::IL_ETH1::PDU_FITrueCyclicPeriod::TCPServer_SSOA_ICAS3IVI_GW_XIX_E3V_VLAN_Infotainment, -1, 0);
  }
}

on sysvar_update sysvar::IL_ETH1::PDU_DisturbFalseCyclicTiming::TCPServer_SSOA_ICAS3IVI_GW_XIX_E3V_VLAN_Infotainment
{
  if (@this == 1)
  {
    SetBusContext(gILETH1_BusContext);
    ILSetPDUTimingCyclic(ETH_Cluster_MEB::TCPServer_SSOA_ICAS3IVI_GW_XIX_E3V_VLAN_Infotainment, 0, 0, @sysvar::IL_ETH1::PDU_FIFalseCyclicPeriod::TCPServer_SSOA_ICAS3IVI_GW_XIX_E3V_VLAN_Infotainment, -1, 0);
  }
  else
  {
    SetBusContext(gILETH1_BusContext);
    ILResetPDUTimingCyclic(ETH_Cluster_MEB::TCPServer_SSOA_ICAS3IVI_GW_XIX_E3V_VLAN_Infotainment, 0);
  }
}

on sysvar_update sysvar::IL_ETH1::PDU_FIFalseCyclicPeriod::TCPServer_SSOA_ICAS3IVI_GW_XIX_E3V_VLAN_Infotainment
{
  if (@sysvar::IL_ETH1::PDU_DisturbFalseCyclicTiming::TCPServer_SSOA_ICAS3IVI_GW_XIX_E3V_VLAN_Infotainment == 1)
  {
    SetBusContext(gILETH1_BusContext);
    ILSetPDUTimingCyclic(ETH_Cluster_MEB::TCPServer_SSOA_ICAS3IVI_GW_XIX_E3V_VLAN_Infotainment, 1, 0, @sysvar::IL_ETH1::PDU_FITrueCyclicPeriod::TCPServer_SSOA_ICAS3IVI_GW_XIX_E3V_VLAN_Infotainment, -1, 0);
  }
}

on sysvar_update sysvar::IL_ETH1::PDU_SendOnce::TCPServer_SSOA_ICAS3IVI_GW_XIX_E3V_VLAN_Infotainment
{
  if (@this == 1)
  {
    SetBusContext(gILETH1_BusContext);
    ILSetPDUEvent(ETH_Cluster_MEB::TCPServer_SSOA_ICAS3IVI_GW_XIX_E3V_VLAN_Infotainment);
  }
}

on sysvar_update sysvar::IL_ETH1::PDU_DisturbTrueEventTiming::TCPServer_SSOA_ICAS3IVI_GW_XIX_E3V_VLAN_Infotainment
{
  if (@this == 1)
  {
    SetBusContext(gILETH1_BusContext);
    ILSetPDUTimingEvent(ETH_Cluster_MEB::TCPServer_SSOA_ICAS3IVI_GW_XIX_E3V_VLAN_Infotainment, 1, @sysvar::IL_ETH1::PDU_FITrueEventEnable::TCPServer_SSOA_ICAS3IVI_GW_XIX_E3V_VLAN_Infotainment, @sysvar::IL_ETH1::PDU_FITrueEventRepCount::TCPServer_SSOA_ICAS3IVI_GW_XIX_E3V_VLAN_Infotainment, @sysvar::IL_ETH1::PDU_FITrueEventRepPeriod::TCPServer_SSOA_ICAS3IVI_GW_XIX_E3V_VLAN_Infotainment, @sysvar::IL_ETH1::PDU_FIEventDebounceDelay::TCPServer_SSOA_ICAS3IVI_GW_XIX_E3V_VLAN_Infotainment, -1, 0);
  }
  else
  {
    SetBusContext(gILETH1_BusContext);
    ILResetPDUTimingEvent(ETH_Cluster_MEB::TCPServer_SSOA_ICAS3IVI_GW_XIX_E3V_VLAN_Infotainment, 1);
  }
}

on sysvar_update sysvar::IL_ETH1::PDU_FITrueEventEnable::TCPServer_SSOA_ICAS3IVI_GW_XIX_E3V_VLAN_Infotainment
{
  if (@sysvar::IL_ETH1::PDU_DisturbTrueEventTiming::TCPServer_SSOA_ICAS3IVI_GW_XIX_E3V_VLAN_Infotainment == 1)
  {
    SetBusContext(gILETH1_BusContext);
    ILSetPDUTimingEvent(ETH_Cluster_MEB::TCPServer_SSOA_ICAS3IVI_GW_XIX_E3V_VLAN_Infotainment, 1, @sysvar::IL_ETH1::PDU_FITrueEventEnable::TCPServer_SSOA_ICAS3IVI_GW_XIX_E3V_VLAN_Infotainment, @sysvar::IL_ETH1::PDU_FITrueEventRepCount::TCPServer_SSOA_ICAS3IVI_GW_XIX_E3V_VLAN_Infotainment, @sysvar::IL_ETH1::PDU_FITrueEventRepPeriod::TCPServer_SSOA_ICAS3IVI_GW_XIX_E3V_VLAN_Infotainment, @sysvar::IL_ETH1::PDU_FIEventDebounceDelay::TCPServer_SSOA_ICAS3IVI_GW_XIX_E3V_VLAN_Infotainment, -1, 0);
  }
}

on sysvar_update sysvar::IL_ETH1::PDU_FITrueEventRepCount::TCPServer_SSOA_ICAS3IVI_GW_XIX_E3V_VLAN_Infotainment
{
  if (@sysvar::IL_ETH1::PDU_DisturbTrueEventTiming::TCPServer_SSOA_ICAS3IVI_GW_XIX_E3V_VLAN_Infotainment == 1)
  {
    SetBusContext(gILETH1_BusContext);
    ILSetPDUTimingEvent(ETH_Cluster_MEB::TCPServer_SSOA_ICAS3IVI_GW_XIX_E3V_VLAN_Infotainment, 1, @sysvar::IL_ETH1::PDU_FITrueEventEnable::TCPServer_SSOA_ICAS3IVI_GW_XIX_E3V_VLAN_Infotainment, @sysvar::IL_ETH1::PDU_FITrueEventRepCount::TCPServer_SSOA_ICAS3IVI_GW_XIX_E3V_VLAN_Infotainment, @sysvar::IL_ETH1::PDU_FITrueEventRepPeriod::TCPServer_SSOA_ICAS3IVI_GW_XIX_E3V_VLAN_Infotainment, @sysvar::IL_ETH1::PDU_FIEventDebounceDelay::TCPServer_SSOA_ICAS3IVI_GW_XIX_E3V_VLAN_Infotainment, -1, 0);
  }
}

on sysvar_update sysvar::IL_ETH1::PDU_FITrueEventRepPeriod::TCPServer_SSOA_ICAS3IVI_GW_XIX_E3V_VLAN_Infotainment
{
  if (@sysvar::IL_ETH1::PDU_DisturbTrueEventTiming::TCPServer_SSOA_ICAS3IVI_GW_XIX_E3V_VLAN_Infotainment == 1)
  {
    SetBusContext(gILETH1_BusContext);
    ILSetPDUTimingEvent(ETH_Cluster_MEB::TCPServer_SSOA_ICAS3IVI_GW_XIX_E3V_VLAN_Infotainment, 1, @sysvar::IL_ETH1::PDU_FITrueEventEnable::TCPServer_SSOA_ICAS3IVI_GW_XIX_E3V_VLAN_Infotainment, @sysvar::IL_ETH1::PDU_FITrueEventRepCount::TCPServer_SSOA_ICAS3IVI_GW_XIX_E3V_VLAN_Infotainment, @sysvar::IL_ETH1::PDU_FITrueEventRepPeriod::TCPServer_SSOA_ICAS3IVI_GW_XIX_E3V_VLAN_Infotainment, @sysvar::IL_ETH1::PDU_FIEventDebounceDelay::TCPServer_SSOA_ICAS3IVI_GW_XIX_E3V_VLAN_Infotainment, -1, 0);
  }
}

on sysvar_update sysvar::IL_ETH1::PDU_FIEventDebounceDelay::TCPServer_SSOA_ICAS3IVI_GW_XIX_E3V_VLAN_Infotainment
{
  if (@sysvar::IL_ETH1::PDU_DisturbTrueEventTiming::TCPServer_SSOA_ICAS3IVI_GW_XIX_E3V_VLAN_Infotainment == 1)
  {
    SetBusContext(gILETH1_BusContext);
    ILSetPDUTimingEvent(ETH_Cluster_MEB::TCPServer_SSOA_ICAS3IVI_GW_XIX_E3V_VLAN_Infotainment, 1, @sysvar::IL_ETH1::PDU_FITrueEventEnable::TCPServer_SSOA_ICAS3IVI_GW_XIX_E3V_VLAN_Infotainment, @sysvar::IL_ETH1::PDU_FITrueEventRepCount::TCPServer_SSOA_ICAS3IVI_GW_XIX_E3V_VLAN_Infotainment, @sysvar::IL_ETH1::PDU_FITrueEventRepPeriod::TCPServer_SSOA_ICAS3IVI_GW_XIX_E3V_VLAN_Infotainment, @sysvar::IL_ETH1::PDU_FIEventDebounceDelay::TCPServer_SSOA_ICAS3IVI_GW_XIX_E3V_VLAN_Infotainment, -1, 0);
  }
  if (@sysvar::IL_ETH1::PDU_DisturbFalseEventTiming::TCPServer_SSOA_ICAS3IVI_GW_XIX_E3V_VLAN_Infotainment == 1)
  {
    SetBusContext(gILETH1_BusContext);
    ILSetPDUTimingEvent(ETH_Cluster_MEB::TCPServer_SSOA_ICAS3IVI_GW_XIX_E3V_VLAN_Infotainment, 0, @sysvar::IL_ETH1::PDU_FIFalseEventEnable::TCPServer_SSOA_ICAS3IVI_GW_XIX_E3V_VLAN_Infotainment, @sysvar::IL_ETH1::PDU_FIFalseEventRepCount::TCPServer_SSOA_ICAS3IVI_GW_XIX_E3V_VLAN_Infotainment, @sysvar::IL_ETH1::PDU_FIFalseEventRepPeriod::TCPServer_SSOA_ICAS3IVI_GW_XIX_E3V_VLAN_Infotainment, @sysvar::IL_ETH1::PDU_FIEventDebounceDelay::TCPServer_SSOA_ICAS3IVI_GW_XIX_E3V_VLAN_Infotainment, -1, 0);
  }
}

on sysvar_update sysvar::IL_ETH1::PDU_DisturbFalseEventTiming::TCPServer_SSOA_ICAS3IVI_GW_XIX_E3V_VLAN_Infotainment
{
  if (@this == 1)
  {
    SetBusContext(gILETH1_BusContext);
    ILSetPDUTimingEvent(ETH_Cluster_MEB::TCPServer_SSOA_ICAS3IVI_GW_XIX_E3V_VLAN_Infotainment, 0, @sysvar::IL_ETH1::PDU_FIFalseEventEnable::TCPServer_SSOA_ICAS3IVI_GW_XIX_E3V_VLAN_Infotainment, @sysvar::IL_ETH1::PDU_FIFalseEventRepCount::TCPServer_SSOA_ICAS3IVI_GW_XIX_E3V_VLAN_Infotainment, @sysvar::IL_ETH1::PDU_FIFalseEventRepPeriod::TCPServer_SSOA_ICAS3IVI_GW_XIX_E3V_VLAN_Infotainment, @sysvar::IL_ETH1::PDU_FIEventDebounceDelay::TCPServer_SSOA_ICAS3IVI_GW_XIX_E3V_VLAN_Infotainment, -1, 0);
  }
  else
  {
    SetBusContext(gILETH1_BusContext);
    ILResetPDUTimingEvent(ETH_Cluster_MEB::TCPServer_SSOA_ICAS3IVI_GW_XIX_E3V_VLAN_Infotainment, 0);
  }
}

on sysvar_update sysvar::IL_ETH1::PDU_FIFalseEventEnable::TCPServer_SSOA_ICAS3IVI_GW_XIX_E3V_VLAN_Infotainment
{
  if (@sysvar::IL_ETH1::PDU_DisturbFalseEventTiming::TCPServer_SSOA_ICAS3IVI_GW_XIX_E3V_VLAN_Infotainment == 1)
  {
    SetBusContext(gILETH1_BusContext);
    ILSetPDUTimingEvent(ETH_Cluster_MEB::TCPServer_SSOA_ICAS3IVI_GW_XIX_E3V_VLAN_Infotainment, 0, @sysvar::IL_ETH1::PDU_FIFalseEventEnable::TCPServer_SSOA_ICAS3IVI_GW_XIX_E3V_VLAN_Infotainment, @sysvar::IL_ETH1::PDU_FIFalseEventRepCount::TCPServer_SSOA_ICAS3IVI_GW_XIX_E3V_VLAN_Infotainment, @sysvar::IL_ETH1::PDU_FIFalseEventRepPeriod::TCPServer_SSOA_ICAS3IVI_GW_XIX_E3V_VLAN_Infotainment, @sysvar::IL_ETH1::PDU_FIEventDebounceDelay::TCPServer_SSOA_ICAS3IVI_GW_XIX_E3V_VLAN_Infotainment, -1, 0);
  }
}

on sysvar_update sysvar::IL_ETH1::PDU_FIFalseEventRepCount::TCPServer_SSOA_ICAS3IVI_GW_XIX_E3V_VLAN_Infotainment
{
  if (@sysvar::IL_ETH1::PDU_DisturbFalseEventTiming::TCPServer_SSOA_ICAS3IVI_GW_XIX_E3V_VLAN_Infotainment == 1)
  {
    SetBusContext(gILETH1_BusContext);
    ILSetPDUTimingEvent(ETH_Cluster_MEB::TCPServer_SSOA_ICAS3IVI_GW_XIX_E3V_VLAN_Infotainment, 0, @sysvar::IL_ETH1::PDU_FIFalseEventEnable::TCPServer_SSOA_ICAS3IVI_GW_XIX_E3V_VLAN_Infotainment, @sysvar::IL_ETH1::PDU_FIFalseEventRepCount::TCPServer_SSOA_ICAS3IVI_GW_XIX_E3V_VLAN_Infotainment, @sysvar::IL_ETH1::PDU_FIFalseEventRepPeriod::TCPServer_SSOA_ICAS3IVI_GW_XIX_E3V_VLAN_Infotainment, @sysvar::IL_ETH1::PDU_FIEventDebounceDelay::TCPServer_SSOA_ICAS3IVI_GW_XIX_E3V_VLAN_Infotainment, -1, 0);
  }
}

on sysvar_update sysvar::IL_ETH1::PDU_FIFalseEventRepPeriod::TCPServer_SSOA_ICAS3IVI_GW_XIX_E3V_VLAN_Infotainment
{
  if (@sysvar::IL_ETH1::PDU_DisturbFalseEventTiming::TCPServer_SSOA_ICAS3IVI_GW_XIX_E3V_VLAN_Infotainment == 1)
  {
    SetBusContext(gILETH1_BusContext);
    ILSetPDUTimingEvent(ETH_Cluster_MEB::TCPServer_SSOA_ICAS3IVI_GW_XIX_E3V_VLAN_Infotainment, 0, @sysvar::IL_ETH1::PDU_FIFalseEventEnable::TCPServer_SSOA_ICAS3IVI_GW_XIX_E3V_VLAN_Infotainment, @sysvar::IL_ETH1::PDU_FIFalseEventRepCount::TCPServer_SSOA_ICAS3IVI_GW_XIX_E3V_VLAN_Infotainment, @sysvar::IL_ETH1::PDU_FIFalseEventRepPeriod::TCPServer_SSOA_ICAS3IVI_GW_XIX_E3V_VLAN_Infotainment, @sysvar::IL_ETH1::PDU_FIEventDebounceDelay::TCPServer_SSOA_ICAS3IVI_GW_XIX_E3V_VLAN_Infotainment, -1, 0);
  }
}

on sysvar_update sysvar::IL_ETH1::PDU_DisturbTimingMode::TCPServer_SSOA_ICAS3IVI_ICAS1Sys01_XIX_E3V_VLAN_Infotainment
{
  if (@this == 1)
  {
    SetBusContext(gILETH1_BusContext);
    ILSetPDUAsrTXMode(ETH_Cluster_MEB::TCPServer_SSOA_ICAS3IVI_ICAS1Sys01_XIX_E3V_VLAN_Infotainment, @sysvar::IL_ETH1::PDU_FITimingMode::TCPServer_SSOA_ICAS3IVI_ICAS1Sys01_XIX_E3V_VLAN_Infotainment, -1, 0);
  }
  else
  {
    SetBusContext(gILETH1_BusContext);
    ILResetPDUAsrTXMode(ETH_Cluster_MEB::TCPServer_SSOA_ICAS3IVI_ICAS1Sys01_XIX_E3V_VLAN_Infotainment);
  }
}

on sysvar_update sysvar::IL_ETH1::PDU_FITimingMode::TCPServer_SSOA_ICAS3IVI_ICAS1Sys01_XIX_E3V_VLAN_Infotainment
{
  if (@sysvar::IL_ETH1::PDU_DisturbTimingMode::TCPServer_SSOA_ICAS3IVI_ICAS1Sys01_XIX_E3V_VLAN_Infotainment == 1)
  {
    SetBusContext(gILETH1_BusContext);
    ILSetPDUAsrTXMode(ETH_Cluster_MEB::TCPServer_SSOA_ICAS3IVI_ICAS1Sys01_XIX_E3V_VLAN_Infotainment, @sysvar::IL_ETH1::PDU_FITimingMode::TCPServer_SSOA_ICAS3IVI_ICAS1Sys01_XIX_E3V_VLAN_Infotainment, -1, 0);
  }
}

on sysvar_update sysvar::IL_ETH1::PDU_DisturbTrueCyclicTiming::TCPServer_SSOA_ICAS3IVI_ICAS1Sys01_XIX_E3V_VLAN_Infotainment
{
  if (@this == 1)
  {
    SetBusContext(gILETH1_BusContext);
    ILSetPDUTimingCyclic(ETH_Cluster_MEB::TCPServer_SSOA_ICAS3IVI_ICAS1Sys01_XIX_E3V_VLAN_Infotainment, 1, 0, @sysvar::IL_ETH1::PDU_FITrueCyclicPeriod::TCPServer_SSOA_ICAS3IVI_ICAS1Sys01_XIX_E3V_VLAN_Infotainment, -1, 0);
  }
  else
  {
    SetBusContext(gILETH1_BusContext);
    ILResetPDUTimingCyclic(ETH_Cluster_MEB::TCPServer_SSOA_ICAS3IVI_ICAS1Sys01_XIX_E3V_VLAN_Infotainment, 1);
  }
}

on sysvar_update sysvar::IL_ETH1::PDU_FITrueCyclicPeriod::TCPServer_SSOA_ICAS3IVI_ICAS1Sys01_XIX_E3V_VLAN_Infotainment
{
  if (@sysvar::IL_ETH1::PDU_DisturbTrueCyclicTiming::TCPServer_SSOA_ICAS3IVI_ICAS1Sys01_XIX_E3V_VLAN_Infotainment == 1)
  {
    SetBusContext(gILETH1_BusContext);
    ILSetPDUTimingCyclic(ETH_Cluster_MEB::TCPServer_SSOA_ICAS3IVI_ICAS1Sys01_XIX_E3V_VLAN_Infotainment, 1, 0, @sysvar::IL_ETH1::PDU_FITrueCyclicPeriod::TCPServer_SSOA_ICAS3IVI_ICAS1Sys01_XIX_E3V_VLAN_Infotainment, -1, 0);
  }
}

on sysvar_update sysvar::IL_ETH1::PDU_DisturbFalseCyclicTiming::TCPServer_SSOA_ICAS3IVI_ICAS1Sys01_XIX_E3V_VLAN_Infotainment
{
  if (@this == 1)
  {
    SetBusContext(gILETH1_BusContext);
    ILSetPDUTimingCyclic(ETH_Cluster_MEB::TCPServer_SSOA_ICAS3IVI_ICAS1Sys01_XIX_E3V_VLAN_Infotainment, 0, 0, @sysvar::IL_ETH1::PDU_FIFalseCyclicPeriod::TCPServer_SSOA_ICAS3IVI_ICAS1Sys01_XIX_E3V_VLAN_Infotainment, -1, 0);
  }
  else
  {
    SetBusContext(gILETH1_BusContext);
    ILResetPDUTimingCyclic(ETH_Cluster_MEB::TCPServer_SSOA_ICAS3IVI_ICAS1Sys01_XIX_E3V_VLAN_Infotainment, 0);
  }
}

on sysvar_update sysvar::IL_ETH1::PDU_FIFalseCyclicPeriod::TCPServer_SSOA_ICAS3IVI_ICAS1Sys01_XIX_E3V_VLAN_Infotainment
{
  if (@sysvar::IL_ETH1::PDU_DisturbFalseCyclicTiming::TCPServer_SSOA_ICAS3IVI_ICAS1Sys01_XIX_E3V_VLAN_Infotainment == 1)
  {
    SetBusContext(gILETH1_BusContext);
    ILSetPDUTimingCyclic(ETH_Cluster_MEB::TCPServer_SSOA_ICAS3IVI_ICAS1Sys01_XIX_E3V_VLAN_Infotainment, 1, 0, @sysvar::IL_ETH1::PDU_FITrueCyclicPeriod::TCPServer_SSOA_ICAS3IVI_ICAS1Sys01_XIX_E3V_VLAN_Infotainment, -1, 0);
  }
}

on sysvar_update sysvar::IL_ETH1::PDU_SendOnce::TCPServer_SSOA_ICAS3IVI_ICAS1Sys01_XIX_E3V_VLAN_Infotainment
{
  if (@this == 1)
  {
    SetBusContext(gILETH1_BusContext);
    ILSetPDUEvent(ETH_Cluster_MEB::TCPServer_SSOA_ICAS3IVI_ICAS1Sys01_XIX_E3V_VLAN_Infotainment);
  }
}

on sysvar_update sysvar::IL_ETH1::PDU_DisturbTrueEventTiming::TCPServer_SSOA_ICAS3IVI_ICAS1Sys01_XIX_E3V_VLAN_Infotainment
{
  if (@this == 1)
  {
    SetBusContext(gILETH1_BusContext);
    ILSetPDUTimingEvent(ETH_Cluster_MEB::TCPServer_SSOA_ICAS3IVI_ICAS1Sys01_XIX_E3V_VLAN_Infotainment, 1, @sysvar::IL_ETH1::PDU_FITrueEventEnable::TCPServer_SSOA_ICAS3IVI_ICAS1Sys01_XIX_E3V_VLAN_Infotainment, @sysvar::IL_ETH1::PDU_FITrueEventRepCount::TCPServer_SSOA_ICAS3IVI_ICAS1Sys01_XIX_E3V_VLAN_Infotainment, @sysvar::IL_ETH1::PDU_FITrueEventRepPeriod::TCPServer_SSOA_ICAS3IVI_ICAS1Sys01_XIX_E3V_VLAN_Infotainment, @sysvar::IL_ETH1::PDU_FIEventDebounceDelay::TCPServer_SSOA_ICAS3IVI_ICAS1Sys01_XIX_E3V_VLAN_Infotainment, -1, 0);
  }
  else
  {
    SetBusContext(gILETH1_BusContext);
    ILResetPDUTimingEvent(ETH_Cluster_MEB::TCPServer_SSOA_ICAS3IVI_ICAS1Sys01_XIX_E3V_VLAN_Infotainment, 1);
  }
}

on sysvar_update sysvar::IL_ETH1::PDU_FITrueEventEnable::TCPServer_SSOA_ICAS3IVI_ICAS1Sys01_XIX_E3V_VLAN_Infotainment
{
  if (@sysvar::IL_ETH1::PDU_DisturbTrueEventTiming::TCPServer_SSOA_ICAS3IVI_ICAS1Sys01_XIX_E3V_VLAN_Infotainment == 1)
  {
    SetBusContext(gILETH1_BusContext);
    ILSetPDUTimingEvent(ETH_Cluster_MEB::TCPServer_SSOA_ICAS3IVI_ICAS1Sys01_XIX_E3V_VLAN_Infotainment, 1, @sysvar::IL_ETH1::PDU_FITrueEventEnable::TCPServer_SSOA_ICAS3IVI_ICAS1Sys01_XIX_E3V_VLAN_Infotainment, @sysvar::IL_ETH1::PDU_FITrueEventRepCount::TCPServer_SSOA_ICAS3IVI_ICAS1Sys01_XIX_E3V_VLAN_Infotainment, @sysvar::IL_ETH1::PDU_FITrueEventRepPeriod::TCPServer_SSOA_ICAS3IVI_ICAS1Sys01_XIX_E3V_VLAN_Infotainment, @sysvar::IL_ETH1::PDU_FIEventDebounceDelay::TCPServer_SSOA_ICAS3IVI_ICAS1Sys01_XIX_E3V_VLAN_Infotainment, -1, 0);
  }
}

on sysvar_update sysvar::IL_ETH1::PDU_FITrueEventRepCount::TCPServer_SSOA_ICAS3IVI_ICAS1Sys01_XIX_E3V_VLAN_Infotainment
{
  if (@sysvar::IL_ETH1::PDU_DisturbTrueEventTiming::TCPServer_SSOA_ICAS3IVI_ICAS1Sys01_XIX_E3V_VLAN_Infotainment == 1)
  {
    SetBusContext(gILETH1_BusContext);
    ILSetPDUTimingEvent(ETH_Cluster_MEB::TCPServer_SSOA_ICAS3IVI_ICAS1Sys01_XIX_E3V_VLAN_Infotainment, 1, @sysvar::IL_ETH1::PDU_FITrueEventEnable::TCPServer_SSOA_ICAS3IVI_ICAS1Sys01_XIX_E3V_VLAN_Infotainment, @sysvar::IL_ETH1::PDU_FITrueEventRepCount::TCPServer_SSOA_ICAS3IVI_ICAS1Sys01_XIX_E3V_VLAN_Infotainment, @sysvar::IL_ETH1::PDU_FITrueEventRepPeriod::TCPServer_SSOA_ICAS3IVI_ICAS1Sys01_XIX_E3V_VLAN_Infotainment, @sysvar::IL_ETH1::PDU_FIEventDebounceDelay::TCPServer_SSOA_ICAS3IVI_ICAS1Sys01_XIX_E3V_VLAN_Infotainment, -1, 0);
  }
}

on sysvar_update sysvar::IL_ETH1::PDU_FITrueEventRepPeriod::TCPServer_SSOA_ICAS3IVI_ICAS1Sys01_XIX_E3V_VLAN_Infotainment
{
  if (@sysvar::IL_ETH1::PDU_DisturbTrueEventTiming::TCPServer_SSOA_ICAS3IVI_ICAS1Sys01_XIX_E3V_VLAN_Infotainment == 1)
  {
    SetBusContext(gILETH1_BusContext);
    ILSetPDUTimingEvent(ETH_Cluster_MEB::TCPServer_SSOA_ICAS3IVI_ICAS1Sys01_XIX_E3V_VLAN_Infotainment, 1, @sysvar::IL_ETH1::PDU_FITrueEventEnable::TCPServer_SSOA_ICAS3IVI_ICAS1Sys01_XIX_E3V_VLAN_Infotainment, @sysvar::IL_ETH1::PDU_FITrueEventRepCount::TCPServer_SSOA_ICAS3IVI_ICAS1Sys01_XIX_E3V_VLAN_Infotainment, @sysvar::IL_ETH1::PDU_FITrueEventRepPeriod::TCPServer_SSOA_ICAS3IVI_ICAS1Sys01_XIX_E3V_VLAN_Infotainment, @sysvar::IL_ETH1::PDU_FIEventDebounceDelay::TCPServer_SSOA_ICAS3IVI_ICAS1Sys01_XIX_E3V_VLAN_Infotainment, -1, 0);
  }
}

on sysvar_update sysvar::IL_ETH1::PDU_FIEventDebounceDelay::TCPServer_SSOA_ICAS3IVI_ICAS1Sys01_XIX_E3V_VLAN_Infotainment
{
  if (@sysvar::IL_ETH1::PDU_DisturbTrueEventTiming::TCPServer_SSOA_ICAS3IVI_ICAS1Sys01_XIX_E3V_VLAN_Infotainment == 1)
  {
    SetBusContext(gILETH1_BusContext);
    ILSetPDUTimingEvent(ETH_Cluster_MEB::TCPServer_SSOA_ICAS3IVI_ICAS1Sys01_XIX_E3V_VLAN_Infotainment, 1, @sysvar::IL_ETH1::PDU_FITrueEventEnable::TCPServer_SSOA_ICAS3IVI_ICAS1Sys01_XIX_E3V_VLAN_Infotainment, @sysvar::IL_ETH1::PDU_FITrueEventRepCount::TCPServer_SSOA_ICAS3IVI_ICAS1Sys01_XIX_E3V_VLAN_Infotainment, @sysvar::IL_ETH1::PDU_FITrueEventRepPeriod::TCPServer_SSOA_ICAS3IVI_ICAS1Sys01_XIX_E3V_VLAN_Infotainment, @sysvar::IL_ETH1::PDU_FIEventDebounceDelay::TCPServer_SSOA_ICAS3IVI_ICAS1Sys01_XIX_E3V_VLAN_Infotainment, -1, 0);
  }
  if (@sysvar::IL_ETH1::PDU_DisturbFalseEventTiming::TCPServer_SSOA_ICAS3IVI_ICAS1Sys01_XIX_E3V_VLAN_Infotainment == 1)
  {
    SetBusContext(gILETH1_BusContext);
    ILSetPDUTimingEvent(ETH_Cluster_MEB::TCPServer_SSOA_ICAS3IVI_ICAS1Sys01_XIX_E3V_VLAN_Infotainment, 0, @sysvar::IL_ETH1::PDU_FIFalseEventEnable::TCPServer_SSOA_ICAS3IVI_ICAS1Sys01_XIX_E3V_VLAN_Infotainment, @sysvar::IL_ETH1::PDU_FIFalseEventRepCount::TCPServer_SSOA_ICAS3IVI_ICAS1Sys01_XIX_E3V_VLAN_Infotainment, @sysvar::IL_ETH1::PDU_FIFalseEventRepPeriod::TCPServer_SSOA_ICAS3IVI_ICAS1Sys01_XIX_E3V_VLAN_Infotainment, @sysvar::IL_ETH1::PDU_FIEventDebounceDelay::TCPServer_SSOA_ICAS3IVI_ICAS1Sys01_XIX_E3V_VLAN_Infotainment, -1, 0);
  }
}

on sysvar_update sysvar::IL_ETH1::PDU_DisturbFalseEventTiming::TCPServer_SSOA_ICAS3IVI_ICAS1Sys01_XIX_E3V_VLAN_Infotainment
{
  if (@this == 1)
  {
    SetBusContext(gILETH1_BusContext);
    ILSetPDUTimingEvent(ETH_Cluster_MEB::TCPServer_SSOA_ICAS3IVI_ICAS1Sys01_XIX_E3V_VLAN_Infotainment, 0, @sysvar::IL_ETH1::PDU_FIFalseEventEnable::TCPServer_SSOA_ICAS3IVI_ICAS1Sys01_XIX_E3V_VLAN_Infotainment, @sysvar::IL_ETH1::PDU_FIFalseEventRepCount::TCPServer_SSOA_ICAS3IVI_ICAS1Sys01_XIX_E3V_VLAN_Infotainment, @sysvar::IL_ETH1::PDU_FIFalseEventRepPeriod::TCPServer_SSOA_ICAS3IVI_ICAS1Sys01_XIX_E3V_VLAN_Infotainment, @sysvar::IL_ETH1::PDU_FIEventDebounceDelay::TCPServer_SSOA_ICAS3IVI_ICAS1Sys01_XIX_E3V_VLAN_Infotainment, -1, 0);
  }
  else
  {
    SetBusContext(gILETH1_BusContext);
    ILResetPDUTimingEvent(ETH_Cluster_MEB::TCPServer_SSOA_ICAS3IVI_ICAS1Sys01_XIX_E3V_VLAN_Infotainment, 0);
  }
}

on sysvar_update sysvar::IL_ETH1::PDU_FIFalseEventEnable::TCPServer_SSOA_ICAS3IVI_ICAS1Sys01_XIX_E3V_VLAN_Infotainment
{
  if (@sysvar::IL_ETH1::PDU_DisturbFalseEventTiming::TCPServer_SSOA_ICAS3IVI_ICAS1Sys01_XIX_E3V_VLAN_Infotainment == 1)
  {
    SetBusContext(gILETH1_BusContext);
    ILSetPDUTimingEvent(ETH_Cluster_MEB::TCPServer_SSOA_ICAS3IVI_ICAS1Sys01_XIX_E3V_VLAN_Infotainment, 0, @sysvar::IL_ETH1::PDU_FIFalseEventEnable::TCPServer_SSOA_ICAS3IVI_ICAS1Sys01_XIX_E3V_VLAN_Infotainment, @sysvar::IL_ETH1::PDU_FIFalseEventRepCount::TCPServer_SSOA_ICAS3IVI_ICAS1Sys01_XIX_E3V_VLAN_Infotainment, @sysvar::IL_ETH1::PDU_FIFalseEventRepPeriod::TCPServer_SSOA_ICAS3IVI_ICAS1Sys01_XIX_E3V_VLAN_Infotainment, @sysvar::IL_ETH1::PDU_FIEventDebounceDelay::TCPServer_SSOA_ICAS3IVI_ICAS1Sys01_XIX_E3V_VLAN_Infotainment, -1, 0);
  }
}

on sysvar_update sysvar::IL_ETH1::PDU_FIFalseEventRepCount::TCPServer_SSOA_ICAS3IVI_ICAS1Sys01_XIX_E3V_VLAN_Infotainment
{
  if (@sysvar::IL_ETH1::PDU_DisturbFalseEventTiming::TCPServer_SSOA_ICAS3IVI_ICAS1Sys01_XIX_E3V_VLAN_Infotainment == 1)
  {
    SetBusContext(gILETH1_BusContext);
    ILSetPDUTimingEvent(ETH_Cluster_MEB::TCPServer_SSOA_ICAS3IVI_ICAS1Sys01_XIX_E3V_VLAN_Infotainment, 0, @sysvar::IL_ETH1::PDU_FIFalseEventEnable::TCPServer_SSOA_ICAS3IVI_ICAS1Sys01_XIX_E3V_VLAN_Infotainment, @sysvar::IL_ETH1::PDU_FIFalseEventRepCount::TCPServer_SSOA_ICAS3IVI_ICAS1Sys01_XIX_E3V_VLAN_Infotainment, @sysvar::IL_ETH1::PDU_FIFalseEventRepPeriod::TCPServer_SSOA_ICAS3IVI_ICAS1Sys01_XIX_E3V_VLAN_Infotainment, @sysvar::IL_ETH1::PDU_FIEventDebounceDelay::TCPServer_SSOA_ICAS3IVI_ICAS1Sys01_XIX_E3V_VLAN_Infotainment, -1, 0);
  }
}

on sysvar_update sysvar::IL_ETH1::PDU_FIFalseEventRepPeriod::TCPServer_SSOA_ICAS3IVI_ICAS1Sys01_XIX_E3V_VLAN_Infotainment
{
  if (@sysvar::IL_ETH1::PDU_DisturbFalseEventTiming::TCPServer_SSOA_ICAS3IVI_ICAS1Sys01_XIX_E3V_VLAN_Infotainment == 1)
  {
    SetBusContext(gILETH1_BusContext);
    ILSetPDUTimingEvent(ETH_Cluster_MEB::TCPServer_SSOA_ICAS3IVI_ICAS1Sys01_XIX_E3V_VLAN_Infotainment, 0, @sysvar::IL_ETH1::PDU_FIFalseEventEnable::TCPServer_SSOA_ICAS3IVI_ICAS1Sys01_XIX_E3V_VLAN_Infotainment, @sysvar::IL_ETH1::PDU_FIFalseEventRepCount::TCPServer_SSOA_ICAS3IVI_ICAS1Sys01_XIX_E3V_VLAN_Infotainment, @sysvar::IL_ETH1::PDU_FIFalseEventRepPeriod::TCPServer_SSOA_ICAS3IVI_ICAS1Sys01_XIX_E3V_VLAN_Infotainment, @sysvar::IL_ETH1::PDU_FIEventDebounceDelay::TCPServer_SSOA_ICAS3IVI_ICAS1Sys01_XIX_E3V_VLAN_Infotainment, -1, 0);
  }
}

on sysvar_update sysvar::IL_ETH1::PDU_DisturbTimingMode::TCPServer_SSOA_ICAS3IVI_ICAS1Sys02_XIX_E3V_VLAN_Infotainment
{
  if (@this == 1)
  {
    SetBusContext(gILETH1_BusContext);
    ILSetPDUAsrTXMode(ETH_Cluster_MEB::TCPServer_SSOA_ICAS3IVI_ICAS1Sys02_XIX_E3V_VLAN_Infotainment, @sysvar::IL_ETH1::PDU_FITimingMode::TCPServer_SSOA_ICAS3IVI_ICAS1Sys02_XIX_E3V_VLAN_Infotainment, -1, 0);
  }
  else
  {
    SetBusContext(gILETH1_BusContext);
    ILResetPDUAsrTXMode(ETH_Cluster_MEB::TCPServer_SSOA_ICAS3IVI_ICAS1Sys02_XIX_E3V_VLAN_Infotainment);
  }
}

on sysvar_update sysvar::IL_ETH1::PDU_FITimingMode::TCPServer_SSOA_ICAS3IVI_ICAS1Sys02_XIX_E3V_VLAN_Infotainment
{
  if (@sysvar::IL_ETH1::PDU_DisturbTimingMode::TCPServer_SSOA_ICAS3IVI_ICAS1Sys02_XIX_E3V_VLAN_Infotainment == 1)
  {
    SetBusContext(gILETH1_BusContext);
    ILSetPDUAsrTXMode(ETH_Cluster_MEB::TCPServer_SSOA_ICAS3IVI_ICAS1Sys02_XIX_E3V_VLAN_Infotainment, @sysvar::IL_ETH1::PDU_FITimingMode::TCPServer_SSOA_ICAS3IVI_ICAS1Sys02_XIX_E3V_VLAN_Infotainment, -1, 0);
  }
}

on sysvar_update sysvar::IL_ETH1::PDU_DisturbTrueCyclicTiming::TCPServer_SSOA_ICAS3IVI_ICAS1Sys02_XIX_E3V_VLAN_Infotainment
{
  if (@this == 1)
  {
    SetBusContext(gILETH1_BusContext);
    ILSetPDUTimingCyclic(ETH_Cluster_MEB::TCPServer_SSOA_ICAS3IVI_ICAS1Sys02_XIX_E3V_VLAN_Infotainment, 1, 0, @sysvar::IL_ETH1::PDU_FITrueCyclicPeriod::TCPServer_SSOA_ICAS3IVI_ICAS1Sys02_XIX_E3V_VLAN_Infotainment, -1, 0);
  }
  else
  {
    SetBusContext(gILETH1_BusContext);
    ILResetPDUTimingCyclic(ETH_Cluster_MEB::TCPServer_SSOA_ICAS3IVI_ICAS1Sys02_XIX_E3V_VLAN_Infotainment, 1);
  }
}

on sysvar_update sysvar::IL_ETH1::PDU_FITrueCyclicPeriod::TCPServer_SSOA_ICAS3IVI_ICAS1Sys02_XIX_E3V_VLAN_Infotainment
{
  if (@sysvar::IL_ETH1::PDU_DisturbTrueCyclicTiming::TCPServer_SSOA_ICAS3IVI_ICAS1Sys02_XIX_E3V_VLAN_Infotainment == 1)
  {
    SetBusContext(gILETH1_BusContext);
    ILSetPDUTimingCyclic(ETH_Cluster_MEB::TCPServer_SSOA_ICAS3IVI_ICAS1Sys02_XIX_E3V_VLAN_Infotainment, 1, 0, @sysvar::IL_ETH1::PDU_FITrueCyclicPeriod::TCPServer_SSOA_ICAS3IVI_ICAS1Sys02_XIX_E3V_VLAN_Infotainment, -1, 0);
  }
}

on sysvar_update sysvar::IL_ETH1::PDU_DisturbFalseCyclicTiming::TCPServer_SSOA_ICAS3IVI_ICAS1Sys02_XIX_E3V_VLAN_Infotainment
{
  if (@this == 1)
  {
    SetBusContext(gILETH1_BusContext);
    ILSetPDUTimingCyclic(ETH_Cluster_MEB::TCPServer_SSOA_ICAS3IVI_ICAS1Sys02_XIX_E3V_VLAN_Infotainment, 0, 0, @sysvar::IL_ETH1::PDU_FIFalseCyclicPeriod::TCPServer_SSOA_ICAS3IVI_ICAS1Sys02_XIX_E3V_VLAN_Infotainment, -1, 0);
  }
  else
  {
    SetBusContext(gILETH1_BusContext);
    ILResetPDUTimingCyclic(ETH_Cluster_MEB::TCPServer_SSOA_ICAS3IVI_ICAS1Sys02_XIX_E3V_VLAN_Infotainment, 0);
  }
}

on sysvar_update sysvar::IL_ETH1::PDU_FIFalseCyclicPeriod::TCPServer_SSOA_ICAS3IVI_ICAS1Sys02_XIX_E3V_VLAN_Infotainment
{
  if (@sysvar::IL_ETH1::PDU_DisturbFalseCyclicTiming::TCPServer_SSOA_ICAS3IVI_ICAS1Sys02_XIX_E3V_VLAN_Infotainment == 1)
  {
    SetBusContext(gILETH1_BusContext);
    ILSetPDUTimingCyclic(ETH_Cluster_MEB::TCPServer_SSOA_ICAS3IVI_ICAS1Sys02_XIX_E3V_VLAN_Infotainment, 1, 0, @sysvar::IL_ETH1::PDU_FITrueCyclicPeriod::TCPServer_SSOA_ICAS3IVI_ICAS1Sys02_XIX_E3V_VLAN_Infotainment, -1, 0);
  }
}

on sysvar_update sysvar::IL_ETH1::PDU_SendOnce::TCPServer_SSOA_ICAS3IVI_ICAS1Sys02_XIX_E3V_VLAN_Infotainment
{
  if (@this == 1)
  {
    SetBusContext(gILETH1_BusContext);
    ILSetPDUEvent(ETH_Cluster_MEB::TCPServer_SSOA_ICAS3IVI_ICAS1Sys02_XIX_E3V_VLAN_Infotainment);
  }
}

on sysvar_update sysvar::IL_ETH1::PDU_DisturbTrueEventTiming::TCPServer_SSOA_ICAS3IVI_ICAS1Sys02_XIX_E3V_VLAN_Infotainment
{
  if (@this == 1)
  {
    SetBusContext(gILETH1_BusContext);
    ILSetPDUTimingEvent(ETH_Cluster_MEB::TCPServer_SSOA_ICAS3IVI_ICAS1Sys02_XIX_E3V_VLAN_Infotainment, 1, @sysvar::IL_ETH1::PDU_FITrueEventEnable::TCPServer_SSOA_ICAS3IVI_ICAS1Sys02_XIX_E3V_VLAN_Infotainment, @sysvar::IL_ETH1::PDU_FITrueEventRepCount::TCPServer_SSOA_ICAS3IVI_ICAS1Sys02_XIX_E3V_VLAN_Infotainment, @sysvar::IL_ETH1::PDU_FITrueEventRepPeriod::TCPServer_SSOA_ICAS3IVI_ICAS1Sys02_XIX_E3V_VLAN_Infotainment, @sysvar::IL_ETH1::PDU_FIEventDebounceDelay::TCPServer_SSOA_ICAS3IVI_ICAS1Sys02_XIX_E3V_VLAN_Infotainment, -1, 0);
  }
  else
  {
    SetBusContext(gILETH1_BusContext);
    ILResetPDUTimingEvent(ETH_Cluster_MEB::TCPServer_SSOA_ICAS3IVI_ICAS1Sys02_XIX_E3V_VLAN_Infotainment, 1);
  }
}

on sysvar_update sysvar::IL_ETH1::PDU_FITrueEventEnable::TCPServer_SSOA_ICAS3IVI_ICAS1Sys02_XIX_E3V_VLAN_Infotainment
{
  if (@sysvar::IL_ETH1::PDU_DisturbTrueEventTiming::TCPServer_SSOA_ICAS3IVI_ICAS1Sys02_XIX_E3V_VLAN_Infotainment == 1)
  {
    SetBusContext(gILETH1_BusContext);
    ILSetPDUTimingEvent(ETH_Cluster_MEB::TCPServer_SSOA_ICAS3IVI_ICAS1Sys02_XIX_E3V_VLAN_Infotainment, 1, @sysvar::IL_ETH1::PDU_FITrueEventEnable::TCPServer_SSOA_ICAS3IVI_ICAS1Sys02_XIX_E3V_VLAN_Infotainment, @sysvar::IL_ETH1::PDU_FITrueEventRepCount::TCPServer_SSOA_ICAS3IVI_ICAS1Sys02_XIX_E3V_VLAN_Infotainment, @sysvar::IL_ETH1::PDU_FITrueEventRepPeriod::TCPServer_SSOA_ICAS3IVI_ICAS1Sys02_XIX_E3V_VLAN_Infotainment, @sysvar::IL_ETH1::PDU_FIEventDebounceDelay::TCPServer_SSOA_ICAS3IVI_ICAS1Sys02_XIX_E3V_VLAN_Infotainment, -1, 0);
  }
}

on sysvar_update sysvar::IL_ETH1::PDU_FITrueEventRepCount::TCPServer_SSOA_ICAS3IVI_ICAS1Sys02_XIX_E3V_VLAN_Infotainment
{
  if (@sysvar::IL_ETH1::PDU_DisturbTrueEventTiming::TCPServer_SSOA_ICAS3IVI_ICAS1Sys02_XIX_E3V_VLAN_Infotainment == 1)
  {
    SetBusContext(gILETH1_BusContext);
    ILSetPDUTimingEvent(ETH_Cluster_MEB::TCPServer_SSOA_ICAS3IVI_ICAS1Sys02_XIX_E3V_VLAN_Infotainment, 1, @sysvar::IL_ETH1::PDU_FITrueEventEnable::TCPServer_SSOA_ICAS3IVI_ICAS1Sys02_XIX_E3V_VLAN_Infotainment, @sysvar::IL_ETH1::PDU_FITrueEventRepCount::TCPServer_SSOA_ICAS3IVI_ICAS1Sys02_XIX_E3V_VLAN_Infotainment, @sysvar::IL_ETH1::PDU_FITrueEventRepPeriod::TCPServer_SSOA_ICAS3IVI_ICAS1Sys02_XIX_E3V_VLAN_Infotainment, @sysvar::IL_ETH1::PDU_FIEventDebounceDelay::TCPServer_SSOA_ICAS3IVI_ICAS1Sys02_XIX_E3V_VLAN_Infotainment, -1, 0);
  }
}

on sysvar_update sysvar::IL_ETH1::PDU_FITrueEventRepPeriod::TCPServer_SSOA_ICAS3IVI_ICAS1Sys02_XIX_E3V_VLAN_Infotainment
{
  if (@sysvar::IL_ETH1::PDU_DisturbTrueEventTiming::TCPServer_SSOA_ICAS3IVI_ICAS1Sys02_XIX_E3V_VLAN_Infotainment == 1)
  {
    SetBusContext(gILETH1_BusContext);
    ILSetPDUTimingEvent(ETH_Cluster_MEB::TCPServer_SSOA_ICAS3IVI_ICAS1Sys02_XIX_E3V_VLAN_Infotainment, 1, @sysvar::IL_ETH1::PDU_FITrueEventEnable::TCPServer_SSOA_ICAS3IVI_ICAS1Sys02_XIX_E3V_VLAN_Infotainment, @sysvar::IL_ETH1::PDU_FITrueEventRepCount::TCPServer_SSOA_ICAS3IVI_ICAS1Sys02_XIX_E3V_VLAN_Infotainment, @sysvar::IL_ETH1::PDU_FITrueEventRepPeriod::TCPServer_SSOA_ICAS3IVI_ICAS1Sys02_XIX_E3V_VLAN_Infotainment, @sysvar::IL_ETH1::PDU_FIEventDebounceDelay::TCPServer_SSOA_ICAS3IVI_ICAS1Sys02_XIX_E3V_VLAN_Infotainment, -1, 0);
  }
}

on sysvar_update sysvar::IL_ETH1::PDU_FIEventDebounceDelay::TCPServer_SSOA_ICAS3IVI_ICAS1Sys02_XIX_E3V_VLAN_Infotainment
{
  if (@sysvar::IL_ETH1::PDU_DisturbTrueEventTiming::TCPServer_SSOA_ICAS3IVI_ICAS1Sys02_XIX_E3V_VLAN_Infotainment == 1)
  {
    SetBusContext(gILETH1_BusContext);
    ILSetPDUTimingEvent(ETH_Cluster_MEB::TCPServer_SSOA_ICAS3IVI_ICAS1Sys02_XIX_E3V_VLAN_Infotainment, 1, @sysvar::IL_ETH1::PDU_FITrueEventEnable::TCPServer_SSOA_ICAS3IVI_ICAS1Sys02_XIX_E3V_VLAN_Infotainment, @sysvar::IL_ETH1::PDU_FITrueEventRepCount::TCPServer_SSOA_ICAS3IVI_ICAS1Sys02_XIX_E3V_VLAN_Infotainment, @sysvar::IL_ETH1::PDU_FITrueEventRepPeriod::TCPServer_SSOA_ICAS3IVI_ICAS1Sys02_XIX_E3V_VLAN_Infotainment, @sysvar::IL_ETH1::PDU_FIEventDebounceDelay::TCPServer_SSOA_ICAS3IVI_ICAS1Sys02_XIX_E3V_VLAN_Infotainment, -1, 0);
  }
  if (@sysvar::IL_ETH1::PDU_DisturbFalseEventTiming::TCPServer_SSOA_ICAS3IVI_ICAS1Sys02_XIX_E3V_VLAN_Infotainment == 1)
  {
    SetBusContext(gILETH1_BusContext);
    ILSetPDUTimingEvent(ETH_Cluster_MEB::TCPServer_SSOA_ICAS3IVI_ICAS1Sys02_XIX_E3V_VLAN_Infotainment, 0, @sysvar::IL_ETH1::PDU_FIFalseEventEnable::TCPServer_SSOA_ICAS3IVI_ICAS1Sys02_XIX_E3V_VLAN_Infotainment, @sysvar::IL_ETH1::PDU_FIFalseEventRepCount::TCPServer_SSOA_ICAS3IVI_ICAS1Sys02_XIX_E3V_VLAN_Infotainment, @sysvar::IL_ETH1::PDU_FIFalseEventRepPeriod::TCPServer_SSOA_ICAS3IVI_ICAS1Sys02_XIX_E3V_VLAN_Infotainment, @sysvar::IL_ETH1::PDU_FIEventDebounceDelay::TCPServer_SSOA_ICAS3IVI_ICAS1Sys02_XIX_E3V_VLAN_Infotainment, -1, 0);
  }
}

on sysvar_update sysvar::IL_ETH1::PDU_DisturbFalseEventTiming::TCPServer_SSOA_ICAS3IVI_ICAS1Sys02_XIX_E3V_VLAN_Infotainment
{
  if (@this == 1)
  {
    SetBusContext(gILETH1_BusContext);
    ILSetPDUTimingEvent(ETH_Cluster_MEB::TCPServer_SSOA_ICAS3IVI_ICAS1Sys02_XIX_E3V_VLAN_Infotainment, 0, @sysvar::IL_ETH1::PDU_FIFalseEventEnable::TCPServer_SSOA_ICAS3IVI_ICAS1Sys02_XIX_E3V_VLAN_Infotainment, @sysvar::IL_ETH1::PDU_FIFalseEventRepCount::TCPServer_SSOA_ICAS3IVI_ICAS1Sys02_XIX_E3V_VLAN_Infotainment, @sysvar::IL_ETH1::PDU_FIFalseEventRepPeriod::TCPServer_SSOA_ICAS3IVI_ICAS1Sys02_XIX_E3V_VLAN_Infotainment, @sysvar::IL_ETH1::PDU_FIEventDebounceDelay::TCPServer_SSOA_ICAS3IVI_ICAS1Sys02_XIX_E3V_VLAN_Infotainment, -1, 0);
  }
  else
  {
    SetBusContext(gILETH1_BusContext);
    ILResetPDUTimingEvent(ETH_Cluster_MEB::TCPServer_SSOA_ICAS3IVI_ICAS1Sys02_XIX_E3V_VLAN_Infotainment, 0);
  }
}

on sysvar_update sysvar::IL_ETH1::PDU_FIFalseEventEnable::TCPServer_SSOA_ICAS3IVI_ICAS1Sys02_XIX_E3V_VLAN_Infotainment
{
  if (@sysvar::IL_ETH1::PDU_DisturbFalseEventTiming::TCPServer_SSOA_ICAS3IVI_ICAS1Sys02_XIX_E3V_VLAN_Infotainment == 1)
  {
    SetBusContext(gILETH1_BusContext);
    ILSetPDUTimingEvent(ETH_Cluster_MEB::TCPServer_SSOA_ICAS3IVI_ICAS1Sys02_XIX_E3V_VLAN_Infotainment, 0, @sysvar::IL_ETH1::PDU_FIFalseEventEnable::TCPServer_SSOA_ICAS3IVI_ICAS1Sys02_XIX_E3V_VLAN_Infotainment, @sysvar::IL_ETH1::PDU_FIFalseEventRepCount::TCPServer_SSOA_ICAS3IVI_ICAS1Sys02_XIX_E3V_VLAN_Infotainment, @sysvar::IL_ETH1::PDU_FIFalseEventRepPeriod::TCPServer_SSOA_ICAS3IVI_ICAS1Sys02_XIX_E3V_VLAN_Infotainment, @sysvar::IL_ETH1::PDU_FIEventDebounceDelay::TCPServer_SSOA_ICAS3IVI_ICAS1Sys02_XIX_E3V_VLAN_Infotainment, -1, 0);
  }
}

on sysvar_update sysvar::IL_ETH1::PDU_FIFalseEventRepCount::TCPServer_SSOA_ICAS3IVI_ICAS1Sys02_XIX_E3V_VLAN_Infotainment
{
  if (@sysvar::IL_ETH1::PDU_DisturbFalseEventTiming::TCPServer_SSOA_ICAS3IVI_ICAS1Sys02_XIX_E3V_VLAN_Infotainment == 1)
  {
    SetBusContext(gILETH1_BusContext);
    ILSetPDUTimingEvent(ETH_Cluster_MEB::TCPServer_SSOA_ICAS3IVI_ICAS1Sys02_XIX_E3V_VLAN_Infotainment, 0, @sysvar::IL_ETH1::PDU_FIFalseEventEnable::TCPServer_SSOA_ICAS3IVI_ICAS1Sys02_XIX_E3V_VLAN_Infotainment, @sysvar::IL_ETH1::PDU_FIFalseEventRepCount::TCPServer_SSOA_ICAS3IVI_ICAS1Sys02_XIX_E3V_VLAN_Infotainment, @sysvar::IL_ETH1::PDU_FIFalseEventRepPeriod::TCPServer_SSOA_ICAS3IVI_ICAS1Sys02_XIX_E3V_VLAN_Infotainment, @sysvar::IL_ETH1::PDU_FIEventDebounceDelay::TCPServer_SSOA_ICAS3IVI_ICAS1Sys02_XIX_E3V_VLAN_Infotainment, -1, 0);
  }
}

on sysvar_update sysvar::IL_ETH1::PDU_FIFalseEventRepPeriod::TCPServer_SSOA_ICAS3IVI_ICAS1Sys02_XIX_E3V_VLAN_Infotainment
{
  if (@sysvar::IL_ETH1::PDU_DisturbFalseEventTiming::TCPServer_SSOA_ICAS3IVI_ICAS1Sys02_XIX_E3V_VLAN_Infotainment == 1)
  {
    SetBusContext(gILETH1_BusContext);
    ILSetPDUTimingEvent(ETH_Cluster_MEB::TCPServer_SSOA_ICAS3IVI_ICAS1Sys02_XIX_E3V_VLAN_Infotainment, 0, @sysvar::IL_ETH1::PDU_FIFalseEventEnable::TCPServer_SSOA_ICAS3IVI_ICAS1Sys02_XIX_E3V_VLAN_Infotainment, @sysvar::IL_ETH1::PDU_FIFalseEventRepCount::TCPServer_SSOA_ICAS3IVI_ICAS1Sys02_XIX_E3V_VLAN_Infotainment, @sysvar::IL_ETH1::PDU_FIFalseEventRepPeriod::TCPServer_SSOA_ICAS3IVI_ICAS1Sys02_XIX_E3V_VLAN_Infotainment, @sysvar::IL_ETH1::PDU_FIEventDebounceDelay::TCPServer_SSOA_ICAS3IVI_ICAS1Sys02_XIX_E3V_VLAN_Infotainment, -1, 0);
  }
}

on sysvar_update sysvar::IL_ETH1::PDU_DisturbTimingMode::TCPServer_SSOA_ICAS3IVI_Info_El_XIX_E3V_VLAN_Infotainment
{
  if (@this == 1)
  {
    SetBusContext(gILETH1_BusContext);
    ILSetPDUAsrTXMode(ETH_Cluster_MEB::TCPServer_SSOA_ICAS3IVI_Info_El_XIX_E3V_VLAN_Infotainment, @sysvar::IL_ETH1::PDU_FITimingMode::TCPServer_SSOA_ICAS3IVI_Info_El_XIX_E3V_VLAN_Infotainment, -1, 0);
  }
  else
  {
    SetBusContext(gILETH1_BusContext);
    ILResetPDUAsrTXMode(ETH_Cluster_MEB::TCPServer_SSOA_ICAS3IVI_Info_El_XIX_E3V_VLAN_Infotainment);
  }
}

on sysvar_update sysvar::IL_ETH1::PDU_FITimingMode::TCPServer_SSOA_ICAS3IVI_Info_El_XIX_E3V_VLAN_Infotainment
{
  if (@sysvar::IL_ETH1::PDU_DisturbTimingMode::TCPServer_SSOA_ICAS3IVI_Info_El_XIX_E3V_VLAN_Infotainment == 1)
  {
    SetBusContext(gILETH1_BusContext);
    ILSetPDUAsrTXMode(ETH_Cluster_MEB::TCPServer_SSOA_ICAS3IVI_Info_El_XIX_E3V_VLAN_Infotainment, @sysvar::IL_ETH1::PDU_FITimingMode::TCPServer_SSOA_ICAS3IVI_Info_El_XIX_E3V_VLAN_Infotainment, -1, 0);
  }
}

on sysvar_update sysvar::IL_ETH1::PDU_DisturbTrueCyclicTiming::TCPServer_SSOA_ICAS3IVI_Info_El_XIX_E3V_VLAN_Infotainment
{
  if (@this == 1)
  {
    SetBusContext(gILETH1_BusContext);
    ILSetPDUTimingCyclic(ETH_Cluster_MEB::TCPServer_SSOA_ICAS3IVI_Info_El_XIX_E3V_VLAN_Infotainment, 1, 0, @sysvar::IL_ETH1::PDU_FITrueCyclicPeriod::TCPServer_SSOA_ICAS3IVI_Info_El_XIX_E3V_VLAN_Infotainment, -1, 0);
  }
  else
  {
    SetBusContext(gILETH1_BusContext);
    ILResetPDUTimingCyclic(ETH_Cluster_MEB::TCPServer_SSOA_ICAS3IVI_Info_El_XIX_E3V_VLAN_Infotainment, 1);
  }
}

on sysvar_update sysvar::IL_ETH1::PDU_FITrueCyclicPeriod::TCPServer_SSOA_ICAS3IVI_Info_El_XIX_E3V_VLAN_Infotainment
{
  if (@sysvar::IL_ETH1::PDU_DisturbTrueCyclicTiming::TCPServer_SSOA_ICAS3IVI_Info_El_XIX_E3V_VLAN_Infotainment == 1)
  {
    SetBusContext(gILETH1_BusContext);
    ILSetPDUTimingCyclic(ETH_Cluster_MEB::TCPServer_SSOA_ICAS3IVI_Info_El_XIX_E3V_VLAN_Infotainment, 1, 0, @sysvar::IL_ETH1::PDU_FITrueCyclicPeriod::TCPServer_SSOA_ICAS3IVI_Info_El_XIX_E3V_VLAN_Infotainment, -1, 0);
  }
}

on sysvar_update sysvar::IL_ETH1::PDU_DisturbFalseCyclicTiming::TCPServer_SSOA_ICAS3IVI_Info_El_XIX_E3V_VLAN_Infotainment
{
  if (@this == 1)
  {
    SetBusContext(gILETH1_BusContext);
    ILSetPDUTimingCyclic(ETH_Cluster_MEB::TCPServer_SSOA_ICAS3IVI_Info_El_XIX_E3V_VLAN_Infotainment, 0, 0, @sysvar::IL_ETH1::PDU_FIFalseCyclicPeriod::TCPServer_SSOA_ICAS3IVI_Info_El_XIX_E3V_VLAN_Infotainment, -1, 0);
  }
  else
  {
    SetBusContext(gILETH1_BusContext);
    ILResetPDUTimingCyclic(ETH_Cluster_MEB::TCPServer_SSOA_ICAS3IVI_Info_El_XIX_E3V_VLAN_Infotainment, 0);
  }
}

on sysvar_update sysvar::IL_ETH1::PDU_FIFalseCyclicPeriod::TCPServer_SSOA_ICAS3IVI_Info_El_XIX_E3V_VLAN_Infotainment
{
  if (@sysvar::IL_ETH1::PDU_DisturbFalseCyclicTiming::TCPServer_SSOA_ICAS3IVI_Info_El_XIX_E3V_VLAN_Infotainment == 1)
  {
    SetBusContext(gILETH1_BusContext);
    ILSetPDUTimingCyclic(ETH_Cluster_MEB::TCPServer_SSOA_ICAS3IVI_Info_El_XIX_E3V_VLAN_Infotainment, 1, 0, @sysvar::IL_ETH1::PDU_FITrueCyclicPeriod::TCPServer_SSOA_ICAS3IVI_Info_El_XIX_E3V_VLAN_Infotainment, -1, 0);
  }
}

on sysvar_update sysvar::IL_ETH1::PDU_SendOnce::TCPServer_SSOA_ICAS3IVI_Info_El_XIX_E3V_VLAN_Infotainment
{
  if (@this == 1)
  {
    SetBusContext(gILETH1_BusContext);
    ILSetPDUEvent(ETH_Cluster_MEB::TCPServer_SSOA_ICAS3IVI_Info_El_XIX_E3V_VLAN_Infotainment);
  }
}

on sysvar_update sysvar::IL_ETH1::PDU_DisturbTrueEventTiming::TCPServer_SSOA_ICAS3IVI_Info_El_XIX_E3V_VLAN_Infotainment
{
  if (@this == 1)
  {
    SetBusContext(gILETH1_BusContext);
    ILSetPDUTimingEvent(ETH_Cluster_MEB::TCPServer_SSOA_ICAS3IVI_Info_El_XIX_E3V_VLAN_Infotainment, 1, @sysvar::IL_ETH1::PDU_FITrueEventEnable::TCPServer_SSOA_ICAS3IVI_Info_El_XIX_E3V_VLAN_Infotainment, @sysvar::IL_ETH1::PDU_FITrueEventRepCount::TCPServer_SSOA_ICAS3IVI_Info_El_XIX_E3V_VLAN_Infotainment, @sysvar::IL_ETH1::PDU_FITrueEventRepPeriod::TCPServer_SSOA_ICAS3IVI_Info_El_XIX_E3V_VLAN_Infotainment, @sysvar::IL_ETH1::PDU_FIEventDebounceDelay::TCPServer_SSOA_ICAS3IVI_Info_El_XIX_E3V_VLAN_Infotainment, -1, 0);
  }
  else
  {
    SetBusContext(gILETH1_BusContext);
    ILResetPDUTimingEvent(ETH_Cluster_MEB::TCPServer_SSOA_ICAS3IVI_Info_El_XIX_E3V_VLAN_Infotainment, 1);
  }
}

on sysvar_update sysvar::IL_ETH1::PDU_FITrueEventEnable::TCPServer_SSOA_ICAS3IVI_Info_El_XIX_E3V_VLAN_Infotainment
{
  if (@sysvar::IL_ETH1::PDU_DisturbTrueEventTiming::TCPServer_SSOA_ICAS3IVI_Info_El_XIX_E3V_VLAN_Infotainment == 1)
  {
    SetBusContext(gILETH1_BusContext);
    ILSetPDUTimingEvent(ETH_Cluster_MEB::TCPServer_SSOA_ICAS3IVI_Info_El_XIX_E3V_VLAN_Infotainment, 1, @sysvar::IL_ETH1::PDU_FITrueEventEnable::TCPServer_SSOA_ICAS3IVI_Info_El_XIX_E3V_VLAN_Infotainment, @sysvar::IL_ETH1::PDU_FITrueEventRepCount::TCPServer_SSOA_ICAS3IVI_Info_El_XIX_E3V_VLAN_Infotainment, @sysvar::IL_ETH1::PDU_FITrueEventRepPeriod::TCPServer_SSOA_ICAS3IVI_Info_El_XIX_E3V_VLAN_Infotainment, @sysvar::IL_ETH1::PDU_FIEventDebounceDelay::TCPServer_SSOA_ICAS3IVI_Info_El_XIX_E3V_VLAN_Infotainment, -1, 0);
  }
}

on sysvar_update sysvar::IL_ETH1::PDU_FITrueEventRepCount::TCPServer_SSOA_ICAS3IVI_Info_El_XIX_E3V_VLAN_Infotainment
{
  if (@sysvar::IL_ETH1::PDU_DisturbTrueEventTiming::TCPServer_SSOA_ICAS3IVI_Info_El_XIX_E3V_VLAN_Infotainment == 1)
  {
    SetBusContext(gILETH1_BusContext);
    ILSetPDUTimingEvent(ETH_Cluster_MEB::TCPServer_SSOA_ICAS3IVI_Info_El_XIX_E3V_VLAN_Infotainment, 1, @sysvar::IL_ETH1::PDU_FITrueEventEnable::TCPServer_SSOA_ICAS3IVI_Info_El_XIX_E3V_VLAN_Infotainment, @sysvar::IL_ETH1::PDU_FITrueEventRepCount::TCPServer_SSOA_ICAS3IVI_Info_El_XIX_E3V_VLAN_Infotainment, @sysvar::IL_ETH1::PDU_FITrueEventRepPeriod::TCPServer_SSOA_ICAS3IVI_Info_El_XIX_E3V_VLAN_Infotainment, @sysvar::IL_ETH1::PDU_FIEventDebounceDelay::TCPServer_SSOA_ICAS3IVI_Info_El_XIX_E3V_VLAN_Infotainment, -1, 0);
  }
}

on sysvar_update sysvar::IL_ETH1::PDU_FITrueEventRepPeriod::TCPServer_SSOA_ICAS3IVI_Info_El_XIX_E3V_VLAN_Infotainment
{
  if (@sysvar::IL_ETH1::PDU_DisturbTrueEventTiming::TCPServer_SSOA_ICAS3IVI_Info_El_XIX_E3V_VLAN_Infotainment == 1)
  {
    SetBusContext(gILETH1_BusContext);
    ILSetPDUTimingEvent(ETH_Cluster_MEB::TCPServer_SSOA_ICAS3IVI_Info_El_XIX_E3V_VLAN_Infotainment, 1, @sysvar::IL_ETH1::PDU_FITrueEventEnable::TCPServer_SSOA_ICAS3IVI_Info_El_XIX_E3V_VLAN_Infotainment, @sysvar::IL_ETH1::PDU_FITrueEventRepCount::TCPServer_SSOA_ICAS3IVI_Info_El_XIX_E3V_VLAN_Infotainment, @sysvar::IL_ETH1::PDU_FITrueEventRepPeriod::TCPServer_SSOA_ICAS3IVI_Info_El_XIX_E3V_VLAN_Infotainment, @sysvar::IL_ETH1::PDU_FIEventDebounceDelay::TCPServer_SSOA_ICAS3IVI_Info_El_XIX_E3V_VLAN_Infotainment, -1, 0);
  }
}

on sysvar_update sysvar::IL_ETH1::PDU_FIEventDebounceDelay::TCPServer_SSOA_ICAS3IVI_Info_El_XIX_E3V_VLAN_Infotainment
{
  if (@sysvar::IL_ETH1::PDU_DisturbTrueEventTiming::TCPServer_SSOA_ICAS3IVI_Info_El_XIX_E3V_VLAN_Infotainment == 1)
  {
    SetBusContext(gILETH1_BusContext);
    ILSetPDUTimingEvent(ETH_Cluster_MEB::TCPServer_SSOA_ICAS3IVI_Info_El_XIX_E3V_VLAN_Infotainment, 1, @sysvar::IL_ETH1::PDU_FITrueEventEnable::TCPServer_SSOA_ICAS3IVI_Info_El_XIX_E3V_VLAN_Infotainment, @sysvar::IL_ETH1::PDU_FITrueEventRepCount::TCPServer_SSOA_ICAS3IVI_Info_El_XIX_E3V_VLAN_Infotainment, @sysvar::IL_ETH1::PDU_FITrueEventRepPeriod::TCPServer_SSOA_ICAS3IVI_Info_El_XIX_E3V_VLAN_Infotainment, @sysvar::IL_ETH1::PDU_FIEventDebounceDelay::TCPServer_SSOA_ICAS3IVI_Info_El_XIX_E3V_VLAN_Infotainment, -1, 0);
  }
  if (@sysvar::IL_ETH1::PDU_DisturbFalseEventTiming::TCPServer_SSOA_ICAS3IVI_Info_El_XIX_E3V_VLAN_Infotainment == 1)
  {
    SetBusContext(gILETH1_BusContext);
    ILSetPDUTimingEvent(ETH_Cluster_MEB::TCPServer_SSOA_ICAS3IVI_Info_El_XIX_E3V_VLAN_Infotainment, 0, @sysvar::IL_ETH1::PDU_FIFalseEventEnable::TCPServer_SSOA_ICAS3IVI_Info_El_XIX_E3V_VLAN_Infotainment, @sysvar::IL_ETH1::PDU_FIFalseEventRepCount::TCPServer_SSOA_ICAS3IVI_Info_El_XIX_E3V_VLAN_Infotainment, @sysvar::IL_ETH1::PDU_FIFalseEventRepPeriod::TCPServer_SSOA_ICAS3IVI_Info_El_XIX_E3V_VLAN_Infotainment, @sysvar::IL_ETH1::PDU_FIEventDebounceDelay::TCPServer_SSOA_ICAS3IVI_Info_El_XIX_E3V_VLAN_Infotainment, -1, 0);
  }
}

on sysvar_update sysvar::IL_ETH1::PDU_DisturbFalseEventTiming::TCPServer_SSOA_ICAS3IVI_Info_El_XIX_E3V_VLAN_Infotainment
{
  if (@this == 1)
  {
    SetBusContext(gILETH1_BusContext);
    ILSetPDUTimingEvent(ETH_Cluster_MEB::TCPServer_SSOA_ICAS3IVI_Info_El_XIX_E3V_VLAN_Infotainment, 0, @sysvar::IL_ETH1::PDU_FIFalseEventEnable::TCPServer_SSOA_ICAS3IVI_Info_El_XIX_E3V_VLAN_Infotainment, @sysvar::IL_ETH1::PDU_FIFalseEventRepCount::TCPServer_SSOA_ICAS3IVI_Info_El_XIX_E3V_VLAN_Infotainment, @sysvar::IL_ETH1::PDU_FIFalseEventRepPeriod::TCPServer_SSOA_ICAS3IVI_Info_El_XIX_E3V_VLAN_Infotainment, @sysvar::IL_ETH1::PDU_FIEventDebounceDelay::TCPServer_SSOA_ICAS3IVI_Info_El_XIX_E3V_VLAN_Infotainment, -1, 0);
  }
  else
  {
    SetBusContext(gILETH1_BusContext);
    ILResetPDUTimingEvent(ETH_Cluster_MEB::TCPServer_SSOA_ICAS3IVI_Info_El_XIX_E3V_VLAN_Infotainment, 0);
  }
}

on sysvar_update sysvar::IL_ETH1::PDU_FIFalseEventEnable::TCPServer_SSOA_ICAS3IVI_Info_El_XIX_E3V_VLAN_Infotainment
{
  if (@sysvar::IL_ETH1::PDU_DisturbFalseEventTiming::TCPServer_SSOA_ICAS3IVI_Info_El_XIX_E3V_VLAN_Infotainment == 1)
  {
    SetBusContext(gILETH1_BusContext);
    ILSetPDUTimingEvent(ETH_Cluster_MEB::TCPServer_SSOA_ICAS3IVI_Info_El_XIX_E3V_VLAN_Infotainment, 0, @sysvar::IL_ETH1::PDU_FIFalseEventEnable::TCPServer_SSOA_ICAS3IVI_Info_El_XIX_E3V_VLAN_Infotainment, @sysvar::IL_ETH1::PDU_FIFalseEventRepCount::TCPServer_SSOA_ICAS3IVI_Info_El_XIX_E3V_VLAN_Infotainment, @sysvar::IL_ETH1::PDU_FIFalseEventRepPeriod::TCPServer_SSOA_ICAS3IVI_Info_El_XIX_E3V_VLAN_Infotainment, @sysvar::IL_ETH1::PDU_FIEventDebounceDelay::TCPServer_SSOA_ICAS3IVI_Info_El_XIX_E3V_VLAN_Infotainment, -1, 0);
  }
}

on sysvar_update sysvar::IL_ETH1::PDU_FIFalseEventRepCount::TCPServer_SSOA_ICAS3IVI_Info_El_XIX_E3V_VLAN_Infotainment
{
  if (@sysvar::IL_ETH1::PDU_DisturbFalseEventTiming::TCPServer_SSOA_ICAS3IVI_Info_El_XIX_E3V_VLAN_Infotainment == 1)
  {
    SetBusContext(gILETH1_BusContext);
    ILSetPDUTimingEvent(ETH_Cluster_MEB::TCPServer_SSOA_ICAS3IVI_Info_El_XIX_E3V_VLAN_Infotainment, 0, @sysvar::IL_ETH1::PDU_FIFalseEventEnable::TCPServer_SSOA_ICAS3IVI_Info_El_XIX_E3V_VLAN_Infotainment, @sysvar::IL_ETH1::PDU_FIFalseEventRepCount::TCPServer_SSOA_ICAS3IVI_Info_El_XIX_E3V_VLAN_Infotainment, @sysvar::IL_ETH1::PDU_FIFalseEventRepPeriod::TCPServer_SSOA_ICAS3IVI_Info_El_XIX_E3V_VLAN_Infotainment, @sysvar::IL_ETH1::PDU_FIEventDebounceDelay::TCPServer_SSOA_ICAS3IVI_Info_El_XIX_E3V_VLAN_Infotainment, -1, 0);
  }
}

on sysvar_update sysvar::IL_ETH1::PDU_FIFalseEventRepPeriod::TCPServer_SSOA_ICAS3IVI_Info_El_XIX_E3V_VLAN_Infotainment
{
  if (@sysvar::IL_ETH1::PDU_DisturbFalseEventTiming::TCPServer_SSOA_ICAS3IVI_Info_El_XIX_E3V_VLAN_Infotainment == 1)
  {
    SetBusContext(gILETH1_BusContext);
    ILSetPDUTimingEvent(ETH_Cluster_MEB::TCPServer_SSOA_ICAS3IVI_Info_El_XIX_E3V_VLAN_Infotainment, 0, @sysvar::IL_ETH1::PDU_FIFalseEventEnable::TCPServer_SSOA_ICAS3IVI_Info_El_XIX_E3V_VLAN_Infotainment, @sysvar::IL_ETH1::PDU_FIFalseEventRepCount::TCPServer_SSOA_ICAS3IVI_Info_El_XIX_E3V_VLAN_Infotainment, @sysvar::IL_ETH1::PDU_FIFalseEventRepPeriod::TCPServer_SSOA_ICAS3IVI_Info_El_XIX_E3V_VLAN_Infotainment, @sysvar::IL_ETH1::PDU_FIEventDebounceDelay::TCPServer_SSOA_ICAS3IVI_Info_El_XIX_E3V_VLAN_Infotainment, -1, 0);
  }
}

on sysvar_update sysvar::IL_ETH1::PDU_DisturbTimingMode::TCPServer_SSOA_ICAS3VI_OCU_XIX_E3V_VLAN_Infotainment
{
  if (@this == 1)
  {
    SetBusContext(gILETH1_BusContext);
    ILSetPDUAsrTXMode(ETH_Cluster_MEB::TCPServer_SSOA_ICAS3VI_OCU_XIX_E3V_VLAN_Infotainment, @sysvar::IL_ETH1::PDU_FITimingMode::TCPServer_SSOA_ICAS3VI_OCU_XIX_E3V_VLAN_Infotainment, -1, 0);
  }
  else
  {
    SetBusContext(gILETH1_BusContext);
    ILResetPDUAsrTXMode(ETH_Cluster_MEB::TCPServer_SSOA_ICAS3VI_OCU_XIX_E3V_VLAN_Infotainment);
  }
}

on sysvar_update sysvar::IL_ETH1::PDU_FITimingMode::TCPServer_SSOA_ICAS3VI_OCU_XIX_E3V_VLAN_Infotainment
{
  if (@sysvar::IL_ETH1::PDU_DisturbTimingMode::TCPServer_SSOA_ICAS3VI_OCU_XIX_E3V_VLAN_Infotainment == 1)
  {
    SetBusContext(gILETH1_BusContext);
    ILSetPDUAsrTXMode(ETH_Cluster_MEB::TCPServer_SSOA_ICAS3VI_OCU_XIX_E3V_VLAN_Infotainment, @sysvar::IL_ETH1::PDU_FITimingMode::TCPServer_SSOA_ICAS3VI_OCU_XIX_E3V_VLAN_Infotainment, -1, 0);
  }
}

on sysvar_update sysvar::IL_ETH1::PDU_DisturbTrueCyclicTiming::TCPServer_SSOA_ICAS3VI_OCU_XIX_E3V_VLAN_Infotainment
{
  if (@this == 1)
  {
    SetBusContext(gILETH1_BusContext);
    ILSetPDUTimingCyclic(ETH_Cluster_MEB::TCPServer_SSOA_ICAS3VI_OCU_XIX_E3V_VLAN_Infotainment, 1, 0, @sysvar::IL_ETH1::PDU_FITrueCyclicPeriod::TCPServer_SSOA_ICAS3VI_OCU_XIX_E3V_VLAN_Infotainment, -1, 0);
  }
  else
  {
    SetBusContext(gILETH1_BusContext);
    ILResetPDUTimingCyclic(ETH_Cluster_MEB::TCPServer_SSOA_ICAS3VI_OCU_XIX_E3V_VLAN_Infotainment, 1);
  }
}

on sysvar_update sysvar::IL_ETH1::PDU_FITrueCyclicPeriod::TCPServer_SSOA_ICAS3VI_OCU_XIX_E3V_VLAN_Infotainment
{
  if (@sysvar::IL_ETH1::PDU_DisturbTrueCyclicTiming::TCPServer_SSOA_ICAS3VI_OCU_XIX_E3V_VLAN_Infotainment == 1)
  {
    SetBusContext(gILETH1_BusContext);
    ILSetPDUTimingCyclic(ETH_Cluster_MEB::TCPServer_SSOA_ICAS3VI_OCU_XIX_E3V_VLAN_Infotainment, 1, 0, @sysvar::IL_ETH1::PDU_FITrueCyclicPeriod::TCPServer_SSOA_ICAS3VI_OCU_XIX_E3V_VLAN_Infotainment, -1, 0);
  }
}

on sysvar_update sysvar::IL_ETH1::PDU_DisturbFalseCyclicTiming::TCPServer_SSOA_ICAS3VI_OCU_XIX_E3V_VLAN_Infotainment
{
  if (@this == 1)
  {
    SetBusContext(gILETH1_BusContext);
    ILSetPDUTimingCyclic(ETH_Cluster_MEB::TCPServer_SSOA_ICAS3VI_OCU_XIX_E3V_VLAN_Infotainment, 0, 0, @sysvar::IL_ETH1::PDU_FIFalseCyclicPeriod::TCPServer_SSOA_ICAS3VI_OCU_XIX_E3V_VLAN_Infotainment, -1, 0);
  }
  else
  {
    SetBusContext(gILETH1_BusContext);
    ILResetPDUTimingCyclic(ETH_Cluster_MEB::TCPServer_SSOA_ICAS3VI_OCU_XIX_E3V_VLAN_Infotainment, 0);
  }
}

on sysvar_update sysvar::IL_ETH1::PDU_FIFalseCyclicPeriod::TCPServer_SSOA_ICAS3VI_OCU_XIX_E3V_VLAN_Infotainment
{
  if (@sysvar::IL_ETH1::PDU_DisturbFalseCyclicTiming::TCPServer_SSOA_ICAS3VI_OCU_XIX_E3V_VLAN_Infotainment == 1)
  {
    SetBusContext(gILETH1_BusContext);
    ILSetPDUTimingCyclic(ETH_Cluster_MEB::TCPServer_SSOA_ICAS3VI_OCU_XIX_E3V_VLAN_Infotainment, 1, 0, @sysvar::IL_ETH1::PDU_FITrueCyclicPeriod::TCPServer_SSOA_ICAS3VI_OCU_XIX_E3V_VLAN_Infotainment, -1, 0);
  }
}

on sysvar_update sysvar::IL_ETH1::PDU_SendOnce::TCPServer_SSOA_ICAS3VI_OCU_XIX_E3V_VLAN_Infotainment
{
  if (@this == 1)
  {
    SetBusContext(gILETH1_BusContext);
    ILSetPDUEvent(ETH_Cluster_MEB::TCPServer_SSOA_ICAS3VI_OCU_XIX_E3V_VLAN_Infotainment);
  }
}

on sysvar_update sysvar::IL_ETH1::PDU_DisturbTrueEventTiming::TCPServer_SSOA_ICAS3VI_OCU_XIX_E3V_VLAN_Infotainment
{
  if (@this == 1)
  {
    SetBusContext(gILETH1_BusContext);
    ILSetPDUTimingEvent(ETH_Cluster_MEB::TCPServer_SSOA_ICAS3VI_OCU_XIX_E3V_VLAN_Infotainment, 1, @sysvar::IL_ETH1::PDU_FITrueEventEnable::TCPServer_SSOA_ICAS3VI_OCU_XIX_E3V_VLAN_Infotainment, @sysvar::IL_ETH1::PDU_FITrueEventRepCount::TCPServer_SSOA_ICAS3VI_OCU_XIX_E3V_VLAN_Infotainment, @sysvar::IL_ETH1::PDU_FITrueEventRepPeriod::TCPServer_SSOA_ICAS3VI_OCU_XIX_E3V_VLAN_Infotainment, @sysvar::IL_ETH1::PDU_FIEventDebounceDelay::TCPServer_SSOA_ICAS3VI_OCU_XIX_E3V_VLAN_Infotainment, -1, 0);
  }
  else
  {
    SetBusContext(gILETH1_BusContext);
    ILResetPDUTimingEvent(ETH_Cluster_MEB::TCPServer_SSOA_ICAS3VI_OCU_XIX_E3V_VLAN_Infotainment, 1);
  }
}

on sysvar_update sysvar::IL_ETH1::PDU_FITrueEventEnable::TCPServer_SSOA_ICAS3VI_OCU_XIX_E3V_VLAN_Infotainment
{
  if (@sysvar::IL_ETH1::PDU_DisturbTrueEventTiming::TCPServer_SSOA_ICAS3VI_OCU_XIX_E3V_VLAN_Infotainment == 1)
  {
    SetBusContext(gILETH1_BusContext);
    ILSetPDUTimingEvent(ETH_Cluster_MEB::TCPServer_SSOA_ICAS3VI_OCU_XIX_E3V_VLAN_Infotainment, 1, @sysvar::IL_ETH1::PDU_FITrueEventEnable::TCPServer_SSOA_ICAS3VI_OCU_XIX_E3V_VLAN_Infotainment, @sysvar::IL_ETH1::PDU_FITrueEventRepCount::TCPServer_SSOA_ICAS3VI_OCU_XIX_E3V_VLAN_Infotainment, @sysvar::IL_ETH1::PDU_FITrueEventRepPeriod::TCPServer_SSOA_ICAS3VI_OCU_XIX_E3V_VLAN_Infotainment, @sysvar::IL_ETH1::PDU_FIEventDebounceDelay::TCPServer_SSOA_ICAS3VI_OCU_XIX_E3V_VLAN_Infotainment, -1, 0);
  }
}

on sysvar_update sysvar::IL_ETH1::PDU_FITrueEventRepCount::TCPServer_SSOA_ICAS3VI_OCU_XIX_E3V_VLAN_Infotainment
{
  if (@sysvar::IL_ETH1::PDU_DisturbTrueEventTiming::TCPServer_SSOA_ICAS3VI_OCU_XIX_E3V_VLAN_Infotainment == 1)
  {
    SetBusContext(gILETH1_BusContext);
    ILSetPDUTimingEvent(ETH_Cluster_MEB::TCPServer_SSOA_ICAS3VI_OCU_XIX_E3V_VLAN_Infotainment, 1, @sysvar::IL_ETH1::PDU_FITrueEventEnable::TCPServer_SSOA_ICAS3VI_OCU_XIX_E3V_VLAN_Infotainment, @sysvar::IL_ETH1::PDU_FITrueEventRepCount::TCPServer_SSOA_ICAS3VI_OCU_XIX_E3V_VLAN_Infotainment, @sysvar::IL_ETH1::PDU_FITrueEventRepPeriod::TCPServer_SSOA_ICAS3VI_OCU_XIX_E3V_VLAN_Infotainment, @sysvar::IL_ETH1::PDU_FIEventDebounceDelay::TCPServer_SSOA_ICAS3VI_OCU_XIX_E3V_VLAN_Infotainment, -1, 0);
  }
}

on sysvar_update sysvar::IL_ETH1::PDU_FITrueEventRepPeriod::TCPServer_SSOA_ICAS3VI_OCU_XIX_E3V_VLAN_Infotainment
{
  if (@sysvar::IL_ETH1::PDU_DisturbTrueEventTiming::TCPServer_SSOA_ICAS3VI_OCU_XIX_E3V_VLAN_Infotainment == 1)
  {
    SetBusContext(gILETH1_BusContext);
    ILSetPDUTimingEvent(ETH_Cluster_MEB::TCPServer_SSOA_ICAS3VI_OCU_XIX_E3V_VLAN_Infotainment, 1, @sysvar::IL_ETH1::PDU_FITrueEventEnable::TCPServer_SSOA_ICAS3VI_OCU_XIX_E3V_VLAN_Infotainment, @sysvar::IL_ETH1::PDU_FITrueEventRepCount::TCPServer_SSOA_ICAS3VI_OCU_XIX_E3V_VLAN_Infotainment, @sysvar::IL_ETH1::PDU_FITrueEventRepPeriod::TCPServer_SSOA_ICAS3VI_OCU_XIX_E3V_VLAN_Infotainment, @sysvar::IL_ETH1::PDU_FIEventDebounceDelay::TCPServer_SSOA_ICAS3VI_OCU_XIX_E3V_VLAN_Infotainment, -1, 0);
  }
}

on sysvar_update sysvar::IL_ETH1::PDU_FIEventDebounceDelay::TCPServer_SSOA_ICAS3VI_OCU_XIX_E3V_VLAN_Infotainment
{
  if (@sysvar::IL_ETH1::PDU_DisturbTrueEventTiming::TCPServer_SSOA_ICAS3VI_OCU_XIX_E3V_VLAN_Infotainment == 1)
  {
    SetBusContext(gILETH1_BusContext);
    ILSetPDUTimingEvent(ETH_Cluster_MEB::TCPServer_SSOA_ICAS3VI_OCU_XIX_E3V_VLAN_Infotainment, 1, @sysvar::IL_ETH1::PDU_FITrueEventEnable::TCPServer_SSOA_ICAS3VI_OCU_XIX_E3V_VLAN_Infotainment, @sysvar::IL_ETH1::PDU_FITrueEventRepCount::TCPServer_SSOA_ICAS3VI_OCU_XIX_E3V_VLAN_Infotainment, @sysvar::IL_ETH1::PDU_FITrueEventRepPeriod::TCPServer_SSOA_ICAS3VI_OCU_XIX_E3V_VLAN_Infotainment, @sysvar::IL_ETH1::PDU_FIEventDebounceDelay::TCPServer_SSOA_ICAS3VI_OCU_XIX_E3V_VLAN_Infotainment, -1, 0);
  }
  if (@sysvar::IL_ETH1::PDU_DisturbFalseEventTiming::TCPServer_SSOA_ICAS3VI_OCU_XIX_E3V_VLAN_Infotainment == 1)
  {
    SetBusContext(gILETH1_BusContext);
    ILSetPDUTimingEvent(ETH_Cluster_MEB::TCPServer_SSOA_ICAS3VI_OCU_XIX_E3V_VLAN_Infotainment, 0, @sysvar::IL_ETH1::PDU_FIFalseEventEnable::TCPServer_SSOA_ICAS3VI_OCU_XIX_E3V_VLAN_Infotainment, @sysvar::IL_ETH1::PDU_FIFalseEventRepCount::TCPServer_SSOA_ICAS3VI_OCU_XIX_E3V_VLAN_Infotainment, @sysvar::IL_ETH1::PDU_FIFalseEventRepPeriod::TCPServer_SSOA_ICAS3VI_OCU_XIX_E3V_VLAN_Infotainment, @sysvar::IL_ETH1::PDU_FIEventDebounceDelay::TCPServer_SSOA_ICAS3VI_OCU_XIX_E3V_VLAN_Infotainment, -1, 0);
  }
}

on sysvar_update sysvar::IL_ETH1::PDU_DisturbFalseEventTiming::TCPServer_SSOA_ICAS3VI_OCU_XIX_E3V_VLAN_Infotainment
{
  if (@this == 1)
  {
    SetBusContext(gILETH1_BusContext);
    ILSetPDUTimingEvent(ETH_Cluster_MEB::TCPServer_SSOA_ICAS3VI_OCU_XIX_E3V_VLAN_Infotainment, 0, @sysvar::IL_ETH1::PDU_FIFalseEventEnable::TCPServer_SSOA_ICAS3VI_OCU_XIX_E3V_VLAN_Infotainment, @sysvar::IL_ETH1::PDU_FIFalseEventRepCount::TCPServer_SSOA_ICAS3VI_OCU_XIX_E3V_VLAN_Infotainment, @sysvar::IL_ETH1::PDU_FIFalseEventRepPeriod::TCPServer_SSOA_ICAS3VI_OCU_XIX_E3V_VLAN_Infotainment, @sysvar::IL_ETH1::PDU_FIEventDebounceDelay::TCPServer_SSOA_ICAS3VI_OCU_XIX_E3V_VLAN_Infotainment, -1, 0);
  }
  else
  {
    SetBusContext(gILETH1_BusContext);
    ILResetPDUTimingEvent(ETH_Cluster_MEB::TCPServer_SSOA_ICAS3VI_OCU_XIX_E3V_VLAN_Infotainment, 0);
  }
}

on sysvar_update sysvar::IL_ETH1::PDU_FIFalseEventEnable::TCPServer_SSOA_ICAS3VI_OCU_XIX_E3V_VLAN_Infotainment
{
  if (@sysvar::IL_ETH1::PDU_DisturbFalseEventTiming::TCPServer_SSOA_ICAS3VI_OCU_XIX_E3V_VLAN_Infotainment == 1)
  {
    SetBusContext(gILETH1_BusContext);
    ILSetPDUTimingEvent(ETH_Cluster_MEB::TCPServer_SSOA_ICAS3VI_OCU_XIX_E3V_VLAN_Infotainment, 0, @sysvar::IL_ETH1::PDU_FIFalseEventEnable::TCPServer_SSOA_ICAS3VI_OCU_XIX_E3V_VLAN_Infotainment, @sysvar::IL_ETH1::PDU_FIFalseEventRepCount::TCPServer_SSOA_ICAS3VI_OCU_XIX_E3V_VLAN_Infotainment, @sysvar::IL_ETH1::PDU_FIFalseEventRepPeriod::TCPServer_SSOA_ICAS3VI_OCU_XIX_E3V_VLAN_Infotainment, @sysvar::IL_ETH1::PDU_FIEventDebounceDelay::TCPServer_SSOA_ICAS3VI_OCU_XIX_E3V_VLAN_Infotainment, -1, 0);
  }
}

on sysvar_update sysvar::IL_ETH1::PDU_FIFalseEventRepCount::TCPServer_SSOA_ICAS3VI_OCU_XIX_E3V_VLAN_Infotainment
{
  if (@sysvar::IL_ETH1::PDU_DisturbFalseEventTiming::TCPServer_SSOA_ICAS3VI_OCU_XIX_E3V_VLAN_Infotainment == 1)
  {
    SetBusContext(gILETH1_BusContext);
    ILSetPDUTimingEvent(ETH_Cluster_MEB::TCPServer_SSOA_ICAS3VI_OCU_XIX_E3V_VLAN_Infotainment, 0, @sysvar::IL_ETH1::PDU_FIFalseEventEnable::TCPServer_SSOA_ICAS3VI_OCU_XIX_E3V_VLAN_Infotainment, @sysvar::IL_ETH1::PDU_FIFalseEventRepCount::TCPServer_SSOA_ICAS3VI_OCU_XIX_E3V_VLAN_Infotainment, @sysvar::IL_ETH1::PDU_FIFalseEventRepPeriod::TCPServer_SSOA_ICAS3VI_OCU_XIX_E3V_VLAN_Infotainment, @sysvar::IL_ETH1::PDU_FIEventDebounceDelay::TCPServer_SSOA_ICAS3VI_OCU_XIX_E3V_VLAN_Infotainment, -1, 0);
  }
}

on sysvar_update sysvar::IL_ETH1::PDU_FIFalseEventRepPeriod::TCPServer_SSOA_ICAS3VI_OCU_XIX_E3V_VLAN_Infotainment
{
  if (@sysvar::IL_ETH1::PDU_DisturbFalseEventTiming::TCPServer_SSOA_ICAS3VI_OCU_XIX_E3V_VLAN_Infotainment == 1)
  {
    SetBusContext(gILETH1_BusContext);
    ILSetPDUTimingEvent(ETH_Cluster_MEB::TCPServer_SSOA_ICAS3VI_OCU_XIX_E3V_VLAN_Infotainment, 0, @sysvar::IL_ETH1::PDU_FIFalseEventEnable::TCPServer_SSOA_ICAS3VI_OCU_XIX_E3V_VLAN_Infotainment, @sysvar::IL_ETH1::PDU_FIFalseEventRepCount::TCPServer_SSOA_ICAS3VI_OCU_XIX_E3V_VLAN_Infotainment, @sysvar::IL_ETH1::PDU_FIFalseEventRepPeriod::TCPServer_SSOA_ICAS3VI_OCU_XIX_E3V_VLAN_Infotainment, @sysvar::IL_ETH1::PDU_FIEventDebounceDelay::TCPServer_SSOA_ICAS3VI_OCU_XIX_E3V_VLAN_Infotainment, -1, 0);
  }
}

on sysvar_update sysvar::IL_ETH1::PDU_DisturbTimingMode::TCPServer_ViWi_01_ICAS3IVI_Info_El_XIX_E3V_VLAN_Infotainment
{
  if (@this == 1)
  {
    SetBusContext(gILETH1_BusContext);
    ILSetPDUAsrTXMode(ETH_Cluster_MEB::TCPServer_ViWi_01_ICAS3IVI_Info_El_XIX_E3V_VLAN_Infotainment, @sysvar::IL_ETH1::PDU_FITimingMode::TCPServer_ViWi_01_ICAS3IVI_Info_El_XIX_E3V_VLAN_Infotainment, -1, 0);
  }
  else
  {
    SetBusContext(gILETH1_BusContext);
    ILResetPDUAsrTXMode(ETH_Cluster_MEB::TCPServer_ViWi_01_ICAS3IVI_Info_El_XIX_E3V_VLAN_Infotainment);
  }
}

on sysvar_update sysvar::IL_ETH1::PDU_FITimingMode::TCPServer_ViWi_01_ICAS3IVI_Info_El_XIX_E3V_VLAN_Infotainment
{
  if (@sysvar::IL_ETH1::PDU_DisturbTimingMode::TCPServer_ViWi_01_ICAS3IVI_Info_El_XIX_E3V_VLAN_Infotainment == 1)
  {
    SetBusContext(gILETH1_BusContext);
    ILSetPDUAsrTXMode(ETH_Cluster_MEB::TCPServer_ViWi_01_ICAS3IVI_Info_El_XIX_E3V_VLAN_Infotainment, @sysvar::IL_ETH1::PDU_FITimingMode::TCPServer_ViWi_01_ICAS3IVI_Info_El_XIX_E3V_VLAN_Infotainment, -1, 0);
  }
}

on sysvar_update sysvar::IL_ETH1::PDU_DisturbTrueCyclicTiming::TCPServer_ViWi_01_ICAS3IVI_Info_El_XIX_E3V_VLAN_Infotainment
{
  if (@this == 1)
  {
    SetBusContext(gILETH1_BusContext);
    ILSetPDUTimingCyclic(ETH_Cluster_MEB::TCPServer_ViWi_01_ICAS3IVI_Info_El_XIX_E3V_VLAN_Infotainment, 1, 0, @sysvar::IL_ETH1::PDU_FITrueCyclicPeriod::TCPServer_ViWi_01_ICAS3IVI_Info_El_XIX_E3V_VLAN_Infotainment, -1, 0);
  }
  else
  {
    SetBusContext(gILETH1_BusContext);
    ILResetPDUTimingCyclic(ETH_Cluster_MEB::TCPServer_ViWi_01_ICAS3IVI_Info_El_XIX_E3V_VLAN_Infotainment, 1);
  }
}

on sysvar_update sysvar::IL_ETH1::PDU_FITrueCyclicPeriod::TCPServer_ViWi_01_ICAS3IVI_Info_El_XIX_E3V_VLAN_Infotainment
{
  if (@sysvar::IL_ETH1::PDU_DisturbTrueCyclicTiming::TCPServer_ViWi_01_ICAS3IVI_Info_El_XIX_E3V_VLAN_Infotainment == 1)
  {
    SetBusContext(gILETH1_BusContext);
    ILSetPDUTimingCyclic(ETH_Cluster_MEB::TCPServer_ViWi_01_ICAS3IVI_Info_El_XIX_E3V_VLAN_Infotainment, 1, 0, @sysvar::IL_ETH1::PDU_FITrueCyclicPeriod::TCPServer_ViWi_01_ICAS3IVI_Info_El_XIX_E3V_VLAN_Infotainment, -1, 0);
  }
}

on sysvar_update sysvar::IL_ETH1::PDU_DisturbFalseCyclicTiming::TCPServer_ViWi_01_ICAS3IVI_Info_El_XIX_E3V_VLAN_Infotainment
{
  if (@this == 1)
  {
    SetBusContext(gILETH1_BusContext);
    ILSetPDUTimingCyclic(ETH_Cluster_MEB::TCPServer_ViWi_01_ICAS3IVI_Info_El_XIX_E3V_VLAN_Infotainment, 0, 0, @sysvar::IL_ETH1::PDU_FIFalseCyclicPeriod::TCPServer_ViWi_01_ICAS3IVI_Info_El_XIX_E3V_VLAN_Infotainment, -1, 0);
  }
  else
  {
    SetBusContext(gILETH1_BusContext);
    ILResetPDUTimingCyclic(ETH_Cluster_MEB::TCPServer_ViWi_01_ICAS3IVI_Info_El_XIX_E3V_VLAN_Infotainment, 0);
  }
}

on sysvar_update sysvar::IL_ETH1::PDU_FIFalseCyclicPeriod::TCPServer_ViWi_01_ICAS3IVI_Info_El_XIX_E3V_VLAN_Infotainment
{
  if (@sysvar::IL_ETH1::PDU_DisturbFalseCyclicTiming::TCPServer_ViWi_01_ICAS3IVI_Info_El_XIX_E3V_VLAN_Infotainment == 1)
  {
    SetBusContext(gILETH1_BusContext);
    ILSetPDUTimingCyclic(ETH_Cluster_MEB::TCPServer_ViWi_01_ICAS3IVI_Info_El_XIX_E3V_VLAN_Infotainment, 1, 0, @sysvar::IL_ETH1::PDU_FITrueCyclicPeriod::TCPServer_ViWi_01_ICAS3IVI_Info_El_XIX_E3V_VLAN_Infotainment, -1, 0);
  }
}

on sysvar_update sysvar::IL_ETH1::PDU_SendOnce::TCPServer_ViWi_01_ICAS3IVI_Info_El_XIX_E3V_VLAN_Infotainment
{
  if (@this == 1)
  {
    SetBusContext(gILETH1_BusContext);
    ILSetPDUEvent(ETH_Cluster_MEB::TCPServer_ViWi_01_ICAS3IVI_Info_El_XIX_E3V_VLAN_Infotainment);
  }
}

on sysvar_update sysvar::IL_ETH1::PDU_DisturbTrueEventTiming::TCPServer_ViWi_01_ICAS3IVI_Info_El_XIX_E3V_VLAN_Infotainment
{
  if (@this == 1)
  {
    SetBusContext(gILETH1_BusContext);
    ILSetPDUTimingEvent(ETH_Cluster_MEB::TCPServer_ViWi_01_ICAS3IVI_Info_El_XIX_E3V_VLAN_Infotainment, 1, @sysvar::IL_ETH1::PDU_FITrueEventEnable::TCPServer_ViWi_01_ICAS3IVI_Info_El_XIX_E3V_VLAN_Infotainment, @sysvar::IL_ETH1::PDU_FITrueEventRepCount::TCPServer_ViWi_01_ICAS3IVI_Info_El_XIX_E3V_VLAN_Infotainment, @sysvar::IL_ETH1::PDU_FITrueEventRepPeriod::TCPServer_ViWi_01_ICAS3IVI_Info_El_XIX_E3V_VLAN_Infotainment, @sysvar::IL_ETH1::PDU_FIEventDebounceDelay::TCPServer_ViWi_01_ICAS3IVI_Info_El_XIX_E3V_VLAN_Infotainment, -1, 0);
  }
  else
  {
    SetBusContext(gILETH1_BusContext);
    ILResetPDUTimingEvent(ETH_Cluster_MEB::TCPServer_ViWi_01_ICAS3IVI_Info_El_XIX_E3V_VLAN_Infotainment, 1);
  }
}

on sysvar_update sysvar::IL_ETH1::PDU_FITrueEventEnable::TCPServer_ViWi_01_ICAS3IVI_Info_El_XIX_E3V_VLAN_Infotainment
{
  if (@sysvar::IL_ETH1::PDU_DisturbTrueEventTiming::TCPServer_ViWi_01_ICAS3IVI_Info_El_XIX_E3V_VLAN_Infotainment == 1)
  {
    SetBusContext(gILETH1_BusContext);
    ILSetPDUTimingEvent(ETH_Cluster_MEB::TCPServer_ViWi_01_ICAS3IVI_Info_El_XIX_E3V_VLAN_Infotainment, 1, @sysvar::IL_ETH1::PDU_FITrueEventEnable::TCPServer_ViWi_01_ICAS3IVI_Info_El_XIX_E3V_VLAN_Infotainment, @sysvar::IL_ETH1::PDU_FITrueEventRepCount::TCPServer_ViWi_01_ICAS3IVI_Info_El_XIX_E3V_VLAN_Infotainment, @sysvar::IL_ETH1::PDU_FITrueEventRepPeriod::TCPServer_ViWi_01_ICAS3IVI_Info_El_XIX_E3V_VLAN_Infotainment, @sysvar::IL_ETH1::PDU_FIEventDebounceDelay::TCPServer_ViWi_01_ICAS3IVI_Info_El_XIX_E3V_VLAN_Infotainment, -1, 0);
  }
}

on sysvar_update sysvar::IL_ETH1::PDU_FITrueEventRepCount::TCPServer_ViWi_01_ICAS3IVI_Info_El_XIX_E3V_VLAN_Infotainment
{
  if (@sysvar::IL_ETH1::PDU_DisturbTrueEventTiming::TCPServer_ViWi_01_ICAS3IVI_Info_El_XIX_E3V_VLAN_Infotainment == 1)
  {
    SetBusContext(gILETH1_BusContext);
    ILSetPDUTimingEvent(ETH_Cluster_MEB::TCPServer_ViWi_01_ICAS3IVI_Info_El_XIX_E3V_VLAN_Infotainment, 1, @sysvar::IL_ETH1::PDU_FITrueEventEnable::TCPServer_ViWi_01_ICAS3IVI_Info_El_XIX_E3V_VLAN_Infotainment, @sysvar::IL_ETH1::PDU_FITrueEventRepCount::TCPServer_ViWi_01_ICAS3IVI_Info_El_XIX_E3V_VLAN_Infotainment, @sysvar::IL_ETH1::PDU_FITrueEventRepPeriod::TCPServer_ViWi_01_ICAS3IVI_Info_El_XIX_E3V_VLAN_Infotainment, @sysvar::IL_ETH1::PDU_FIEventDebounceDelay::TCPServer_ViWi_01_ICAS3IVI_Info_El_XIX_E3V_VLAN_Infotainment, -1, 0);
  }
}

on sysvar_update sysvar::IL_ETH1::PDU_FITrueEventRepPeriod::TCPServer_ViWi_01_ICAS3IVI_Info_El_XIX_E3V_VLAN_Infotainment
{
  if (@sysvar::IL_ETH1::PDU_DisturbTrueEventTiming::TCPServer_ViWi_01_ICAS3IVI_Info_El_XIX_E3V_VLAN_Infotainment == 1)
  {
    SetBusContext(gILETH1_BusContext);
    ILSetPDUTimingEvent(ETH_Cluster_MEB::TCPServer_ViWi_01_ICAS3IVI_Info_El_XIX_E3V_VLAN_Infotainment, 1, @sysvar::IL_ETH1::PDU_FITrueEventEnable::TCPServer_ViWi_01_ICAS3IVI_Info_El_XIX_E3V_VLAN_Infotainment, @sysvar::IL_ETH1::PDU_FITrueEventRepCount::TCPServer_ViWi_01_ICAS3IVI_Info_El_XIX_E3V_VLAN_Infotainment, @sysvar::IL_ETH1::PDU_FITrueEventRepPeriod::TCPServer_ViWi_01_ICAS3IVI_Info_El_XIX_E3V_VLAN_Infotainment, @sysvar::IL_ETH1::PDU_FIEventDebounceDelay::TCPServer_ViWi_01_ICAS3IVI_Info_El_XIX_E3V_VLAN_Infotainment, -1, 0);
  }
}

on sysvar_update sysvar::IL_ETH1::PDU_FIEventDebounceDelay::TCPServer_ViWi_01_ICAS3IVI_Info_El_XIX_E3V_VLAN_Infotainment
{
  if (@sysvar::IL_ETH1::PDU_DisturbTrueEventTiming::TCPServer_ViWi_01_ICAS3IVI_Info_El_XIX_E3V_VLAN_Infotainment == 1)
  {
    SetBusContext(gILETH1_BusContext);
    ILSetPDUTimingEvent(ETH_Cluster_MEB::TCPServer_ViWi_01_ICAS3IVI_Info_El_XIX_E3V_VLAN_Infotainment, 1, @sysvar::IL_ETH1::PDU_FITrueEventEnable::TCPServer_ViWi_01_ICAS3IVI_Info_El_XIX_E3V_VLAN_Infotainment, @sysvar::IL_ETH1::PDU_FITrueEventRepCount::TCPServer_ViWi_01_ICAS3IVI_Info_El_XIX_E3V_VLAN_Infotainment, @sysvar::IL_ETH1::PDU_FITrueEventRepPeriod::TCPServer_ViWi_01_ICAS3IVI_Info_El_XIX_E3V_VLAN_Infotainment, @sysvar::IL_ETH1::PDU_FIEventDebounceDelay::TCPServer_ViWi_01_ICAS3IVI_Info_El_XIX_E3V_VLAN_Infotainment, -1, 0);
  }
  if (@sysvar::IL_ETH1::PDU_DisturbFalseEventTiming::TCPServer_ViWi_01_ICAS3IVI_Info_El_XIX_E3V_VLAN_Infotainment == 1)
  {
    SetBusContext(gILETH1_BusContext);
    ILSetPDUTimingEvent(ETH_Cluster_MEB::TCPServer_ViWi_01_ICAS3IVI_Info_El_XIX_E3V_VLAN_Infotainment, 0, @sysvar::IL_ETH1::PDU_FIFalseEventEnable::TCPServer_ViWi_01_ICAS3IVI_Info_El_XIX_E3V_VLAN_Infotainment, @sysvar::IL_ETH1::PDU_FIFalseEventRepCount::TCPServer_ViWi_01_ICAS3IVI_Info_El_XIX_E3V_VLAN_Infotainment, @sysvar::IL_ETH1::PDU_FIFalseEventRepPeriod::TCPServer_ViWi_01_ICAS3IVI_Info_El_XIX_E3V_VLAN_Infotainment, @sysvar::IL_ETH1::PDU_FIEventDebounceDelay::TCPServer_ViWi_01_ICAS3IVI_Info_El_XIX_E3V_VLAN_Infotainment, -1, 0);
  }
}

on sysvar_update sysvar::IL_ETH1::PDU_DisturbFalseEventTiming::TCPServer_ViWi_01_ICAS3IVI_Info_El_XIX_E3V_VLAN_Infotainment
{
  if (@this == 1)
  {
    SetBusContext(gILETH1_BusContext);
    ILSetPDUTimingEvent(ETH_Cluster_MEB::TCPServer_ViWi_01_ICAS3IVI_Info_El_XIX_E3V_VLAN_Infotainment, 0, @sysvar::IL_ETH1::PDU_FIFalseEventEnable::TCPServer_ViWi_01_ICAS3IVI_Info_El_XIX_E3V_VLAN_Infotainment, @sysvar::IL_ETH1::PDU_FIFalseEventRepCount::TCPServer_ViWi_01_ICAS3IVI_Info_El_XIX_E3V_VLAN_Infotainment, @sysvar::IL_ETH1::PDU_FIFalseEventRepPeriod::TCPServer_ViWi_01_ICAS3IVI_Info_El_XIX_E3V_VLAN_Infotainment, @sysvar::IL_ETH1::PDU_FIEventDebounceDelay::TCPServer_ViWi_01_ICAS3IVI_Info_El_XIX_E3V_VLAN_Infotainment, -1, 0);
  }
  else
  {
    SetBusContext(gILETH1_BusContext);
    ILResetPDUTimingEvent(ETH_Cluster_MEB::TCPServer_ViWi_01_ICAS3IVI_Info_El_XIX_E3V_VLAN_Infotainment, 0);
  }
}

on sysvar_update sysvar::IL_ETH1::PDU_FIFalseEventEnable::TCPServer_ViWi_01_ICAS3IVI_Info_El_XIX_E3V_VLAN_Infotainment
{
  if (@sysvar::IL_ETH1::PDU_DisturbFalseEventTiming::TCPServer_ViWi_01_ICAS3IVI_Info_El_XIX_E3V_VLAN_Infotainment == 1)
  {
    SetBusContext(gILETH1_BusContext);
    ILSetPDUTimingEvent(ETH_Cluster_MEB::TCPServer_ViWi_01_ICAS3IVI_Info_El_XIX_E3V_VLAN_Infotainment, 0, @sysvar::IL_ETH1::PDU_FIFalseEventEnable::TCPServer_ViWi_01_ICAS3IVI_Info_El_XIX_E3V_VLAN_Infotainment, @sysvar::IL_ETH1::PDU_FIFalseEventRepCount::TCPServer_ViWi_01_ICAS3IVI_Info_El_XIX_E3V_VLAN_Infotainment, @sysvar::IL_ETH1::PDU_FIFalseEventRepPeriod::TCPServer_ViWi_01_ICAS3IVI_Info_El_XIX_E3V_VLAN_Infotainment, @sysvar::IL_ETH1::PDU_FIEventDebounceDelay::TCPServer_ViWi_01_ICAS3IVI_Info_El_XIX_E3V_VLAN_Infotainment, -1, 0);
  }
}

on sysvar_update sysvar::IL_ETH1::PDU_FIFalseEventRepCount::TCPServer_ViWi_01_ICAS3IVI_Info_El_XIX_E3V_VLAN_Infotainment
{
  if (@sysvar::IL_ETH1::PDU_DisturbFalseEventTiming::TCPServer_ViWi_01_ICAS3IVI_Info_El_XIX_E3V_VLAN_Infotainment == 1)
  {
    SetBusContext(gILETH1_BusContext);
    ILSetPDUTimingEvent(ETH_Cluster_MEB::TCPServer_ViWi_01_ICAS3IVI_Info_El_XIX_E3V_VLAN_Infotainment, 0, @sysvar::IL_ETH1::PDU_FIFalseEventEnable::TCPServer_ViWi_01_ICAS3IVI_Info_El_XIX_E3V_VLAN_Infotainment, @sysvar::IL_ETH1::PDU_FIFalseEventRepCount::TCPServer_ViWi_01_ICAS3IVI_Info_El_XIX_E3V_VLAN_Infotainment, @sysvar::IL_ETH1::PDU_FIFalseEventRepPeriod::TCPServer_ViWi_01_ICAS3IVI_Info_El_XIX_E3V_VLAN_Infotainment, @sysvar::IL_ETH1::PDU_FIEventDebounceDelay::TCPServer_ViWi_01_ICAS3IVI_Info_El_XIX_E3V_VLAN_Infotainment, -1, 0);
  }
}

on sysvar_update sysvar::IL_ETH1::PDU_FIFalseEventRepPeriod::TCPServer_ViWi_01_ICAS3IVI_Info_El_XIX_E3V_VLAN_Infotainment
{
  if (@sysvar::IL_ETH1::PDU_DisturbFalseEventTiming::TCPServer_ViWi_01_ICAS3IVI_Info_El_XIX_E3V_VLAN_Infotainment == 1)
  {
    SetBusContext(gILETH1_BusContext);
    ILSetPDUTimingEvent(ETH_Cluster_MEB::TCPServer_ViWi_01_ICAS3IVI_Info_El_XIX_E3V_VLAN_Infotainment, 0, @sysvar::IL_ETH1::PDU_FIFalseEventEnable::TCPServer_ViWi_01_ICAS3IVI_Info_El_XIX_E3V_VLAN_Infotainment, @sysvar::IL_ETH1::PDU_FIFalseEventRepCount::TCPServer_ViWi_01_ICAS3IVI_Info_El_XIX_E3V_VLAN_Infotainment, @sysvar::IL_ETH1::PDU_FIFalseEventRepPeriod::TCPServer_ViWi_01_ICAS3IVI_Info_El_XIX_E3V_VLAN_Infotainment, @sysvar::IL_ETH1::PDU_FIEventDebounceDelay::TCPServer_ViWi_01_ICAS3IVI_Info_El_XIX_E3V_VLAN_Infotainment, -1, 0);
  }
}

on sysvar_update sysvar::NM_ETH1::ICAS3_Sys_IVI_01::OpenNodePanel
{
  OpenNodePanel("ETH_Cluster_MEB::ICAS3_Sys_IVI_01", 1);
}

on sysvar_update sysvar::NM_ETH1::StateControl::CloseNodePanels
{
  OpenNodePanel("ETH_Cluster_MEB::ICAS3_Sys_IVI_01", 0);
}

/* #ChannelEnd# |ETH1| #BusEnd# |ETH_Cluster_MEB| */
//--- end generated part --- Block end <#SysVar_Handler#> do not delete this line! Add application code below this line.

//--- begin generated part --- Block start <#MsgUpdateFcns#> do not delete this line and do not add application code in this code block!
/* #ChannelStart# |ETH1| #BusStart# |ETH_Cluster_MEB| */
/* #ChannelEnd# |ETH1| #BusEnd# |ETH_Cluster_MEB| */
//--- end generated part --- Block end <#MsgUpdateFcns#> do not delete this line! Add application code below this line.

