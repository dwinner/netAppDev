/*@!Encoding:1252*/
/* ------- generated code for Rest Bus Simulation ------- */

variables
{
  dword _DI_KL_58xd;
  dword _DI_KL_58xs;
  dword _DI_KL_58xt;
  double _BCM1_Aussen_Temp_ungef;
  double _LS_Helligkeit_IR;
  double _LS_Helligkeit_FW;
  double _RS_Regenmenge;
  dword _LSS_Tastencode;
}

on EnvVar eAAG_Bremsl_durch_ECDS
{
  switch (getValue( eAAG_Bremsl_durch_ECDS ))
  {
    case  0: putValue( eAAG_Bremsl_durch_ECDT, "Bremslicht ist aus" ); break;
    case  1: putValue( eAAG_Bremsl_durch_ECDT, "Bremslicht durch ECD aktiv" ); break;
    default: putValue( eAAG_Bremsl_durch_ECDT, "!?!" );
  }
}

on EnvVar eAAG_Anhaenger_abgestecktS
{
  switch (getValue( eAAG_Anhaenger_abgestecktS ))
  {
    case  1: putValue( eAAG_Anhaenger_abgestecktT, "Anhaenger wurde bei KL15 aus abgesteckt" ); break;
    default: putValue( eAAG_Anhaenger_abgestecktT, "!?!" );
  }
}

on EnvVar eAAG_NSL_aktivS
{
  switch (getValue( eAAG_NSL_aktivS ))
  {
    case  1: putValue( eAAG_NSL_aktivT, "Anhaenger Nebelschusslicht aktiv" ); break;
    default: putValue( eAAG_NSL_aktivT, "!?!" );
  }
}

on EnvVar eAAG_Anhaenger_erkanntS
{
  switch (getValue( eAAG_Anhaenger_erkanntS ))
  {
    case  0: putValue( eAAG_Anhaenger_erkanntT, "kein Anhaenger erkannt" ); break;
    case  1: putValue( eAAG_Anhaenger_erkanntT, "AAG Anhaenger erkannt" ); break;
    default: putValue( eAAG_Anhaenger_erkanntT, "!?!" );
  }
}

on EnvVar eAAG_Blinker_H_aktivS
{
  switch (getValue( eAAG_Blinker_H_aktivS ))
  {
    case  1: putValue( eAAG_Blinker_H_aktivT, "Anhaenger Blinker aktiv" ); break;
    default: putValue( eAAG_Blinker_H_aktivT, "!?!" );
  }
}

on EnvVar eAAG_Blinker_HL_defS
{
  switch (getValue( eAAG_Blinker_HL_defS ))
  {
    case  1: putValue( eAAG_Blinker_HL_defT, "Anhaenger Blinker links defekt" ); break;
    default: putValue( eAAG_Blinker_HL_defT, "!?!" );
  }
}

on EnvVar eAAG_Blinker_HR_defS
{
  switch (getValue( eAAG_Blinker_HR_defS ))
  {
    case  1: putValue( eAAG_Blinker_HR_defT, "Anhaenger Blinker rechts defekt" ); break;
    default: putValue( eAAG_Blinker_HR_defT, "!?!" );
  }
}

on EnvVar eAAG_Bremslicht_H_defS
{
  switch (getValue( eAAG_Bremslicht_H_defS ))
  {
    case  1: putValue( eAAG_Bremslicht_H_defT, "Anhaenger Bremslicht defekt" ); break;
    default: putValue( eAAG_Bremslicht_H_defT, "!?!" );
  }
}

on EnvVar eAAG_Schlusslicht_HL_defS
{
  switch (getValue( eAAG_Schlusslicht_HL_defS ))
  {
    case  1: putValue( eAAG_Schlusslicht_HL_defT, "Anhaenger Schlusslicht links defekt" ); break;
    default: putValue( eAAG_Schlusslicht_HL_defT, "!?!" );
  }
}

on EnvVar eAAG_Schlusslicht_HR_defS
{
  switch (getValue( eAAG_Schlusslicht_HR_defS ))
  {
    case  1: putValue( eAAG_Schlusslicht_HR_defT, "Anhaenger Schlusslicht rechts defekt" ); break;
    default: putValue( eAAG_Schlusslicht_HR_defT, "!?!" );
  }
}

on EnvVar eAAG_AVS_Fehler_02S
{
  switch (getValue( eAAG_AVS_Fehler_02S ))
  {
    case  0: putValue( eAAG_AVS_Fehler_02T, "iO" ); break;
    case  1: putValue( eAAG_AVS_Fehler_02T, "niO" ); break;
    case  2: putValue( eAAG_AVS_Fehler_02T, "niO Fahrzeugstopp erforderlich" ); break;
    case  3: putValue( eAAG_AVS_Fehler_02T, "tbd" ); break;
    default: putValue( eAAG_AVS_Fehler_02T, "!?!" );
  }
}

on EnvVar eAAG_AVS_StatiS
{
  switch (getValue( eAAG_AVS_StatiS ))
  {
    case  0: putValue( eAAG_AVS_StatiT, "endlage eingefahren erreicht" ); break;
    case  1: putValue( eAAG_AVS_StatiT, "endlage ausgefahren erreicht" ); break;
    case  2: putValue( eAAG_AVS_StatiT, "ausfahren automatik" ); break;
    case  3: putValue( eAAG_AVS_StatiT, "einfahren automatik" ); break;
    case  4: putValue( eAAG_AVS_StatiT, "ausfahren manuell" ); break;
    case  5: putValue( eAAG_AVS_StatiT, "einfahren manuell" ); break;
    case  6: putValue( eAAG_AVS_StatiT, "zwischenposition" ); break;
    case  7: putValue( eAAG_AVS_StatiT, "nicht initialisiert" ); break;
    default: putValue( eAAG_AVS_StatiT, "!?!" );
  }
}

on EnvVar eBCM_Bremsbelag_SensorS
{
  switch (getValue( eBCM_Bremsbelag_SensorS ))
  {
    case  0: putValue( eBCM_Bremsbelag_SensorT, "OK" ); break;
    case  1: putValue( eBCM_Bremsbelag_SensorT, "Bremsbelag unter min" ); break;
    default: putValue( eBCM_Bremsbelag_SensorT, "!?!" );
  }
}

on EnvVar eBCM_Bremsfluessigkeit_SensorS
{
  switch (getValue( eBCM_Bremsfluessigkeit_SensorS ))
  {
    case  0: putValue( eBCM_Bremsfluessigkeit_SensorT, "OK" ); break;
    case  1: putValue( eBCM_Bremsfluessigkeit_SensorT, "Bremsfluessigkeit unter min" ); break;
    default: putValue( eBCM_Bremsfluessigkeit_SensorT, "!?!" );
  }
}

on EnvVar eBCM1_Licht_WarnS
{
  switch (getValue( eBCM1_Licht_WarnS ))
  {
    case  0: putValue( eBCM1_Licht_WarnT, "OK" ); break;
    case  1: putValue( eBCM1_Licht_WarnT, "Lichtwarnung aktiv" ); break;
    default: putValue( eBCM1_Licht_WarnT, "!?!" );
  }
}

on EnvVar eBCM_Waschwasser_SensorS
{
  switch (getValue( eBCM_Waschwasser_SensorS ))
  {
    case  0: putValue( eBCM_Waschwasser_SensorT, "OK" ); break;
    case  1: putValue( eBCM_Waschwasser_SensorT, "Waschwasser unter min" ); break;
    default: putValue( eBCM_Waschwasser_SensorT, "!?!" );
  }
}

on EnvVar eBCM_Kuehlmittel_SensorS
{
  switch (getValue( eBCM_Kuehlmittel_SensorS ))
  {
    case  0: putValue( eBCM_Kuehlmittel_SensorT, "OK" ); break;
    case  1: putValue( eBCM_Kuehlmittel_SensorT, "Kuehlmittel unter min" ); break;
    default: putValue( eBCM_Kuehlmittel_SensorT, "!?!" );
  }
}

on EnvVar eBCM1_Kl_15_HW_erkanntS
{
  switch (getValue( eBCM1_Kl_15_HW_erkanntS ))
  {
    case  1: putValue( eBCM1_Kl_15_HW_erkanntT, "Klemme 15 erkannt" ); break;
    default: putValue( eBCM1_Kl_15_HW_erkanntT, "!?!" );
  }
}

on EnvVar eZZH_Endlage_obenS
{
  switch (getValue( eZZH_Endlage_obenS ))
  {
    case  0: putValue( eZZH_Endlage_obenT, "ZZH nicht in oberer Endlage" ); break;
    case  1: putValue( eZZH_Endlage_obenT, "ZZH in Endlage oben" ); break;
    default: putValue( eZZH_Endlage_obenT, "!?!" );
  }
}

on EnvVar eZZH_Endlage_untenS
{
  switch (getValue( eZZH_Endlage_untenS ))
  {
    case  0: putValue( eZZH_Endlage_untenT, "ZZH nicht in unterer Endlage" ); break;
    case  1: putValue( eZZH_Endlage_untenT, "ZZH in Endlage unten" ); break;
    default: putValue( eZZH_Endlage_untenT, "!?!" );
  }
}

on EnvVar eZZH_Endlage_unplausibelS
{
  switch (getValue( eZZH_Endlage_unplausibelS ))
  {
    case  0: putValue( eZZH_Endlage_unplausibelT, "Endlage ZZH plausibel" ); break;
    case  1: putValue( eZZH_Endlage_unplausibelT, "unplausible Endlage der ZZH erkannt" ); break;
    default: putValue( eZZH_Endlage_unplausibelT, "!?!" );
  }
}

on EnvVar eBCM2_EZS_gedruecktS
{
  switch (getValue( eBCM2_EZS_gedruecktS ))
  {
    case  1: putValue( eBCM2_EZS_gedruecktT, "EZS gedrueckt" ); break;
    default: putValue( eBCM2_EZS_gedruecktT, "!?!" );
  }
}

on EnvVar eBCM2_SST_gedruecktS
{
  switch (getValue( eBCM2_SST_gedruecktS ))
  {
    case  1: putValue( eBCM2_SST_gedruecktT, "SST gedrueckt" ); break;
    default: putValue( eBCM2_SST_gedruecktT, "!?!" );
  }
}

on EnvVar eBCM1_Warnblink_TasterS
{
  switch (getValue( eBCM1_Warnblink_TasterS ))
  {
    case  0: putValue( eBCM1_Warnblink_TasterT, "nicht betaetigt" ); break;
    case  1: putValue( eBCM1_Warnblink_TasterT, "betaetigt" ); break;
    default: putValue( eBCM1_Warnblink_TasterT, "!?!" );
  }
}

on EnvVar eBCM1_Valet_Parking_TasterS
{
  switch (getValue( eBCM1_Valet_Parking_TasterS ))
  {
    case  0: putValue( eBCM1_Valet_Parking_TasterT, "nicht betaetigt" ); break;
    case  1: putValue( eBCM1_Valet_Parking_TasterT, "betaetigt" ); break;
    default: putValue( eBCM1_Valet_Parking_TasterT, "!?!" );
  }
}

on EnvVar eBCM1_HSK_TasterS
{
  switch (getValue( eBCM1_HSK_TasterS ))
  {
    case  0: putValue( eBCM1_HSK_TasterT, "nicht betaetigt" ); break;
    case  1: putValue( eBCM1_HSK_TasterT, "betaetigt" ); break;
    default: putValue( eBCM1_HSK_TasterT, "!?!" );
  }
}

on EnvVar eBCM1_Heckrollo_TasterS
{
  switch (getValue( eBCM1_Heckrollo_TasterS ))
  {
    case  0: putValue( eBCM1_Heckrollo_TasterT, "nicht betaetigt" ); break;
    case  1: putValue( eBCM1_Heckrollo_TasterT, "betaetigt" ); break;
    default: putValue( eBCM1_Heckrollo_TasterT, "!?!" );
  }
}

on EnvVar eBCM1_Rueckfahrlicht_SchalterS
{
  switch (getValue( eBCM1_Rueckfahrlicht_SchalterS ))
  {
    case  0: putValue( eBCM1_Rueckfahrlicht_SchalterT, "nicht betaetigt" ); break;
    case  1: putValue( eBCM1_Rueckfahrlicht_SchalterT, "betaetigt" ); break;
    default: putValue( eBCM1_Rueckfahrlicht_SchalterT, "!?!" );
  }
}

on EnvVar eBCM1_MH_SchalterS
{
  switch (getValue( eBCM1_MH_SchalterS ))
  {
    case  0: putValue( eBCM1_MH_SchalterT, "MH geschlossen" ); break;
    case  1: putValue( eBCM1_MH_SchalterT, "MH offen" ); break;
    default: putValue( eBCM1_MH_SchalterT, "!?!" );
  }
}

on EnvVar eBCM1_MH_WIV_SchalterS
{
  switch (getValue( eBCM1_MH_WIV_SchalterS ))
  {
    case  0: putValue( eBCM1_MH_WIV_SchalterT, "MH geschlossen" ); break;
    case  1: putValue( eBCM1_MH_WIV_SchalterT, "MH offen" ); break;
    default: putValue( eBCM1_MH_WIV_SchalterT, "!?!" );
  }
}

on EnvVar eBCM1_Lichtwarn_TexteS
{
  switch (getValue( eBCM1_Lichtwarn_TexteS ))
  {
    case  0: putValue( eBCM1_Lichtwarn_TexteT, "keine Warnung" ); break;
    case  1: putValue( eBCM1_Lichtwarn_TexteT, "Standlichtwarnung" ); break;
    case  2: putValue( eBCM1_Lichtwarn_TexteT, "Parklichtwarnung" ); break;
    case  3: putValue( eBCM1_Lichtwarn_TexteT, "Nebelschlusslichtwarnung" ); break;
    default: putValue( eBCM1_Lichtwarn_TexteT, "!?!" );
  }
}

on EnvVar eKY_IDGeber_1_StatusS
{
  switch (getValue( eKY_IDGeber_1_StatusS ))
  {
    case  0: putValue( eKY_IDGeber_1_StatusT, "keine Antwort" ); break;
    case  1: putValue( eKY_IDGeber_1_StatusT, "authentifiziert" ); break;
    case  2: putValue( eKY_IDGeber_1_StatusT, "UHV Antwort nicht authentifiziert" ); break;
    default: putValue( eKY_IDGeber_1_StatusT, "!?!" );
  }
}

on EnvVar eKY_IDGeber_2_StatusS
{
  switch (getValue( eKY_IDGeber_2_StatusS ))
  {
    case  0: putValue( eKY_IDGeber_2_StatusT, "keine Antwort" ); break;
    case  1: putValue( eKY_IDGeber_2_StatusT, "authentifiziert" ); break;
    case  2: putValue( eKY_IDGeber_2_StatusT, "UHV Antwort nicht authentifiziert" ); break;
    default: putValue( eKY_IDGeber_2_StatusT, "!?!" );
  }
}

on EnvVar eKY_SofttouchS
{
  switch (getValue( eKY_SofttouchS ))
  {
    case  0: putValue( eKY_SofttouchT, "inaktiv" ); break;
    case  1: putValue( eKY_SofttouchT, "aktiv" ); break;
    default: putValue( eKY_SofttouchT, "!?!" );
  }
}

on EnvVar eKY_IDGeber_3_StatusS
{
  switch (getValue( eKY_IDGeber_3_StatusS ))
  {
    case  0: putValue( eKY_IDGeber_3_StatusT, "keine Antwort" ); break;
    case  1: putValue( eKY_IDGeber_3_StatusT, "authentifiziert" ); break;
    case  2: putValue( eKY_IDGeber_3_StatusT, "UHV Antwort nicht authentifiziert" ); break;
    default: putValue( eKY_IDGeber_3_StatusT, "!?!" );
  }
}

on EnvVar eKY_IDGeber_4_StatusS
{
  switch (getValue( eKY_IDGeber_4_StatusS ))
  {
    case  0: putValue( eKY_IDGeber_4_StatusT, "keine Antwort" ); break;
    case  1: putValue( eKY_IDGeber_4_StatusT, "authentifiziert" ); break;
    case  2: putValue( eKY_IDGeber_4_StatusT, "UHV Antwort nicht authentifiziert" ); break;
    default: putValue( eKY_IDGeber_4_StatusT, "!?!" );
  }
}

on EnvVar eKY_FFB_in_LF_ReichwS
{
  switch (getValue( eKY_FFB_in_LF_ReichwS ))
  {
    case  0: putValue( eKY_FFB_in_LF_ReichwT, "inaktiv" ); break;
    case  1: putValue( eKY_FFB_in_LF_ReichwT, "aktiv" ); break;
    default: putValue( eKY_FFB_in_LF_ReichwT, "!?!" );
  }
}

on EnvVar eKY_IDGeber_1_BatS
{
  switch (getValue( eKY_IDGeber_1_BatS ))
  {
    case  0: putValue( eKY_IDGeber_1_BatT, "Batterie iO" ); break;
    case  1: putValue( eKY_IDGeber_1_BatT, "Entry Exit gesperrt" ); break;
    case  2: putValue( eKY_IDGeber_1_BatT, "Go gesperrt" ); break;
    default: putValue( eKY_IDGeber_1_BatT, "!?!" );
  }
}

on EnvVar eKY_IDGeber_2_BatS
{
  switch (getValue( eKY_IDGeber_2_BatS ))
  {
    case  0: putValue( eKY_IDGeber_2_BatT, "Batterie iO" ); break;
    case  1: putValue( eKY_IDGeber_2_BatT, "Entry Exit gesperrt" ); break;
    case  2: putValue( eKY_IDGeber_2_BatT, "Go gesperrt" ); break;
    default: putValue( eKY_IDGeber_2_BatT, "!?!" );
  }
}

on EnvVar eKY_IDGeber_3_BatS
{
  switch (getValue( eKY_IDGeber_3_BatS ))
  {
    case  0: putValue( eKY_IDGeber_3_BatT, "Batterie iO" ); break;
    case  1: putValue( eKY_IDGeber_3_BatT, "Entry Exit gesperrt" ); break;
    case  2: putValue( eKY_IDGeber_3_BatT, "Go gesperrt" ); break;
    default: putValue( eKY_IDGeber_3_BatT, "!?!" );
  }
}

on EnvVar eKY_IDGeber_4_BatS
{
  switch (getValue( eKY_IDGeber_4_BatS ))
  {
    case  0: putValue( eKY_IDGeber_4_BatT, "Batterie iO" ); break;
    case  1: putValue( eKY_IDGeber_4_BatT, "Entry Exit gesperrt" ); break;
    case  2: putValue( eKY_IDGeber_4_BatT, "Go gesperrt" ); break;
    default: putValue( eKY_IDGeber_4_BatT, "!?!" );
  }
}

on EnvVar eKY_KessyEntryExit_AktS
{
  switch (getValue( eKY_KessyEntryExit_AktS ))
  {
    case  0: putValue( eKY_KessyEntryExit_AktT, "inaktiv" ); break;
    case  1: putValue( eKY_KessyEntryExit_AktT, "aktiv" ); break;
    default: putValue( eKY_KessyEntryExit_AktT, "!?!" );
  }
}

on EnvVar eKY_Autofunktion_AktivS
{
  switch (getValue( eKY_Autofunktion_AktivS ))
  {
    case  0: putValue( eKY_Autofunktion_AktivT, "inaktiv" ); break;
    case  1: putValue( eKY_Autofunktion_AktivT, "aktiv" ); break;
    default: putValue( eKY_Autofunktion_AktivT, "!?!" );
  }
}

on EnvVar eKY_Anf_ReichwbegrS
{
  switch (getValue( eKY_Anf_ReichwbegrS ))
  {
    case  0: putValue( eKY_Anf_ReichwbegrT, "inaktiv" ); break;
    case  1: putValue( eKY_Anf_ReichwbegrT, "aktiv" ); break;
    default: putValue( eKY_Anf_ReichwbegrT, "!?!" );
  }
}

on EnvVar eKY_Anf_Reichwbegr_GesamtS
{
  switch (getValue( eKY_Anf_Reichwbegr_GesamtS ))
  {
    case  0: putValue( eKY_Anf_Reichwbegr_GesamtT, "inaktiv" ); break;
    case  1: putValue( eKY_Anf_Reichwbegr_GesamtT, "aktiv" ); break;
    default: putValue( eKY_Anf_Reichwbegr_GesamtT, "!?!" );
  }
}

on EnvVar eKY_VerriegelnS
{
  switch (getValue( eKY_VerriegelnS ))
  {
    case  0: putValue( eKY_VerriegelnT, "inaktiv" ); break;
    case  1: putValue( eKY_VerriegelnT, "aktiv" ); break;
    default: putValue( eKY_VerriegelnT, "!?!" );
  }
}

on EnvVar eKY_EntriegelnS
{
  switch (getValue( eKY_EntriegelnS ))
  {
    case  0: putValue( eKY_EntriegelnT, "inaktiv" ); break;
    case  1: putValue( eKY_EntriegelnT, "aktiv" ); break;
    default: putValue( eKY_EntriegelnT, "!?!" );
  }
}

on EnvVar eKY_SchluesselnrS
{
  switch (getValue( eKY_SchluesselnrS ))
  {
    case  0: putValue( eKY_SchluesselnrT, "kein authorisierter Schluessel erkannt" ); break;
    case  1: putValue( eKY_SchluesselnrT, "aktive Funkschluessel Nr 01" ); break;
    case  2: putValue( eKY_SchluesselnrT, "aktive Funkschluessel Nr 02" ); break;
    case  3: putValue( eKY_SchluesselnrT, "aktive Funkschluessel Nr 03" ); break;
    case  4: putValue( eKY_SchluesselnrT, "aktive Funkschluessel Nr 04" ); break;
    case  5: putValue( eKY_SchluesselnrT, "aktive Funkschluessel Nr 05" ); break;
    case  6: putValue( eKY_SchluesselnrT, "aktive Funkschluessel Nr 06" ); break;
    case  7: putValue( eKY_SchluesselnrT, "aktive Funkschluessel Nr 07" ); break;
    case  8: putValue( eKY_SchluesselnrT, "aktive Funkschluessel Nr 08" ); break;
    case  9: putValue( eKY_SchluesselnrT, "ungueltig 09" ); break;
    case 10: putValue( eKY_SchluesselnrT, "ungueltig 10" ); break;
    case 11: putValue( eKY_SchluesselnrT, "ungueltig 11" ); break;
    case 12: putValue( eKY_SchluesselnrT, "ungueltig 12" ); break;
    case 13: putValue( eKY_SchluesselnrT, "ungueltig 13" ); break;
    case 14: putValue( eKY_SchluesselnrT, "ungueltig 14" ); break;
    case 15: putValue( eKY_SchluesselnrT, "ungueltig 15" ); break;
    default: putValue( eKY_SchluesselnrT, "!?!" );
  }
}

on EnvVar eKY_ID_Geber_1S
{
  switch (getValue( eKY_ID_Geber_1S ))
  {
    case  0: putValue( eKY_ID_Geber_1T, "inaktiv" ); break;
    case  1: putValue( eKY_ID_Geber_1T, "aktiv" ); break;
    default: putValue( eKY_ID_Geber_1T, "!?!" );
  }
}

on EnvVar eKY_ID_Geber_2S
{
  switch (getValue( eKY_ID_Geber_2S ))
  {
    case  0: putValue( eKY_ID_Geber_2T, "inaktiv" ); break;
    case  1: putValue( eKY_ID_Geber_2T, "aktiv" ); break;
    default: putValue( eKY_ID_Geber_2T, "!?!" );
  }
}

on EnvVar eKY_ID_Geber_3S
{
  switch (getValue( eKY_ID_Geber_3S ))
  {
    case  0: putValue( eKY_ID_Geber_3T, "inaktiv" ); break;
    case  1: putValue( eKY_ID_Geber_3T, "aktiv" ); break;
    default: putValue( eKY_ID_Geber_3T, "!?!" );
  }
}

on EnvVar eKY_ID_Geber_4S
{
  switch (getValue( eKY_ID_Geber_4S ))
  {
    case  0: putValue( eKY_ID_Geber_4T, "inaktiv" ); break;
    case  1: putValue( eKY_ID_Geber_4T, "aktiv" ); break;
    default: putValue( eKY_ID_Geber_4T, "!?!" );
  }
}

on EnvVar eKY_GoTransponder_IDS
{
  switch (getValue( eKY_GoTransponder_IDS ))
  {
    case  0: putValue( eKY_GoTransponder_IDT, "inaktiv" ); break;
    case  1: putValue( eKY_GoTransponder_IDT, "aktiv" ); break;
    default: putValue( eKY_GoTransponder_IDT, "!?!" );
  }
}

on EnvVar eKY_GoAuthent_RespS
{
  switch (getValue( eKY_GoAuthent_RespS ))
  {
    case  0: putValue( eKY_GoAuthent_RespT, "inaktiv" ); break;
    case  1: putValue( eKY_GoAuthent_RespT, "aktiv" ); break;
    default: putValue( eKY_GoAuthent_RespT, "!?!" );
  }
}

on EnvVar eBM_ZV_aufS
{
  switch (getValue( eBM_ZV_aufS ))
  {
    case  0: putValue( eBM_ZV_aufT, "Blinken bei ZV auf nicht aktiv" ); break;
    case  1: putValue( eBM_ZV_aufT, "Blinken bei ZV auf aktiv" ); break;
    default: putValue( eBM_ZV_aufT, "!?!" );
  }
}

on EnvVar eBM_ZV_zuS
{
  switch (getValue( eBM_ZV_zuS ))
  {
    case  0: putValue( eBM_ZV_zuT, "Blinken bei ZV zu nicht aktiv" ); break;
    case  1: putValue( eBM_ZV_zuT, "Blinken bei ZV zu aktiv" ); break;
    default: putValue( eBM_ZV_zuT, "!?!" );
  }
}

on EnvVar eBM_DWA_einS
{
  switch (getValue( eBM_DWA_einS ))
  {
    case  0: putValue( eBM_DWA_einT, "Quittierungsblinken DWA nicht aktiv" ); break;
    case  1: putValue( eBM_DWA_einT, "Quittierungsblinken DWA aktiv" ); break;
    default: putValue( eBM_DWA_einT, "!?!" );
  }
}

on EnvVar eBM_DWA_AlarmS
{
  switch (getValue( eBM_DWA_AlarmS ))
  {
    case  0: putValue( eBM_DWA_AlarmT, "DWA-Alarmblinken nicht aktiv" ); break;
    case  1: putValue( eBM_DWA_AlarmT, "DWA-Alarmblinken aktiv" ); break;
    default: putValue( eBM_DWA_AlarmT, "!?!" );
  }
}

on EnvVar eBM_CrashS
{
  switch (getValue( eBM_CrashS ))
  {
    case  0: putValue( eBM_CrashT, "Crashblinken nicht aktiv" ); break;
    case  1: putValue( eBM_CrashT, "Crashblinken aktiv" ); break;
    default: putValue( eBM_CrashT, "!?!" );
  }
}

on EnvVar eBM_PanikS
{
  switch (getValue( eBM_PanikS ))
  {
    case  0: putValue( eBM_PanikT, "Panikblinken nicht aktiv" ); break;
    case  1: putValue( eBM_PanikT, "Panikblinken aktiv" ); break;
    default: putValue( eBM_PanikT, "!?!" );
  }
}

on EnvVar eBM_Not_BremsungS
{
  switch (getValue( eBM_Not_BremsungS ))
  {
    case  0: putValue( eBM_Not_BremsungT, "Notbremsblinken nicht aktiv" ); break;
    case  1: putValue( eBM_Not_BremsungT, "Notbremsblinken aktiv" ); break;
    default: putValue( eBM_Not_BremsungT, "!?!" );
  }
}

on EnvVar eBM_GDOS
{
  switch (getValue( eBM_GDOS ))
  {
    case  0: putValue( eBM_GDOT, "Blinken bei UGDO anlernen nicht aktiv" ); break;
    case  1: putValue( eBM_GDOT, "Blinken bei UGDO anlernen aktiv" ); break;
    default: putValue( eBM_GDOT, "!?!" );
  }
}

on EnvVar eBM_WarnblinkenS
{
  switch (getValue( eBM_WarnblinkenS ))
  {
    case  0: putValue( eBM_WarnblinkenT, "Warnblinken nicht aktiv" ); break;
    case  1: putValue( eBM_WarnblinkenT, "Warnblinken aktiv" ); break;
    default: putValue( eBM_WarnblinkenT, "!?!" );
  }
}

on EnvVar eBM_Taxi_NotalarmS
{
  switch (getValue( eBM_Taxi_NotalarmS ))
  {
    case  0: putValue( eBM_Taxi_NotalarmT, "Blinken bei Taxi-Not-Alarm nicht aktiv" ); break;
    case  1: putValue( eBM_Taxi_NotalarmT, "Blinken bei Taxi-Not-Alarm aktiv" ); break;
    default: putValue( eBM_Taxi_NotalarmT, "!?!" );
  }
}

on EnvVar eBM_TelematikS
{
  switch (getValue( eBM_TelematikS ))
  {
    case  0: putValue( eBM_TelematikT, "Telematikblinken nicht aktiv" ); break;
    case  1: putValue( eBM_TelematikT, "Telematikblinken aktiv" ); break;
    default: putValue( eBM_TelematikT, "!?!" );
  }
}

on EnvVar eBM_linksS
{
  switch (getValue( eBM_linksS ))
  {
    case  0: putValue( eBM_linksT, "Richtungsblinken links nicht aktiv" ); break;
    case  1: putValue( eBM_linksT, "Richtungsblinken links aktiv" ); break;
    default: putValue( eBM_linksT, "!?!" );
  }
}

on EnvVar eBM_rechtsS
{
  switch (getValue( eBM_rechtsS ))
  {
    case  0: putValue( eBM_rechtsT, "Richtungsblinken rechts nicht aktiv" ); break;
    case  1: putValue( eBM_rechtsT, "Richtungsblinken rechts aktiv" ); break;
    default: putValue( eBM_rechtsT, "!?!" );
  }
}

on EnvVar eBlinken_li_Fzg_TaktS
{
  switch (getValue( eBlinken_li_Fzg_TaktS ))
  {
    case  0: putValue( eBlinken_li_Fzg_TaktT, "Blinker links ausgeschaltet" ); break;
    case  1: putValue( eBlinken_li_Fzg_TaktT, "Blinker links eingeschaltet" ); break;
    default: putValue( eBlinken_li_Fzg_TaktT, "!?!" );
  }
}

on EnvVar eBlinken_re_Fzg_TaktS
{
  switch (getValue( eBlinken_re_Fzg_TaktS ))
  {
    case  0: putValue( eBlinken_re_Fzg_TaktT, "Blinker rechts ausgeschaltet" ); break;
    case  1: putValue( eBlinken_re_Fzg_TaktT, "Blinker rechts eingeschaltet" ); break;
    default: putValue( eBlinken_re_Fzg_TaktT, "!?!" );
  }
}

on EnvVar eBlinken_li_Kombi_TaktS
{
  switch (getValue( eBlinken_li_Kombi_TaktS ))
  {
    case  0: putValue( eBlinken_li_Kombi_TaktT, "Blinkerkontrolllampe links ausgeschaltet" ); break;
    case  1: putValue( eBlinken_li_Kombi_TaktT, "Blinkerkontrolllampe links eingeschaltet" ); break;
    default: putValue( eBlinken_li_Kombi_TaktT, "!?!" );
  }
}

on EnvVar eBlinken_re_Kombi_TaktS
{
  switch (getValue( eBlinken_re_Kombi_TaktS ))
  {
    case  0: putValue( eBlinken_re_Kombi_TaktT, "Blinkerkontrolllampe rechts ausgeschaltet" ); break;
    case  1: putValue( eBlinken_re_Kombi_TaktT, "Blinkerkontrolllampe rechts eingeschaltet" ); break;
    default: putValue( eBlinken_re_Kombi_TaktT, "!?!" );
  }
}

on EnvVar eBM_NBA_n_codiert_n_aktivS
{
  switch (getValue( eBM_NBA_n_codiert_n_aktivS ))
  {
    case  0: putValue( eBM_NBA_n_codiert_n_aktivT, "codiert AND kein Fehler" ); break;
    case  1: putValue( eBM_NBA_n_codiert_n_aktivT, "nicht codiert OR Fehler erkannt" ); break;
    default: putValue( eBM_NBA_n_codiert_n_aktivT, "!?!" );
  }
}

on EnvVar eBM_NBA_StatusS
{
  switch (getValue( eBM_NBA_StatusS ))
  {
    case  0: putValue( eBM_NBA_StatusT, "NBA nicht aktiv" ); break;
    case  1: putValue( eBM_NBA_StatusT, "BRL Dunkelphase" ); break;
    case  3: putValue( eBM_NBA_StatusT, "BRL Hellphase" ); break;
    default: putValue( eBM_NBA_StatusT, "!?!" );
  }
}

on EnvVar eDI_KL_58xd254
{
  if (getValue( this ))
  {
    _DI_KL_58xd = getValue( eDI_KL_58xdS );
    putValue( eDI_KL_58xdS, 254 );
  }
  else if (getValue( eDI_KL_58xdS ) == 254)
  {
    if (_DI_KL_58xd != 254)
      putValue( eDI_KL_58xdS, _DI_KL_58xd );
    else
      putValue( eDI_KL_58xdS, 0 );
  }

}

on EnvVar eDI_KL_58xd255
{
  if (getValue( this ))
  {
    _DI_KL_58xd = getValue( eDI_KL_58xdS );
    putValue( eDI_KL_58xdS, 255 );
  }
  else if (getValue( eDI_KL_58xdS ) == 255)
  {
    if (_DI_KL_58xd != 255)
      putValue( eDI_KL_58xdS, _DI_KL_58xd );
    else
      putValue( eDI_KL_58xdS, 254 );
  }

}

on EnvVar eDI_KL_58xdS
{
  putValue( eDI_KL_58xd254, getValue( eDI_KL_58xdS ) == 254 );
  putValue( eDI_KL_58xd255, getValue( eDI_KL_58xdS ) == 255 );
}

on EnvVar eDI_KL_58xs126
{
  if (getValue( this ))
  {
    _DI_KL_58xs = getValue( eDI_KL_58xsS );
    putValue( eDI_KL_58xsS, 126 );
  }
  else if (getValue( eDI_KL_58xsS ) == 126)
  {
    if (_DI_KL_58xs != 126)
      putValue( eDI_KL_58xsS, _DI_KL_58xs );
    else
      putValue( eDI_KL_58xsS, 0 );
  }

}

on EnvVar eDI_KL_58xs127
{
  if (getValue( this ))
  {
    _DI_KL_58xs = getValue( eDI_KL_58xsS );
    putValue( eDI_KL_58xsS, 127 );
  }
  else if (getValue( eDI_KL_58xsS ) == 127)
  {
    if (_DI_KL_58xs != 127)
      putValue( eDI_KL_58xsS, _DI_KL_58xs );
    else
      putValue( eDI_KL_58xsS, 126 );
  }

}

on EnvVar eDI_KL_58xsS
{
  putValue( eDI_KL_58xs126, getValue( eDI_KL_58xsS ) == 126 );
  putValue( eDI_KL_58xs127, getValue( eDI_KL_58xsS ) == 127 );
}

on EnvVar eDI_KL_58xt126
{
  if (getValue( this ))
  {
    _DI_KL_58xt = getValue( eDI_KL_58xtS );
    putValue( eDI_KL_58xtS, 126 );
  }
  else if (getValue( eDI_KL_58xtS ) == 126)
  {
    if (_DI_KL_58xt != 126)
      putValue( eDI_KL_58xtS, _DI_KL_58xt );
    else
      putValue( eDI_KL_58xtS, 0 );
  }

}

on EnvVar eDI_KL_58xt127
{
  if (getValue( this ))
  {
    _DI_KL_58xt = getValue( eDI_KL_58xtS );
    putValue( eDI_KL_58xtS, 127 );
  }
  else if (getValue( eDI_KL_58xtS ) == 127)
  {
    if (_DI_KL_58xt != 127)
      putValue( eDI_KL_58xtS, _DI_KL_58xt );
    else
      putValue( eDI_KL_58xtS, 126 );
  }

}

on EnvVar eDI_KL_58xtS
{
  putValue( eDI_KL_58xt126, getValue( eDI_KL_58xtS ) == 126 );
  putValue( eDI_KL_58xt127, getValue( eDI_KL_58xtS ) == 127 );
}

on EnvVar eELV_VerriegeltS
{
  switch (getValue( eELV_VerriegeltS ))
  {
    case  0: putValue( eELV_VerriegeltT, "nicht verriegelt" ); break;
    case  1: putValue( eELV_VerriegeltT, "verriegelt" ); break;
    default: putValue( eELV_VerriegeltT, "!?!" );
  }
}

on EnvVar eELV_EntriegeltS
{
  switch (getValue( eELV_EntriegeltS ))
  {
    case  0: putValue( eELV_EntriegeltT, "ELV nicht entriegelt" ); break;
    case  1: putValue( eELV_EntriegeltT, "ELV entriegelt" ); break;
    default: putValue( eELV_EntriegeltT, "!?!" );
  }
}

on EnvVar eELV_LebenszustandS
{
  switch (getValue( eELV_LebenszustandS ))
  {
    case  0: putValue( eELV_LebenszustandT, "Lebenszustand 0" ); break;
    case  1: putValue( eELV_LebenszustandT, "Lebenszustand 4" ); break;
    default: putValue( eELV_LebenszustandT, "!?!" );
  }
}

on EnvVar eELV_AnlernmodusS
{
  switch (getValue( eELV_AnlernmodusS ))
  {
    case  0: putValue( eELV_AnlernmodusT, "Normalbetrieb" ); break;
    case  1: putValue( eELV_AnlernmodusT, "Anlernmodus" ); break;
    default: putValue( eELV_AnlernmodusT, "!?!" );
  }
}

on EnvVar eELV_Blink_LEDS
{
  switch (getValue( eELV_Blink_LEDS ))
  {
    case  0: putValue( eELV_Blink_LEDT, "nicht blinken" ); break;
    case  1: putValue( eELV_Blink_LEDT, "blinken" ); break;
    default: putValue( eELV_Blink_LEDT, "!?!" );
  }
}

on EnvVar eELV_LED_RotS
{
  switch (getValue( eELV_LED_RotS ))
  {
    case  0: putValue( eELV_LED_RotT, "Aus" ); break;
    case  1: putValue( eELV_LED_RotT, "Ein" ); break;
    default: putValue( eELV_LED_RotT, "!?!" );
  }
}

on EnvVar eELV_LED_BremseS
{
  switch (getValue( eELV_LED_BremseS ))
  {
    case  0: putValue( eELV_LED_BremseT, "Aus" ); break;
    case  1: putValue( eELV_LED_BremseT, "Ein" ); break;
    default: putValue( eELV_LED_BremseT, "!?!" );
  }
}

on EnvVar eELV_Txt_Lkg_BewegenS
{
  switch (getValue( eELV_Txt_Lkg_BewegenS ))
  {
    case  1: putValue( eELV_Txt_Lkg_BewegenT, "ID TXT 2016.5" ); break;
    default: putValue( eELV_Txt_Lkg_BewegenT, "!?!" );
  }
}

on EnvVar eELV_Txt_WerkstattS
{
  switch (getValue( eELV_Txt_WerkstattS ))
  {
    case  1: putValue( eELV_Txt_WerkstattT, "ID TXT 2018.0" ); break;
    default: putValue( eELV_Txt_WerkstattT, "!?!" );
  }
}

on EnvVar eELV_Txt_DefektS
{
  switch (getValue( eELV_Txt_DefektS ))
  {
    case  1: putValue( eELV_Txt_DefektT, "ID TXT 2017.0" ); break;
    default: putValue( eELV_Txt_DefektT, "!?!" );
  }
}

on EnvVar eELV_P_VerriegeltS
{
  switch (getValue( eELV_P_VerriegeltS ))
  {
    case  0: putValue( eELV_P_VerriegeltT, "nicht verriegelt" ); break;
    case  1: putValue( eELV_P_VerriegeltT, "verriegelt" ); break;
    default: putValue( eELV_P_VerriegeltT, "!?!" );
  }
}

on EnvVar eKY_ID_Geber1_im_FzgS
{
  switch (getValue( eKY_ID_Geber1_im_FzgS ))
  {
    case  0: putValue( eKY_ID_Geber1_im_FzgT, "inaktiv" ); break;
    case  1: putValue( eKY_ID_Geber1_im_FzgT, "aktiv" ); break;
    default: putValue( eKY_ID_Geber1_im_FzgT, "!?!" );
  }
}

on EnvVar eKY_ID_Geber2_im_FzgS
{
  switch (getValue( eKY_ID_Geber2_im_FzgS ))
  {
    case  0: putValue( eKY_ID_Geber2_im_FzgT, "inaktiv" ); break;
    case  1: putValue( eKY_ID_Geber2_im_FzgT, "aktiv" ); break;
    default: putValue( eKY_ID_Geber2_im_FzgT, "!?!" );
  }
}

on EnvVar eKY_ID_Geber3_im_FzgS
{
  switch (getValue( eKY_ID_Geber3_im_FzgS ))
  {
    case  0: putValue( eKY_ID_Geber3_im_FzgT, "inaktiv" ); break;
    case  1: putValue( eKY_ID_Geber3_im_FzgT, "aktiv" ); break;
    default: putValue( eKY_ID_Geber3_im_FzgT, "!?!" );
  }
}

on EnvVar eKY_ID_Geber4_im_FzgS
{
  switch (getValue( eKY_ID_Geber4_im_FzgS ))
  {
    case  0: putValue( eKY_ID_Geber4_im_FzgT, "inaktiv" ); break;
    case  1: putValue( eKY_ID_Geber4_im_FzgT, "aktiv" ); break;
    default: putValue( eKY_ID_Geber4_im_FzgT, "!?!" );
  }
}

on EnvVar eKY_Startknopf_BelS
{
  switch (getValue( eKY_Startknopf_BelS ))
  {
    case  0: putValue( eKY_Startknopf_BelT, "inaktiv" ); break;
    case  1: putValue( eKY_Startknopf_BelT, "aktiv" ); break;
    default: putValue( eKY_Startknopf_BelT, "!?!" );
  }
}

on EnvVar eKY_ID_Geber_SucheS
{
  switch (getValue( eKY_ID_Geber_SucheS ))
  {
    case  0: putValue( eKY_ID_Geber_SucheT, "inaktiv" ); break;
    case  1: putValue( eKY_ID_Geber_SucheT, "aktiv" ); break;
    default: putValue( eKY_ID_Geber_SucheT, "!?!" );
  }
}

on EnvVar eKY_MeldungenS
{
  switch (getValue( eKY_MeldungenS ))
  {
    case  0: putValue( eKY_MeldungenT, "keine Meldung" ); break;
    case  1: putValue( eKY_MeldungenT, "Schluessel nicht gefunden" ); break;
    case  2: putValue( eKY_MeldungenT, "Schluessel im Kofferraum" ); break;
    case  3: putValue( eKY_MeldungenT, "Schluessel im Fahrzeug" ); break;
    case  4: putValue( eKY_MeldungenT, "Kessy defekt" ); break;
    default: putValue( eKY_MeldungenT, "!?!" );
  }
}

on EnvVar eKY_Gong_600S
{
  switch (getValue( eKY_Gong_600S ))
  {
    case  0: putValue( eKY_Gong_600T, "inaktiv" ); break;
    case  1: putValue( eKY_Gong_600T, "aktiv" ); break;
    default: putValue( eKY_Gong_600T, "!?!" );
  }
}

on EnvVar eKY_Passiv_Autolock_MenueS
{
  switch (getValue( eKY_Passiv_Autolock_MenueS ))
  {
    case  0: putValue( eKY_Passiv_Autolock_MenueT, "inaktiv" ); break;
    case  1: putValue( eKY_Passiv_Autolock_MenueT, "aktiv" ); break;
    default: putValue( eKY_Passiv_Autolock_MenueT, "!?!" );
  }
}

on EnvVar eKY_Passiv_Autolock_AktS
{
  switch (getValue( eKY_Passiv_Autolock_AktS ))
  {
    case  0: putValue( eKY_Passiv_Autolock_AktT, "inaktiv" ); break;
    case  1: putValue( eKY_Passiv_Autolock_AktT, "aktiv" ); break;
    default: putValue( eKY_Passiv_Autolock_AktT, "!?!" );
  }
}

on EnvVar eKY_Passiv_AutolockS
{
  switch (getValue( eKY_Passiv_AutolockS ))
  {
    case  0: putValue( eKY_Passiv_AutolockT, "inaktiv" ); break;
    case  1: putValue( eKY_Passiv_AutolockT, "aktiv" ); break;
    default: putValue( eKY_Passiv_AutolockT, "!?!" );
  }
}

on EnvVar eKY_Passiv_AutounlockS
{
  switch (getValue( eKY_Passiv_AutounlockS ))
  {
    case  0: putValue( eKY_Passiv_AutounlockT, "inaktiv" ); break;
    case  1: putValue( eKY_Passiv_AutounlockT, "aktiv" ); break;
    default: putValue( eKY_Passiv_AutounlockT, "!?!" );
  }
}

on EnvVar eKY_Gestik_HDS
{
  switch (getValue( eKY_Gestik_HDS ))
  {
    case  0: putValue( eKY_Gestik_HDT, "inaktiv" ); break;
    case  1: putValue( eKY_Gestik_HDT, "aktiv" ); break;
    default: putValue( eKY_Gestik_HDT, "!?!" );
  }
}

on EnvVar eKY_StartStopp_InfoS
{
  switch (getValue( eKY_StartStopp_InfoS ))
  {
    case  0: putValue( eKY_StartStopp_InfoT, "Motorlauf nicht notwendig (Stoppfreigabe)" ); break;
    case  1: putValue( eKY_StartStopp_InfoT, "Motoranlauf nicht zwingend notwendig (Stoppverbot,keine Startanforderung)" ); break;
    case  2: putValue( eKY_StartStopp_InfoT, "Motoranlauf zwingend notwendig (Startanforderung)" ); break;
    case  3: putValue( eKY_StartStopp_InfoT, "Systemfehler" ); break;
    default: putValue( eKY_StartStopp_InfoT, "!?!" );
  }
}

on EnvVar eZAS_Kl_SS
{
  switch (getValue( eZAS_Kl_SS ))
  {
    case  0: putValue( eZAS_Kl_ST, "aus" ); break;
    case  1: putValue( eZAS_Kl_ST, "S Kontakt ein" ); break;
    default: putValue( eZAS_Kl_ST, "!?!" );
  }
}

on EnvVar eZAS_Kl_15S
{
  switch (getValue( eZAS_Kl_15S ))
  {
    case  0: putValue( eZAS_Kl_15T, "aus" ); break;
    case  1: putValue( eZAS_Kl_15T, "ein" ); break;
    default: putValue( eZAS_Kl_15T, "!?!" );
  }
}

on EnvVar eZAS_Kl_XS
{
  switch (getValue( eZAS_Kl_XS ))
  {
    case  0: putValue( eZAS_Kl_XT, "aus" ); break;
    case  1: putValue( eZAS_Kl_XT, "ein" ); break;
    default: putValue( eZAS_Kl_XT, "!?!" );
  }
}

on EnvVar eBCM1_FStatus_Aussentemp_ungefS
{
  switch (getValue( eBCM1_FStatus_Aussentemp_ungefS ))
  {
    case  0: putValue( eBCM1_FStatus_Aussentemp_ungefT, "iO" ); break;
    case  1: putValue( eBCM1_FStatus_Aussentemp_ungefT, "niO" ); break;
    default: putValue( eBCM1_FStatus_Aussentemp_ungefT, "!?!" );
  }
}

on EnvVar eBCM1_OBD_FStatus_ATempS
{
  switch (getValue( eBCM1_OBD_FStatus_ATempS ))
  {
    case  0: putValue( eBCM1_OBD_FStatus_ATempT, "kein Fehler" ); break;
    case  1: putValue( eBCM1_OBD_FStatus_ATempT, "KS-" ); break;
    case  2: putValue( eBCM1_OBD_FStatus_ATempT, "KS+" ); break;
    case  3: putValue( eBCM1_OBD_FStatus_ATempT, "OC (Leitungsunterbrechung)" ); break;
    case  4: putValue( eBCM1_OBD_FStatus_ATempT, "OOR+ (out of range high)" ); break;
    case  5: putValue( eBCM1_OBD_FStatus_ATempT, "OOR- (out of range low)" ); break;
    case  6: putValue( eBCM1_OBD_FStatus_ATempT, "RC+ (Signal unplausibel hoch)" ); break;
    case  7: putValue( eBCM1_OBD_FStatus_ATempT, "RC- (Signal unplausibel niedrig)" ); break;
    case  8: putValue( eBCM1_OBD_FStatus_ATempT, "KS+/OC" ); break;
    case  9: putValue( eBCM1_OBD_FStatus_ATempT, "KS-/OC" ); break;
    case 10: putValue( eBCM1_OBD_FStatus_ATempT, "KS-/KS+" ); break;
    case 11: putValue( eBCM1_OBD_FStatus_ATempT, "KS-/KS+/OC (allgemeiner Fehler)" ); break;
    default: putValue( eBCM1_OBD_FStatus_ATempT, "!?!" );
  }
}

on EnvVar eBCM1_Aussen_Temp_ungef253
{
  if (getValue( this ))
  {
    _BCM1_Aussen_Temp_ungef = getValue( eBCM1_Aussen_Temp_ungefS );
    putValue( eBCM1_Aussen_Temp_ungefS, 76.5 );
  }
  else if (getValue( eBCM1_Aussen_Temp_ungefS ) == 76.5)
  {
    if (_BCM1_Aussen_Temp_ungef != 76.5)
      putValue( eBCM1_Aussen_Temp_ungefS, _BCM1_Aussen_Temp_ungef );
    else
      putValue( eBCM1_Aussen_Temp_ungefS, 77 );
  }

}

on EnvVar eBCM1_Aussen_Temp_ungef254
{
  if (getValue( this ))
  {
    _BCM1_Aussen_Temp_ungef = getValue( eBCM1_Aussen_Temp_ungefS );
    putValue( eBCM1_Aussen_Temp_ungefS, 77 );
  }
  else if (getValue( eBCM1_Aussen_Temp_ungefS ) == 77)
  {
    if (_BCM1_Aussen_Temp_ungef != 77)
      putValue( eBCM1_Aussen_Temp_ungefS, _BCM1_Aussen_Temp_ungef );
    else
      putValue( eBCM1_Aussen_Temp_ungefS, 0 );
  }

}

on EnvVar eBCM1_Aussen_Temp_ungef255
{
  if (getValue( this ))
  {
    _BCM1_Aussen_Temp_ungef = getValue( eBCM1_Aussen_Temp_ungefS );
    putValue( eBCM1_Aussen_Temp_ungefS, 77.5 );
  }
  else if (getValue( eBCM1_Aussen_Temp_ungefS ) == 77.5)
  {
    if (_BCM1_Aussen_Temp_ungef != 77.5)
      putValue( eBCM1_Aussen_Temp_ungefS, _BCM1_Aussen_Temp_ungef );
    else
      putValue( eBCM1_Aussen_Temp_ungefS, 77 );
  }

}

on EnvVar eBCM1_Aussen_Temp_ungefS
{
  putValue( eBCM1_Aussen_Temp_ungef253, getValue( eBCM1_Aussen_Temp_ungefS ) == 76.5 );
  putValue( eBCM1_Aussen_Temp_ungef254, getValue( eBCM1_Aussen_Temp_ungefS ) == 77 );
  putValue( eBCM1_Aussen_Temp_ungef255, getValue( eBCM1_Aussen_Temp_ungefS ) == 77.5 );
}

on EnvVar eBCM1_Kurvenlicht_links_AnfS
{
  switch (getValue( eBCM1_Kurvenlicht_links_AnfS ))
  {
    case  0: putValue( eBCM1_Kurvenlicht_links_AnfT, "linkes Kurvenlicht/Abbiegelicht durch BCM1 nicht angesteuert" ); break;
    case  1: putValue( eBCM1_Kurvenlicht_links_AnfT, "linkes Kurven/Abbiegelicht durch BCM1 angesteuert" ); break;
    default: putValue( eBCM1_Kurvenlicht_links_AnfT, "!?!" );
  }
}

on EnvVar eBCM1_Kurvenlicht_rechts_AnfS
{
  switch (getValue( eBCM1_Kurvenlicht_rechts_AnfS ))
  {
    case  0: putValue( eBCM1_Kurvenlicht_rechts_AnfT, "rechtes Kurvenlicht/Abbiegelicht durch BCM1 nicht angesteuert" ); break;
    case  1: putValue( eBCM1_Kurvenlicht_rechts_AnfT, "rechtes Kurvenlicht/Abbiegelicht durch BCM1 angesteuert" ); break;
    default: putValue( eBCM1_Kurvenlicht_rechts_AnfT, "!?!" );
  }
}

on EnvVar eBCM1_Standlicht_AnfS
{
  switch (getValue( eBCM1_Standlicht_AnfS ))
  {
    case  0: putValue( eBCM1_Standlicht_AnfT, "Licht nicht angefordert" ); break;
    case  1: putValue( eBCM1_Standlicht_AnfT, "Licht ist einzuschalten" ); break;
    default: putValue( eBCM1_Standlicht_AnfT, "!?!" );
  }
}

on EnvVar eBCM1_Abblendlicht_AnfS
{
  switch (getValue( eBCM1_Abblendlicht_AnfS ))
  {
    case  0: putValue( eBCM1_Abblendlicht_AnfT, "Licht nicht angefordert" ); break;
    case  1: putValue( eBCM1_Abblendlicht_AnfT, "Licht ist einzuschalten" ); break;
    default: putValue( eBCM1_Abblendlicht_AnfT, "!?!" );
  }
}

on EnvVar eBCM1_Fernlicht_AnfS
{
  switch (getValue( eBCM1_Fernlicht_AnfS ))
  {
    case  0: putValue( eBCM1_Fernlicht_AnfT, "Licht nicht angefordert" ); break;
    case  1: putValue( eBCM1_Fernlicht_AnfT, "Licht ist einzuschalten" ); break;
    default: putValue( eBCM1_Fernlicht_AnfT, "!?!" );
  }
}

on EnvVar eBCM1_Nebellicht_AnfS
{
  switch (getValue( eBCM1_Nebellicht_AnfS ))
  {
    case  0: putValue( eBCM1_Nebellicht_AnfT, "Licht nicht angefordert" ); break;
    case  1: putValue( eBCM1_Nebellicht_AnfT, "Licht ist einzuschalten" ); break;
    default: putValue( eBCM1_Nebellicht_AnfT, "!?!" );
  }
}

on EnvVar eBCM1_Parklicht_li_AnfS
{
  switch (getValue( eBCM1_Parklicht_li_AnfS ))
  {
    case  0: putValue( eBCM1_Parklicht_li_AnfT, "Licht nicht angefordert" ); break;
    case  1: putValue( eBCM1_Parklicht_li_AnfT, "Licht ist einzuschalten" ); break;
    default: putValue( eBCM1_Parklicht_li_AnfT, "!?!" );
  }
}

on EnvVar eBCM1_Parklicht_re_AnfS
{
  switch (getValue( eBCM1_Parklicht_re_AnfS ))
  {
    case  0: putValue( eBCM1_Parklicht_re_AnfT, "Licht nicht angefordert" ); break;
    case  1: putValue( eBCM1_Parklicht_re_AnfT, "Licht ist einzuschalten" ); break;
    default: putValue( eBCM1_Parklicht_re_AnfT, "!?!" );
  }
}

on EnvVar eBCM1_Nebelschluss_Ahg_AnfS
{
  switch (getValue( eBCM1_Nebelschluss_Ahg_AnfS ))
  {
    case  0: putValue( eBCM1_Nebelschluss_Ahg_AnfT, "Licht nicht angefordert" ); break;
    case  1: putValue( eBCM1_Nebelschluss_Ahg_AnfT, "Licht ist einzuschalten" ); break;
    default: putValue( eBCM1_Nebelschluss_Ahg_AnfT, "!?!" );
  }
}

on EnvVar eBCM1_Nebelschluss_Fzg_AnfS
{
  switch (getValue( eBCM1_Nebelschluss_Fzg_AnfS ))
  {
    case  0: putValue( eBCM1_Nebelschluss_Fzg_AnfT, "Licht nicht angefordert" ); break;
    case  1: putValue( eBCM1_Nebelschluss_Fzg_AnfT, "Licht ist einzuschalten" ); break;
    default: putValue( eBCM1_Nebelschluss_Fzg_AnfT, "!?!" );
  }
}

on EnvVar eBCM1_Schlusslicht_AnfS
{
  switch (getValue( eBCM1_Schlusslicht_AnfS ))
  {
    case  0: putValue( eBCM1_Schlusslicht_AnfT, "Licht nicht angefordert" ); break;
    case  1: putValue( eBCM1_Schlusslicht_AnfT, "Licht ist einzuschalten" ); break;
    default: putValue( eBCM1_Schlusslicht_AnfT, "!?!" );
  }
}

on EnvVar eBCM1_RFahrlicht_Fzg_AnfS
{
  switch (getValue( eBCM1_RFahrlicht_Fzg_AnfS ))
  {
    case  0: putValue( eBCM1_RFahrlicht_Fzg_AnfT, "Licht nicht angefordert" ); break;
    case  1: putValue( eBCM1_RFahrlicht_Fzg_AnfT, "Licht ist einzuschalten" ); break;
    default: putValue( eBCM1_RFahrlicht_Fzg_AnfT, "!?!" );
  }
}


on EnvVar eBCM1_Umfeldleuchten_AnfS
{
  switch (getValue( eBCM1_Umfeldleuchten_AnfS ))
  {
    case  0: putValue( eBCM1_Umfeldleuchten_AnfT, "Licht nicht angefordert" ); break;
    case  1: putValue( eBCM1_Umfeldleuchten_AnfT, "Licht ist einzuschalten" ); break;
    default: putValue( eBCM1_Umfeldleuchten_AnfT, "!?!" );
  }
}

on EnvVar eBCM1_Tagfahrlicht_AnfS
{
  switch (getValue( eBCM1_Tagfahrlicht_AnfS ))
  {
    case  0: putValue( eBCM1_Tagfahrlicht_AnfT, "Licht nicht angefordert" ); break;
    case  1: putValue( eBCM1_Tagfahrlicht_AnfT, "Licht ist einzuschalten" ); break;
    default: putValue( eBCM1_Tagfahrlicht_AnfT, "!?!" );
  }
}

on EnvVar eBCM1_Regenlicht_AnfS
{
  switch (getValue( eBCM1_Regenlicht_AnfS ))
  {
    case  0: putValue( eBCM1_Regenlicht_AnfT, "Licht nicht angefordert" ); break;
    case  1: putValue( eBCM1_Regenlicht_AnfT, "Licht ist einzuschalten" ); break;
    default: putValue( eBCM1_Regenlicht_AnfT, "!?!" );
  }
}

on EnvVar eBCM1_Autobahnlicht_AnfS
{
  switch (getValue( eBCM1_Autobahnlicht_AnfS ))
  {
    case  0: putValue( eBCM1_Autobahnlicht_AnfT, "Licht nicht angefordert" ); break;
    case  1: putValue( eBCM1_Autobahnlicht_AnfT, "Licht ist einzuschalten" ); break;
    default: putValue( eBCM1_Autobahnlicht_AnfT, "!?!" );
  }
}

on EnvVar eBCM1_Touristen_Licht_AnfS
{
  switch (getValue( eBCM1_Touristen_Licht_AnfS ))
  {
    case  0: putValue( eBCM1_Touristen_Licht_AnfT, "Licht nicht angefordert" ); break;
    case  1: putValue( eBCM1_Touristen_Licht_AnfT, "Anforderung von Touristenlicht" ); break;
    default: putValue( eBCM1_Touristen_Licht_AnfT, "!?!" );
  }
}


on EnvVar eBCM1_Gleitende_Leuchtw_AnfS
{
  switch (getValue( eBCM1_Gleitende_Leuchtw_AnfS ))
  {
    case  0: putValue( eBCM1_Gleitende_Leuchtw_AnfT, "Aus" ); break;
    case  1: putValue( eBCM1_Gleitende_Leuchtw_AnfT, "Ein" ); break;
    default: putValue( eBCM1_Gleitende_Leuchtw_AnfT, "!?!" );
  }
}

on EnvVar eBCM1_GLW_Fernlicht_AnfS
{
  switch (getValue( eBCM1_GLW_Fernlicht_AnfS ))
  {
    case  0: putValue( eBCM1_GLW_Fernlicht_AnfT, "Aus" ); break;
    case  1: putValue( eBCM1_GLW_Fernlicht_AnfT, "Ein" ); break;
    default: putValue( eBCM1_GLW_Fernlicht_AnfT, "!?!" );
  }
}

on EnvVar eBCM1_Adaptive_Lichtvert_AnfS
{
  switch (getValue( eBCM1_Adaptive_Lichtvert_AnfS ))
  {
    case  0: putValue( eBCM1_Adaptive_Lichtvert_AnfT, "Aus" ); break;
    case  1: putValue( eBCM1_Adaptive_Lichtvert_AnfT, "Ein" ); break;
    default: putValue( eBCM1_Adaptive_Lichtvert_AnfT, "!?!" );
  }
}

on EnvVar eBCM2_Bremsl_durch_ECDS
{
  switch (getValue( eBCM2_Bremsl_durch_ECDS ))
  {
    case  0: putValue( eBCM2_Bremsl_durch_ECDT, "Bremslicht ist aus" ); break;
    case  1: putValue( eBCM2_Bremsl_durch_ECDT, "Bremslicht durch ECD aktiv" ); break;
    default: putValue( eBCM2_Bremsl_durch_ECDT, "!?!" );
  }
}

on EnvVar eLH_Aussenlicht_defS
{
  switch (getValue( eLH_Aussenlicht_defS ))
  {
    case  0: putValue( eLH_Aussenlicht_defT, "OK" ); break;
    case  1: putValue( eLH_Aussenlicht_defT, "defekt" ); break;
    default: putValue( eLH_Aussenlicht_defT, "!?!" );
  }
}

on EnvVar eLH_Standlicht_H_aktivS
{
  switch (getValue( eLH_Standlicht_H_aktivS ))
  {
    case  1: putValue( eLH_Standlicht_H_aktivT, "Standlicht hinten aktiv" ); break;
    default: putValue( eLH_Standlicht_H_aktivT, "!?!" );
  }
}

on EnvVar eLH_Parklicht_HL_aktivS
{
  switch (getValue( eLH_Parklicht_HL_aktivS ))
  {
    case  0: putValue( eLH_Parklicht_HL_aktivT, "nicht aktiv" ); break;
    case  1: putValue( eLH_Parklicht_HL_aktivT, "Parklicht hinten links aktiv" ); break;
    default: putValue( eLH_Parklicht_HL_aktivT, "!?!" );
  }
}

on EnvVar eLH_Parklicht_HR_aktivS
{
  switch (getValue( eLH_Parklicht_HR_aktivS ))
  {
    case  0: putValue( eLH_Parklicht_HR_aktivT, "nicht aktiv" ); break;
    case  1: putValue( eLH_Parklicht_HR_aktivT, "Parklicht hinten rechts aktiv" ); break;
    default: putValue( eLH_Parklicht_HR_aktivT, "!?!" );
  }
}

on EnvVar eLH_Bremslicht_H_aktivS
{
  switch (getValue( eLH_Bremslicht_H_aktivS ))
  {
    case  1: putValue( eLH_Bremslicht_H_aktivT, "Bremslicht hinten aktiv" ); break;
    default: putValue( eLH_Bremslicht_H_aktivT, "!?!" );
  }
}

on EnvVar eLH_Nebelschluss_aktivS
{
  switch (getValue( eLH_Nebelschluss_aktivS ))
  {
    case  0: putValue( eLH_Nebelschluss_aktivT, "nicht aktiv" ); break;
    case  1: putValue( eLH_Nebelschluss_aktivT, "aktiv" ); break;
    default: putValue( eLH_Nebelschluss_aktivT, "!?!" );
  }
}

on EnvVar eLH_Rueckfahrlicht_aktivS
{
  switch (getValue( eLH_Rueckfahrlicht_aktivS ))
  {
    case  0: putValue( eLH_Rueckfahrlicht_aktivT, "nicht aktiv" ); break;
    case  1: putValue( eLH_Rueckfahrlicht_aktivT, "aktiv" ); break;
    default: putValue( eLH_Rueckfahrlicht_aktivT, "!?!" );
  }
}

on EnvVar eLH_Blinker_HL_aktS
{
  switch (getValue( eLH_Blinker_HL_aktS ))
  {
    case  1: putValue( eLH_Blinker_HL_aktT, "Blinker hinten links aktiv" ); break;
    default: putValue( eLH_Blinker_HL_aktT, "!?!" );
  }
}

on EnvVar eLH_Blinker_HR_aktS
{
  switch (getValue( eLH_Blinker_HR_aktS ))
  {
    case  1: putValue( eLH_Blinker_HR_aktT, "Blinker hinten rechts aktiv" ); break;
    default: putValue( eLH_Blinker_HR_aktT, "!?!" );
  }
}

on EnvVar eLH_Blinker_li_defS
{
  switch (getValue( eLH_Blinker_li_defS ))
  {
    case  0: putValue( eLH_Blinker_li_defT, "OK" ); break;
    case  1: putValue( eLH_Blinker_li_defT, "Blinker hinten links defekt" ); break;
    default: putValue( eLH_Blinker_li_defT, "!?!" );
  }
}

on EnvVar eLH_Bremsl_li_defS
{
  switch (getValue( eLH_Bremsl_li_defS ))
  {
    case  0: putValue( eLH_Bremsl_li_defT, "OK" ); break;
    case  1: putValue( eLH_Bremsl_li_defT, "mindestens ein Bremslicht hinten links defekt" ); break;
    default: putValue( eLH_Bremsl_li_defT, "!?!" );
  }
}

on EnvVar eLH_Schlusslicht_li_defS
{
  switch (getValue( eLH_Schlusslicht_li_defS ))
  {
    case  0: putValue( eLH_Schlusslicht_li_defT, "OK" ); break;
    case  1: putValue( eLH_Schlusslicht_li_defT, "mindestens ein Schlusslicht hinten links defekt" ); break;
    default: putValue( eLH_Schlusslicht_li_defT, "!?!" );
  }
}

on EnvVar eLH_Rueckf_li_defS
{
  switch (getValue( eLH_Rueckf_li_defS ))
  {
    case  0: putValue( eLH_Rueckf_li_defT, "OK" ); break;
    case  1: putValue( eLH_Rueckf_li_defT, "Rückfahrlicht hinten links defekt" ); break;
    default: putValue( eLH_Rueckf_li_defT, "!?!" );
  }
}

on EnvVar eLH_Nebel_li_defS
{
  switch (getValue( eLH_Nebel_li_defS ))
  {
    case  0: putValue( eLH_Nebel_li_defT, "OK" ); break;
    case  1: putValue( eLH_Nebel_li_defT, "Nebelschlusslicht hinten links defekt" ); break;
    default: putValue( eLH_Nebel_li_defT, "!?!" );
  }
}

on EnvVar eLH_Schluss_Brems_Nebel_li_defS
{
  switch (getValue( eLH_Schluss_Brems_Nebel_li_defS ))
  {
    case  0: putValue( eLH_Schluss_Brems_Nebel_li_defT, "iO" ); break;
    case  1: putValue( eLH_Schluss_Brems_Nebel_li_defT, "defekt" ); break;
    default: putValue( eLH_Schluss_Brems_Nebel_li_defT, "!?!" );
  }
}

on EnvVar eLH_Schluss_Brems_Nebel_re_defS
{
  switch (getValue( eLH_Schluss_Brems_Nebel_re_defS ))
  {
    case  0: putValue( eLH_Schluss_Brems_Nebel_re_defT, "iO" ); break;
    case  1: putValue( eLH_Schluss_Brems_Nebel_re_defT, "defekt" ); break;
    default: putValue( eLH_Schluss_Brems_Nebel_re_defT, "!?!" );
  }
}

on EnvVar eLH_Schluss_Brems_li_defS
{
  switch (getValue( eLH_Schluss_Brems_li_defS ))
  {
    case  0: putValue( eLH_Schluss_Brems_li_defT, "OK" ); break;
    case  1: putValue( eLH_Schluss_Brems_li_defT, "defekt" ); break;
    default: putValue( eLH_Schluss_Brems_li_defT, "!?!" );
  }
}

on EnvVar eLH_Schluss_Nebel_li_defS
{
  switch (getValue( eLH_Schluss_Nebel_li_defS ))
  {
    case  0: putValue( eLH_Schluss_Nebel_li_defT, "OK" ); break;
    case  1: putValue( eLH_Schluss_Nebel_li_defT, "defekt" ); break;
    default: putValue( eLH_Schluss_Nebel_li_defT, "!?!" );
  }
}

on EnvVar eLH_SL_BRL_BLK_li_defS
{
  switch (getValue( eLH_SL_BRL_BLK_li_defS ))
  {
    case  0: putValue( eLH_SL_BRL_BLK_li_defT, "OK" ); break;
    case  1: putValue( eLH_SL_BRL_BLK_li_defT, "defekt" ); break;
    default: putValue( eLH_SL_BRL_BLK_li_defT, "!?!" );
  }
}

on EnvVar eLH_Brems_Blk_li_defS
{
  switch (getValue( eLH_Brems_Blk_li_defS ))
  {
    case  0: putValue( eLH_Brems_Blk_li_defT, "OK" ); break;
    case  1: putValue( eLH_Brems_Blk_li_defT, "defekt" ); break;
    default: putValue( eLH_Brems_Blk_li_defT, "!?!" );
  }
}

on EnvVar eLH_Blinker_re_defS
{
  switch (getValue( eLH_Blinker_re_defS ))
  {
    case  0: putValue( eLH_Blinker_re_defT, "OK" ); break;
    case  1: putValue( eLH_Blinker_re_defT, "Blinker hinten rechts defekt" ); break;
    default: putValue( eLH_Blinker_re_defT, "!?!" );
  }
}

on EnvVar eLH_Bremsl_re_defS
{
  switch (getValue( eLH_Bremsl_re_defS ))
  {
    case  0: putValue( eLH_Bremsl_re_defT, "OK" ); break;
    case  1: putValue( eLH_Bremsl_re_defT, "mindestens ein Bremslicht hinten rechts defekt" ); break;
    default: putValue( eLH_Bremsl_re_defT, "!?!" );
  }
}

on EnvVar eLH_Schlusslicht_re_defS
{
  switch (getValue( eLH_Schlusslicht_re_defS ))
  {
    case  0: putValue( eLH_Schlusslicht_re_defT, "OK" ); break;
    case  1: putValue( eLH_Schlusslicht_re_defT, "mindestens ein Schlusslicht hinten rechts defekt" ); break;
    default: putValue( eLH_Schlusslicht_re_defT, "!?!" );
  }
}

on EnvVar eLH_Rueckf_re_defS
{
  switch (getValue( eLH_Rueckf_re_defS ))
  {
    case  0: putValue( eLH_Rueckf_re_defT, "OK" ); break;
    case  1: putValue( eLH_Rueckf_re_defT, "Rückfahrlicht hinten rechts defekt" ); break;
    default: putValue( eLH_Rueckf_re_defT, "!?!" );
  }
}

on EnvVar eLH_Nebel_re_defS
{
  switch (getValue( eLH_Nebel_re_defS ))
  {
    case  0: putValue( eLH_Nebel_re_defT, "OK" ); break;
    case  1: putValue( eLH_Nebel_re_defT, "Nebelschlusslicht hinten rechts defekt" ); break;
    default: putValue( eLH_Nebel_re_defT, "!?!" );
  }
}

on EnvVar eLH_Schluss_Brems_re_defS
{
  switch (getValue( eLH_Schluss_Brems_re_defS ))
  {
    case  0: putValue( eLH_Schluss_Brems_re_defT, "OK" ); break;
    case  1: putValue( eLH_Schluss_Brems_re_defT, "defekt" ); break;
    default: putValue( eLH_Schluss_Brems_re_defT, "!?!" );
  }
}

on EnvVar eLH_Schluss_Nebel_re_defS
{
  switch (getValue( eLH_Schluss_Nebel_re_defS ))
  {
    case  0: putValue( eLH_Schluss_Nebel_re_defT, "OK" ); break;
    case  1: putValue( eLH_Schluss_Nebel_re_defT, "defekt" ); break;
    default: putValue( eLH_Schluss_Nebel_re_defT, "!?!" );
  }
}

on EnvVar eLH_SL_BRL_BLK_re_defS
{
  switch (getValue( eLH_SL_BRL_BLK_re_defS ))
  {
    case  0: putValue( eLH_SL_BRL_BLK_re_defT, "OK" ); break;
    case  1: putValue( eLH_SL_BRL_BLK_re_defT, "defekt" ); break;
    default: putValue( eLH_SL_BRL_BLK_re_defT, "!?!" );
  }
}

on EnvVar eLH_Brems_Blk_re_defS
{
  switch (getValue( eLH_Brems_Blk_re_defS ))
  {
    case  0: putValue( eLH_Brems_Blk_re_defT, "OK" ); break;
    case  1: putValue( eLH_Brems_Blk_re_defT, "defekt" ); break;
    default: putValue( eLH_Brems_Blk_re_defT, "!?!" );
  }
}

on EnvVar eLH_Kennzl_defS
{
  switch (getValue( eLH_Kennzl_defS ))
  {
    case  0: putValue( eLH_Kennzl_defT, "OK" ); break;
    case  1: putValue( eLH_Kennzl_defT, "Kennzeichenbeleuchtung hinten defekt" ); break;
    default: putValue( eLH_Kennzl_defT, "!?!" );
  }
}

on EnvVar eLH_3_Bremsl_defS
{
  switch (getValue( eLH_3_Bremsl_defS ))
  {
    case  0: putValue( eLH_3_Bremsl_defT, "OK" ); break;
    case  1: putValue( eLH_3_Bremsl_defT, "hochgesetzte  Bremsleuchte defekt" ); break;
    default: putValue( eLH_3_Bremsl_defT, "!?!" );
  }
}

on EnvVar eLH_Nebel_mi_defS
{
  switch (getValue( eLH_Nebel_mi_defS ))
  {
    case  0: putValue( eLH_Nebel_mi_defT, "OK" ); break;
    case  1: putValue( eLH_Nebel_mi_defT, "Nebelschlusslicht hinten Mitte defekt" ); break;
    default: putValue( eLH_Nebel_mi_defT, "!?!" );
  }
}

on EnvVar eLH_Rueckf_mi_defS
{
  switch (getValue( eLH_Rueckf_mi_defS ))
  {
    case  0: putValue( eLH_Rueckf_mi_defT, "OK" ); break;
    case  1: putValue( eLH_Rueckf_mi_defT, "Rückfahllicht Mitte defekt" ); break;
    default: putValue( eLH_Rueckf_mi_defT, "!?!" );
  }
}

on EnvVar eLH_Bremsl_li_ges_defS
{
  switch (getValue( eLH_Bremsl_li_ges_defS ))
  {
    case  0: putValue( eLH_Bremsl_li_ges_defT, "OK" ); break;
    case  1: putValue( eLH_Bremsl_li_ges_defT, "Alle Bremslichter hinten links defekt" ); break;
    default: putValue( eLH_Bremsl_li_ges_defT, "!?!" );
  }
}

on EnvVar eLH_Bremsl_re_ges_defS
{
  switch (getValue( eLH_Bremsl_re_ges_defS ))
  {
    case  0: putValue( eLH_Bremsl_re_ges_defT, "OK" ); break;
    case  1: putValue( eLH_Bremsl_re_ges_defT, "Alle Bremslichter hinten rechts defekt" ); break;
    default: putValue( eLH_Bremsl_re_ges_defT, "!?!" );
  }
}

on EnvVar eLV_Standlicht_AnzeigeS
{
  switch (getValue( eLV_Standlicht_AnzeigeS ))
  {
    case  0: putValue( eLV_Standlicht_AnzeigeT, "nicht aktiv" ); break;
    case  1: putValue( eLV_Standlicht_AnzeigeT, "aktiv" ); break;
    default: putValue( eLV_Standlicht_AnzeigeT, "!?!" );
  }
}

on EnvVar eLV_Abblendlicht_AnzeigeS
{
  switch (getValue( eLV_Abblendlicht_AnzeigeS ))
  {
    case  0: putValue( eLV_Abblendlicht_AnzeigeT, "nicht aktiv" ); break;
    case  1: putValue( eLV_Abblendlicht_AnzeigeT, "aktiv" ); break;
    default: putValue( eLV_Abblendlicht_AnzeigeT, "!?!" );
  }
}

on EnvVar eLV_Fernlicht_AnzeigeS
{
  switch (getValue( eLV_Fernlicht_AnzeigeS ))
  {
    case  0: putValue( eLV_Fernlicht_AnzeigeT, "nicht aktiv" ); break;
    case  1: putValue( eLV_Fernlicht_AnzeigeT, "aktiv" ); break;
    default: putValue( eLV_Fernlicht_AnzeigeT, "!?!" );
  }
}

on EnvVar eLV_Nebellicht_AnzeigeS
{
  switch (getValue( eLV_Nebellicht_AnzeigeS ))
  {
    case  0: putValue( eLV_Nebellicht_AnzeigeT, "nicht aktiv" ); break;
    case  1: putValue( eLV_Nebellicht_AnzeigeT, "aktiv" ); break;
    default: putValue( eLV_Nebellicht_AnzeigeT, "!?!" );
  }
}

on EnvVar eLV_Nebelschlusslicht_AnzeigeS
{
  switch (getValue( eLV_Nebelschlusslicht_AnzeigeS ))
  {
    case  0: putValue( eLV_Nebelschlusslicht_AnzeigeT, "nicht aktiv" ); break;
    case  1: putValue( eLV_Nebelschlusslicht_AnzeigeT, "aktiv" ); break;
    default: putValue( eLV_Nebelschlusslicht_AnzeigeT, "!?!" );
  }
}

on EnvVar eLV_Tagfahrlicht_AnzeigeS
{
  switch (getValue( eLV_Tagfahrlicht_AnzeigeS ))
  {
    case  0: putValue( eLV_Tagfahrlicht_AnzeigeT, "nicht aktiv" ); break;
    case  1: putValue( eLV_Tagfahrlicht_AnzeigeT, "aktiv" ); break;
    default: putValue( eLV_Tagfahrlicht_AnzeigeT, "!?!" );
  }
}

on EnvVar eLV_AFL_aktiv_AnzeigeS
{
  switch (getValue( eLV_AFL_aktiv_AnzeigeS ))
  {
    case  0: putValue( eLV_AFL_aktiv_AnzeigeT, "nicht aktiv" ); break;
    case  1: putValue( eLV_AFL_aktiv_AnzeigeT, "aktiv" ); break;
    default: putValue( eLV_AFL_aktiv_AnzeigeT, "!?!" );
  }
}

on EnvVar eLV_AFL_defektS
{
  switch (getValue( eLV_AFL_defektS ))
  {
    case  0: putValue( eLV_AFL_defektT, "OK" ); break;
    case  1: putValue( eLV_AFL_defektT, "defekt" ); break;
    default: putValue( eLV_AFL_defektT, "!?!" );
  }
}

on EnvVar eLV_Blinker_li_defS
{
  switch (getValue( eLV_Blinker_li_defS ))
  {
    case  0: putValue( eLV_Blinker_li_defT, "OK" ); break;
    case  1: putValue( eLV_Blinker_li_defT, "defekt" ); break;
    default: putValue( eLV_Blinker_li_defT, "!?!" );
  }
}

on EnvVar eLV_Standlicht_li_defS
{
  switch (getValue( eLV_Standlicht_li_defS ))
  {
    case  0: putValue( eLV_Standlicht_li_defT, "OK" ); break;
    case  1: putValue( eLV_Standlicht_li_defT, "defekt" ); break;
    default: putValue( eLV_Standlicht_li_defT, "!?!" );
  }
}

on EnvVar eLV_Abblendlicht_li_defS
{
  switch (getValue( eLV_Abblendlicht_li_defS ))
  {
    case  0: putValue( eLV_Abblendlicht_li_defT, "OK" ); break;
    case  1: putValue( eLV_Abblendlicht_li_defT, "defekt" ); break;
    default: putValue( eLV_Abblendlicht_li_defT, "!?!" );
  }
}

on EnvVar eLV_Fernlicht_li_defS
{
  switch (getValue( eLV_Fernlicht_li_defS ))
  {
    case  0: putValue( eLV_Fernlicht_li_defT, "OK" ); break;
    case  1: putValue( eLV_Fernlicht_li_defT, "defekt" ); break;
    default: putValue( eLV_Fernlicht_li_defT, "!?!" );
  }
}

on EnvVar eLV_Nebellicht_li_defS
{
  switch (getValue( eLV_Nebellicht_li_defS ))
  {
    case  0: putValue( eLV_Nebellicht_li_defT, "OK" ); break;
    case  1: putValue( eLV_Nebellicht_li_defT, "defekt" ); break;
    default: putValue( eLV_Nebellicht_li_defT, "!?!" );
  }
}

on EnvVar eLV_Blk_li_Seite_defS
{
  switch (getValue( eLV_Blk_li_Seite_defS ))
  {
    case  0: putValue( eLV_Blk_li_Seite_defT, "OK" ); break;
    case  1: putValue( eLV_Blk_li_Seite_defT, "defekt" ); break;
    default: putValue( eLV_Blk_li_Seite_defT, "!?!" );
  }
}

on EnvVar eLV_Tagfahrlicht_li_defS
{
  switch (getValue( eLV_Tagfahrlicht_li_defS ))
  {
    case  0: putValue( eLV_Tagfahrlicht_li_defT, "OK" ); break;
    case  1: putValue( eLV_Tagfahrlicht_li_defT, "defekt" ); break;
    default: putValue( eLV_Tagfahrlicht_li_defT, "!?!" );
  }
}

on EnvVar eLV_FLA_aktiv_AnzeigeS
{
  switch (getValue( eLV_FLA_aktiv_AnzeigeS ))
  {
    case  0: putValue( eLV_FLA_aktiv_AnzeigeT, "aus" ); break;
    case  1: putValue( eLV_FLA_aktiv_AnzeigeT, "ein" ); break;
    default: putValue( eLV_FLA_aktiv_AnzeigeT, "!?!" );
  }
}

on EnvVar eLV_FLA_defektS
{
  switch (getValue( eLV_FLA_defektS ))
  {
    case  0: putValue( eLV_FLA_defektT, "i.O." ); break;
    case  1: putValue( eLV_FLA_defektT, "FLA defekt" ); break;
    default: putValue( eLV_FLA_defektT, "!?!" );
  }
}

on EnvVar eLV_FLA_Sensor_blockiertS
{
  switch (getValue( eLV_FLA_Sensor_blockiertS ))
  {
    case  0: putValue( eLV_FLA_Sensor_blockiertT, "i.O." ); break;
    case  1: putValue( eLV_FLA_Sensor_blockiertT, "FLA-Sensor blockiert" ); break;
    default: putValue( eLV_FLA_Sensor_blockiertT, "!?!" );
  }
}

on EnvVar eLV_Blinker_re_defS
{
  switch (getValue( eLV_Blinker_re_defS ))
  {
    case  0: putValue( eLV_Blinker_re_defT, "OK" ); break;
    case  1: putValue( eLV_Blinker_re_defT, "defekt" ); break;
    default: putValue( eLV_Blinker_re_defT, "!?!" );
  }
}

on EnvVar eLV_Standlicht_re_defS
{
  switch (getValue( eLV_Standlicht_re_defS ))
  {
    case  0: putValue( eLV_Standlicht_re_defT, "OK" ); break;
    case  1: putValue( eLV_Standlicht_re_defT, "defekt" ); break;
    default: putValue( eLV_Standlicht_re_defT, "!?!" );
  }
}

on EnvVar eLV_Abblendlicht_re_defS
{
  switch (getValue( eLV_Abblendlicht_re_defS ))
  {
    case  0: putValue( eLV_Abblendlicht_re_defT, "OK" ); break;
    case  1: putValue( eLV_Abblendlicht_re_defT, "defekt" ); break;
    default: putValue( eLV_Abblendlicht_re_defT, "!?!" );
  }
}

on EnvVar eLV_Fernlicht_re_defS
{
  switch (getValue( eLV_Fernlicht_re_defS ))
  {
    case  0: putValue( eLV_Fernlicht_re_defT, "OK" ); break;
    case  1: putValue( eLV_Fernlicht_re_defT, "defekt" ); break;
    default: putValue( eLV_Fernlicht_re_defT, "!?!" );
  }
}

on EnvVar eLV_Nebellicht_re_defS
{
  switch (getValue( eLV_Nebellicht_re_defS ))
  {
    case  0: putValue( eLV_Nebellicht_re_defT, "OK" ); break;
    case  1: putValue( eLV_Nebellicht_re_defT, "defekt" ); break;
    default: putValue( eLV_Nebellicht_re_defT, "!?!" );
  }
}

on EnvVar eLV_Blk_re_Seite_defS
{
  switch (getValue( eLV_Blk_re_Seite_defS ))
  {
    case  0: putValue( eLV_Blk_re_Seite_defT, "OK" ); break;
    case  1: putValue( eLV_Blk_re_Seite_defT, "defekt" ); break;
    default: putValue( eLV_Blk_re_Seite_defT, "!?!" );
  }
}

on EnvVar eLV_Tagfahrlicht_re_defS
{
  switch (getValue( eLV_Tagfahrlicht_re_defS ))
  {
    case  0: putValue( eLV_Tagfahrlicht_re_defT, "OK" ); break;
    case  1: putValue( eLV_Tagfahrlicht_re_defT, "defekt" ); break;
    default: putValue( eLV_Tagfahrlicht_re_defT, "!?!" );
  }
}

on EnvVar eLV_Aussenlicht_defS
{
  switch (getValue( eLV_Aussenlicht_defS ))
  {
    case  0: putValue( eLV_Aussenlicht_defT, "OK" ); break;
    case  1: putValue( eLV_Aussenlicht_defT, "defekt" ); break;
    default: putValue( eLV_Aussenlicht_defT, "!?!" );
  }
}

on EnvVar eLV_Abblendlicht_TFL_li_defS
{
  switch (getValue( eLV_Abblendlicht_TFL_li_defS ))
  {
    case  0: putValue( eLV_Abblendlicht_TFL_li_defT, "OK" ); break;
    case  1: putValue( eLV_Abblendlicht_TFL_li_defT, "defekt" ); break;
    default: putValue( eLV_Abblendlicht_TFL_li_defT, "!?!" );
  }
}

on EnvVar eLV_Nebellicht_TFL_li_defS
{
  switch (getValue( eLV_Nebellicht_TFL_li_defS ))
  {
    case  0: putValue( eLV_Nebellicht_TFL_li_defT, "OK" ); break;
    case  1: putValue( eLV_Nebellicht_TFL_li_defT, "defekt" ); break;
    default: putValue( eLV_Nebellicht_TFL_li_defT, "!?!" );
  }
}

on EnvVar eLV_Standlicht_TFL_li_defS
{
  switch (getValue( eLV_Standlicht_TFL_li_defS ))
  {
    case  0: putValue( eLV_Standlicht_TFL_li_defT, "OK" ); break;
    case  1: putValue( eLV_Standlicht_TFL_li_defT, "defekt" ); break;
    default: putValue( eLV_Standlicht_TFL_li_defT, "!?!" );
  }
}

on EnvVar eLV_Abblend_Fernlicht_li_defS
{
  switch (getValue( eLV_Abblend_Fernlicht_li_defS ))
  {
    case  0: putValue( eLV_Abblend_Fernlicht_li_defT, "OK" ); break;
    case  1: putValue( eLV_Abblend_Fernlicht_li_defT, "defekt" ); break;
    default: putValue( eLV_Abblend_Fernlicht_li_defT, "!?!" );
  }
}

on EnvVar eLV_Abblendlicht_TFL_re_defS
{
  switch (getValue( eLV_Abblendlicht_TFL_re_defS ))
  {
    case  0: putValue( eLV_Abblendlicht_TFL_re_defT, "OK" ); break;
    case  1: putValue( eLV_Abblendlicht_TFL_re_defT, "defekt" ); break;
    default: putValue( eLV_Abblendlicht_TFL_re_defT, "!?!" );
  }
}

on EnvVar eLV_Nebellicht_TFL_re_defS
{
  switch (getValue( eLV_Nebellicht_TFL_re_defS ))
  {
    case  0: putValue( eLV_Nebellicht_TFL_re_defT, "OK" ); break;
    case  1: putValue( eLV_Nebellicht_TFL_re_defT, "defekt" ); break;
    default: putValue( eLV_Nebellicht_TFL_re_defT, "!?!" );
  }
}

on EnvVar eLV_Standlicht_TFL_re_defS
{
  switch (getValue( eLV_Standlicht_TFL_re_defS ))
  {
    case  0: putValue( eLV_Standlicht_TFL_re_defT, "OK" ); break;
    case  1: putValue( eLV_Standlicht_TFL_re_defT, "defekt" ); break;
    default: putValue( eLV_Standlicht_TFL_re_defT, "!?!" );
  }
}

on EnvVar eLV_Abblend_Fernlicht_re_defS
{
  switch (getValue( eLV_Abblend_Fernlicht_re_defS ))
  {
    case  0: putValue( eLV_Abblend_Fernlicht_re_defT, "OK" ); break;
    case  1: putValue( eLV_Abblend_Fernlicht_re_defT, "defekt" ); break;
    default: putValue( eLV_Abblend_Fernlicht_re_defT, "!?!" );
  }
}

on EnvVar eBFS_Fond_Bed_AckS
{
  switch (getValue( eBFS_Fond_Bed_AckS ))
  {
    case  0: putValue( eBFS_Fond_Bed_AckT, "nicht aktiviert" ); break;
    case  1: putValue( eBFS_Fond_Bed_AckT, "aktiviert" ); break;
    default: putValue( eBFS_Fond_Bed_AckT, "!?!" );
  }
}

on EnvVar eBFS_Lehne_nicht_verriegeltS
{
  switch (getValue( eBFS_Lehne_nicht_verriegeltS ))
  {
    case  0: putValue( eBFS_Lehne_nicht_verriegeltT, "keine Anzeige" ); break;
    case  1: putValue( eBFS_Lehne_nicht_verriegeltT, "Lehne nicht verriegelt" ); break;
    default: putValue( eBFS_Lehne_nicht_verriegeltT, "!?!" );
  }
}

on EnvVar eBFS_Klapptisch_offenS
{
  switch (getValue( eBFS_Klapptisch_offenS ))
  {
    case  0: putValue( eBFS_Klapptisch_offenT, "inaktiv" ); break;
    case  1: putValue( eBFS_Klapptisch_offenT, "aktiv" ); break;
    default: putValue( eBFS_Klapptisch_offenT, "!?!" );
  }
}

on EnvVar eBFS_KD_FehlerS
{
  switch (getValue( eBFS_KD_FehlerS ))
  {
    case  0: putValue( eBFS_KD_FehlerT, "kein KD Fehler" ); break;
    case  1: putValue( eBFS_KD_FehlerT, "KD Fehler" ); break;
    default: putValue( eBFS_KD_FehlerT, "!?!" );
  }
}

on EnvVar eBFS_Sitzsym_Fahrt_aktivS
{
  switch (getValue( eBFS_Sitzsym_Fahrt_aktivS ))
  {
    case  0: putValue( eBFS_Sitzsym_Fahrt_aktivT, "inaktiv" ); break;
    case  1: putValue( eBFS_Sitzsym_Fahrt_aktivT, "aktiv" ); break;
    default: putValue( eBFS_Sitzsym_Fahrt_aktivT, "!?!" );
  }
}

on EnvVar eBFS_Sitzfahrt_aktivS
{
  switch (getValue( eBFS_Sitzfahrt_aktivS ))
  {
    case  1: putValue( eBFS_Sitzfahrt_aktivT, "Sitz in Bewegung" ); break;
    default: putValue( eBFS_Sitzfahrt_aktivT, "!?!" );
  }
}

on EnvVar eBFS_SLV_aktivS
{
  switch (getValue( eBFS_SLV_aktivS ))
  {
    case  0: putValue( eBFS_SLV_aktivT, "nicht aktiv" ); break;
    case  1: putValue( eBFS_SLV_aktivT, "Sitzlaengsverstellung aktiv" ); break;
    default: putValue( eBFS_SLV_aktivT, "!?!" );
  }
}

on EnvVar eBFS_SHV_aktivS
{
  switch (getValue( eBFS_SHV_aktivS ))
  {
    case  0: putValue( eBFS_SHV_aktivT, "nicht aktiv" ); break;
    case  1: putValue( eBFS_SHV_aktivT, "Sitzhoehenverstellung aktiv" ); break;
    default: putValue( eBFS_SHV_aktivT, "!?!" );
  }
}

on EnvVar eBFS_LNV_aktivS
{
  switch (getValue( eBFS_LNV_aktivS ))
  {
    case  0: putValue( eBFS_LNV_aktivT, "inaktiv" ); break;
    case  1: putValue( eBFS_LNV_aktivT, "aktiv" ); break;
    default: putValue( eBFS_LNV_aktivT, "!?!" );
  }
}

on EnvVar eBFS_SNV_aktivS
{
  switch (getValue( eBFS_SNV_aktivS ))
  {
    case  0: putValue( eBFS_SNV_aktivT, "nicht aktiv" ); break;
    case  1: putValue( eBFS_SNV_aktivT, "Sitzneigungsverstellung aktiv" ); break;
    default: putValue( eBFS_SNV_aktivT, "!?!" );
  }
}

on EnvVar eBFS_KSV_aktivS
{
  switch (getValue( eBFS_KSV_aktivS ))
  {
    case  0: putValue( eBFS_KSV_aktivT, "nicht aktiv" ); break;
    case  1: putValue( eBFS_KSV_aktivT, "Kopfstuetzenverstellung aktiv" ); break;
    default: putValue( eBFS_KSV_aktivT, "!?!" );
  }
}

on EnvVar eBFS_LKV_aktivS
{
  switch (getValue( eBFS_LKV_aktivS ))
  {
    case  0: putValue( eBFS_LKV_aktivT, "nicht aktiv" ); break;
    case  1: putValue( eBFS_LKV_aktivT, "aktiv" ); break;
    default: putValue( eBFS_LKV_aktivT, "!?!" );
  }
}

on EnvVar eBFS_STV_aktivS
{
  switch (getValue( eBFS_STV_aktivS ))
  {
    case  0: putValue( eBFS_STV_aktivT, "inaktiv" ); break;
    case  1: putValue( eBFS_STV_aktivT, "Sitztiefeverstellung aktiv" ); break;
    default: putValue( eBFS_STV_aktivT, "!?!" );
  }
}

on EnvVar eBFS_LHV_aktivS
{
  switch (getValue( eBFS_LHV_aktivS ))
  {
    case  0: putValue( eBFS_LHV_aktivT, "inaktiv" ); break;
    case  1: putValue( eBFS_LHV_aktivT, "aktiv" ); break;
    default: putValue( eBFS_LHV_aktivT, "!?!" );
  }
}

on EnvVar eBFS_LWV_aktivS
{
  switch (getValue( eBFS_LWV_aktivS ))
  {
    case  0: putValue( eBFS_LWV_aktivT, "nicht aktiv" ); break;
    case  1: putValue( eBFS_LWV_aktivT, "aktiv" ); break;
    default: putValue( eBFS_LWV_aktivT, "!?!" );
  }
}

on EnvVar eBFS_GHV_aktivS
{
  switch (getValue( eBFS_GHV_aktivS ))
  {
    case  0: putValue( eBFS_GHV_aktivT, "nicht aktiv" ); break;
    case  1: putValue( eBFS_GHV_aktivT, "Gurthoehe Verstellung aktiv" ); break;
    default: putValue( eBFS_GHV_aktivT, "!?!" );
  }
}

on EnvVar eBFS_KSS_Fahrt_aktivS
{
  switch (getValue( eBFS_KSS_Fahrt_aktivS ))
  {
    case  0: putValue( eBFS_KSS_Fahrt_aktivT, "nicht aktiv" ); break;
    case  1: putValue( eBFS_KSS_Fahrt_aktivT, "Komfortseitensichtfahrt aktiv" ); break;
    default: putValue( eBFS_KSS_Fahrt_aktivT, "!?!" );
  }
}

on EnvVar eBFS_MMB_lokal_StopS
{
  switch (getValue( eBFS_MMB_lokal_StopS ))
  {
    case  0: putValue( eBFS_MMB_lokal_StopT, "kein Abbruch" ); break;
    case  1: putValue( eBFS_MMB_lokal_StopT, "lokaler Abbruch" ); break;
    default: putValue( eBFS_MMB_lokal_StopT, "!?!" );
  }
}

on EnvVar eBFS_Ruhestellung_StatusS
{
  switch (getValue( eBFS_Ruhestellung_StatusS ))
  {
    case  0: putValue( eBFS_Ruhestellung_StatusT, "inakiv" ); break;
    case  1: putValue( eBFS_Ruhestellung_StatusT, "Ruhestellung aktiv" ); break;
    default: putValue( eBFS_Ruhestellung_StatusT, "!?!" );
  }
}

on EnvVar eBFS_MMB_storageS
{
  switch (getValue( eBFS_MMB_storageS ))
  {
    case  0: putValue( eBFS_MMB_storageT, "keine Zuweisung" ); break;
    case  1: putValue( eBFS_MMB_storageT, "P1/FP1 Pos Zuweisung" ); break;
    case  2: putValue( eBFS_MMB_storageT, "P2/FP2 Pos Zuweisung" ); break;
    case  3: putValue( eBFS_MMB_storageT, "P3/FP3 Pos Zuweisung" ); break;
    case  4: putValue( eBFS_MMB_storageT, "P4/FP4 Pos Zuweisung an den im System aktiven Funkschlüssel/FPI ID über MMI" ); break;
    case  5: putValue( eBFS_MMB_storageT, "FS1" ); break;
    case  6: putValue( eBFS_MMB_storageT, "FS2" ); break;
    case  7: putValue( eBFS_MMB_storageT, "FS3" ); break;
    case  8: putValue( eBFS_MMB_storageT, "FS4" ); break;
    default: putValue( eBFS_MMB_storageT, "!?!" );
  }
}

on EnvVar eBFS_MMB_tippS
{
  switch (getValue( eBFS_MMB_tippS ))
  {
    case  0: putValue( eBFS_MMB_tippT, "kein Tippbetrieb" ); break;
    case  1: putValue( eBFS_MMB_tippT, "Tippbetrieb" ); break;
    default: putValue( eBFS_MMB_tippT, "!?!" );
  }
}

on EnvVar eBFS_MMB_tastS
{
  switch (getValue( eBFS_MMB_tastS ))
  {
    case  0: putValue( eBFS_MMB_tastT, "kein Tastbetrieb" ); break;
    case  1: putValue( eBFS_MMB_tastT, "Tastbetrieb" ); break;
    default: putValue( eBFS_MMB_tastT, "!?!" );
  }
}

on EnvVar eBFS_MMB_store_LED_onS
{
  switch (getValue( eBFS_MMB_store_LED_onS ))
  {
    case  0: putValue( eBFS_MMB_store_LED_onT, "LED aus" ); break;
    case  1: putValue( eBFS_MMB_store_LED_onT, "LED ein" ); break;
    default: putValue( eBFS_MMB_store_LED_onT, "!?!" );
  }
}

on EnvVar eBFS_MMB_storage_beepS
{
  switch (getValue( eBFS_MMB_storage_beepS ))
  {
    case  0: putValue( eBFS_MMB_storage_beepT, "beep aus" ); break;
    case  1: putValue( eBFS_MMB_storage_beepT, "beep ein" ); break;
    default: putValue( eBFS_MMB_storage_beepT, "!?!" );
  }
}

on EnvVar eBFS_MMB_storeS
{
  switch (getValue( eBFS_MMB_storeS ))
  {
    case  0: putValue( eBFS_MMB_storeT, "nicht speichern" ); break;
    case  1: putValue( eBFS_MMB_storeT, "speichern" ); break;
    default: putValue( eBFS_MMB_storeT, "!?!" );
  }
}

on EnvVar eBFS_MMB_glob_stopS
{
  switch (getValue( eBFS_MMB_glob_stopS ))
  {
    case  0: putValue( eBFS_MMB_glob_stopT, "kein globaler Abbruch" ); break;
    case  1: putValue( eBFS_MMB_glob_stopT, "globaler Abbruch" ); break;
    default: putValue( eBFS_MMB_glob_stopT, "!?!" );
  }
}

on EnvVar eBFS_SIH_StatusS
{
  switch (getValue( eBFS_SIH_StatusS ))
  {
    case  0: putValue( eBFS_SIH_StatusT, "aus" ); break;
    case  1: putValue( eBFS_SIH_StatusT, "ein" ); break;
    case  2: putValue( eBFS_SIH_StatusT, "tbd" ); break;
    case  3: putValue( eBFS_SIH_StatusT, "Fehler" ); break;
    default: putValue( eBFS_SIH_StatusT, "!?!" );
  }
}

on EnvVar eBFS_SLR_ReglerstatusS
{
  switch (getValue( eBFS_SLR_ReglerstatusS ))
  {
    case  0: putValue( eBFS_SLR_ReglerstatusT, "i.O." ); break;
    case  1: putValue( eBFS_SLR_ReglerstatusT, "Heizung Abbruch" ); break;
    case  2: putValue( eBFS_SLR_ReglerstatusT, "Lueftung Abbruch" ); break;
    case  3: putValue( eBFS_SLR_ReglerstatusT, "Heizung/Lueftung Abbruch" ); break;
    default: putValue( eBFS_SLR_ReglerstatusT, "!?!" );
  }
}

on EnvVar eFS_Fond_Bed_enableS
{
  switch (getValue( eFS_Fond_Bed_enableS ))
  {
    case  0: putValue( eFS_Fond_Bed_enableT, "disable" ); break;
    case  1: putValue( eFS_Fond_Bed_enableT, "enable" ); break;
    default: putValue( eFS_Fond_Bed_enableT, "!?!" );
  }
}

on EnvVar eFS_Lehne_nicht_verriegeltS
{
  switch (getValue( eFS_Lehne_nicht_verriegeltS ))
  {
    case  0: putValue( eFS_Lehne_nicht_verriegeltT, "keine Anzeige" ); break;
    case  1: putValue( eFS_Lehne_nicht_verriegeltT, "Lehne nicht verriegelt" ); break;
    default: putValue( eFS_Lehne_nicht_verriegeltT, "!?!" );
  }
}

on EnvVar eFS_Spezialposition_anfahrenS
{
  switch (getValue( eFS_Spezialposition_anfahrenS ))
  {
    case  0: putValue( eFS_Spezialposition_anfahrenT, "Fkt inaktiv" ); break;
    case  1: putValue( eFS_Spezialposition_anfahrenT, "Fkt aktiv" ); break;
    default: putValue( eFS_Spezialposition_anfahrenT, "!?!" );
  }
}

on EnvVar eFS_BFS_Sitzsym_AnfahrtS
{
  switch (getValue( eFS_BFS_Sitzsym_AnfahrtS ))
  {
    case  0: putValue( eFS_BFS_Sitzsym_AnfahrtT, "keine Sitzsymetrie Anfahrt BFS" ); break;
    case  1: putValue( eFS_BFS_Sitzsym_AnfahrtT, "Sitzsymetrie Anfahrt BFS" ); break;
    default: putValue( eFS_BFS_Sitzsym_AnfahrtT, "!?!" );
  }
}

on EnvVar eFS_Sitzfahrt_aktivS
{
  switch (getValue( eFS_Sitzfahrt_aktivS ))
  {
    case  0: putValue( eFS_Sitzfahrt_aktivT, "Sitz nicht in Bewegung" ); break;
    case  1: putValue( eFS_Sitzfahrt_aktivT, "Sitz in Bewegung" ); break;
    default: putValue( eFS_Sitzfahrt_aktivT, "!?!" );
  }
}

on EnvVar eFS_SLV_aktivS
{
  switch (getValue( eFS_SLV_aktivS ))
  {
    case  0: putValue( eFS_SLV_aktivT, "nicht aktiv" ); break;
    case  1: putValue( eFS_SLV_aktivT, "Sitzlaengsverstellung aktiv" ); break;
    default: putValue( eFS_SLV_aktivT, "!?!" );
  }
}

on EnvVar eFS_SHV_aktivS
{
  switch (getValue( eFS_SHV_aktivS ))
  {
    case  0: putValue( eFS_SHV_aktivT, "nicht aktiv" ); break;
    case  1: putValue( eFS_SHV_aktivT, "Sitzhoehenverstellung aktiv" ); break;
    default: putValue( eFS_SHV_aktivT, "!?!" );
  }
}

on EnvVar eFS_LNV_aktivS
{
  switch (getValue( eFS_LNV_aktivS ))
  {
    case  0: putValue( eFS_LNV_aktivT, "nicht aktiv" ); break;
    case  1: putValue( eFS_LNV_aktivT, "Lehnenneigungverstellung aktiv" ); break;
    default: putValue( eFS_LNV_aktivT, "!?!" );
  }
}

on EnvVar eFS_SNV_aktivS
{
  switch (getValue( eFS_SNV_aktivS ))
  {
    case  0: putValue( eFS_SNV_aktivT, "nicht aktiv" ); break;
    case  1: putValue( eFS_SNV_aktivT, "Sitzneigungsverstellung aktiv" ); break;
    default: putValue( eFS_SNV_aktivT, "!?!" );
  }
}

on EnvVar eFS_KSV_aktivS
{
  switch (getValue( eFS_KSV_aktivS ))
  {
    case  0: putValue( eFS_KSV_aktivT, "nicht aktiv" ); break;
    case  1: putValue( eFS_KSV_aktivT, "Kopfstuetzenverstellung aktiv" ); break;
    default: putValue( eFS_KSV_aktivT, "!?!" );
  }
}

on EnvVar eFS_LKV_aktivS
{
  switch (getValue( eFS_LKV_aktivS ))
  {
    case  0: putValue( eFS_LKV_aktivT, "nicht aktiv" ); break;
    case  1: putValue( eFS_LKV_aktivT, "Lehnenkopfverstellung aktiv" ); break;
    default: putValue( eFS_LKV_aktivT, "!?!" );
  }
}

on EnvVar eFS_STV_aktivS
{
  switch (getValue( eFS_STV_aktivS ))
  {
    case  0: putValue( eFS_STV_aktivT, "nicht aktiv" ); break;
    case  1: putValue( eFS_STV_aktivT, "Sitztiefeverstellung aktiv" ); break;
    default: putValue( eFS_STV_aktivT, "!?!" );
  }
}

on EnvVar eFS_LHV_aktivS
{
  switch (getValue( eFS_LHV_aktivS ))
  {
    case  0: putValue( eFS_LHV_aktivT, "nicht aktiv" ); break;
    case  1: putValue( eFS_LHV_aktivT, "Lordose Höhe Verstellung aktiv" ); break;
    default: putValue( eFS_LHV_aktivT, "!?!" );
  }
}

on EnvVar eFS_LWV_aktivS
{
  switch (getValue( eFS_LWV_aktivS ))
  {
    case  0: putValue( eFS_LWV_aktivT, "nicht aktiv" ); break;
    case  1: putValue( eFS_LWV_aktivT, "Lordose W Verstellung aktiv" ); break;
    default: putValue( eFS_LWV_aktivT, "!?!" );
  }
}

on EnvVar eFS_GHV_aktivS
{
  switch (getValue( eFS_GHV_aktivS ))
  {
    case  0: putValue( eFS_GHV_aktivT, "nicht aktiv" ); break;
    case  1: putValue( eFS_GHV_aktivT, "Gurthoehenverstellung aktiv" ); break;
    default: putValue( eFS_GHV_aktivT, "!?!" );
  }
}

on EnvVar eFS_BFS_KSS_AnfahrtS
{
  switch (getValue( eFS_BFS_KSS_AnfahrtS ))
  {
    case  0: putValue( eFS_BFS_KSS_AnfahrtT, "keine Anfahrt KSS BFS" ); break;
    case  1: putValue( eFS_BFS_KSS_AnfahrtT, "Anfahrt KSS BFS" ); break;
    default: putValue( eFS_BFS_KSS_AnfahrtT, "!?!" );
  }
}

on EnvVar eFS_MMB_lokal_StopS
{
  switch (getValue( eFS_MMB_lokal_StopS ))
  {
    case  0: putValue( eFS_MMB_lokal_StopT, "kein Abbruch" ); break;
    case  1: putValue( eFS_MMB_lokal_StopT, "lokaler Abbruch" ); break;
    default: putValue( eFS_MMB_lokal_StopT, "!?!" );
  }
}

on EnvVar eFS_MMB_storageS
{
  switch (getValue( eFS_MMB_storageS ))
  {
    case  0: putValue( eFS_MMB_storageT, "keine Zuweisung" ); break;
    case  1: putValue( eFS_MMB_storageT, "P1/FP1 Pos Zuweisung" ); break;
    case  2: putValue( eFS_MMB_storageT, "P2/FP2 Pos Zuweisung" ); break;
    case  3: putValue( eFS_MMB_storageT, "P3/FP3 Pos Zuweisung" ); break;
    case  4: putValue( eFS_MMB_storageT, "P4/FP4 Pos Zuweisung; an den im System aktiven Funkschlüssel/FPI ID über MMI" ); break;
    case  5: putValue( eFS_MMB_storageT, "FS1" ); break;
    case  6: putValue( eFS_MMB_storageT, "FS2" ); break;
    case  7: putValue( eFS_MMB_storageT, "FS3" ); break;
    case  8: putValue( eFS_MMB_storageT, "FS4" ); break;
    default: putValue( eFS_MMB_storageT, "!?!" );
  }
}

on EnvVar eFS_MMB_tippS
{
  switch (getValue( eFS_MMB_tippS ))
  {
    case  0: putValue( eFS_MMB_tippT, "kein Tippbetrieb" ); break;
    case  1: putValue( eFS_MMB_tippT, "Tippbetrieb  automatisches Funkschlüsselmemory aktivieren;" ); break;
    default: putValue( eFS_MMB_tippT, "!?!" );
  }
}

on EnvVar eFS_MMB_tastS
{
  switch (getValue( eFS_MMB_tastS ))
  {
    case  0: putValue( eFS_MMB_tastT, "kein Tastbetrieb" ); break;
    case  1: putValue( eFS_MMB_tastT, "Tastbetrieb  Fingerprintautomatismus aktivieren über MMI" ); break;
    default: putValue( eFS_MMB_tastT, "!?!" );
  }
}

on EnvVar eFS_MMB_store_LED_onS
{
  switch (getValue( eFS_MMB_store_LED_onS ))
  {
    case  0: putValue( eFS_MMB_store_LED_onT, "LED aus" ); break;
    case  1: putValue( eFS_MMB_store_LED_onT, "LED ein" ); break;
    default: putValue( eFS_MMB_store_LED_onT, "!?!" );
  }
}

on EnvVar eFS_MMB_storage_beepS
{
  switch (getValue( eFS_MMB_storage_beepS ))
  {
    case  0: putValue( eFS_MMB_storage_beepT, "beep aus" ); break;
    case  1: putValue( eFS_MMB_storage_beepT, "beep ein" ); break;
    default: putValue( eFS_MMB_storage_beepT, "!?!" );
  }
}

on EnvVar eFS_MMB_storeS
{
  switch (getValue( eFS_MMB_storeS ))
  {
    case  0: putValue( eFS_MMB_storeT, "nicht speichern  kein keyless verbaut" ); break;
    case  1: putValue( eFS_MMB_storeT, "abspeichern  keyless verbaut" ); break;
    default: putValue( eFS_MMB_storeT, "!?!" );
  }
}

on EnvVar eFS_MMB_glob_stopS
{
  switch (getValue( eFS_MMB_glob_stopS ))
  {
    case  0: putValue( eFS_MMB_glob_stopT, "kein globaler Abbrucht" ); break;
    case  1: putValue( eFS_MMB_glob_stopT, "globaler Abbruch" ); break;
    default: putValue( eFS_MMB_glob_stopT, "!?!" );
  }
}

on EnvVar eFS_EE_Fond_FS_enableS
{
  switch (getValue( eFS_EE_Fond_FS_enableS ))
  {
    case  0: putValue( eFS_EE_Fond_FS_enableT, "EE Fond links deaktiv" ); break;
    case  1: putValue( eFS_EE_Fond_FS_enableT, "EE Fond links aktiv (default) vom MMI" ); break;
    default: putValue( eFS_EE_Fond_FS_enableT, "!?!" );
  }
}

on EnvVar eFS_EE_Fond_BFS_enableS
{
  switch (getValue( eFS_EE_Fond_BFS_enableS ))
  {
    case  0: putValue( eFS_EE_Fond_BFS_enableT, "EE Fond rechts deaktiv" ); break;
    case  1: putValue( eFS_EE_Fond_BFS_enableT, "EE Fond rechts aktiv (default) vom MMI" ); break;
    default: putValue( eFS_EE_Fond_BFS_enableT, "!?!" );
  }
}

on EnvVar eFS_EE_BFS_enableS
{
  switch (getValue( eFS_EE_BFS_enableS ))
  {
    case  0: putValue( eFS_EE_BFS_enableT, "keine EE Freigabe" ); break;
    case  1: putValue( eFS_EE_BFS_enableT, "EE Freigabe" ); break;
    default: putValue( eFS_EE_BFS_enableT, "!?!" );
  }
}

on EnvVar eFS_SIH_StatusS
{
  switch (getValue( eFS_SIH_StatusS ))
  {
    case  0: putValue( eFS_SIH_StatusT, "aus" ); break;
    case  1: putValue( eFS_SIH_StatusT, "ein" ); break;
    case  2: putValue( eFS_SIH_StatusT, "tbd" ); break;
    case  3: putValue( eFS_SIH_StatusT, "Fehler" ); break;
    default: putValue( eFS_SIH_StatusT, "!?!" );
  }
}

on EnvVar eFS_SLR_ReglerstatusS
{
  switch (getValue( eFS_SLR_ReglerstatusS ))
  {
    case  0: putValue( eFS_SLR_ReglerstatusT, "i.O." ); break;
    case  1: putValue( eFS_SLR_ReglerstatusT, "Heizung Abbruch" ); break;
    case  2: putValue( eFS_SLR_ReglerstatusT, "Lueftung Abbruch" ); break;
    case  3: putValue( eFS_SLR_ReglerstatusT, "Heizung/Lueftung Abbruch" ); break;
    default: putValue( eFS_SLR_ReglerstatusT, "!?!" );
  }
}

on EnvVar eMF_MotorweiterlaufS
{
  switch (getValue( eMF_MotorweiterlaufS ))
  {
    case  0: putValue( eMF_MotorweiterlaufT, "inaktiv" ); break;
    case  1: putValue( eMF_MotorweiterlaufT, "aktiv" ); break;
    default: putValue( eMF_MotorweiterlaufT, "!?!" );
  }
}

on EnvVar eMF_AbzugssperreS
{
  switch (getValue( eMF_AbzugssperreS ))
  {
    case  0: putValue( eMF_AbzugssperreT, "inaktiv" ); break;
    case  1: putValue( eMF_AbzugssperreT, "aktiv" ); break;
    default: putValue( eMF_AbzugssperreT, "!?!" );
  }
}

on EnvVar eMF_AnlassersperreS
{
  switch (getValue( eMF_AnlassersperreS ))
  {
    case  0: putValue( eMF_AnlassersperreT, "inaktiv" ); break;
    case  1: putValue( eMF_AnlassersperreT, "aktiv" ); break;
    default: putValue( eMF_AnlassersperreT, "!?!" );
  }
}

on EnvVar eMF_VarianteS
{
  switch (getValue( eMF_VarianteS ))
  {
    case  0: putValue( eMF_VarianteT, "keine Sonderfunktion" ); break;
    case  1: putValue( eMF_VarianteT, "Sondersignalfahrzeug" ); break;
    case  2: putValue( eMF_VarianteT, "Taxi" ); break;
    case  3: putValue( eMF_VarianteT, "Fahrhilfe" ); break;
    case  4: putValue( eMF_VarianteT, "Fahrschule Extra" ); break;
    case  5: putValue( eMF_VarianteT, "SSF" ); break;
    default: putValue( eMF_VarianteT, "!?!" );
  }
}

on EnvVar eMF_Schluessel_scanS
{
  switch (getValue( eMF_Schluessel_scanS ))
  {
    case  0: putValue( eMF_Schluessel_scanT, "inaktiv" ); break;
    case  1: putValue( eMF_Schluessel_scanT, "aktiv" ); break;
    default: putValue( eMF_Schluessel_scanT, "!?!" );
  }
}

on EnvVar eMF_StartStopp_InfoS
{
  switch (getValue( eMF_StartStopp_InfoS ))
  {
    case  0: putValue( eMF_StartStopp_InfoT, "Motorlauf nicht notwendig (Stoppfreigabe)" ); break;
    case  1: putValue( eMF_StartStopp_InfoT, "Motoranlauf nicht zwingend notwendig (Stoppverbot,keine Startanforderung)" ); break;
    case  2: putValue( eMF_StartStopp_InfoT, "Motoranlauf zwingend notwendig (Startanforderung)" ); break;
    case  3: putValue( eMF_StartStopp_InfoT, "Systemfehler" ); break;
    default: putValue( eMF_StartStopp_InfoT, "!?!" );
  }
}

on EnvVar eMF_Fernbed_einS
{
  switch (getValue( eMF_Fernbed_einS ))
  {
    case  0: putValue( eMF_Fernbed_einT, "inaktiv" ); break;
    case  1: putValue( eMF_Fernbed_einT, "aktiv" ); break;
    default: putValue( eMF_Fernbed_einT, "!?!" );
  }
}

on EnvVar eMF_StandlichtS
{
  switch (getValue( eMF_StandlichtS ))
  {
    case  0: putValue( eMF_StandlichtT, "inaktiv" ); break;
    case  1: putValue( eMF_StandlichtT, "aktiv" ); break;
    default: putValue( eMF_StandlichtT, "!?!" );
  }
}

on EnvVar eMF_FahrlichtS
{
  switch (getValue( eMF_FahrlichtS ))
  {
    case  0: putValue( eMF_FahrlichtT, "inaktiv" ); break;
    case  1: putValue( eMF_FahrlichtT, "aktiv" ); break;
    default: putValue( eMF_FahrlichtT, "!?!" );
  }
}

on EnvVar eMF_interm_FernlichtS
{
  switch (getValue( eMF_interm_FernlichtS ))
  {
    case  0: putValue( eMF_interm_FernlichtT, "inaktiv" ); break;
    case  1: putValue( eMF_interm_FernlichtT, "aktiv" ); break;
    default: putValue( eMF_interm_FernlichtT, "!?!" );
  }
}

on EnvVar eMF_WarnblinkerS
{
  switch (getValue( eMF_WarnblinkerS ))
  {
    case  0: putValue( eMF_WarnblinkerT, "inaktiv" ); break;
    case  1: putValue( eMF_WarnblinkerT, "aktiv" ); break;
    default: putValue( eMF_WarnblinkerT, "!?!" );
  }
}

on EnvVar eMF_FussraumbelS
{
  switch (getValue( eMF_FussraumbelS ))
  {
    case  0: putValue( eMF_FussraumbelT, "inaktiv" ); break;
    case  1: putValue( eMF_FussraumbelT, "aktiv" ); break;
    default: putValue( eMF_FussraumbelT, "!?!" );
  }
}

on EnvVar eMF_InnenraumbelS
{
  switch (getValue( eMF_InnenraumbelS ))
  {
    case  0: putValue( eMF_InnenraumbelT, "inaktiv" ); break;
    case  1: putValue( eMF_InnenraumbelT, "aktiv" ); break;
    default: putValue( eMF_InnenraumbelT, "!?!" );
  }
}

on EnvVar eMF_Innenraumbel_UnterdrueckS
{
  switch (getValue( eMF_Innenraumbel_UnterdrueckS ))
  {
    case  0: putValue( eMF_Innenraumbel_UnterdrueckT, "inaktiv" ); break;
    case  1: putValue( eMF_Innenraumbel_UnterdrueckT, "aktiv" ); break;
    default: putValue( eMF_Innenraumbel_UnterdrueckT, "!?!" );
  }
}

on EnvVar eMF_Blk_liS
{
  switch (getValue( eMF_Blk_liS ))
  {
    case  0: putValue( eMF_Blk_liT, "inaktiv" ); break;
    case  1: putValue( eMF_Blk_liT, "aktiv" ); break;
    default: putValue( eMF_Blk_liT, "!?!" );
  }
}

on EnvVar eMF_Blk_reS
{
  switch (getValue( eMF_Blk_reS ))
  {
    case  0: putValue( eMF_Blk_reT, "inaktiv" ); break;
    case  1: putValue( eMF_Blk_reT, "aktiv" ); break;
    default: putValue( eMF_Blk_reT, "!?!" );
  }
}

on EnvVar eMF_LichthupeS
{
  switch (getValue( eMF_LichthupeS ))
  {
    case  0: putValue( eMF_LichthupeT, "inaktiv" ); break;
    case  1: putValue( eMF_LichthupeT, "aktiv" ); break;
    default: putValue( eMF_LichthupeT, "!?!" );
  }
}

on EnvVar eMF_FernlichtS
{
  switch (getValue( eMF_FernlichtS ))
  {
    case  0: putValue( eMF_FernlichtT, "inaktiv" ); break;
    case  1: putValue( eMF_FernlichtT, "aktiv" ); break;
    default: putValue( eMF_FernlichtT, "!?!" );
  }
}

on EnvVar eMF_TippwischenS
{
  switch (getValue( eMF_TippwischenS ))
  {
    case  0: putValue( eMF_TippwischenT, "inaktiv" ); break;
    case  1: putValue( eMF_TippwischenT, "aktiv" ); break;
    default: putValue( eMF_TippwischenT, "!?!" );
  }
}

on EnvVar eMF_FrontintervallS
{
  switch (getValue( eMF_FrontintervallS ))
  {
    case  0: putValue( eMF_FrontintervallT, "inaktiv" ); break;
    case  1: putValue( eMF_FrontintervallT, "aktiv" ); break;
    default: putValue( eMF_FrontintervallT, "!?!" );
  }
}

on EnvVar eMF_Wischerstufe_1S
{
  switch (getValue( eMF_Wischerstufe_1S ))
  {
    case  0: putValue( eMF_Wischerstufe_1T, "inaktiv" ); break;
    case  1: putValue( eMF_Wischerstufe_1T, "aktiv" ); break;
    default: putValue( eMF_Wischerstufe_1T, "!?!" );
  }
}

on EnvVar eMF_Wischerstufe_2S
{
  switch (getValue( eMF_Wischerstufe_2S ))
  {
    case  0: putValue( eMF_Wischerstufe_2T, "inaktiv" ); break;
    case  1: putValue( eMF_Wischerstufe_2T, "aktiv" ); break;
    default: putValue( eMF_Wischerstufe_2T, "!?!" );
  }
}

on EnvVar eMF_FrontwaschenS
{
  switch (getValue( eMF_FrontwaschenS ))
  {
    case  0: putValue( eMF_FrontwaschenT, "inaktiv" ); break;
    case  1: putValue( eMF_FrontwaschenT, "aktiv" ); break;
    default: putValue( eMF_FrontwaschenT, "!?!" );
  }
}

on EnvVar eMF_HeckintervallS
{
  switch (getValue( eMF_HeckintervallS ))
  {
    case  0: putValue( eMF_HeckintervallT, "inaktiv" ); break;
    case  1: putValue( eMF_HeckintervallT, "aktiv" ); break;
    default: putValue( eMF_HeckintervallT, "!?!" );
  }
}

on EnvVar eMF_HeckwaschenS
{
  switch (getValue( eMF_HeckwaschenS ))
  {
    case  0: putValue( eMF_HeckwaschenT, "inaktiv" ); break;
    case  1: putValue( eMF_HeckwaschenT, "aktiv" ); break;
    default: putValue( eMF_HeckwaschenT, "!?!" );
  }
}

on EnvVar eMF_SummerS
{
  switch (getValue( eMF_SummerS ))
  {
    case  0: putValue( eMF_SummerT, "inaktiv" ); break;
    case  1: putValue( eMF_SummerT, "aktiv" ); break;
    default: putValue( eMF_SummerT, "!?!" );
  }
}

on EnvVar eMF_Alarm_BlinkertaktS
{
  switch (getValue( eMF_Alarm_BlinkertaktS ))
  {
    case  0: putValue( eMF_Alarm_BlinkertaktT, "inaktiv" ); break;
    case  1: putValue( eMF_Alarm_BlinkertaktT, "aktiv" ); break;
    default: putValue( eMF_Alarm_BlinkertaktT, "!?!" );
  }
}

on EnvVar eMF_Alarm_BlinkerS
{
  switch (getValue( eMF_Alarm_BlinkerS ))
  {
    case  0: putValue( eMF_Alarm_BlinkerT, "inaktiv" ); break;
    case  1: putValue( eMF_Alarm_BlinkerT, "aktiv" ); break;
    default: putValue( eMF_Alarm_BlinkerT, "!?!" );
  }
}

on EnvVar eMF_TFL_AbschaltungS
{
  switch (getValue( eMF_TFL_AbschaltungS ))
  {
    case  0: putValue( eMF_TFL_AbschaltungT, "inaktiv" ); break;
    case  1: putValue( eMF_TFL_AbschaltungT, "aktiv" ); break;
    default: putValue( eMF_TFL_AbschaltungT, "!?!" );
  }
}

on EnvVar eMF_interm_TaktS
{
  switch (getValue( eMF_interm_TaktS ))
  {
    case  0: putValue( eMF_interm_TaktT, "inaktiv" ); break;
    case  1: putValue( eMF_interm_TaktT, "aktiv" ); break;
    default: putValue( eMF_interm_TaktT, "!?!" );
  }
}

on EnvVar eMF_Tuerentriegelung_hintenS
{
  switch (getValue( eMF_Tuerentriegelung_hintenS ))
  {
    case  0: putValue( eMF_Tuerentriegelung_hintenT, "inaktiv" ); break;
    case  1: putValue( eMF_Tuerentriegelung_hintenT, "aktiv" ); break;
    default: putValue( eMF_Tuerentriegelung_hintenT, "!?!" );
  }
}

on EnvVar eMF_interm_FahrlichtS
{
  switch (getValue( eMF_interm_FahrlichtS ))
  {
    case  0: putValue( eMF_interm_FahrlichtT, "inaktiv" ); break;
    case  1: putValue( eMF_interm_FahrlichtT, "aktiv" ); break;
    default: putValue( eMF_interm_FahrlichtT, "!?!" );
  }
}

on EnvVar eMF_SignalhornS
{
  switch (getValue( eMF_SignalhornS ))
  {
    case  0: putValue( eMF_SignalhornT, "inaktiv" ); break;
    case  1: putValue( eMF_SignalhornT, "aktiv" ); break;
    default: putValue( eMF_SignalhornT, "!?!" );
  }
}

on EnvVar eMF_FH_FT_hochS
{
  switch (getValue( eMF_FH_FT_hochS ))
  {
    case  0: putValue( eMF_FH_FT_hochT, "inaktiv" ); break;
    case  1: putValue( eMF_FH_FT_hochT, "aktiv" ); break;
    default: putValue( eMF_FH_FT_hochT, "!?!" );
  }
}

on EnvVar eMF_FH_FT_tiefS
{
  switch (getValue( eMF_FH_FT_tiefS ))
  {
    case  0: putValue( eMF_FH_FT_tiefT, "inaktiv" ); break;
    case  1: putValue( eMF_FH_FT_tiefT, "aktiv" ); break;
    default: putValue( eMF_FH_FT_tiefT, "!?!" );
  }
}

on EnvVar eMF_FH_BT_hochS
{
  switch (getValue( eMF_FH_BT_hochS ))
  {
    case  0: putValue( eMF_FH_BT_hochT, "inaktiv" ); break;
    case  1: putValue( eMF_FH_BT_hochT, "aktiv" ); break;
    default: putValue( eMF_FH_BT_hochT, "!?!" );
  }
}

on EnvVar eMF_FH_BT_tiefS
{
  switch (getValue( eMF_FH_BT_tiefS ))
  {
    case  0: putValue( eMF_FH_BT_tiefT, "inaktiv" ); break;
    case  1: putValue( eMF_FH_BT_tiefT, "aktiv" ); break;
    default: putValue( eMF_FH_BT_tiefT, "!?!" );
  }
}

on EnvVar eLS_defektS
{
  switch (getValue( eLS_defektS ))
  {
    case  0: putValue( eLS_defektT, "OK" ); break;
    case  1: putValue( eLS_defektT, "defekt" ); break;
    default: putValue( eLS_defektT, "!?!" );
  }
}

on EnvVar eLS_VerbauS
{
  switch (getValue( eLS_VerbauS ))
  {
    case  1: putValue( eLS_VerbauT, "Lichtsensor verbaut" ); break;
    default: putValue( eLS_VerbauT, "!?!" );
  }
}

on EnvVar eRS_VerbauS
{
  switch (getValue( eRS_VerbauS ))
  {
    case  1: putValue( eRS_VerbauT, "Regensensor verbaut" ); break;
    default: putValue( eRS_VerbauT, "!?!" );
  }
}

on EnvVar eRS_Verglasung_schliessenS
{
  switch (getValue( eRS_Verglasung_schliessenS ))
  {
    case  0: putValue( eRS_Verglasung_schliessenT, "Verglasung nicht schliessen" ); break;
    case  1: putValue( eRS_Verglasung_schliessenT, "Verglasung schliessen" ); break;
    default: putValue( eRS_Verglasung_schliessenT, "!?!" );
  }
}

on EnvVar eRS_defektS
{
  switch (getValue( eRS_defektS ))
  {
    case  0: putValue( eRS_defektT, "OK" ); break;
    case  1: putValue( eRS_defektT, "defekt" ); break;
    default: putValue( eRS_defektT, "!?!" );
  }
}

on EnvVar eRS_WischergeschwindigkeitS
{
  switch (getValue( eRS_WischergeschwindigkeitS ))
  {
    case  0: putValue( eRS_WischergeschwindigkeitT, "kein Wischen" ); break;
    case  1: putValue( eRS_WischergeschwindigkeitT, "42 Huebe/min" ); break;
    case  2: putValue( eRS_WischergeschwindigkeitT, "45 Huebe/min" ); break;
    case  3: putValue( eRS_WischergeschwindigkeitT, "48 Huebe/min" ); break;
    case  4: putValue( eRS_WischergeschwindigkeitT, "51 Huebe/min" ); break;
    case  5: putValue( eRS_WischergeschwindigkeitT, "54 Huebe/min" ); break;
    case  6: putValue( eRS_WischergeschwindigkeitT, "57 Huebe/min" ); break;
    case  7: putValue( eRS_WischergeschwindigkeitT, "60 Huebe/min" ); break;
    default: putValue( eRS_WischergeschwindigkeitT, "!?!" );
  }
}

on EnvVar eLS_Helligkeit_IR254
{
  if (getValue( this ))
  {
    _LS_Helligkeit_IR = getValue( eLS_Helligkeit_IRS );
    putValue( eLS_Helligkeit_IRS, 101600 );
  }
  else if (getValue( eLS_Helligkeit_IRS ) == 101600)
  {
    if (_LS_Helligkeit_IR != 101600)
      putValue( eLS_Helligkeit_IRS, _LS_Helligkeit_IR );
    else
      putValue( eLS_Helligkeit_IRS, 0 );
  }

}

on EnvVar eLS_Helligkeit_IR255
{
  if (getValue( this ))
  {
    _LS_Helligkeit_IR = getValue( eLS_Helligkeit_IRS );
    putValue( eLS_Helligkeit_IRS, 102000 );
  }
  else if (getValue( eLS_Helligkeit_IRS ) == 102000)
  {
    if (_LS_Helligkeit_IR != 102000)
      putValue( eLS_Helligkeit_IRS, _LS_Helligkeit_IR );
    else
      putValue( eLS_Helligkeit_IRS, 101600 );
  }

}

on EnvVar eLS_Helligkeit_IRS
{
  putValue( eLS_Helligkeit_IR254, getValue( eLS_Helligkeit_IRS ) == 101600 );
  putValue( eLS_Helligkeit_IR255, getValue( eLS_Helligkeit_IRS ) == 102000 );
}

on EnvVar eLS_Helligkeit_FW1022
{
  if (getValue( this ))
  {
    _LS_Helligkeit_FW = getValue( eLS_Helligkeit_FWS );
    putValue( eLS_Helligkeit_FWS, 6132 );
  }
  else if (getValue( eLS_Helligkeit_FWS ) == 6132)
  {
    if (_LS_Helligkeit_FW != 6132)
      putValue( eLS_Helligkeit_FWS, _LS_Helligkeit_FW );
    else
      putValue( eLS_Helligkeit_FWS, 0 );
  }

}

on EnvVar eLS_Helligkeit_FW1023
{
  if (getValue( this ))
  {
    _LS_Helligkeit_FW = getValue( eLS_Helligkeit_FWS );
    putValue( eLS_Helligkeit_FWS, 6138 );
  }
  else if (getValue( eLS_Helligkeit_FWS ) == 6138)
  {
    if (_LS_Helligkeit_FW != 6138)
      putValue( eLS_Helligkeit_FWS, _LS_Helligkeit_FW );
    else
      putValue( eLS_Helligkeit_FWS, 6132 );
  }

}

on EnvVar eLS_Helligkeit_FWS
{
  putValue( eLS_Helligkeit_FW1022, getValue( eLS_Helligkeit_FWS ) == 6132 );
  putValue( eLS_Helligkeit_FW1023, getValue( eLS_Helligkeit_FWS ) == 6138 );
}

on EnvVar eRS_Regenmenge14
{
  if (getValue( this ))
  {
    _RS_Regenmenge = getValue( eRS_RegenmengeS );
    putValue( eRS_RegenmengeS, 140 );
  }
  else if (getValue( eRS_RegenmengeS ) == 140)
  {
    if (_RS_Regenmenge != 140)
      putValue( eRS_RegenmengeS, _RS_Regenmenge );
    else
      putValue( eRS_RegenmengeS, 0 );
  }

}

on EnvVar eRS_Regenmenge15
{
  if (getValue( this ))
  {
    _RS_Regenmenge = getValue( eRS_RegenmengeS );
    putValue( eRS_RegenmengeS, 150 );
  }
  else if (getValue( eRS_RegenmengeS ) == 150)
  {
    if (_RS_Regenmenge != 150)
      putValue( eRS_RegenmengeS, _RS_Regenmenge );
    else
      putValue( eRS_RegenmengeS, 140 );
  }

}

on EnvVar eRS_RegenmengeS
{
  putValue( eRS_Regenmenge14, getValue( eRS_RegenmengeS ) == 140 );
  putValue( eRS_Regenmenge15, getValue( eRS_RegenmengeS ) == 150 );
}

on EnvVar eBH_Blinker_liS
{
  switch (getValue( eBH_Blinker_liS ))
  {
    case  0: putValue( eBH_Blinker_liT, "nicht betaetigt" ); break;
    case  1: putValue( eBH_Blinker_liT, "Blinkerhebel Richtung links betaetigt" ); break;
    default: putValue( eBH_Blinker_liT, "!?!" );
  }
}

on EnvVar eBH_Blinker_reS
{
  switch (getValue( eBH_Blinker_reS ))
  {
    case  0: putValue( eBH_Blinker_reT, "nicht betaetigt" ); break;
    case  1: putValue( eBH_Blinker_reT, "Blinkerhebel Richtung rechts betaetigt" ); break;
    default: putValue( eBH_Blinker_reT, "!?!" );
  }
}

on EnvVar eBH_LichthupeS
{
  switch (getValue( eBH_LichthupeS ))
  {
    case  0: putValue( eBH_LichthupeT, "nicht betaetigt" ); break;
    case  1: putValue( eBH_LichthupeT, "Blinkerhebel in Richtung Lichthupe betaetigt" ); break;
    default: putValue( eBH_LichthupeT, "!?!" );
  }
}

on EnvVar eBH_FernlichtS
{
  switch (getValue( eBH_FernlichtS ))
  {
    case  0: putValue( eBH_FernlichtT, "nicht betaetigt" ); break;
    case  1: putValue( eBH_FernlichtT, "Blinkerhebel in Richtung Fernlicht betaetigt" ); break;
    default: putValue( eBH_FernlichtT, "!?!" );
  }
}

on EnvVar eWH_TipwischenS
{
  switch (getValue( eWH_TipwischenS ))
  {
    case  0: putValue( eWH_TipwischenT, "nicht betaetigt" ); break;
    case  1: putValue( eWH_TipwischenT, "betaetigt" ); break;
    default: putValue( eWH_TipwischenT, "!?!" );
  }
}

on EnvVar eWH_IntervallS
{
  switch (getValue( eWH_IntervallS ))
  {
    case  0: putValue( eWH_IntervallT, "aus" ); break;
    case  1: putValue( eWH_IntervallT, "Wischerhebel in Stellung Intervall" ); break;
    default: putValue( eWH_IntervallT, "!?!" );
  }
}

on EnvVar eWH_WischerStufe1S
{
  switch (getValue( eWH_WischerStufe1S ))
  {
    case  0: putValue( eWH_WischerStufe1T, "aus" ); break;
    case  1: putValue( eWH_WischerStufe1T, "Wischerhebel in Stufe Wischen 1" ); break;
    default: putValue( eWH_WischerStufe1T, "!?!" );
  }
}

on EnvVar eWH_WischerStufe2S
{
  switch (getValue( eWH_WischerStufe2S ))
  {
    case  0: putValue( eWH_WischerStufe2T, "aus" ); break;
    case  1: putValue( eWH_WischerStufe2T, "Wischerhebel in Stufe Wischen 2" ); break;
    default: putValue( eWH_WischerStufe2T, "!?!" );
  }
}

on EnvVar eWH_FrontwaschenS
{
  switch (getValue( eWH_FrontwaschenS ))
  {
    case  0: putValue( eWH_FrontwaschenT, "aus" ); break;
    case  1: putValue( eWH_FrontwaschenT, "Wischerhebel in Stellung Wisch Wasch vorne" ); break;
    default: putValue( eWH_FrontwaschenT, "!?!" );
  }
}

on EnvVar eWH_HeckwaschenS
{
  switch (getValue( eWH_HeckwaschenS ))
  {
    case  0: putValue( eWH_HeckwaschenT, "nicht betaetigt" ); break;
    case  1: putValue( eWH_HeckwaschenT, "Wischerhebel in Stellung Wisch Wasch hinten" ); break;
    default: putValue( eWH_HeckwaschenT, "!?!" );
  }
}

on EnvVar eWH_IntervallstufenS
{
  switch (getValue( eWH_IntervallstufenS ))
  {
    case  0: putValue( eWH_IntervallstufenT, "Init / Default" ); break;
    case  1: putValue( eWH_IntervallstufenT, "Intervallstufe 1" ); break;
    case  5: putValue( eWH_IntervallstufenT, "Intervallstufe 2" ); break;
    case  9: putValue( eWH_IntervallstufenT, "Intervallstufe 3" ); break;
    case 13: putValue( eWH_IntervallstufenT, "Intervallstufe 4" ); break;
    case 15: putValue( eWH_IntervallstufenT, "Fehler" ); break;
    default: putValue( eWH_IntervallstufenT, "!?!" );
  }
}

on EnvVar eFAS_TasterS
{
  switch (getValue( eFAS_TasterS ))
  {
    case  0: putValue( eFAS_TasterT, "nicht betaetigt" ); break;
    case  1: putValue( eFAS_TasterT, "betaetigt" ); break;
    default: putValue( eFAS_TasterT, "!?!" );
  }
}

on EnvVar eFAS_Taster_FehlerS
{
  switch (getValue( eFAS_Taster_FehlerS ))
  {
    case  0: putValue( eFAS_Taster_FehlerT, "kein Fehler" ); break;
    case  1: putValue( eFAS_Taster_FehlerT, "Fehler" ); break;
    default: putValue( eFAS_Taster_FehlerT, "!?!" );
  }
}

on EnvVar eSMLS_HupeS
{
  switch (getValue( eSMLS_HupeS ))
  {
    case  0: putValue( eSMLS_HupeT, "nicht betaetigt" ); break;
    case  1: putValue( eSMLS_HupeT, "Hupe gedrueckt" ); break;
    default: putValue( eSMLS_HupeT, "!?!" );
  }
}

on EnvVar eLRH_on_offS
{
  switch (getValue( eLRH_on_offS ))
  {
    case  0: putValue( eLRH_on_offT, "Keine Anzeige" ); break;
    case  1: putValue( eLRH_on_offT, "Lenradheizung aus" ); break;
    case  2: putValue( eLRH_on_offT, "Lenkradheizung ein" ); break;
    case  3: putValue( eLRH_on_offT, "res" ); break;
    default: putValue( eLRH_on_offT, "!?!" );
  }
}

on EnvVar eLSS_Tastencode0
{
  if (getValue( this ))
  {
    _LSS_Tastencode = getValue( eLSS_TastencodeS );
    putValue( eLSS_TastencodeS, 0 );
  }
  else if (getValue( eLSS_TastencodeS ) == 0)
  {
    if (_LSS_Tastencode != 0)
      putValue( eLSS_TastencodeS, _LSS_Tastencode );
    else
      putValue( eLSS_TastencodeS, 1 );
  }

}

on EnvVar eLSS_Tastencode4
{
  if (getValue( this ))
  {
    _LSS_Tastencode = getValue( eLSS_TastencodeS );
    putValue( eLSS_TastencodeS, 4 );
  }
  else if (getValue( eLSS_TastencodeS ) == 4)
  {
    if (_LSS_Tastencode != 4)
      putValue( eLSS_TastencodeS, _LSS_Tastencode );
    else
      putValue( eLSS_TastencodeS, 0 );
  }

}

on EnvVar eLSS_Tastencode5
{
  if (getValue( this ))
  {
    _LSS_Tastencode = getValue( eLSS_TastencodeS );
    putValue( eLSS_TastencodeS, 5 );
  }
  else if (getValue( eLSS_TastencodeS ) == 5)
  {
    if (_LSS_Tastencode != 5)
      putValue( eLSS_TastencodeS, _LSS_Tastencode );
    else
      putValue( eLSS_TastencodeS, 0 );
  }

}

on EnvVar eLSS_Tastencode7
{
  if (getValue( this ))
  {
    _LSS_Tastencode = getValue( eLSS_TastencodeS );
    putValue( eLSS_TastencodeS, 7 );
  }
  else if (getValue( eLSS_TastencodeS ) == 7)
  {
    if (_LSS_Tastencode != 7)
      putValue( eLSS_TastencodeS, _LSS_Tastencode );
    else
      putValue( eLSS_TastencodeS, 0 );
  }

}

on EnvVar eLSS_TastencodeS
{
  putValue( eLSS_Tastencode0, getValue( eLSS_TastencodeS ) == 0 );
  putValue( eLSS_Tastencode4, getValue( eLSS_TastencodeS ) == 4 );
  putValue( eLSS_Tastencode5, getValue( eLSS_TastencodeS ) == 5 );
  putValue( eLSS_Tastencode7, getValue( eLSS_TastencodeS ) == 7 );
}

on EnvVar eSTS_Car_not_under_theftS
{
  switch (getValue( eSTS_Car_not_under_theftS ))
  {
    case  0: putValue( eSTS_Car_not_under_theftT, "false" ); break;
    case  1: putValue( eSTS_Car_not_under_theftT, "true" ); break;
    default: putValue( eSTS_Car_not_under_theftT, "!?!" );
  }
}

on EnvVar eSTS_Car_under_theftS
{
  switch (getValue( eSTS_Car_under_theftS ))
  {
    case  0: putValue( eSTS_Car_under_theftT, "false" ); break;
    case  1: putValue( eSTS_Car_under_theftT, "true" ); break;
    default: putValue( eSTS_Car_under_theftT, "!?!" );
  }
}

on EnvVar eSTS_AnlassersperreS
{
  switch (getValue( eSTS_AnlassersperreS ))
  {
    case  0: putValue( eSTS_AnlassersperreT, "inaktiv" ); break;
    case  1: putValue( eSTS_AnlassersperreT, "aktiv" ); break;
    default: putValue( eSTS_AnlassersperreT, "!?!" );
  }
}

on EnvVar eSTS_TypencodierungS
{
  switch (getValue( eSTS_TypencodierungS ))
  {
    case  0: putValue( eSTS_TypencodierungT, "Basis" ); break;
    case  1: putValue( eSTS_TypencodierungT, "E-Gas" ); break;
    case  4: putValue( eSTS_TypencodierungT, "Sonderschutz" ); break;
    default: putValue( eSTS_TypencodierungT, "!?!" );
  }
}

on EnvVar eSTS_StandlichtS
{
  switch (getValue( eSTS_StandlichtS ))
  {
    case  0: putValue( eSTS_StandlichtT, "inaktiv" ); break;
    case  1: putValue( eSTS_StandlichtT, "aktiv" ); break;
    default: putValue( eSTS_StandlichtT, "!?!" );
  }
}

on EnvVar eSTS_FahrlichtS
{
  switch (getValue( eSTS_FahrlichtS ))
  {
    case  0: putValue( eSTS_FahrlichtT, "inaktiv" ); break;
    case  1: putValue( eSTS_FahrlichtT, "aktiv" ); break;
    default: putValue( eSTS_FahrlichtT, "!?!" );
  }
}

on EnvVar eSTS_Alarm_stillS
{
  switch (getValue( eSTS_Alarm_stillS ))
  {
    case  0: putValue( eSTS_Alarm_stillT, "inaktiv" ); break;
    case  1: putValue( eSTS_Alarm_stillT, "aktiv" ); break;
    default: putValue( eSTS_Alarm_stillT, "!?!" );
  }
}

on EnvVar eSTS_TexteS
{
  switch (getValue( eSTS_TexteS ))
  {
    case  0: putValue( eSTS_TexteT, "kein Text" ); break;
    case  1: putValue( eSTS_TexteT, "Text 01" ); break;
    case  2: putValue( eSTS_TexteT, "Text 02" ); break;
    case  3: putValue( eSTS_TexteT, "Text 03" ); break;
    case  4: putValue( eSTS_TexteT, "Text 04" ); break;
    case  5: putValue( eSTS_TexteT, "Text 05" ); break;
    case  6: putValue( eSTS_TexteT, "Text 06" ); break;
    case  7: putValue( eSTS_TexteT, "Text 07" ); break;
    case  8: putValue( eSTS_TexteT, "Text 08" ); break;
    case  9: putValue( eSTS_TexteT, "Text 09" ); break;
    case 10: putValue( eSTS_TexteT, "Text 10" ); break;
    case 11: putValue( eSTS_TexteT, "Text 11" ); break;
    case 12: putValue( eSTS_TexteT, "Text 12" ); break;
    case 13: putValue( eSTS_TexteT, "Text 13" ); break;
    case 14: putValue( eSTS_TexteT, "Init" ); break;
    case 15: putValue( eSTS_TexteT, "Fehler" ); break;
    default: putValue( eSTS_TexteT, "!?!" );
  }
}

on EnvVar eSTS_LaderelaisS
{
  switch (getValue( eSTS_LaderelaisS ))
  {
    case  0: putValue( eSTS_LaderelaisT, "Relais offen" ); break;
    case  1: putValue( eSTS_LaderelaisT, "Relais geschlossen" ); break;
    default: putValue( eSTS_LaderelaisT, "!?!" );
  }
}

on EnvVar eSTS_SummerS
{
  switch (getValue( eSTS_SummerS ))
  {
    case  0: putValue( eSTS_SummerT, "inaktiv" ); break;
    case  1: putValue( eSTS_SummerT, "aktiv" ); break;
    default: putValue( eSTS_SummerT, "!?!" );
  }
}

on EnvVar eSTS_NotstartS
{
  switch (getValue( eSTS_NotstartS ))
  {
    case  0: putValue( eSTS_NotstartT, "kein Notstart" ); break;
    case  1: putValue( eSTS_NotstartT, "Notstart" ); break;
    default: putValue( eSTS_NotstartT, "!?!" );
  }
}

on EnvVar eSTS_SignalhornS
{
  switch (getValue( eSTS_SignalhornS ))
  {
    case  0: putValue( eSTS_SignalhornT, "inaktiv" ); break;
    case  1: putValue( eSTS_SignalhornT, "aktiv" ); break;
    default: putValue( eSTS_SignalhornT, "!?!" );
  }
}

on EnvVar eSTS_LeerlaufschaltungS
{
  switch (getValue( eSTS_LeerlaufschaltungS ))
  {
    case  0: putValue( eSTS_LeerlaufschaltungT, "Leerlaufschaltung Aus" ); break;
    case  1: putValue( eSTS_LeerlaufschaltungT, "Leerlaufschaltung Ein" ); break;
    default: putValue( eSTS_LeerlaufschaltungT, "!?!" );
  }
}

on EnvVar eTCO_Driver1_DSS
{
  switch (getValue( eTCO_Driver1_DSS ))
  {
    case  0: putValue( eTCO_Driver1_DST, "Pause" ); break;
    case  1: putValue( eTCO_Driver1_DST, "Verfuegbar" ); break;
    case  2: putValue( eTCO_Driver1_DST, "Arbeitet" ); break;
    case  3: putValue( eTCO_Driver1_DST, "Faehrt" ); break;
    case  6: putValue( eTCO_Driver1_DST, "Fehler" ); break;
    case  7: putValue( eTCO_Driver1_DST, "na" ); break;
    default: putValue( eTCO_Driver1_DST, "!?!" );
  }
}

on EnvVar eTCO_Driver2_DSS
{
  switch (getValue( eTCO_Driver2_DSS ))
  {
    case  0: putValue( eTCO_Driver2_DST, "Pause" ); break;
    case  1: putValue( eTCO_Driver2_DST, "Verfuegbar" ); break;
    case  2: putValue( eTCO_Driver2_DST, "Arbeitet" ); break;
    case  3: putValue( eTCO_Driver2_DST, "Faehrt" ); break;
    case  6: putValue( eTCO_Driver2_DST, "Fehler" ); break;
    case  7: putValue( eTCO_Driver2_DST, "na" ); break;
    default: putValue( eTCO_Driver2_DST, "!?!" );
  }
}

on EnvVar eTCO_FahrerkennS
{
  switch (getValue( eTCO_FahrerkennS ))
  {
    case  0: putValue( eTCO_FahrerkennT, "Fahrzeug steht" ); break;
    case  1: putValue( eTCO_FahrerkennT, "Fahrzeug faehrt" ); break;
    case  2: putValue( eTCO_FahrerkennT, "Fehler" ); break;
    case  3: putValue( eTCO_FahrerkennT, "na" ); break;
    default: putValue( eTCO_FahrerkennT, "!?!" );
  }
}

on EnvVar eTCO_System_EvS
{
  switch (getValue( eTCO_System_EvS ))
  {
    case  0: putValue( eTCO_System_EvT, "no system event" ); break;
    case  1: putValue( eTCO_System_EvT, "system event" ); break;
    case  2: putValue( eTCO_System_EvT, "Fehler" ); break;
    case  3: putValue( eTCO_System_EvT, "na" ); break;
    default: putValue( eTCO_System_EvT, "!?!" );
  }
}

on EnvVar eTCO_Handle_InfS
{
  switch (getValue( eTCO_Handle_InfS ))
  {
    case  0: putValue( eTCO_Handle_InfT, "no handling info" ); break;
    case  1: putValue( eTCO_Handle_InfT, "handling info" ); break;
    case  2: putValue( eTCO_Handle_InfT, "Fehler" ); break;
    case  3: putValue( eTCO_Handle_InfT, "na" ); break;
    default: putValue( eTCO_Handle_InfT, "!?!" );
  }
}

on EnvVar eTCO_Sys_PerfS
{
  switch (getValue( eTCO_Sys_PerfS ))
  {
    case  0: putValue( eTCO_Sys_PerfT, "no system performance" ); break;
    case  1: putValue( eTCO_Sys_PerfT, "system performance" ); break;
    case  2: putValue( eTCO_Sys_PerfT, "Fehler" ); break;
    case  3: putValue( eTCO_Sys_PerfT, "na" ); break;
    default: putValue( eTCO_Sys_PerfT, "!?!" );
  }
}

on EnvVar eTCO_Dir_IndS
{
  switch (getValue( eTCO_Dir_IndS ))
  {
    case  0: putValue( eTCO_Dir_IndT, "forward" ); break;
    case  1: putValue( eTCO_Dir_IndT, "reverse" ); break;
    case  2: putValue( eTCO_Dir_IndT, "Fehler" ); break;
    case  3: putValue( eTCO_Dir_IndT, "na" ); break;
    default: putValue( eTCO_Dir_IndT, "!?!" );
  }
}

on EnvVar eWischer_vorne_aktivS
{
  switch (getValue( eWischer_vorne_aktivS ))
  {
    case  1: putValue( eWischer_vorne_aktivT, "Wischer vorne läuft" ); break;
    default: putValue( eWischer_vorne_aktivT, "!?!" );
  }
}

on EnvVar eWaschen_vorne_aktivS
{
  switch (getValue( eWaschen_vorne_aktivS ))
  {
    case  1: putValue( eWaschen_vorne_aktivT, "Waschen aktiv" ); break;
    default: putValue( eWaschen_vorne_aktivT, "!?!" );
  }
}

on EnvVar eWischer_vorne_NormalS
{
  switch (getValue( eWischer_vorne_NormalS ))
  {
    case  1: putValue( eWischer_vorne_NormalT, "Wischer Front normal aktiv" ); break;
    default: putValue( eWischer_vorne_NormalT, "!?!" );
  }
}

on EnvVar eWischer_vorne_SchnellS
{
  switch (getValue( eWischer_vorne_SchnellS ))
  {
    case  1: putValue( eWischer_vorne_SchnellT, "Wischer vorne schnell aktiv" ); break;
    default: putValue( eWischer_vorne_SchnellT, "!?!" );
  }
}

on EnvVar eWischer_vorne_ParklageS
{
  switch (getValue( eWischer_vorne_ParklageS ))
  {
    case  1: putValue( eWischer_vorne_ParklageT, "Wischer Front in Parklage" ); break;
    default: putValue( eWischer_vorne_ParklageT, "!?!" );
  }
}

on EnvVar eWischer_vorne_defektS
{
  switch (getValue( eWischer_vorne_defektS ))
  {
    case  1: putValue( eWischer_vorne_defektT, "Wischer vorne defekt" ); break;
    default: putValue( eWischer_vorne_defektT, "!?!" );
  }
}

on EnvVar eWischer_vorne_blockiertS
{
  switch (getValue( eWischer_vorne_blockiertS ))
  {
    case  1: putValue( eWischer_vorne_blockiertT, "Wischer vorne blockiert" ); break;
    default: putValue( eWischer_vorne_blockiertT, "!?!" );
  }
}

on EnvVar eBCM_FH_FreigabeS
{
  switch (getValue( eBCM_FH_FreigabeS ))
  {
    case  1: putValue( eBCM_FH_FreigabeT, "Funktionsfreigabe Fensterheber" ); break;
    default: putValue( eBCM_FH_FreigabeT, "!?!" );
  }
}

on EnvVar eBCM_Komfortfkt_FreigabeS
{
  switch (getValue( eBCM_Komfortfkt_FreigabeS ))
  {
    case  0: putValue( eBCM_Komfortfkt_FreigabeT, "Komfortfunktion gesperrt" ); break;
    case  1: putValue( eBCM_Komfortfkt_FreigabeT, "globale Freigabe der Komfortfunktion erteilt" ); break;
    default: putValue( eBCM_Komfortfkt_FreigabeT, "!?!" );
  }
}

on EnvVar eBCM_HSK_FreigabeS
{
  switch (getValue( eBCM_HSK_FreigabeS ))
  {
    case  0: putValue( eBCM_HSK_FreigabeT, "erlauben" ); break;
    case  1: putValue( eBCM_HSK_FreigabeT, "sperren" ); break;
    default: putValue( eBCM_HSK_FreigabeT, "!?!" );
  }
}

on EnvVar eBCM_Verdeck_FreigabeS
{
  switch (getValue( eBCM_Verdeck_FreigabeS ))
  {
    case  0: putValue( eBCM_Verdeck_FreigabeT, "Verdeckbetrieb nicht erlaubt" ); break;
    case  1: putValue( eBCM_Verdeck_FreigabeT, "Verdeckbetrieb erlaubt" ); break;
    default: putValue( eBCM_Verdeck_FreigabeT, "!?!" );
  }
}

on EnvVar eZV_verriegelt_intern_istS
{
  switch (getValue( eZV_verriegelt_intern_istS ))
  {
    case  1: putValue( eZV_verriegelt_intern_istT, "Fahrzeug innen verrieglt; Istzustand" ); break;
    default: putValue( eZV_verriegelt_intern_istT, "!?!" );
  }
}

on EnvVar eZV_verriegelt_extern_istS
{
  switch (getValue( eZV_verriegelt_extern_istS ))
  {
    case  1: putValue( eZV_verriegelt_extern_istT, "Fahrzeug aussen verriegelt Istzustand" ); break;
    default: putValue( eZV_verriegelt_extern_istT, "!?!" );
  }
}

on EnvVar eZV_verriegelt_intern_sollS
{
  switch (getValue( eZV_verriegelt_intern_sollS ))
  {
    case  1: putValue( eZV_verriegelt_intern_sollT, "Fahrzeug verriegelt intern; Sollzusstand" ); break;
    default: putValue( eZV_verriegelt_intern_sollT, "!?!" );
  }
}

on EnvVar eZV_verriegelt_extern_sollS
{
  switch (getValue( eZV_verriegelt_extern_sollS ))
  {
    case  1: putValue( eZV_verriegelt_extern_sollT, "Fahrzeug verriegelt extern; Sollzusstand" ); break;
    default: putValue( eZV_verriegelt_extern_sollT, "!?!" );
  }
}

on EnvVar eZV_gesafet_extern_istS
{
  switch (getValue( eZV_gesafet_extern_istS ))
  {
    case  1: putValue( eZV_gesafet_extern_istT, "Fahrzeug aussen gesafet; Istzustand" ); break;
    default: putValue( eZV_gesafet_extern_istT, "!?!" );
  }
}

on EnvVar eZV_gesafet_extern_sollS
{
  switch (getValue( eZV_gesafet_extern_sollS ))
  {
    case  1: putValue( eZV_gesafet_extern_sollT, "Fahrzeug aussen gesafet Sollzustand" ); break;
    default: putValue( eZV_gesafet_extern_sollT, "!?!" );
  }
}

on EnvVar eZV_EinzeltuerentriegelungS
{
  switch (getValue( eZV_EinzeltuerentriegelungS ))
  {
    case  1: putValue( eZV_EinzeltuerentriegelungT, "Fahrzeug an Einzeltuer entriegelt" ); break;
    default: putValue( eZV_EinzeltuerentriegelungT, "!?!" );
  }
}

on EnvVar eZV_HeckeinzelentriegelungS
{
  switch (getValue( eZV_HeckeinzelentriegelungS ))
  {
    case  1: putValue( eZV_HeckeinzelentriegelungT, "Heckdeckeleinzelentriegelung" ); break;
    default: putValue( eZV_HeckeinzelentriegelungT, "!?!" );
  }
}

on EnvVar eZV_FT_offenS
{
  switch (getValue( eZV_FT_offenS ))
  {
    case  1: putValue( eZV_FT_offenT, "FT geoeffnet" ); break;
    default: putValue( eZV_FT_offenT, "!?!" );
  }
}

on EnvVar eZV_BT_offenS
{
  switch (getValue( eZV_BT_offenS ))
  {
    case  1: putValue( eZV_BT_offenT, "BT geoeffnet" ); break;
    default: putValue( eZV_BT_offenT, "!?!" );
  }
}

on EnvVar eZV_HFS_offenS
{
  switch (getValue( eZV_HFS_offenS ))
  {
    case  0: putValue( eZV_HFS_offenT, "geschlossen" ); break;
    case  1: putValue( eZV_HFS_offenT, "offen" ); break;
    default: putValue( eZV_HFS_offenT, "!?!" );
  }
}

on EnvVar eZV_HBFS_offenS
{
  switch (getValue( eZV_HBFS_offenS ))
  {
    case  0: putValue( eZV_HBFS_offenT, "geschlossen" ); break;
    case  1: putValue( eZV_HBFS_offenT, "offen" ); break;
    default: putValue( eZV_HBFS_offenT, "!?!" );
  }
}

on EnvVar eZV_HD_offenS
{
  switch (getValue( eZV_HD_offenS ))
  {
    case  1: putValue( eZV_HD_offenT, "Heckdeckel auf" ); break;
    default: putValue( eZV_HD_offenT, "!?!" );
  }
}

on EnvVar eZV_HS_offenS
{
  switch (getValue( eZV_HS_offenS ))
  {
    case  0: putValue( eZV_HS_offenT, "Heckscheibe geschlossen" ); break;
    case  1: putValue( eZV_HS_offenT, "Heckscheibe auf" ); break;
    default: putValue( eZV_HS_offenT, "!?!" );
  }
}

on EnvVar eIRUE_aktivS
{
  switch (getValue( eIRUE_aktivS ))
  {
    case  0: putValue( eIRUE_aktivT, "unscharf" ); break;
    case  1: putValue( eIRUE_aktivT, "scharf" ); break;
    default: putValue( eIRUE_aktivT, "!?!" );
  }
}

on EnvVar eDWA_aktivS
{
  switch (getValue( eDWA_aktivS ))
  {
    case  0: putValue( eDWA_aktivT, "unscharf" ); break;
    case  1: putValue( eDWA_aktivT, "scharf" ); break;
    default: putValue( eDWA_aktivT, "!?!" );
  }
}

on EnvVar eHD_HauptrasteS
{
  switch (getValue( eHD_HauptrasteS ))
  {
    case  0: putValue( eHD_HauptrasteT, "geschlossen" ); break;
    case  1: putValue( eHD_HauptrasteT, "offen" ); break;
    default: putValue( eHD_HauptrasteT, "!?!" );
  }
}

on EnvVar eHD_VorrasteS
{
  switch (getValue( eHD_VorrasteS ))
  {
    case  0: putValue( eHD_VorrasteT, "geschlossen" ); break;
    case  1: putValue( eHD_VorrasteT, "offen" ); break;
    default: putValue( eHD_VorrasteT, "!?!" );
  }
}

on EnvVar eFFB_HDF_TasteS
{
  switch (getValue( eFFB_HDF_TasteS ))
  {
    case  0: putValue( eFFB_HDF_TasteT, "Taste nicht betaetigt" ); break;
    case  1: putValue( eFFB_HDF_TasteT, "HDF Taste am Funkschluessel betaetigt" ); break;
    default: putValue( eFFB_HDF_TasteT, "!?!" );
  }
}

on EnvVar eFFB_Panik_TasteS
{
  switch (getValue( eFFB_Panik_TasteS ))
  {
    case  0: putValue( eFFB_Panik_TasteT, "Taste nicht betaetigt" ); break;
    case  1: putValue( eFFB_Panik_TasteT, "Panik Taste am Funkschluessel betaetigt" ); break;
    default: putValue( eFFB_Panik_TasteT, "!?!" );
  }
}

on EnvVar eFFB_Auf_TasteS
{
  switch (getValue( eFFB_Auf_TasteS ))
  {
    case  0: putValue( eFFB_Auf_TasteT, "Taste nicht betaetigt" ); break;
    case  1: putValue( eFFB_Auf_TasteT, "Oeffnentaste betaetigt" ); break;
    default: putValue( eFFB_Auf_TasteT, "!?!" );
  }
}

on EnvVar eFFB_Zu_TasteS
{
  switch (getValue( eFFB_Zu_TasteS ))
  {
    case  0: putValue( eFFB_Zu_TasteT, "Taste nicht betaetigt" ); break;
    case  1: putValue( eFFB_Zu_TasteT, "Zu Taste am Funkschluessel betaetigt" ); break;
    default: putValue( eFFB_Zu_TasteT, "!?!" );
  }
}

on EnvVar eFFB_CarFinderS
{
  switch (getValue( eFFB_CarFinderS ))
  {
    case  0: putValue( eFFB_CarFinderT, "nicht aktiv" ); break;
    case  1: putValue( eFFB_CarFinderT, "aktiv" ); break;
    default: putValue( eFFB_CarFinderT, "!?!" );
  }
}

on EnvVar eFFB_KomfortoeffnenS
{
  switch (getValue( eFFB_KomfortoeffnenS ))
  {
    case  0: putValue( eFFB_KomfortoeffnenT, "kein Komfortoeffnen empfangen" ); break;
    case  1: putValue( eFFB_KomfortoeffnenT, "Komfortoeffnen ueber Funk empfangen" ); break;
    default: putValue( eFFB_KomfortoeffnenT, "!?!" );
  }
}

on EnvVar eFFB_KomfortschliessenS
{
  switch (getValue( eFFB_KomfortschliessenS ))
  {
    case  0: putValue( eFFB_KomfortschliessenT, "kein Komfortschliessen empfangen" ); break;
    case  1: putValue( eFFB_KomfortschliessenT, "Komfortschliessen ueber Funk empfangen" ); break;
    default: putValue( eFFB_KomfortschliessenT, "!?!" );
  }
}

on EnvVar eFBS_IDG_in_ReichweiteS
{
  switch (getValue( eFBS_IDG_in_ReichweiteS ))
  {
    case  0: putValue( eFBS_IDG_in_ReichweiteT, "keine Reichweite ermittelbar / ausser Reichweite" ); break;
    case  1: putValue( eFBS_IDG_in_ReichweiteT, "innerhalb Reichweite" ); break;
    default: putValue( eFBS_IDG_in_ReichweiteT, "!?!" );
  }
}

on EnvVar eZV_SafeFunktion_aktivS
{
  switch (getValue( eZV_SafeFunktion_aktivS ))
  {
    case  0: putValue( eZV_SafeFunktion_aktivT, "inaktiv" ); break;
    case  1: putValue( eZV_SafeFunktion_aktivT, "aktiv" ); break;
    default: putValue( eZV_SafeFunktion_aktivT, "!?!" );
  }
}

on EnvVar eFBS_Warn_Schluessel_BattS
{
  switch (getValue( eFBS_Warn_Schluessel_BattS ))
  {
    case  0: putValue( eFBS_Warn_Schluessel_BattT, "i.O." ); break;
    case  1: putValue( eFBS_Warn_Schluessel_BattT, "defekt" ); break;
    default: putValue( eFBS_Warn_Schluessel_BattT, "!?!" );
  }
}

// ===== END OF GENERATED CODE =====


