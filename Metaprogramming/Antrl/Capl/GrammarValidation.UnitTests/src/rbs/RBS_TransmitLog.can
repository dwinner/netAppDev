/*@!Encoding:1252*/
variables
{
    dword file_handle; 
    dword phototransistor_file; 

    long sig_val;
    char sig_str[10];
    msTimer log_timer; 
    
    float curr_time;
    char curr_time_str[20];
 
    word max_pt_val;
    word min_pt_val;

    char photo_transistor_max[10];
    char photo_transistor_min[10];

    byte index = 0;
}

on envVar eStartWriteLog
{
    if (getValue(this))
    {        
        file_handle = openFileWrite ("Logs\\Transmit_Signals.txt", 0);

        if (file_handle != 0)
        {
            putValue(eStatusMsg, "File loading successful");           
            filePutString ("TRANSMIT SIGNAL LOG\n", elCount("TRANSMIT SIGNAL LOG\n"), file_handle);
            filePutString ("===================\n", elCount("===================\n"), file_handle);
            filePutString ("TIME(in sec) | SIGNAL NAME | VALUE\n", elCount("TIME(in sec)  SIGNAL NAME   VALUE\n"), file_handle);
            filePutString ("----------------------------------\n", elCount("----------------------------------\n"), file_handle);

            setTimer (log_timer, getValue(eLogInterval));
        }   
        else
        {
            putValue(eStatusMsg, "File loading unsuccessful");
        }    
    }
}

on envVar eStopWriteLog
{
    cancelTimer (log_timer);
    putValue (eStartWriteLog, 0);
    putValue (eStopWriteLog, 0);
    putValue (eStatusMsg, "Logging stopped");
    fileClose (file_handle);

    if (getValue (eWrite_KBI_Phototransistor))
    {
        ltoa(min_pt_val, photo_transistor_min, 10);
        ltoa(max_pt_val, photo_transistor_max, 10);
              
        phototransistor_file = openFileWrite ("Logs\\KBI_Phototransistor.txt", 0);

        if (file_handle != 0)
        {            
            filePutString ("Min. and Max. value for KBI_Phototransistor\n", elCount("Min. and Max. value for KBI_Phototransistor\n") , phototransistor_file);
            filePutString ("===========================================\n", elCount("===========================================\n") , phototransistor_file);

            filePutString ("Min. value - ", elCount("Min value - ") , phototransistor_file);            
            filePutString (photo_transistor_min, elCount(photo_transistor_min) , phototransistor_file);
            filePutString ("\n", elCount("\n") , phototransistor_file);

            filePutString ("Max. value - ", elCount("Max value - ") , phototransistor_file);            
            filePutString (photo_transistor_max, elCount(photo_transistor_max) , phototransistor_file);
            filePutString ("\n", elCount("\n") , phototransistor_file);

            fileClose (phototransistor_file);
        }
    }
}

on timer log_timer
{    
    /* Einheiten_01 */
    if (getValue (eWrite_KBI_Einheit_Datum))
    {        
        sig_val = getValue (eKBI_Einheit_DatumD);
        ltoa(sig_val, sig_str, 10);

        curr_time = (timeNow()/100000.0); //current time in seconds       
        snprintf(curr_time_str,elcount(curr_time_str),"%f\t", curr_time);                

        filePutString (curr_time_str, elCount(curr_time_str), file_handle);
        filePutString ("KBI_Einheit_Datum\t", elCount("KBI_Einheit_Datum\t") , file_handle);
        filePutString (sig_str, elCount(sig_str) , file_handle);
        filePutString ("\n", elCount("\n") , file_handle);
    }

    if (getValue (eWrite_KBI_Einheit_Druck))
    {        
        sig_val = getValue (eKBI_Einheit_DruckD);
        ltoa(sig_val, sig_str, 10);

        curr_time = (timeNow()/100000.0); //current time in seconds       
        snprintf(curr_time_str,elcount(curr_time_str),"%f\t", curr_time);                

        filePutString (curr_time_str, elCount(curr_time_str), file_handle);
        filePutString ("KBI_Einheit_Druck\t", elCount("KBI_Einheit_Druck\t") , file_handle);
        filePutString (sig_str, elCount(sig_str) , file_handle);
        filePutString ("\n", elCount("\n") , file_handle);
    }

    if (getValue (eWrite_KBI_Einheit_Streckenanz))
    {        
        sig_val = getValue (eKBI_Einheit_StreckenanzD);
        ltoa(sig_val, sig_str, 10);

        curr_time = (timeNow()/100000.0); //current time in seconds       
        snprintf(curr_time_str,elcount(curr_time_str),"%f\t", curr_time);                

        filePutString (curr_time_str, elCount(curr_time_str), file_handle);
        filePutString ("KBI_Einheit_Streckenanz\t", elCount("KBI_Einheit_Streckenanz\t") , file_handle);
        filePutString (sig_str, elCount(sig_str) , file_handle);
        filePutString ("\n", elCount("\n") , file_handle);
    }

    if (getValue (eWrite_KBI_MFA_v_Einheit_02))
    {        
        sig_val = getValue (eKBI_MFA_v_Einheit_02D);
        ltoa(sig_val, sig_str, 10);

        curr_time = (timeNow()/100000.0); //current time in seconds       
        snprintf(curr_time_str,elcount(curr_time_str),"%f\t", curr_time);                

        filePutString (curr_time_str, elCount(curr_time_str), file_handle);
        filePutString ("KBI_MFA_v_Einheit_02\t", elCount("KBI_MFA_v_Einheit_02\t") , file_handle);
        filePutString (sig_str, elCount(sig_str) , file_handle);
        filePutString ("\n", elCount("\n") , file_handle);
    }
    
    if (getValue (eWrite_KBI_Einheit_Temp))
    {        
        sig_val = getValue (eKBI_Einheit_TempD);
        ltoa(sig_val, sig_str, 10);

        curr_time = (timeNow()/100000.0); //current time in seconds       
        snprintf(curr_time_str,elcount(curr_time_str),"%f\t", curr_time);                

        filePutString (curr_time_str, elCount(curr_time_str), file_handle);
        filePutString ("KBI_Einheit_Temp\t", elCount("KBI_Einheit_Temp\t") , file_handle);
        filePutString (sig_str, elCount(sig_str) , file_handle);
        filePutString ("\n", elCount("\n") , file_handle);
    }

    if (getValue (eWrite_KBI_Einheit_Uhrzeit))
    {        
        sig_val = getValue (eKBI_Einheit_UhrzeitD);
        ltoa(sig_val, sig_str, 10);

        curr_time = (timeNow()/100000.0); //current time in seconds       
        snprintf(curr_time_str,elcount(curr_time_str),"%f\t", curr_time);                

        filePutString (curr_time_str, elCount(curr_time_str), file_handle);
        filePutString ("KBI_Einheit_Uhrzeit\t", elCount("KBI_Einheit_Uhrzeit\t") , file_handle);
        filePutString (sig_str, elCount(sig_str) , file_handle);
        filePutString ("\n", elCount("\n") , file_handle);
    }
    
    if (getValue (eWrite_KBI_Einheit_Verbrauch))
    {        
        sig_val = getValue (eKBI_Einheit_VerbrauchD);
        ltoa(sig_val, sig_str, 10);

        curr_time = (timeNow()/100000.0); //current time in seconds       
        snprintf(curr_time_str,elcount(curr_time_str),"%f\t", curr_time);                

        filePutString (curr_time_str, elCount(curr_time_str), file_handle);
        filePutString ("KBI_Einheit_Verbrauch\t", elCount("KBI_Einheit_Verbrauch\t") , file_handle);
        filePutString (sig_str, elCount(sig_str) , file_handle);
        filePutString ("\n", elCount("\n") , file_handle);
    }
    
    if (getValue (eWrite_KBI_Einheit_Volumen))
    {        
        sig_val = getValue (eKBI_Einheit_VolumenD);
        ltoa(sig_val, sig_str, 10);

        curr_time = (timeNow()/100000.0); //current time in seconds       
        snprintf(curr_time_str,elcount(curr_time_str),"%f\t", curr_time);                

        filePutString (curr_time_str, elCount(curr_time_str), file_handle);
        filePutString ("KBI_Einheit_Volumen\t", elCount("KBI_Einheit_Volumen\t") , file_handle);
        filePutString (sig_str, elCount(sig_str) , file_handle);
        filePutString ("\n", elCount("\n") , file_handle);
    }

    if (getValue (eWrite_KBI_Einheit_Sprache))
    {        
        sig_val = getValue (eKBI_Einheit_SpracheD);
        ltoa(sig_val, sig_str, 10);

        curr_time = (timeNow()/100000.0); //current time in seconds       
        snprintf(curr_time_str,elcount(curr_time_str),"%f\t", curr_time);                

        filePutString (curr_time_str, elCount(curr_time_str), file_handle);
        filePutString ("KBI_Einheit_Sprache\t", elCount("KBI_Einheit_Sprache\t") , file_handle);
        filePutString (sig_str, elCount(sig_str) , file_handle);
        filePutString ("\n", elCount("\n") , file_handle);
    }

    /* Kombi_01 */
    if (getValue (eWrite_KBI_ABS_Lampe))
    {        
        sig_val = getValue (eKBI_ABS_LampeD);
        ltoa(sig_val, sig_str, 10);

        curr_time = (timeNow()/100000.0); //current time in seconds       
        snprintf(curr_time_str,elcount(curr_time_str),"%f\t", curr_time);                

        filePutString (curr_time_str, elCount(curr_time_str), file_handle);
        filePutString ("KBI_ABS_Lampe\t", elCount("KBI_ABS_Lampe\t") , file_handle);
        filePutString (sig_str, elCount(sig_str) , file_handle);
        filePutString ("\n", elCount("\n") , file_handle);
    }
    
    if (getValue (eWrite_KBI_ESP_Lampe))
    {        
        sig_val = getValue (eKBI_ESP_LampeD);
        ltoa(sig_val, sig_str, 10);

        curr_time = (timeNow()/100000.0); //current time in seconds       
        snprintf(curr_time_str,elcount(curr_time_str),"%f\t", curr_time);                

        filePutString (curr_time_str, elCount(curr_time_str), file_handle);
        filePutString ("KBI_ESP_Lampe\t", elCount("KBI_ESP_Lampe\t") , file_handle);
        filePutString (sig_str, elCount(sig_str) , file_handle);
        filePutString ("\n", elCount("\n") , file_handle);
    }

    if (getValue (eWrite_KBI_BKL_Lampe))
    {        
        sig_val = getValue (eKBI_BKL_LampeD);
        ltoa(sig_val, sig_str, 10);

        curr_time = (timeNow()/100000.0); //current time in seconds       
        snprintf(curr_time_str,elcount(curr_time_str),"%f\t", curr_time);                

        filePutString (curr_time_str, elCount(curr_time_str), file_handle);
        filePutString ("KBI_BKL_Lampe\t", elCount("KBI_BKL_Lampe\t") , file_handle);
        filePutString (sig_str, elCount(sig_str) , file_handle);
        filePutString ("\n", elCount("\n") , file_handle);
    }

    if (getValue (eWrite_KBI_Airbag_Lampe))
    {        
        sig_val = getValue (eKBI_Airbag_LampeD);
        ltoa(sig_val, sig_str, 10);

        curr_time = (timeNow()/100000.0); //current time in seconds       
        snprintf(curr_time_str,elcount(curr_time_str),"%f\t", curr_time);                

        filePutString (curr_time_str, elCount(curr_time_str), file_handle);
        filePutString ("KBI_Airbag_Lampe\t", elCount("KBI_Airbag_Lampe\t") , file_handle);
        filePutString (sig_str, elCount(sig_str) , file_handle);
        filePutString ("\n", elCount("\n") , file_handle);
    }

    if (getValue (eWrite_KBI_SILA_gueltig))
    {        
        sig_val = getValue (eKBI_SILA_gueltigD);
        ltoa(sig_val, sig_str, 10);

        curr_time = (timeNow()/100000.0); //current time in seconds       
        snprintf(curr_time_str,elcount(curr_time_str),"%f\t", curr_time);                

        filePutString (curr_time_str, elCount(curr_time_str), file_handle);
        filePutString ("KBI_SILA_gueltig\t", elCount("KBI_SILA_gueltig\t") , file_handle);
        filePutString (sig_str, elCount(sig_str) , file_handle);
        filePutString ("\n", elCount("\n") , file_handle);
    }

    if (getValue (eWrite_KBI_Lenkung_Lampe))
    {        
        sig_val = getValue (eKBI_Lenkung_LampeD);
        ltoa(sig_val, sig_str, 10);

        curr_time = (timeNow()/100000.0); //current time in seconds       
        snprintf(curr_time_str,elcount(curr_time_str),"%f\t", curr_time);                

        filePutString (curr_time_str, elCount(curr_time_str), file_handle);
        filePutString ("KBI_Lenkung_Lampe\t", elCount("KBI_Lenkung_Lampe\t") , file_handle);
        filePutString (sig_str, elCount(sig_str) , file_handle);
        filePutString ("\n", elCount("\n") , file_handle);
    }

    if (getValue (eWrite_KBI_Vorglueh_System_Lampe))
    {        
        sig_val = getValue (eKBI_Vorglueh_System_LampeD);
        ltoa(sig_val, sig_str, 10);

        curr_time = (timeNow()/100000.0); //current time in seconds       
        snprintf(curr_time_str,elcount(curr_time_str),"%f\t", curr_time);                

        filePutString (curr_time_str, elCount(curr_time_str), file_handle);
        filePutString ("KBI_Vorglueh_System_Lampe\t", elCount("KBI_Vorglueh_System_Lampe\t") , file_handle);
        filePutString (sig_str, elCount(sig_str) , file_handle);
        filePutString ("\n", elCount("\n") , file_handle);
    }

    if (getValue (eWrite_KBI_NV_in_Anzeige))
    {        
        sig_val = getValue (eKBI_NV_in_AnzeigeD);
        ltoa(sig_val, sig_str, 10);

        curr_time = (timeNow()/100000.0); //current time in seconds       
        snprintf(curr_time_str,elcount(curr_time_str),"%f\t", curr_time);                

        filePutString (curr_time_str, elCount(curr_time_str), file_handle);
        filePutString ("KBI_NV_in_Anzeige\t", elCount("KBI_NV_in_Anzeige\t") , file_handle);
        filePutString (sig_str, elCount(sig_str) , file_handle);
        filePutString ("\n", elCount("\n") , file_handle);
    }

    if (getValue (eWrite_Kombi_01_BZ))
    {        
        sig_val = getValue (eKombi_01_BZD);
        ltoa(sig_val, sig_str, 10);

        curr_time = (timeNow()/100000.0); //current time in seconds       
        snprintf(curr_time_str,elcount(curr_time_str),"%f\t", curr_time);                

        filePutString (curr_time_str, elCount(curr_time_str), file_handle);
        filePutString ("Kombi_01_BZ\t", elCount("Kombi_01_BZ\t") , file_handle);
        filePutString (sig_str, elCount(sig_str) , file_handle);
        filePutString ("\n", elCount("\n") , file_handle);
    }

    if (getValue (eWrite_KBI_Anzeigestatus_ACC))
    {        
        sig_val = getValue (eKBI_Anzeigestatus_ACCD);
        ltoa(sig_val, sig_str, 10);

        curr_time = (timeNow()/100000.0); //current time in seconds       
        snprintf(curr_time_str,elcount(curr_time_str),"%f\t", curr_time);                

        filePutString (curr_time_str, elCount(curr_time_str), file_handle);
        filePutString ("KBI_Anzeigestatus_ACC\t", elCount("KBI_Anzeigestatus_ACC\t") , file_handle);
        filePutString (sig_str, elCount(sig_str) , file_handle);
        filePutString ("\n", elCount("\n") , file_handle);
    }

    if (getValue (eWrite_KBI_Anzeigestatus_GRA))
    {        
        sig_val = getValue (eKBI_Anzeigestatus_GRAD);
        ltoa(sig_val, sig_str, 10);

        curr_time = (timeNow()/100000.0); //current time in seconds       
        snprintf(curr_time_str,elcount(curr_time_str),"%f\t", curr_time);                

        filePutString (curr_time_str, elCount(curr_time_str), file_handle);
        filePutString ("KBI_Anzeigestatus_GRA\t", elCount("KBI_Anzeigestatus_GRA\t") , file_handle);
        filePutString (sig_str, elCount(sig_str) , file_handle);
        filePutString ("\n", elCount("\n") , file_handle);
    }

    if (getValue (eWrite_KBI_Oeldruck_Schalter))
    {        
        sig_val = getValue (eKBI_Oeldruck_SchalterD);
        ltoa(sig_val, sig_str, 10);

        curr_time = (timeNow()/100000.0); //current time in seconds       
        snprintf(curr_time_str,elcount(curr_time_str),"%f\t", curr_time);                

        filePutString (curr_time_str, elCount(curr_time_str), file_handle);
        filePutString ("KBI_Oeldruck_Schalter\t", elCount("KBI_Oeldruck_Schalter\t") , file_handle);
        filePutString (sig_str, elCount(sig_str) , file_handle);
        filePutString ("\n", elCount("\n") , file_handle);
    }

    if (getValue (eWrite_KBI_Tankwarnung))
    {        
        sig_val = getValue (eKBI_TankwarnungD);
        ltoa(sig_val, sig_str, 10);

        curr_time = (timeNow()/100000.0); //current time in seconds       
        snprintf(curr_time_str,elcount(curr_time_str),"%f\t", curr_time);                

        filePutString (curr_time_str, elCount(curr_time_str), file_handle);
        filePutString ("KBI_Tankwarnung\t", elCount("KBI_Tankwarnung\t") , file_handle);
        filePutString (sig_str, elCount(sig_str) , file_handle);
        filePutString ("\n", elCount("\n") , file_handle);
    }

    if (getValue (eWrite_KBI_MFA_v_Einheit_01))
    {        
        sig_val = getValue (eKBI_MFA_v_Einheit_01D);
        ltoa(sig_val, sig_str, 10);

        curr_time = (timeNow()/100000.0); //current time in seconds       
        snprintf(curr_time_str,elcount(curr_time_str),"%f\t", curr_time);                

        filePutString (curr_time_str, elCount(curr_time_str), file_handle);
        filePutString ("KBI_MFA_v_Einheit_01\t", elCount("KBI_MFA_v_Einheit_01\t") , file_handle);
        filePutString (sig_str, elCount(sig_str) , file_handle);
        filePutString ("\n", elCount("\n") , file_handle);
    }

    if (getValue (eWrite_KBI_im_Stellgliedtest))
    {        
        sig_val = getValue (eKBI_im_StellgliedtestD);
        ltoa(sig_val, sig_str, 10);

        curr_time = (timeNow()/100000.0); //current time in seconds       
        snprintf(curr_time_str,elcount(curr_time_str),"%f\t", curr_time);                

        filePutString (curr_time_str, elCount(curr_time_str), file_handle);
        filePutString ("KBI_im_Stellgliedtest\t", elCount("KBI_im_Stellgliedtest\t") , file_handle);
        filePutString (sig_str, elCount(sig_str) , file_handle);
        filePutString ("\n", elCount("\n") , file_handle);
    }
    
    if (getValue (eWrite_KBI_Anzeigefehler_LDW))
    {        
        sig_val = getValue (eKBI_Anzeigefehler_LDWD);
        ltoa(sig_val, sig_str, 10);

        curr_time = (timeNow()/100000.0); //current time in seconds       
        snprintf(curr_time_str,elcount(curr_time_str),"%f\t", curr_time);                

        filePutString (curr_time_str, elCount(curr_time_str), file_handle);
        filePutString ("KBI_Anzeigefehler_LDW\t", elCount("KBI_Anzeigefehler_LDW\t") , file_handle);
        filePutString (sig_str, elCount(sig_str) , file_handle);
        filePutString ("\n", elCount("\n") , file_handle);
    }

    if (getValue (eWrite_KBI_Variante_USA))
    {        
        sig_val = getValue (eKBI_Variante_USAD);
        ltoa(sig_val, sig_str, 10);

        curr_time = (timeNow()/100000.0); //current time in seconds       
        snprintf(curr_time_str,elcount(curr_time_str),"%f\t", curr_time);                

        filePutString (curr_time_str, elCount(curr_time_str), file_handle);
        filePutString ("KBI_Variante_USA\t", elCount("KBI_Variante_USA\t") , file_handle);
        filePutString (sig_str, elCount(sig_str) , file_handle);
        filePutString ("\n", elCount("\n") , file_handle);
    }

    if (getValue (eWrite_KBI_Oeldruckwarnung))
    {        
        sig_val = getValue (eKBI_OeldruckwarnungD);
        ltoa(sig_val, sig_str, 10);

        curr_time = (timeNow()/100000.0); //current time in seconds       
        snprintf(curr_time_str,elcount(curr_time_str),"%f\t", curr_time);                

        filePutString (curr_time_str, elCount(curr_time_str), file_handle);
        filePutString ("KBI_Oeldruckwarnung\t", elCount("KBI_Oeldruckwarnung\t") , file_handle);
        filePutString (sig_str, elCount(sig_str) , file_handle);
        filePutString ("\n", elCount("\n") , file_handle);
    }

    if (getValue (eWrite_KBI_Handbremse))
    {        
        sig_val = getValue (eKBI_HandbremseD);
        ltoa(sig_val, sig_str, 10);

        curr_time = (timeNow()/100000.0); //current time in seconds       
        snprintf(curr_time_str,elcount(curr_time_str),"%f\t", curr_time);                

        filePutString (curr_time_str, elCount(curr_time_str), file_handle);
        filePutString ("KBI_Handbremse\t", elCount("KBI_Handbremse\t") , file_handle);
        filePutString (sig_str, elCount(sig_str) , file_handle);
        filePutString ("\n", elCount("\n") , file_handle);
    }

    if (getValue (eWrite_KBI_V_Digital))
    {        
        sig_val = getValue (eKBI_V_DigitalD);
        ltoa(sig_val, sig_str, 10);

        curr_time = (timeNow()/100000.0); //current time in seconds       
        snprintf(curr_time_str,elcount(curr_time_str),"%f\t", curr_time);                

        filePutString (curr_time_str, elCount(curr_time_str), file_handle);
        filePutString ("KBI_V_Digital\t", elCount("KBI_V_Digital\t") , file_handle);
        filePutString (sig_str, elCount(sig_str) , file_handle);
        filePutString ("\n", elCount("\n") , file_handle);
    }

    if (getValue (eWrite_KBI_PLA_in_Anzeige))
    {        
        sig_val = getValue (eKBI_PLA_in_AnzeigeD);
        ltoa(sig_val, sig_str, 10);

        curr_time = (timeNow()/100000.0); //current time in seconds       
        snprintf(curr_time_str,elcount(curr_time_str),"%f\t", curr_time);                

        filePutString (curr_time_str, elCount(curr_time_str), file_handle);
        filePutString ("KBI_PLA_in_Anzeige\t", elCount("KBI_PLA_in_Anzeige\t") , file_handle);
        filePutString (sig_str, elCount(sig_str) , file_handle);
        filePutString ("\n", elCount("\n") , file_handle);
    }

    if (getValue (eWrite_KBI_Anzeigefehler_NV))
    {        
        sig_val = getValue (eKBI_Anzeigefehler_NVD);
        ltoa(sig_val, sig_str, 10);

        curr_time = (timeNow()/100000.0); //current time in seconds       
        snprintf(curr_time_str,elcount(curr_time_str),"%f\t", curr_time);                

        filePutString (curr_time_str, elCount(curr_time_str), file_handle);
        filePutString ("KBI_Anzeigefehler_NV\t", elCount("KBI_Anzeigefehler_NV\t") , file_handle);
        filePutString (sig_str, elCount(sig_str) , file_handle);
        filePutString ("\n", elCount("\n") , file_handle);
    }

    if (getValue (eWrite_KBI_Anzeigestatus_LIM))
    {        
        sig_val = getValue (eKBI_Anzeigestatus_LIMD);
        ltoa(sig_val, sig_str, 10);

        curr_time = (timeNow()/100000.0); //current time in seconds       
        snprintf(curr_time_str,elcount(curr_time_str),"%f\t", curr_time);                

        filePutString (curr_time_str, elCount(curr_time_str), file_handle);
        filePutString ("KBI_Anzeigestatus_LIM\t", elCount("KBI_Anzeigestatus_LIM\t") , file_handle);
        filePutString (sig_str, elCount(sig_str) , file_handle);
        filePutString ("\n", elCount("\n") , file_handle);
    }

    if (getValue (eWrite_KBI_angez_Geschw))
    {        
        sig_val = getValue (eKBI_angez_GeschwD);
        ltoa(sig_val, sig_str, 10);

        curr_time = (timeNow()/100000.0); //current time in seconds       
        snprintf(curr_time_str,elcount(curr_time_str),"%f\t", curr_time);                

        filePutString (curr_time_str, elCount(curr_time_str), file_handle);
        filePutString ("KBI_angez_Geschw\t", elCount("KBI_angez_Geschw\t") , file_handle);
        filePutString (sig_str, elCount(sig_str) , file_handle);
        filePutString ("\n", elCount("\n") , file_handle);
    }

    if (getValue (eWrite_KBI_Einheit_Tacho))
    {        
        sig_val = getValue (eKBI_Einheit_TachoD);
        ltoa(sig_val, sig_str, 10);

        curr_time = (timeNow()/100000.0); //current time in seconds       
        snprintf(curr_time_str,elcount(curr_time_str),"%f\t", curr_time);                

        filePutString (curr_time_str, elCount(curr_time_str), file_handle);
        filePutString ("KBI_Einheit_Tacho\t", elCount("KBI_Einheit_Tacho\t") , file_handle);
        filePutString (sig_str, elCount(sig_str) , file_handle);
        filePutString ("\n", elCount("\n") , file_handle);
    }

    if (getValue (eWrite_KBI_Konsistenz_ACC))
    {        
        sig_val = getValue (eKBI_Konsistenz_ACCD);
        ltoa(sig_val, sig_str, 10);

        curr_time = (timeNow()/100000.0); //current time in seconds       
        snprintf(curr_time_str,elcount(curr_time_str),"%f\t", curr_time);                

        filePutString (curr_time_str, elCount(curr_time_str), file_handle);
        filePutString ("KBI_Konsistenz_ACC\t", elCount("KBI_Konsistenz_ACC\t") , file_handle);
        filePutString (sig_str, elCount(sig_str) , file_handle);
        filePutString ("\n", elCount("\n") , file_handle);
    }

    if (getValue (eWrite_KBI_Fehler_Anzeige_ACC))
    {        
        sig_val = getValue (eKBI_Fehler_Anzeige_ACCD);
        ltoa(sig_val, sig_str, 10);

        curr_time = (timeNow()/100000.0); //current time in seconds       
        snprintf(curr_time_str,elcount(curr_time_str),"%f\t", curr_time);                

        filePutString (curr_time_str, elCount(curr_time_str), file_handle);
        filePutString ("KBI_Fehler_Anzeige_ACC\t", elCount("KBI_Fehler_Anzeige_ACC\t") , file_handle);
        filePutString (sig_str, elCount(sig_str) , file_handle);
        filePutString ("\n", elCount("\n") , file_handle);
    }

    if (getValue (eWrite_KBI_Anzeigefehler_SWA))
    {        
        sig_val = getValue (eKBI_Anzeigefehler_SWAD);
        ltoa(sig_val, sig_str, 10);

        curr_time = (timeNow()/100000.0); //current time in seconds       
        snprintf(curr_time_str,elcount(curr_time_str),"%f\t", curr_time);                

        filePutString (curr_time_str, elCount(curr_time_str), file_handle);
        filePutString ("KBI_Anzeigefehler_SWA\t", elCount("KBI_Anzeigefehler_SWA\t") , file_handle);
        filePutString (sig_str, elCount(sig_str) , file_handle);
        filePutString ("\n", elCount("\n") , file_handle);
    }
	
	
	
	//MR77431
	if (getValue (eWrite_KN_KBI_DiagPfad))
    {   
        sig_val = getValue (eKN_KBI_DiagPfadD);
        ltoa(sig_val, sig_str, 10);

        curr_time = (timeNow()/100000.0); //current time in seconds       
        snprintf(curr_time_str,elcount(curr_time_str),"%f\t", curr_time);                

        filePutString (curr_time_str, elCount(curr_time_str), file_handle);
        filePutString ("KN_KBI_DiagPfad\t", elCount("KN_KBI_DiagPfad\t") , file_handle);
        filePutString (sig_str, elCount(sig_str) , file_handle);
        filePutString ("\n", elCount("\n") , file_handle);
    }
	//MR77431
	if (getValue (eWrite_KBI_Tankwarnung_ungueltig))
    {        
        sig_val = getValue (eKBI_Tankwarnung_ungueltigD);
        ltoa(sig_val, sig_str, 10);

        curr_time = (timeNow()/100000.0); //current time in seconds       
        snprintf(curr_time_str,elcount(curr_time_str),"%f\t", curr_time);                

        filePutString (curr_time_str, elCount(curr_time_str), file_handle);
        filePutString ("KBI_Tankwarnung_ungueltig\t", elCount("KBI_Tankwarnung_ungueltig\t") , file_handle);
        filePutString (sig_str, elCount(sig_str) , file_handle);
        filePutString ("\n", elCount("\n") , file_handle);
    }
	
	//MR77431
	if (getValue (eWrite_KBI_Systemstatus))
    {        
        sig_val = getValue (eKBI_SystemstatusD);
        ltoa(sig_val, sig_str, 10);

        curr_time = (timeNow()/100000.0); //current time in seconds       
        snprintf(curr_time_str,elcount(curr_time_str),"%f\t", curr_time);                

        filePutString (curr_time_str, elCount(curr_time_str), file_handle);
        filePutString ("KBI_Systemstatus\t", elCount("KBI_Systemstatus\t") , file_handle);
        filePutString (sig_str, elCount(sig_str) , file_handle);
        filePutString ("\n", elCount("\n") , file_handle);
    }
	

    /* Service_Key_01 */
    if (getValue (eWrite_SK1_MUX))
    {        
        sig_val = getValue (eSK1_MUXD);
        ltoa(sig_val, sig_str, 10);

        curr_time = (timeNow()/100000.0); //current time in seconds       
        snprintf(curr_time_str,elcount(curr_time_str),"%f\t", curr_time);                

        filePutString (curr_time_str, elCount(curr_time_str), file_handle);
        filePutString ("SK1_MUX\t", elCount("SK1_MUX\t") , file_handle);
        filePutString (sig_str, elCount(sig_str) , file_handle);
        filePutString ("\n", elCount("\n") , file_handle);
    }

    if (getValue (eWrite_SK1_Key_Data_1))
    {        
        sig_val = getValue (eSK1_Key_Data_1D);
        ltoa(sig_val, sig_str, 10);

        curr_time = (timeNow()/100000.0); //current time in seconds       
        snprintf(curr_time_str,elcount(curr_time_str),"%f\t", curr_time);                

        filePutString (curr_time_str, elCount(curr_time_str), file_handle);
        filePutString ("SK1_Key_Data_1\t", elCount("SK1_Key_Data_1\t") , file_handle);
        filePutString (sig_str, elCount(sig_str) , file_handle);
        filePutString ("\n", elCount("\n") , file_handle);
    }

    if (getValue (eWrite_SK1_Key_Data_2))
    {        
        sig_val = getValue (eSK1_Key_Data_2D);
        ltoa(sig_val, sig_str, 10);

        curr_time = (timeNow()/100000.0); //current time in seconds       
        snprintf(curr_time_str,elcount(curr_time_str),"%f\t", curr_time);                

        filePutString (curr_time_str, elCount(curr_time_str), file_handle);
        filePutString ("SK1_Key_Data_2\t", elCount("SK1_Key_Data_2\t") , file_handle);
        filePutString (sig_str, elCount(sig_str) , file_handle);
        filePutString ("\n", elCount("\n") , file_handle);
    }

    if (getValue (eWrite_SK1_Key_Data_3))
    {        
        sig_val = getValue (eSK1_Key_Data_3D);
        ltoa(sig_val, sig_str, 10);

        curr_time = (timeNow()/100000.0); //current time in seconds       
        snprintf(curr_time_str,elcount(curr_time_str),"%f\t", curr_time);                

        filePutString (curr_time_str, elCount(curr_time_str), file_handle);
        filePutString ("SK1_Key_Data_3\t", elCount("SK1_Key_Data_3\t") , file_handle);
        filePutString (sig_str, elCount(sig_str) , file_handle);
        filePutString ("\n", elCount("\n") , file_handle);
    }

    if (getValue (eWrite_SK1_Key_Data_4))
    {        
        sig_val = getValue (eSK1_Key_Data_4D);
        ltoa(sig_val, sig_str, 10);

        curr_time = (timeNow()/100000.0); //current time in seconds       
        snprintf(curr_time_str,elcount(curr_time_str),"%f\t", curr_time);                

        filePutString (curr_time_str, elCount(curr_time_str), file_handle);
        filePutString ("SK1_Key_Data_4\t", elCount("SK1_Key_Data_4\t") , file_handle);
        filePutString (sig_str, elCount(sig_str) , file_handle);
        filePutString ("\n", elCount("\n") , file_handle);
    }

    if (getValue (eWrite_SK1_Key_Data_5))
    {        
        sig_val = getValue (eSK1_Key_Data_5D);
        ltoa(sig_val, sig_str, 10);

        curr_time = (timeNow()/100000.0); //current time in seconds       
        snprintf(curr_time_str,elcount(curr_time_str),"%f\t", curr_time);                

        filePutString (curr_time_str, elCount(curr_time_str), file_handle);
        filePutString ("SK1_Key_Data_5\t", elCount("SK1_Key_Data_5\t") , file_handle);
        filePutString (sig_str, elCount(sig_str) , file_handle);
        filePutString ("\n", elCount("\n") , file_handle);
    }

    if (getValue (eWrite_SK1_Key_Data_6))
    {        
        sig_val = getValue (eSK1_Key_Data_6D);
        ltoa(sig_val, sig_str, 10);

        curr_time = (timeNow()/100000.0); //current time in seconds       
        snprintf(curr_time_str,elcount(curr_time_str),"%f\t", curr_time);                

        filePutString (curr_time_str, elCount(curr_time_str), file_handle);
        filePutString ("SK1_Key_Data_6\t", elCount("SK1_Key_Data_6\t") , file_handle);
        filePutString (sig_str, elCount(sig_str) , file_handle);
        filePutString ("\n", elCount("\n") , file_handle);
    }

     if (getValue (eWrite_SK1_Key_Data_7))
    {        
        sig_val = getValue (eSK1_Key_Data_7D);
        ltoa(sig_val, sig_str, 10);

        curr_time = (timeNow()/100000.0); //current time in seconds       
        snprintf(curr_time_str,elcount(curr_time_str),"%f\t", curr_time);                

        filePutString (curr_time_str, elCount(curr_time_str), file_handle);
        filePutString ("SK1_Key_Data_7\t", elCount("SK1_Key_Data_7\t") , file_handle);
        filePutString (sig_str, elCount(sig_str) , file_handle);
        filePutString ("\n", elCount("\n") , file_handle);
    }

    if (getValue (eWrite_SK1_Key_Data_8))
    {        
        sig_val = getValue (eSK1_Key_Data_8D);
        ltoa(sig_val, sig_str, 10);

        curr_time = (timeNow()/100000.0); //current time in seconds       
        snprintf(curr_time_str,elcount(curr_time_str),"%f\t", curr_time);                

        filePutString (curr_time_str, elCount(curr_time_str), file_handle);
        filePutString ("SK1_Key_Data_8\t", elCount("SK1_Key_Data_8\t") , file_handle);
        filePutString (sig_str, elCount(sig_str) , file_handle);
        filePutString ("\n", elCount("\n") , file_handle);
    }

    if (getValue (eWrite_SK1_Key_Data_9))
    {        
        sig_val = getValue (eSK1_Key_Data_9D);
        ltoa(sig_val, sig_str, 10);

        curr_time = (timeNow()/100000.0); //current time in seconds       
        snprintf(curr_time_str,elcount(curr_time_str),"%f\t", curr_time);                

        filePutString (curr_time_str, elCount(curr_time_str), file_handle);
        filePutString ("SK1_Key_Data_9\t", elCount("SK1_Key_Data_9\t") , file_handle);
        filePutString (sig_str, elCount(sig_str) , file_handle);
        filePutString ("\n", elCount("\n") , file_handle);
    }
    
    /* Kombi_02 */
    if (getValue (eWrite_KBI_Kilometerstand_0))
    {        
        sig_val = getValue (eKBI_Kilometerstand_0D);
        ltoa(sig_val, sig_str, 10);

        curr_time = (timeNow()/100000.0); //current time in seconds       
        snprintf(curr_time_str,elcount(curr_time_str),"%f\t", curr_time);                

        filePutString (curr_time_str, elCount(curr_time_str), file_handle);
        filePutString ("KBI_Kilometerstand_0\t", elCount("KBI_Kilometerstand_0\t") , file_handle);
        filePutString (sig_str, elCount(sig_str) , file_handle);
        filePutString ("\n", elCount("\n") , file_handle);
    }
    
    if (getValue (eWrite_KBI_Standzeit_02))
    {        
        sig_val = getValue (eKBI_Standzeit_02D);
        ltoa(sig_val, sig_str, 10);

        curr_time = (timeNow()/100000.0); //current time in seconds       
        snprintf(curr_time_str,elcount(curr_time_str),"%f\t", curr_time);                

        filePutString (curr_time_str, elCount(curr_time_str), file_handle);
        filePutString ("KBI_Standzeit_02\t", elCount("KBI_Standzeit_02\t") , file_handle);
        filePutString (sig_str, elCount(sig_str) , file_handle);
        filePutString ("\n", elCount("\n") , file_handle);
    }

    if (getValue (eWrite_KBI_Inhalt_Tank))
    {        
        sig_val = getValue (eKBI_Inhalt_TankD);
        ltoa(sig_val, sig_str, 10);

        curr_time = (timeNow()/100000.0); //current time in seconds       
        snprintf(curr_time_str,elcount(curr_time_str),"%f\t", curr_time);                

        filePutString (curr_time_str, elCount(curr_time_str), file_handle);
        filePutString ("KBI_Inhalt_Tank\t", elCount("KBI_Inhalt_Tank\t") , file_handle);
        filePutString (sig_str, elCount(sig_str) , file_handle);
        filePutString ("\n", elCount("\n") , file_handle);
    }

    if (getValue (eWrite_KBI_FStatus_Tank))
    {        
        sig_val = getValue (eKBI_FStatus_TankD);
        ltoa(sig_val, sig_str, 10);

        curr_time = (timeNow()/100000.0); //current time in seconds       
        snprintf(curr_time_str,elcount(curr_time_str),"%f\t", curr_time);                

        filePutString (curr_time_str, elCount(curr_time_str), file_handle);
        filePutString ("KBI_FStatus_Tank\t", elCount("KBI_FStatus_Tank\t") , file_handle);
        filePutString (sig_str, elCount(sig_str) , file_handle);
        filePutString ("\n", elCount("\n") , file_handle);
    }

    if (getValue (eWrite_KBI_QBit_Aussen_Temp_gef))
    {        
        sig_val = getValue (eKBI_QBit_Aussen_Temp_gefD);
        ltoa(sig_val, sig_str, 10);

        curr_time = (timeNow()/100000.0); //current time in seconds       
        snprintf(curr_time_str,elcount(curr_time_str),"%f\t", curr_time);                

        filePutString (curr_time_str, elCount(curr_time_str), file_handle);
        filePutString ("KBI_QBit_Aussen_Temp_gef\t", elCount("KBI_QBit_Aussen_Temp_gef\t") , file_handle);
        filePutString (sig_str, elCount(sig_str) , file_handle);
        filePutString ("\n", elCount("\n") , file_handle);
    }

    if (getValue (eWrite_KBI_Aussen_Temp_gef))
    {        
        sig_val = getValue (eKBI_Aussen_Temp_gefD);
        ltoa(sig_val, sig_str, 10);

        curr_time = (timeNow()/100000.0); //current time in seconds       
        snprintf(curr_time_str,elcount(curr_time_str),"%f\t", curr_time);                

        filePutString (curr_time_str, elCount(curr_time_str), file_handle);
        filePutString ("KBI_Aussen_Temp_gef\t", elCount("KBI_Aussen_Temp_gef\t") , file_handle);
        filePutString (sig_str, elCount(sig_str) , file_handle);
        filePutString ("\n", elCount("\n") , file_handle);
    }

    /* Uhrzeit_01 */
    if (getValue (eWrite_UH_Monat_0))
    {        
        sig_val = getValue (eUH_Monat_0D);
        ltoa(sig_val, sig_str, 10);

        curr_time = (timeNow()/100000.0); //current time in seconds       
        snprintf(curr_time_str,elcount(curr_time_str),"%f\t", curr_time);                

        filePutString (curr_time_str, elCount(curr_time_str), file_handle);
        filePutString ("UH_Monat_0\t", elCount("UH_Monat_0\t") , file_handle);
        filePutString (sig_str, elCount(sig_str) , file_handle);
        filePutString ("\n", elCount("\n") , file_handle);
    }        
    
    if (getValue (eWrite_UH_Jahr_0))
    {        
        sig_val = getValue (eUH_Jahr_0D);
        ltoa(sig_val, sig_str, 10);

        curr_time = (timeNow()/100000.0); //current time in seconds       
        snprintf(curr_time_str,elcount(curr_time_str),"%f\t", curr_time);                

        filePutString (curr_time_str, elCount(curr_time_str), file_handle);
        filePutString ("UH_Jahr_0\t", elCount("UH_Jahr_0\t") , file_handle);
        filePutString (sig_str, elCount(sig_str) , file_handle);
        filePutString ("\n", elCount("\n") , file_handle);
    }

    if (getValue (eWrite_UH_Tag_0))
    {        
        sig_val = getValue (eUH_Tag_0D);
        ltoa(sig_val, sig_str, 10);

        curr_time = (timeNow()/100000.0); //current time in seconds       
        snprintf(curr_time_str,elcount(curr_time_str),"%f\t", curr_time);                

        filePutString (curr_time_str, elCount(curr_time_str), file_handle);
        filePutString ("UH_Tag_0\t", elCount("UH_Tag_0\t") , file_handle);
        filePutString (sig_str, elCount(sig_str) , file_handle);
        filePutString ("\n", elCount("\n") , file_handle);
    }

    if (getValue (eWrite_UH_Stunde_0))
    {        
        sig_val = getValue (eUH_Stunde_0D);
        ltoa(sig_val, sig_str, 10);

        curr_time = (timeNow()/100000.0); //current time in seconds       
        snprintf(curr_time_str,elcount(curr_time_str),"%f\t", curr_time);                

        filePutString (curr_time_str, elCount(curr_time_str), file_handle);
        filePutString ("UH_Stunde_0\t", elCount("UH_Stunde_0\t") , file_handle);
        filePutString (sig_str, elCount(sig_str) , file_handle);
        filePutString ("\n", elCount("\n") , file_handle);
    }

    if (getValue (eWrite_UH_Minute_0))
    {        
        sig_val = getValue (eUH_Minute_0D);
        ltoa(sig_val, sig_str, 10);

        curr_time = (timeNow()/100000.0); //current time in seconds       
        snprintf(curr_time_str,elcount(curr_time_str),"%f\t", curr_time);                

        filePutString (curr_time_str, elCount(curr_time_str), file_handle);
        filePutString ("UH_Minute_0\t", elCount("UH_Minute_0\t") , file_handle);
        filePutString (sig_str, elCount(sig_str) , file_handle);
        filePutString ("\n", elCount("\n") , file_handle);
    }

    if (getValue (eWrite_UH_Sekunde_0))
    {        
        sig_val = getValue (eUH_Sekunde_0D);
        ltoa(sig_val, sig_str, 10);

        curr_time = (timeNow()/100000.0); //current time in seconds       
        snprintf(curr_time_str,elcount(curr_time_str),"%f\t", curr_time);                

        filePutString (curr_time_str, elCount(curr_time_str), file_handle);
        filePutString ("UH_Sekunde_0\t", elCount("UH_Sekunde_0\t") , file_handle);
        filePutString (sig_str, elCount(sig_str) , file_handle);
        filePutString ("\n", elCount("\n") , file_handle);
    }

    /* Kombi_03 */
    if (getValue (eWrite_KBI_Reifenumfang))
    {        
        sig_val = getValue (eKBI_ReifenumfangD);
        ltoa(sig_val, sig_str, 10);

        curr_time = (timeNow()/100000.0); //current time in seconds       
        snprintf(curr_time_str,elcount(curr_time_str),"%f\t", curr_time);                

        filePutString (curr_time_str, elCount(curr_time_str), file_handle);
        filePutString ("KBI_Reifenumfang\t", elCount("KBI_Reifenumfang\t") , file_handle);
        filePutString (sig_str, elCount(sig_str) , file_handle);
        filePutString ("\n", elCount("\n") , file_handle);
    }

    if (getValue (eWrite_KBI_BCmE_aktiv))
    {        
        sig_val = getValue (eKBI_BCmE_aktivD);
        ltoa(sig_val, sig_str, 10);

        curr_time = (timeNow()/100000.0); //current time in seconds       
        snprintf(curr_time_str,elcount(curr_time_str),"%f\t", curr_time);                

        filePutString (curr_time_str, elCount(curr_time_str), file_handle);
        filePutString ("KBI_BCmE_aktiv\t", elCount("KBI_BCmE_aktiv\t") , file_handle);
        filePutString (sig_str, elCount(sig_str) , file_handle);
        filePutString ("\n", elCount("\n") , file_handle);
    }

    if (getValue (eWrite_KBI_Sparhinweis_quittiert))
    {        
        sig_val = getValue (eKBI_Sparhinweis_quittiertD);
        ltoa(sig_val, sig_str, 10);

        curr_time = (timeNow()/100000.0); //current time in seconds       
        snprintf(curr_time_str,elcount(curr_time_str),"%f\t", curr_time);                

        filePutString (curr_time_str, elCount(curr_time_str), file_handle);
        filePutString ("KBI_Sparhinweis_quittiert\t", elCount("KBI_Sparhinweis_quittiert\t") , file_handle);
        filePutString (sig_str, elCount(sig_str) , file_handle);
        filePutString ("\n", elCount("\n") , file_handle);
    }

    /* KS_Kombi_Resp */
    if (getValue (eWrite_KS_Kombi_Resp_Data))
    {        
        sig_val = getValue (eKS_Kombi_Resp_DataD);
        ltoa(sig_val, sig_str, 10);

        curr_time = (timeNow()/100000.0); //current time in seconds       
        snprintf(curr_time_str,elcount(curr_time_str),"%f\t", curr_time);                

        filePutString (curr_time_str, elCount(curr_time_str), file_handle);
        filePutString ("KS_Kombi_Resp_Data\t", elCount("KS_Kombi_Resp_Data\t") , file_handle);
        filePutString (sig_str, elCount(sig_str) , file_handle);
        filePutString ("\n", elCount("\n") , file_handle);
    }

    /* ISO_Kombi_Resp */
    if (getValue (eWrite_ISO_Kombi_Resp_Data))
    {        
        sig_val = getValue (eISO_Kombi_Resp_DataD);
        ltoa(sig_val, sig_str, 10);

        curr_time = (timeNow()/100000.0); //current time in seconds       
        snprintf(curr_time_str,elcount(curr_time_str),"%f\t", curr_time);                

        filePutString (curr_time_str, elCount(curr_time_str), file_handle);
        filePutString ("ISO_Kombi_Resp_Data\t", elCount("ISO_Kombi_Resp_Data\t") , file_handle);
        filePutString (sig_str, elCount(sig_str) , file_handle);
        filePutString ("\n", elCount("\n") , file_handle);
    }

    /* WFS_01 */
    if (getValue (eWrite_WFS_Schluessel_Fahrberecht))
    {        
        sig_val = getValue (eWFS_Schluessel_FahrberechtD);
        ltoa(sig_val, sig_str, 10);

        curr_time = (timeNow()/100000.0); //current time in seconds       
        snprintf(curr_time_str,elcount(curr_time_str),"%f\t", curr_time);                

        filePutString (curr_time_str, elCount(curr_time_str), file_handle);
        filePutString ("WFS_Schluessel_Fahrberecht\t", elCount("WFS_Schluessel_Fahrberecht\t") , file_handle);
        filePutString (sig_str, elCount(sig_str) , file_handle);
        filePutString ("\n", elCount("\n") , file_handle);
    }

/*    if (getValue (eWrite_KY_ID_Geb_autorisiert))
    {        
        sig_val = getValue (eKY_ID_Geb_autorisiertD);
        ltoa(sig_val, sig_str, 10);

        curr_time = (timeNow()/100000.0); //current time in seconds       
        snprintf(curr_time_str,elcount(curr_time_str),"%f\t", curr_time);                

        filePutString (curr_time_str, elCount(curr_time_str), file_handle);
        filePutString ("KY_ID_Geb_autorisiert\t", elCount("KY_ID_Geb_autorisiert\t") , file_handle);
        filePutString (sig_str, elCount(sig_str) , file_handle);
        filePutString ("\n", elCount("\n") , file_handle);
    }*/

    if (getValue (eWrite_WFS_ID_Geb_autorisiert_in_Kl15))
    {        
        sig_val = getValue (eWFS_ID_Geb_autorisiert_in_Kl15D);
        ltoa(sig_val, sig_str, 10);

        curr_time = (timeNow()/100000.0); //current time in seconds       
        snprintf(curr_time_str,elcount(curr_time_str),"%f\t", curr_time);                

        filePutString (curr_time_str, elCount(curr_time_str), file_handle);
        filePutString ("WFS_ID_Geb_autorisiert_in_Kl15\t", elCount("WFS_ID_Geb_autorisiert_in_Kl15\t") , file_handle);
        filePutString (sig_str, elCount(sig_str) , file_handle);
        filePutString ("\n", elCount("\n") , file_handle);
    }

/*    if (getValue (eWrite_KY_ID_Geb_steckt))
    {        
        sig_val = getValue (eKY_ID_Geb_stecktD);
        ltoa(sig_val, sig_str, 10);

        curr_time = (timeNow()/100000.0); //current time in seconds       
        snprintf(curr_time_str,elcount(curr_time_str),"%f\t", curr_time);                

        filePutString (curr_time_str, elCount(curr_time_str), file_handle);
        filePutString ("KY_ID_Geb_steckt\t", elCount("KY_ID_Geb_steckt\t") , file_handle);
        filePutString (sig_str, elCount(sig_str) , file_handle);
        filePutString ("\n", elCount("\n") , file_handle);
    }*/

 /*   if (getValue (eWrite_KY_Schluessel_Soll))
    {        
        sig_val = getValue (eKY_Schluessel_SollD);
        ltoa(sig_val, sig_str, 10);

        curr_time = (timeNow()/100000.0); //current time in seconds       
        snprintf(curr_time_str,elcount(curr_time_str),"%f\t", curr_time);                

        filePutString (curr_time_str, elCount(curr_time_str), file_handle);
        filePutString ("KY_Schluessel_Soll\t", elCount("KY_Schluessel_Soll\t") , file_handle);
        filePutString (sig_str, elCount(sig_str) , file_handle);
        filePutString ("\n", elCount("\n") , file_handle);
    }*/

/*    if (getValue (eWrite_KY_Schluessel_Ist))
    {        
        sig_val = getValue (eKY_Schluessel_IstD);
        ltoa(sig_val, sig_str, 10);

        curr_time = (timeNow()/100000.0); //current time in seconds       
        snprintf(curr_time_str,elcount(curr_time_str),"%f\t", curr_time);                

        filePutString (curr_time_str, elCount(curr_time_str), file_handle);
        filePutString ("KY_Schluessel_Ist\t", elCount("KY_Schluessel_Ist\t") , file_handle);
        filePutString (sig_str, elCount(sig_str) , file_handle);
        filePutString ("\n", elCount("\n") , file_handle);
    }*/

 /*   if (getValue (eWrite_KY_WFS_Safe))
    {        
        sig_val = getValue (eKY_WFS_SafeD);
        ltoa(sig_val, sig_str, 10);

        curr_time = (timeNow()/100000.0); //current time in seconds       
        snprintf(curr_time_str,elcount(curr_time_str),"%f\t", curr_time);                

        filePutString (curr_time_str, elCount(curr_time_str), file_handle);
        filePutString ("KY_WFS_Safe\t", elCount("KY_WFS_Safe\t") , file_handle);
        filePutString (sig_str, elCount(sig_str) , file_handle);
        filePutString ("\n", elCount("\n") , file_handle);
    }*/

 /*   if (getValue (eWrite_KY_WFS_LZ))
    {        
        sig_val = getValue (eKY_WFS_LZD);
        ltoa(sig_val, sig_str, 10);

        curr_time = (timeNow()/100000.0); //current time in seconds       
        snprintf(curr_time_str,elcount(curr_time_str),"%f\t", curr_time);                

        filePutString (curr_time_str, elCount(curr_time_str), file_handle);
        filePutString ("KY_WFS_LZ\t", elCount("KY_WFS_LZ\t") , file_handle);
        filePutString (sig_str, elCount(sig_str) , file_handle);
        filePutString ("\n", elCount("\n") , file_handle);
    }*/

    if (getValue (eWrite_WFS_ELV_authorisiert))
    {        
        sig_val = getValue (eWFS_ELV_authorisiertD);
        ltoa(sig_val, sig_str, 10);

        curr_time = (timeNow()/100000.0); //current time in seconds       
        snprintf(curr_time_str,elcount(curr_time_str),"%f\t", curr_time);                

        filePutString (curr_time_str, elCount(curr_time_str), file_handle);
        filePutString ("WFS_ELV_authorisiert\t", elCount("WFS_ELV_authorisiert\t") , file_handle);
        filePutString (sig_str, elCount(sig_str) , file_handle);
        filePutString ("\n", elCount("\n") , file_handle);
    }

/*    if (getValue (eWrite_KY_LF_Aktiv))
    {        
        sig_val = getValue (eKY_LF_AktivD);
        ltoa(sig_val, sig_str, 10);

        curr_time = (timeNow()/100000.0); //current time in seconds       
        snprintf(curr_time_str,elcount(curr_time_str),"%f\t", curr_time);                

        filePutString (curr_time_str, elCount(curr_time_str), file_handle);
        filePutString ("KY_LF_Aktiv\t", elCount("KY_LF_Aktiv\t") , file_handle);
        filePutString (sig_str, elCount(sig_str) , file_handle);
        filePutString ("\n", elCount("\n") , file_handle);
    }*/

    if (getValue (eWrite_WFS_Betrieb_Lesespule))
    {        
        sig_val = getValue (eWFS_Betrieb_LesespuleD);
        ltoa(sig_val, sig_str, 10);

        curr_time = (timeNow()/100000.0); //current time in seconds       
        snprintf(curr_time_str,elcount(curr_time_str),"%f\t", curr_time);                

        filePutString (curr_time_str, elCount(curr_time_str), file_handle);
        filePutString ("WFS_Betrieb_Lesespule\t", elCount("WFS_Betrieb_Lesespule\t") , file_handle);
        filePutString (sig_str, elCount(sig_str) , file_handle);
        filePutString ("\n", elCount("\n") , file_handle);
    }

    /* Log_Kombi_Resp */
    if (getValue (eWrite_Log_Kombi_Resp_Data))
    {        
        sig_val = getValue (eLog_Kombi_Resp_DataD);
        ltoa(sig_val, sig_str, 10);

        curr_time = (timeNow()/100000.0); //current time in seconds       
        snprintf(curr_time_str,elcount(curr_time_str),"%f\t", curr_time);                

        filePutString (curr_time_str, elCount(curr_time_str), file_handle);
        filePutString ("Log_Kombi_Resp_Data\t", elCount("Log_Kombi_Resp_Data\t") , file_handle);
        filePutString (sig_str, elCount(sig_str) , file_handle);
        filePutString ("\n", elCount("\n") , file_handle);
    }

    /* WFS_Go_1 */
  /*  if (getValue (eWrite_WFS_Challenge))
    {        
        sig_val = getValue (eWFS_ChallengeD);
        ltoa(sig_val, sig_str, 10);

        curr_time = (timeNow()/100000.0); //current time in seconds       
        snprintf(curr_time_str,elcount(curr_time_str),"%f\t", curr_time);                

        filePutString (curr_time_str, elCount(curr_time_str), file_handle);
        filePutString ("WFS_Challenge\t", elCount("WFS_Challenge\t") , file_handle);
        filePutString (sig_str, elCount(sig_str) , file_handle);
        filePutString ("\n", elCount("\n") , file_handle);
    }*/

 /*   if (getValue (eWrite_WFS_GoTrigger))
    {        
        sig_val = getValue (eWFS_GoTriggerD);
        ltoa(sig_val, sig_str, 10);

        curr_time = (timeNow()/100000.0); //current time in seconds       
        snprintf(curr_time_str,elcount(curr_time_str),"%f\t", curr_time);                

        filePutString (curr_time_str, elCount(curr_time_str), file_handle);
        filePutString ("WFS_GoTrigger\t", elCount("WFS_GoTrigger\t") , file_handle);
        filePutString (sig_str, elCount(sig_str) , file_handle);
        filePutString ("\n", elCount("\n") , file_handle);
    }*/

   /* if (getValue (eWrite_WFS_Trigger_TranspID))
    {        
        sig_val = getValue (eWFS_Trigger_TranspIDD);
        ltoa(sig_val, sig_str, 10);

        curr_time = (timeNow()/100000.0); //current time in seconds       
        snprintf(curr_time_str,elcount(curr_time_str),"%f\t", curr_time);                

        filePutString (curr_time_str, elCount(curr_time_str), file_handle);
        filePutString ("WFS_Trigger_TranspID\t", elCount("WFS_Trigger_TranspID\t") , file_handle);
        filePutString (sig_str, elCount(sig_str) , file_handle);
        filePutString ("\n", elCount("\n") , file_handle);
    }*/

 /*   if (getValue (eWrite_WFS_Nr_ID_Geber))
    {        
        sig_val = getValue (eWFS_Nr_ID_GeberD);
        ltoa(sig_val, sig_str, 10);

        curr_time = (timeNow()/100000.0); //current time in seconds       
        snprintf(curr_time_str,elcount(curr_time_str),"%f\t", curr_time);                

        filePutString (curr_time_str, elCount(curr_time_str), file_handle);
        filePutString ("WFS_Nr_ID_Geber\t", elCount("WFS_Nr_ID_Geber\t") , file_handle);
        filePutString (sig_str, elCount(sig_str) , file_handle);
        filePutString ("\n", elCount("\n") , file_handle);
    }*/

    /* NMH_Kombi */
    if (getValue (eWrite_NM_Kombi_NM_State))
    {        
        sig_val = getValue (eNM_Kombi_NM_StateD);
        ltoa(sig_val, sig_str, 10);

        curr_time = (timeNow()/100000.0); //current time in seconds       
        snprintf(curr_time_str,elcount(curr_time_str),"%f\t", curr_time);                

        filePutString (curr_time_str, elCount(curr_time_str), file_handle);
        filePutString ("NM_Kombi_NM_State\t", elCount("NM_Kombi_NM_State\t") , file_handle);
        filePutString (sig_str, elCount(sig_str) , file_handle);
        filePutString ("\n", elCount("\n") , file_handle);
    }

    if (getValue (eWrite_NM_Kombi_Car_Wakeup))
    {        
        sig_val = getValue (eNM_Kombi_Car_WakeupD);
        ltoa(sig_val, sig_str, 10);

        curr_time = (timeNow()/100000.0); //current time in seconds       
        snprintf(curr_time_str,elcount(curr_time_str),"%f\t", curr_time);                

        filePutString (curr_time_str, elCount(curr_time_str), file_handle);
        filePutString ("NM_Kombi_Car_Wakeup\t", elCount("NM_Kombi_Car_Wakeup\t") , file_handle);
        filePutString (sig_str, elCount(sig_str) , file_handle);
        filePutString ("\n", elCount("\n") , file_handle);
    }

    /* WFS_Go_2 */
 /*   if (getValue (eWrite_WFS_Zufallszahl))
    {        
        sig_val = getValue (eWFS_ZufallszahlD);
        ltoa(sig_val, sig_str, 10);

        curr_time = (timeNow()/100000.0); //current time in seconds       
        snprintf(curr_time_str,elcount(curr_time_str),"%f\t", curr_time);                

        filePutString (curr_time_str, elCount(curr_time_str), file_handle);
        filePutString ("WFS_Zufallszahl\t", elCount("WFS_Zufallszahl\t") , file_handle);
        filePutString (sig_str, elCount(sig_str) , file_handle);
        filePutString ("\n", elCount("\n") , file_handle);
    }*/

    /* Reset */
    if (getValue (eWrite_RES_TripReset))
    {        
        sig_val = getValue (eRES_TripResetD);
        ltoa(sig_val, sig_str, 10);

        curr_time = (timeNow()/100000.0); //current time in seconds       
        snprintf(curr_time_str,elcount(curr_time_str),"%f\t", curr_time);                

        filePutString (curr_time_str, elCount(curr_time_str), file_handle);
        filePutString ("RES_TripReset\t", elCount("RES_TripReset\t") , file_handle);
        filePutString (sig_str, elCount(sig_str) , file_handle);
        filePutString ("\n", elCount("\n") , file_handle);
    }

    /* OBD_Tankgeber_01 */
    if (getValue (eWrite_OBD_TG_F_Status_1))
    {        
        sig_val = getValue (eOBD_TG_F_Status_1D);
        ltoa(sig_val, sig_str, 10);

        curr_time = (timeNow()/100000.0); //current time in seconds       
        snprintf(curr_time_str,elcount(curr_time_str),"%f\t", curr_time);                

        filePutString (curr_time_str, elCount(curr_time_str), file_handle);
        filePutString ("OBD_TG_F_Status_1\t", elCount("OBD_TG_F_Status_1\t") , file_handle);
        filePutString (sig_str, elCount(sig_str) , file_handle);
        filePutString ("\n", elCount("\n") , file_handle);
    }

    if (getValue (eWrite_OBD_TG_F_Status_2))
    {        
        sig_val = getValue (eOBD_TG_F_Status_2D);
        ltoa(sig_val, sig_str, 10);

        curr_time = (timeNow()/100000.0); //current time in seconds       
        snprintf(curr_time_str,elcount(curr_time_str),"%f\t", curr_time);                

        filePutString (curr_time_str, elCount(curr_time_str), file_handle);
        filePutString ("OBD_TG_F_Status_2\t", elCount("OBD_TG_F_Status_2\t") , file_handle);
        filePutString (sig_str, elCount(sig_str) , file_handle);
        filePutString ("\n", elCount("\n") , file_handle);
    }

    if (getValue (eWrite_OBD_TG_F_Status_3))
    {        
        sig_val = getValue (eOBD_TG_F_Status_3D);
        ltoa(sig_val, sig_str, 10);

        curr_time = (timeNow()/100000.0); //current time in seconds       
        snprintf(curr_time_str,elcount(curr_time_str),"%f\t", curr_time);                

        filePutString (curr_time_str, elCount(curr_time_str), file_handle);
        filePutString ("OBD_TG_F_Status_3\t", elCount("OBD_TG_F_Status_3\t") , file_handle);
        filePutString (sig_str, elCount(sig_str) , file_handle);
        filePutString ("\n", elCount("\n") , file_handle);
    }

    if (getValue (eWrite_OBD_TG_F_Status_4))
    {        
        sig_val = getValue (eOBD_TG_F_Status_4D);
        ltoa(sig_val, sig_str, 10);

        curr_time = (timeNow()/100000.0); //current time in seconds       
        snprintf(curr_time_str,elcount(curr_time_str),"%f\t", curr_time);                

        filePutString (curr_time_str, elCount(curr_time_str), file_handle);
        filePutString ("OBD_TG_F_Status_4\t", elCount("OBD_TG_F_Status_4\t") , file_handle);
        filePutString (sig_str, elCount(sig_str) , file_handle);
        filePutString ("\n", elCount("\n") , file_handle);
    }

    if (getValue (eWrite_OBD_TG_Sens_Rohwert_1))
    {        
        sig_val = getValue (eOBD_TG_Sens_Rohwert_1D);
        ltoa(sig_val, sig_str, 10);

        curr_time = (timeNow()/100000.0); //current time in seconds       
        snprintf(curr_time_str,elcount(curr_time_str),"%f\t", curr_time);                

        filePutString (curr_time_str, elCount(curr_time_str), file_handle);
        filePutString ("OBD_TG_Sens_Rohwert_1\t", elCount("OBD_TG_Sens_Rohwert_1\t") , file_handle);
        filePutString (sig_str, elCount(sig_str) , file_handle);
        filePutString ("\n", elCount("\n") , file_handle);
    }

    if (getValue (eWrite_OBD_TG_Sens_Rohwert_2))
    {        
        sig_val = getValue (eOBD_TG_Sens_Rohwert_2D);
        ltoa(sig_val, sig_str, 10);

        curr_time = (timeNow()/100000.0); //current time in seconds       
        snprintf(curr_time_str,elcount(curr_time_str),"%f\t", curr_time);                

        filePutString (curr_time_str, elCount(curr_time_str), file_handle);
        filePutString ("OBD_TG_Sens_Rohwert_2\t", elCount("OBD_TG_Sens_Rohwert_2\t") , file_handle);
        filePutString (sig_str, elCount(sig_str) , file_handle);
        filePutString ("\n", elCount("\n") , file_handle);
    }

    if (getValue (eWrite_OBD_TG_Sens_Rohwert_3))
    {        
        sig_val = getValue (eOBD_TG_Sens_Rohwert_3D);
        ltoa(sig_val, sig_str, 10);

        curr_time = (timeNow()/100000.0); //current time in seconds       
        snprintf(curr_time_str,elcount(curr_time_str),"%f\t", curr_time);                

        filePutString (curr_time_str, elCount(curr_time_str), file_handle);
        filePutString ("OBD_TG_Sens_Rohwert_3\t", elCount("OBD_TG_Sens_Rohwert_3\t") , file_handle);
        filePutString (sig_str, elCount(sig_str) , file_handle);
        filePutString ("\n", elCount("\n") , file_handle);
    }

    if (getValue (eWrite_OBD_TG_Sens_Rohwert_4))
    {        
        sig_val = getValue (eOBD_TG_Sens_Rohwert_4D);
        ltoa(sig_val, sig_str, 10);

        curr_time = (timeNow()/100000.0); //current time in seconds       
        snprintf(curr_time_str,elcount(curr_time_str),"%f\t", curr_time);                

        filePutString (curr_time_str, elCount(curr_time_str), file_handle);
        filePutString ("OBD_TG_Sens_Rohwert_4\t", elCount("OBD_TG_Sens_Rohwert_4\t") , file_handle);
        filePutString (sig_str, elCount(sig_str) , file_handle);
        filePutString ("\n", elCount("\n") , file_handle);
    }
    
    /* KN_Kombi */
    if (getValue (eWrite_Kombi_Nachlauftyp))
    {        
        sig_val = getValue (eKombi_NachlauftypD);
        ltoa(sig_val, sig_str, 10);

        curr_time = (timeNow()/100000.0); //current time in seconds       
        snprintf(curr_time_str,elcount(curr_time_str),"%f\t", curr_time);                

        filePutString (curr_time_str, elCount(curr_time_str), file_handle);
        filePutString ("Kombi_Nachlauftyp\t", elCount("Kombi_Nachlauftyp\t") , file_handle);
        filePutString (sig_str, elCount(sig_str) , file_handle);
        filePutString ("\n", elCount("\n") , file_handle);
    }

    if (getValue (eWrite_KBI_KD_Fehler))
    {        
        sig_val = getValue (eKBI_KD_FehlerD);
        ltoa(sig_val, sig_str, 10);

        curr_time = (timeNow()/100000.0); //current time in seconds       
        snprintf(curr_time_str,elcount(curr_time_str),"%f\t", curr_time);                

        filePutString (curr_time_str, elCount(curr_time_str), file_handle);
        filePutString ("KBI_KD_Fehler\t", elCount("KBI_KD_Fehler\t") , file_handle);
        filePutString (sig_str, elCount(sig_str) , file_handle);
        filePutString ("\n", elCount("\n") , file_handle);
    }

    /* Sensorik_Dimmung_01 */
    if (getValue (eWrite_KBI_Phototransistor))
    {        
        sig_val = getValue (eKBI_PhototransistorD);
        ltoa(sig_val, sig_str, 10);

        curr_time = (timeNow()/100000.0); //current time in seconds       
        snprintf(curr_time_str,elcount(curr_time_str),"%f\t", curr_time);                

        filePutString (curr_time_str, elCount(curr_time_str), file_handle);
        filePutString ("KBI_Phototransistor\t", elCount("KBI_Phototransistor\t") , file_handle);
        filePutString (sig_str, elCount(sig_str) , file_handle);
        filePutString ("\n", elCount("\n") , file_handle);

        /* To calculate the maximum and mimimum value of signal */
        if (index == 0)
        {
            max_pt_val = sig_val;
            min_pt_val = sig_val;
        }
        else
        {
            if (sig_val < min_pt_val)
            {
                min_pt_val = sig_val;
            }
            else if (sig_val > max_pt_val)
            {
                max_pt_val = sig_val;
            }
        }
        index = 1;
    }

    if (getValue (eWrite_KBI_Dimmpoti))
    {        
        sig_val = getValue (eKBI_DimmpotiD);
        ltoa(sig_val, sig_str, 10);

        curr_time = (timeNow()/100000.0); //current time in seconds       
        snprintf(curr_time_str,elcount(curr_time_str),"%f\t", curr_time);                

        filePutString (curr_time_str, elCount(curr_time_str), file_handle);
        filePutString ("KBI_Dimmpoti\t", elCount("KBI_Dimmpoti\t") , file_handle);
        filePutString (sig_str, elCount(sig_str) , file_handle);
        filePutString ("\n", elCount("\n") , file_handle);
    }

    filePutString ("\n", elCount("\n") , file_handle);
    setTimer (log_timer, getValue(eLogInterval));
}

