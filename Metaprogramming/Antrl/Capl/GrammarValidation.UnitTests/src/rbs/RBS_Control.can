/*@!Encoding:1252*/
variables
{
}

on start
{
    putValue( eChangeAnhaenger_01, 1 );
    putValue( eChangeAnhaenger_01, 0 );

    putValue( eChangeASTA_Sensor_01, 1 );
    putValue( eChangeASTA_Sensor_01, 0 );

    putValue( eChangeAZK_01, 1 );
    putValue( eChangeAZK_01, 0 );

    putValue( eChangeBAP_BC_ASG_02, 1 );
    putValue( eChangeBAP_BC_ASG_02, 0 );

    putValue( eChangeBCM_01, 1 );
    putValue( eChangeBCM_01, 0 );

    putValue( eChangeBCM_03, 1 );
    putValue( eChangeBCM_03, 0 );

    putValue( eChangeBCM_04, 1 );
    putValue( eChangeBCM_04, 0 );

    putValue( eChangeBCM_05, 1 );
    putValue( eChangeBCM_05, 0 );

    putValue( eChangeBCM_06, 1 );
    putValue( eChangeBCM_06, 0 );

    putValue( eChangeBCM_Kessy_01, 1 );
    putValue( eChangeBCM_Kessy_01, 0 );

    putValue( eChangeBCM_Kessy_02, 1 );
    putValue( eChangeBCM_Kessy_02, 0 );

    putValue( eChangeBCM_Taster_02, 1 );
    putValue( eChangeBCM_Taster_02, 0 );

    putValue( eChangeBlinkmodi_02, 1 );
    putValue( eChangeBlinkmodi_02, 0 );

    // DDA_AuthTime_Req
    // DiETa_01

    putValue( eChangeDimmung_01, 1 );
    putValue( eChangeDimmung_01, 0 );

    putValue( eChangeELV_01, 1 );
    putValue( eChangeELV_01, 0 );

    // ELV_WFS_Anfrage
    // EmpfEinheit_STSG_HBFS_01
    // EmpfEinheit_STSG_HFS_01
    // FoD_BCM1_Resp
    // FS_Position_01
    // FS_Position_02
    // GRA_ACC_01   BCM and Gateway
    // HDSG_01

    putValue( eChangeHUD_01, 1 );
    putValue( eChangeHUD_01, 0 );

    // IL_TSG_BFS_01
    // IL_TSG_FS_01
    // IL_TSG_HBFS_01
    // IL_TSG_HFS_01
    // IMMO_ELV_Antwort
    // IMMO_GSG_Antwort
    // IMMO_MSG1_Antwort
    // IMMO_MSG2_Antwort
    // IMMO_MSG3_Antwort
    // IMMO_MSG4_Antwort
    // IMMO_OCU_Antwort
    // Innenlicht_11
    // Kessy_03

    putValue( eChangeKessy_04, 1 );
    putValue( eChangeKessy_04, 0 );

    putValue( eChangeKlemmen_Status_01, 1 );
    putValue( eChangeKlemmen_Status_01, 0 );

    // Klemmen_Status_02

    putValue( eChangeKlemmen_Steuerung_01, 1 );
    putValue( eChangeKlemmen_Steuerung_01, 0 );

    // Klima_03  --> message_Klima_03.cin
    // Klima_06  --> message_Klima_06.cin
    // Klima_11
    // Klima_12  --> message_Klima_12.cin
    // Klima_16  --> message_Klima_16.cin
    // Klima_EV_03
    // Klima_EV_04
    // Klima_EV_05
    // Klima_EV_06
    // Klima_hinten_04
    // Klima_SDA_01
    // Klima_Sensor_01

    putValue( eChangeKlima_Sensor_02, 1 );
    putValue( eChangeKlima_Sensor_02, 0 );

    // Klima_Sensor_03
    // Klima_Sensor_04
    // KN_AAG
    // KN_BCM1
    // KN_ELV
    // KN_HDSG
    // KN_HUD
    // KN_Klima
    // KN_MFG
    // KN_SAD
    // KN_Sitzmemo_BFS
    // KN_Sitzmemo_FS
    // KN_STSG_HBFS
    // KN_STSG_HFS
    // KN_TCO
    // KN_TSG_BFS
    // KN_TSG_FS
    // KN_TSG_HBFS
    // KN_TSG_HFS
    // KN_VSG
    // KS_BCM1_Resp
    // KS_MFG_Resp
    // LCM_Soll_Fkt

    putValue( eChangeLicht_Anf_01, 1 );
    putValue( eChangeLicht_Anf_01, 0 );

    putValue( eChangeLicht_hinten_01, 1 );
    putValue( eChangeLicht_hinten_01, 0 );

    putValue( eChangeLicht_vorne_01, 1 );
    putValue( eChangeLicht_vorne_01, 0 );

    putValue( eChangeLoGeWa_03, 1 );
    putValue( eChangeLoGeWa_03, 0 );

    putValue( eChangeLWR_AFS_01, 1 ); // BCM and Gateway
    putValue( eChangeLWR_AFS_01, 0 );

    putValue( eChangeMem_BFS_01, 1 );
    putValue( eChangeMem_BFS_01, 0 );

    putValue( eChangeMem_FS_01, 1 );
    putValue( eChangeMem_FS_01, 0 );

    // Mem_FS_02
    // Mem_Taster_BT_01
    // Mem_Taster_FT_01

    putValue( eChangeMFG_01, 1 );
    putValue( eChangeMFG_01, 0 );

    // MFG_02
    // MFG_03
    // NMH_AAG
    // NMH_BCM1
    // NMH_ELV
    // NMH_HDSG
    // NMH_HUD
    // NMH_Klima
    // NMH_MFG
    // NMH_SAD
    // NMH_Sitzmemo_BFS
    // NMH_Sitzmemo_FS

    putValue( eChangeNMH_STSG_HBFS, 1 );
    putValue( eChangeNMH_STSG_HBFS, 0 );

    putValue( eChangeNMH_STSG_HFS, 1 );
    putValue( eChangeNMH_STSG_HFS, 0 );

    // NMH_TSG_BFS
    // NMH_TSG_FS
    // NMH_TSG_HBFS
    // NMH_TSG_HFS
    // NMH_VSG
    // PAO_Status_01

    putValue( eChangePersonalisierung_01, 1 );
    putValue( eChangePersonalisierung_01, 0 );

    // PTC_01

    putValue( eChangeRLS_01, 1 );
    putValue( eChangeRLS_01, 0 );

    // SAD_01
    // SM_LAPP_01
    // SM_LAPP_02

    putValue( eChangeSMLS_01, 1 );
    putValue( eChangeSMLS_01, 0 );

    putValue( eChangeSOK_NoAuthenticTime_01, 1 );
    putValue( eChangeSOK_NoAuthenticTime_01, 0 );

    // SOK_Zeit_DDA_Chal_01
    // SOK_Zeit_Klima_Chal_01
    // SoSe_01
    // Spiegel_01
    // STSG_HBFS_01
    // STSG_HFS_01
    
    putValue( eChangeTCO_01, 1 );
    putValue( eChangeTCO_01, 0 );

    // Thermo_Verbrauch_01  --> message_Thermo_Verbrauch_01.cin

    putValue( eChangeTimeDate, 1 );
    putValue( eChangeTimeDate, 0 );

    // TSG_BT_01

    putValue( eChangeTSG_FT_01, 1 );
    putValue( eChangeTSG_FT_01, 0 );

    putValue( eChangeTSG_FT_02, 1 );
    putValue( eChangeTSG_FT_02, 0 );

    // TSG_HBFS_01
    // TSG_HFS_01

    putValue( eChangeVehiDist, 1 );
    putValue( eChangeVehiDist, 0 );

    // Verdeck_01
    // VIN_01
    // VLK_01

    putValue( eChangeWFS_01, 1 );
    putValue( eChangeWFS_01, 0 );

    putValue( eChangeWFS_Transponder_Req_02, 1 );
    putValue( eChangeWFS_Transponder_Req_02, 0 );

    putValue( eChangeWischer_01, 1 );
    putValue( eChangeWischer_01, 0 );

    // WLC1_01
    // ZFH_01
    // ZV_01

    putValue( eChangeZV_02, 1 );
    putValue( eChangeZV_02, 0 );


    putValue( eChangeLog_Datenlogger_Req, 1 );
    putValue( eChangeLog_Datenlogger_Req, 0 );

    putValue( eChangeLog_Kombi_Req, 1 );
    putValue( eChangeLog_Kombi_Req, 0 );
}

on envVar eChangeAnhaenger_01
{
    if (getValue(this))
    {
        enableControl( "Non-GW Messages", "EnvVar:eDlcAnhaenger_01", 1 );
        enableControl( "Non-GW Messages", "EnvVar:eDlcAnhaenger_01Dec", 1 );
        enableControl( "Non-GW Messages", "EnvVar:eDlcAnhaenger_01Inc", 1 );
        enableControl( "Non-GW Messages", "EnvVar:eDlcAnhaenger_01Def", 1 );
        enableControl( "Non-GW Messages", "EnvVar:eDlcOnceAnhaenger_01", 1 );
        enableControl( "Non-GW Messages", "EnvVar:eDlcWrongAnhaenger_01", 1 );
        enableControl( "Non-GW Messages", "EnvVar:eBZAnhaenger_01", 1 );
        enableControl( "Non-GW Messages", "EnvVar:eBZStepAnhaenger_01", 1 );
        enableControl( "Non-GW Messages", "EnvVar:eBZStepAnhaenger_01Dec", 1 );
        enableControl( "Non-GW Messages", "EnvVar:eBZStepAnhaenger_01Inc", 1 );
        enableControl( "Non-GW Messages", "EnvVar:eBZStepAnhaenger_01Def", 1 );
        enableControl( "Non-GW Messages", "EnvVar:eCrcAnhaenger_01", 1 );
    }
    else
    {
        enableControl( "Non-GW Messages", "EnvVar:eDlcAnhaenger_01", 0 );
        enableControl( "Non-GW Messages", "EnvVar:eDlcAnhaenger_01Dec", 0 );
        enableControl( "Non-GW Messages", "EnvVar:eDlcAnhaenger_01Inc", 0 );
        enableControl( "Non-GW Messages", "EnvVar:eDlcAnhaenger_01Def", 0 );
        enableControl( "Non-GW Messages", "EnvVar:eDlcOnceAnhaenger_01", 0 );
        enableControl( "Non-GW Messages", "EnvVar:eDlcWrongAnhaenger_01", 0 );
        enableControl( "Non-GW Messages", "EnvVar:eBZAnhaenger_01", 0 );
        enableControl( "Non-GW Messages", "EnvVar:eBZStepAnhaenger_01", 0 );
        enableControl( "Non-GW Messages", "EnvVar:eBZStepAnhaenger_01Dec", 0 );
        enableControl( "Non-GW Messages", "EnvVar:eBZStepAnhaenger_01Inc", 0 );
        enableControl( "Non-GW Messages", "EnvVar:eBZStepAnhaenger_01Def", 0 );
        enableControl( "Non-GW Messages", "EnvVar:eCrcAnhaenger_01", 0 );
    }
}

on envVar eChangeASTA_Sensor_01
{
    if (getValue(this))
    {
        enableControl( "Non-GW Messages", "EnvVar:eDlcASTA_Sensor_01", 1 );
        enableControl( "Non-GW Messages", "EnvVar:eDlcASTA_Sensor_01Dec", 1 );
        enableControl( "Non-GW Messages", "EnvVar:eDlcASTA_Sensor_01Inc", 1 );
        enableControl( "Non-GW Messages", "EnvVar:eDlcASTA_Sensor_01Def", 1 );
        enableControl( "Non-GW Messages", "EnvVar:eDlcOnceASTA_Sensor_01", 1 );
        enableControl( "Non-GW Messages", "EnvVar:eDlcWrongASTA_Sensor_01", 1 );
    }
    else
    {
        enableControl( "Non-GW Messages", "EnvVar:eDlcASTA_Sensor_01", 0 );
        enableControl( "Non-GW Messages", "EnvVar:eDlcASTA_Sensor_01Dec", 0 );
        enableControl( "Non-GW Messages", "EnvVar:eDlcASTA_Sensor_01Inc", 0 );
        enableControl( "Non-GW Messages", "EnvVar:eDlcASTA_Sensor_01Def", 0 );
        enableControl( "Non-GW Messages", "EnvVar:eDlcOnceASTA_Sensor_01", 0 );
        enableControl( "Non-GW Messages", "EnvVar:eDlcWrongASTA_Sensor_01", 0 );
    }
}

on envVar eChangeAZK_01
{
    if (getValue(this))
    {
        enableControl( "Non-GW Messages", "EnvVar:eDlcAZK_01", 1 );
        enableControl( "Non-GW Messages", "EnvVar:eDlcAZK_01Dec", 1 );
        enableControl( "Non-GW Messages", "EnvVar:eDlcAZK_01Inc", 1 );
        enableControl( "Non-GW Messages", "EnvVar:eDlcAZK_01Def", 1 );
        enableControl( "Non-GW Messages", "EnvVar:eDlcOnceAZK_01", 1 );
        enableControl( "Non-GW Messages", "EnvVar:eDlcWrongAZK_01", 1 );
    }
    else
    {
        enableControl( "Non-GW Messages", "EnvVar:eDlcAZK_01", 0 );
        enableControl( "Non-GW Messages", "EnvVar:eDlcAZK_01Dec", 0 );
        enableControl( "Non-GW Messages", "EnvVar:eDlcAZK_01Inc", 0 );
        enableControl( "Non-GW Messages", "EnvVar:eDlcAZK_01Def", 0 );
        enableControl( "Non-GW Messages", "EnvVar:eDlcOnceAZK_01", 0 );
        enableControl( "Non-GW Messages", "EnvVar:eDlcWrongAZK_01", 0 );
    }
}

on envVar eChangeBAP_BC_ASG_02
{
    if (getValue(this))
    {
        enableControl( "Non-GW Messages", "EnvVar:eDlcBAP_BC_ASG_02", 1 );
        enableControl( "Non-GW Messages", "EnvVar:eDlcBAP_BC_ASG_02Dec", 1 );
        enableControl( "Non-GW Messages", "EnvVar:eDlcBAP_BC_ASG_02Inc", 1 );
        enableControl( "Non-GW Messages", "EnvVar:eDlcBAP_BC_ASG_02Def", 1 );
        enableControl( "Non-GW Messages", "EnvVar:eDlcOnceBAP_BC_ASG_02", 1 );
        enableControl( "Non-GW Messages", "EnvVar:eDlcWrongBAP_BC_ASG_02", 1 );
    }
    else
    {
        enableControl( "Non-GW Messages", "EnvVar:eDlcBAP_BC_ASG_02", 0 );
        enableControl( "Non-GW Messages", "EnvVar:eDlcBAP_BC_ASG_02Dec", 0 );
        enableControl( "Non-GW Messages", "EnvVar:eDlcBAP_BC_ASG_02Inc", 0 );
        enableControl( "Non-GW Messages", "EnvVar:eDlcBAP_BC_ASG_02Def", 0 );
        enableControl( "Non-GW Messages", "EnvVar:eDlcOnceBAP_BC_ASG_02", 0 );
        enableControl( "Non-GW Messages", "EnvVar:eDlcWrongBAP_BC_ASG_02", 0 );
    }
}

on envVar eChangeBCM_01
{
    if (getValue(this))
    {
        enableControl( "Non-GW Messages", "EnvVar:eDlcBCM_01", 1 );
        enableControl( "Non-GW Messages", "EnvVar:eDlcBCM_01Dec", 1 );
        enableControl( "Non-GW Messages", "EnvVar:eDlcBCM_01Inc", 1 );
        enableControl( "Non-GW Messages", "EnvVar:eDlcBCM_01Def", 1 );
        enableControl( "Non-GW Messages", "EnvVar:eDlcOnceBCM_01", 1 );
        enableControl( "Non-GW Messages", "EnvVar:eDlcWrongBCM_01", 1 );
    }
    else
    {
        enableControl( "Non-GW Messages", "EnvVar:eDlcBCM_01", 0 );
        enableControl( "Non-GW Messages", "EnvVar:eDlcBCM_01Dec", 0 );
        enableControl( "Non-GW Messages", "EnvVar:eDlcBCM_01Inc", 0 );
        enableControl( "Non-GW Messages", "EnvVar:eDlcBCM_01Def", 0 );
        enableControl( "Non-GW Messages", "EnvVar:eDlcOnceBCM_01", 0 );
        enableControl( "Non-GW Messages", "EnvVar:eDlcWrongBCM_01", 0 );
    }
}

on envVar eChangeBCM_03
{
    if (getValue(this))
    {
        enableControl( "Non-GW Messages", "EnvVar:eDlcBCM_03", 1 );
        enableControl( "Non-GW Messages", "EnvVar:eDlcBCM_03Dec", 1 );
        enableControl( "Non-GW Messages", "EnvVar:eDlcBCM_03Inc", 1 );
        enableControl( "Non-GW Messages", "EnvVar:eDlcBCM_03Def", 1 );
        enableControl( "Non-GW Messages", "EnvVar:eDlcOnceBCM_03", 1 );
        enableControl( "Non-GW Messages", "EnvVar:eDlcWrongBCM_03", 1 );
    }
    else
    {
        enableControl( "Non-GW Messages", "EnvVar:eDlcBCM_03", 0 );
        enableControl( "Non-GW Messages", "EnvVar:eDlcBCM_03Dec", 0 );
        enableControl( "Non-GW Messages", "EnvVar:eDlcBCM_03Inc", 0 );
        enableControl( "Non-GW Messages", "EnvVar:eDlcBCM_03Def", 0 );
        enableControl( "Non-GW Messages", "EnvVar:eDlcOnceBCM_03", 0 );
        enableControl( "Non-GW Messages", "EnvVar:eDlcWrongBCM_03", 0 );
    }
}

on envVar eChangeBCM_04
{
    if (getValue(this))
    {
        enableControl( "Non-GW Messages", "EnvVar:eDlcBCM_04", 1 );
        enableControl( "Non-GW Messages", "EnvVar:eDlcBCM_04Dec", 1 );
        enableControl( "Non-GW Messages", "EnvVar:eDlcBCM_04Inc", 1 );
        enableControl( "Non-GW Messages", "EnvVar:eDlcBCM_04Def", 1 );
        enableControl( "Non-GW Messages", "EnvVar:eDlcOnceBCM_04", 1 );
        enableControl( "Non-GW Messages", "EnvVar:eDlcWrongBCM_04", 1 );
    }
    else
    {
        enableControl( "Non-GW Messages", "EnvVar:eDlcBCM_04", 0 );
        enableControl( "Non-GW Messages", "EnvVar:eDlcBCM_04Dec", 0 );
        enableControl( "Non-GW Messages", "EnvVar:eDlcBCM_04Inc", 0 );
        enableControl( "Non-GW Messages", "EnvVar:eDlcBCM_04Def", 0 );
        enableControl( "Non-GW Messages", "EnvVar:eDlcOnceBCM_04", 0 );
        enableControl( "Non-GW Messages", "EnvVar:eDlcWrongBCM_04", 0 );
    }
}

on envVar eChangeBlinkmodi_02
{
    if (getValue(this))
    {
        enableControl( "Non-GW Messages", "EnvVar:eDlcBlinkmodi_02", 1 );
        enableControl( "Non-GW Messages", "EnvVar:eDlcBlinkmodi_02Dec", 1 );
        enableControl( "Non-GW Messages", "EnvVar:eDlcBlinkmodi_02Inc", 1 );
        enableControl( "Non-GW Messages", "EnvVar:eDlcBlinkmodi_02Def", 1 );
        enableControl( "Non-GW Messages", "EnvVar:eDlcOnceBlinkmodi_02", 1 );
        enableControl( "Non-GW Messages", "EnvVar:eDlcWrongBlinkmodi_02", 1 );
    }
    else
    {
        enableControl( "Non-GW Messages", "EnvVar:eDlcBlinkmodi_02", 0 );
        enableControl( "Non-GW Messages", "EnvVar:eDlcBlinkmodi_02Dec", 0 );
        enableControl( "Non-GW Messages", "EnvVar:eDlcBlinkmodi_02Inc", 0 );
        enableControl( "Non-GW Messages", "EnvVar:eDlcBlinkmodi_02Def", 0 );
        enableControl( "Non-GW Messages", "EnvVar:eDlcOnceBlinkmodi_02", 0 );
        enableControl( "Non-GW Messages", "EnvVar:eDlcWrongBlinkmodi_02", 0 );
    }
}

on envVar eChangeDimmung_01
{
    if (getValue(this))
    {
        enableControl( "Non-GW Messages", "EnvVar:eDlcDimmung_01", 1 );
        enableControl( "Non-GW Messages", "EnvVar:eDlcDimmung_01Dec", 1 );
        enableControl( "Non-GW Messages", "EnvVar:eDlcDimmung_01Inc", 1 );
        enableControl( "Non-GW Messages", "EnvVar:eDlcDimmung_01Def", 1 );
        enableControl( "Non-GW Messages", "EnvVar:eDlcOnceDimmung_01", 1 );
        enableControl( "Non-GW Messages", "EnvVar:eDlcWrongDimmung_01", 1 );
    }
    else
    {
        enableControl( "Non-GW Messages", "EnvVar:eDlcDimmung_01", 0 );
        enableControl( "Non-GW Messages", "EnvVar:eDlcDimmung_01Dec", 0 );
        enableControl( "Non-GW Messages", "EnvVar:eDlcDimmung_01Inc", 0 );
        enableControl( "Non-GW Messages", "EnvVar:eDlcDimmung_01Def", 0 );
        enableControl( "Non-GW Messages", "EnvVar:eDlcOnceDimmung_01", 0 );
        enableControl( "Non-GW Messages", "EnvVar:eDlcWrongDimmung_01", 0 );
    }
}

on envVar eChangeELV_01
{
    if (getValue(this))
    {
        enableControl( "Non-GW Messages", "EnvVar:eDlcELV_01", 1 );
        enableControl( "Non-GW Messages", "EnvVar:eDlcELV_01Dec", 1 );
        enableControl( "Non-GW Messages", "EnvVar:eDlcELV_01Inc", 1 );
        enableControl( "Non-GW Messages", "EnvVar:eDlcELV_01Def", 1 );
        enableControl( "Non-GW Messages", "EnvVar:eDlcOnceELV_01", 1 );
        enableControl( "Non-GW Messages", "EnvVar:eDlcWrongELV_01", 1 );
    }
    else
    {
        enableControl( "Non-GW Messages", "EnvVar:eDlcELV_01", 0 );
        enableControl( "Non-GW Messages", "EnvVar:eDlcELV_01Dec", 0 );
        enableControl( "Non-GW Messages", "EnvVar:eDlcELV_01Inc", 0 );
        enableControl( "Non-GW Messages", "EnvVar:eDlcELV_01Def", 0 );
        enableControl( "Non-GW Messages", "EnvVar:eDlcOnceELV_01", 0 );
        enableControl( "Non-GW Messages", "EnvVar:eDlcWrongELV_01", 0 );
    }
}

on envVar eChangeHUD_01
{
    if (getValue(this))
    {
        enableControl( "Non-GW Messages", "EnvVar:eDlcHUD_01", 1 );
        enableControl( "Non-GW Messages", "EnvVar:eDlcHUD_01Dec", 1 );
        enableControl( "Non-GW Messages", "EnvVar:eDlcHUD_01Inc", 1 );
        enableControl( "Non-GW Messages", "EnvVar:eDlcHUD_01Def", 1 );
        enableControl( "Non-GW Messages", "EnvVar:eDlcOnceHUD_01", 1 );
        enableControl( "Non-GW Messages", "EnvVar:eDlcWrongHUD_01", 1 );
    }
    else
    {
        enableControl( "Non-GW Messages", "EnvVar:eDlcHUD_01", 0 );
        enableControl( "Non-GW Messages", "EnvVar:eDlcHUD_01Dec", 0 );
        enableControl( "Non-GW Messages", "EnvVar:eDlcHUD_01Inc", 0 );
        enableControl( "Non-GW Messages", "EnvVar:eDlcHUD_01Def", 0 );
        enableControl( "Non-GW Messages", "EnvVar:eDlcOnceHUD_01", 0 );
        enableControl( "Non-GW Messages", "EnvVar:eDlcWrongHUD_01", 0 );
    }
}

on envVar eChangeKessy_04
{
    if (getValue(this))
    {
        enableControl( "Non-GW Messages", "EnvVar:eDlcKessy_04", 1 );
        enableControl( "Non-GW Messages", "EnvVar:eDlcKessy_04Dec", 1 );
        enableControl( "Non-GW Messages", "EnvVar:eDlcKessy_04Inc", 1 );
        enableControl( "Non-GW Messages", "EnvVar:eDlcKessy_04Def", 1 );
        enableControl( "Non-GW Messages", "EnvVar:eDlcOnceKessy_04", 1 );
        enableControl( "Non-GW Messages", "EnvVar:eDlcWrongKessy_04", 1 );
    }
    else
    {
        enableControl( "Non-GW Messages", "EnvVar:eDlcKessy_04", 0 );
        enableControl( "Non-GW Messages", "EnvVar:eDlcKessy_04Dec", 0 );
        enableControl( "Non-GW Messages", "EnvVar:eDlcKessy_04Inc", 0 );
        enableControl( "Non-GW Messages", "EnvVar:eDlcKessy_04Def", 0 );
        enableControl( "Non-GW Messages", "EnvVar:eDlcOnceKessy_04", 0 );
        enableControl( "Non-GW Messages", "EnvVar:eDlcWrongKessy_04", 0 );
    }
}

on envVar eChangeKlemmen_Status_01
{
    if (getValue(this))
    {
        enableControl( "Non-GW Messages", "EnvVar:eDlcKlemmen_Status_01", 1 );
        enableControl( "Non-GW Messages", "EnvVar:eDlcKlemmen_Status_01Dec", 1 );
        enableControl( "Non-GW Messages", "EnvVar:eDlcKlemmen_Status_01Inc", 1 );
        enableControl( "Non-GW Messages", "EnvVar:eDlcKlemmen_Status_01Def", 1 );
        enableControl( "Non-GW Messages", "EnvVar:eDlcOnceKlemmen_Status_01", 1 );
        enableControl( "Non-GW Messages", "EnvVar:eDlcWrongKlemmen_Status_01", 1 );
        enableControl( "Non-GW Messages", "EnvVar:eBZKlemmen_Status_01", 1 );
        enableControl( "Non-GW Messages", "EnvVar:eBZStepKlemmen_Status_01", 1 );
        enableControl( "Non-GW Messages", "EnvVar:eBZStepKlemmen_Status_01Dec", 1 );
        enableControl( "Non-GW Messages", "EnvVar:eBZStepKlemmen_Status_01Inc", 1 );
        enableControl( "Non-GW Messages", "EnvVar:eBZStepKlemmen_Status_01Def", 1 );
        enableControl( "Non-GW Messages", "EnvVar:eCrcKlemmen_Status_01", 1 );
    }
    else
    {
        enableControl( "Non-GW Messages", "EnvVar:eDlcKlemmen_Status_01", 0 );
        enableControl( "Non-GW Messages", "EnvVar:eDlcKlemmen_Status_01Dec", 0 );
        enableControl( "Non-GW Messages", "EnvVar:eDlcKlemmen_Status_01Inc", 0 );
        enableControl( "Non-GW Messages", "EnvVar:eDlcKlemmen_Status_01Def", 0 );
        enableControl( "Non-GW Messages", "EnvVar:eDlcOnceKlemmen_Status_01", 0 );
        enableControl( "Non-GW Messages", "EnvVar:eDlcWrongKlemmen_Status_01", 0 );
        enableControl( "Non-GW Messages", "EnvVar:eBZKlemmen_Status_01", 0 );
        enableControl( "Non-GW Messages", "EnvVar:eBZStepKlemmen_Status_01", 0 );
        enableControl( "Non-GW Messages", "EnvVar:eBZStepKlemmen_Status_01Dec", 0 );
        enableControl( "Non-GW Messages", "EnvVar:eBZStepKlemmen_Status_01Inc", 0 );
        enableControl( "Non-GW Messages", "EnvVar:eBZStepKlemmen_Status_01Def", 0 );
        enableControl( "Non-GW Messages", "EnvVar:eCrcKlemmen_Status_01", 0 );
    }
}

on envVar eChangeKlemmen_Steuerung_01
{
    if (getValue(this))
    {
        enableControl( "Non-GW Messages", "EnvVar:eDlcKlemmen_Steuerung_01", 1 );
        enableControl( "Non-GW Messages", "EnvVar:eDlcKlemmen_Steuerung_01Dec", 1 );
        enableControl( "Non-GW Messages", "EnvVar:eDlcKlemmen_Steuerung_01Inc", 1 );
        enableControl( "Non-GW Messages", "EnvVar:eDlcKlemmen_Steuerung_01Def", 1 );
        enableControl( "Non-GW Messages", "EnvVar:eDlcOnceKlemmen_Steuerung_01", 1 );
        enableControl( "Non-GW Messages", "EnvVar:eDlcWrongKlemmen_Steuerung_01", 1 );
    }
    else
    {
        enableControl( "Non-GW Messages", "EnvVar:eDlcKlemmen_Steuerung_01", 0 );
        enableControl( "Non-GW Messages", "EnvVar:eDlcKlemmen_Steuerung_01Dec", 0 );
        enableControl( "Non-GW Messages", "EnvVar:eDlcKlemmen_Steuerung_01Inc", 0 );
        enableControl( "Non-GW Messages", "EnvVar:eDlcKlemmen_Steuerung_01Def", 0 );
        enableControl( "Non-GW Messages", "EnvVar:eDlcOnceKlemmen_Steuerung_01", 0 );
        enableControl( "Non-GW Messages", "EnvVar:eDlcWrongKlemmen_Steuerung_01", 0 );
    }
}

on envVar eChangeKlima_Sensor_02
{
    if (getValue(this))
    {
        enableControl( "Non-GW Messages", "EnvVar:eDlcKlima_Sensor_02", 1 );
        enableControl( "Non-GW Messages", "EnvVar:eDlcKlima_Sensor_02Dec", 1 );
        enableControl( "Non-GW Messages", "EnvVar:eDlcKlima_Sensor_02Inc", 1 );
        enableControl( "Non-GW Messages", "EnvVar:eDlcKlima_Sensor_02Def", 1 );
        enableControl( "Non-GW Messages", "EnvVar:eDlcOnceKlima_Sensor_02", 1 );
        enableControl( "Non-GW Messages", "EnvVar:eDlcWrongKlima_Sensor_02", 1 );
    }
    else
    {
        enableControl( "Non-GW Messages", "EnvVar:eDlcKlima_Sensor_02", 0 );
        enableControl( "Non-GW Messages", "EnvVar:eDlcKlima_Sensor_02Dec", 0 );
        enableControl( "Non-GW Messages", "EnvVar:eDlcKlima_Sensor_02Inc", 0 );
        enableControl( "Non-GW Messages", "EnvVar:eDlcKlima_Sensor_02Def", 0 );
        enableControl( "Non-GW Messages", "EnvVar:eDlcOnceKlima_Sensor_02", 0 );
        enableControl( "Non-GW Messages", "EnvVar:eDlcWrongKlima_Sensor_02", 0 );
    }
}

on envVar eChangeLicht_Anf_01
{
    if (getValue(this))
    {
        enableControl( "Non-GW Messages", "EnvVar:eDlcLicht_Anf_01", 1 );
        enableControl( "Non-GW Messages", "EnvVar:eDlcLicht_Anf_01Dec", 1 );
        enableControl( "Non-GW Messages", "EnvVar:eDlcLicht_Anf_01Inc", 1 );
        enableControl( "Non-GW Messages", "EnvVar:eDlcLicht_Anf_01Def", 1 );
        enableControl( "Non-GW Messages", "EnvVar:eDlcOnceLicht_Anf_01", 1 );
        enableControl( "Non-GW Messages", "EnvVar:eDlcWrongLicht_Anf_01", 1 );
    }
    else
    {
        enableControl( "Non-GW Messages", "EnvVar:eDlcLicht_Anf_01", 0 );
        enableControl( "Non-GW Messages", "EnvVar:eDlcLicht_Anf_01Dec", 0 );
        enableControl( "Non-GW Messages", "EnvVar:eDlcLicht_Anf_01Inc", 0 );
        enableControl( "Non-GW Messages", "EnvVar:eDlcLicht_Anf_01Def", 0 );
        enableControl( "Non-GW Messages", "EnvVar:eDlcOnceLicht_Anf_01", 0 );
        enableControl( "Non-GW Messages", "EnvVar:eDlcWrongLicht_Anf_01", 0 );
    }
}

on envVar eChangeLicht_hinten_01
{
    if (getValue(this))
    {
        enableControl( "Non-GW Messages", "EnvVar:eDlcLicht_hinten_01", 1 );
        enableControl( "Non-GW Messages", "EnvVar:eDlcLicht_hinten_01Dec", 1 );
        enableControl( "Non-GW Messages", "EnvVar:eDlcLicht_hinten_01Inc", 1 );
        enableControl( "Non-GW Messages", "EnvVar:eDlcLicht_hinten_01Def", 1 );
        enableControl( "Non-GW Messages", "EnvVar:eDlcOnceLicht_hinten_01", 1 );
        enableControl( "Non-GW Messages", "EnvVar:eDlcWrongLicht_hinten_01", 1 );
        enableControl( "Non-GW Messages", "EnvVar:eBZLicht_hinten_01", 1 );
        enableControl( "Non-GW Messages", "EnvVar:eBZStepLicht_hinten_01", 1 );
        enableControl( "Non-GW Messages", "EnvVar:eBZStepLicht_hinten_01Dec", 1 );
        enableControl( "Non-GW Messages", "EnvVar:eBZStepLicht_hinten_01Inc", 1 );
        enableControl( "Non-GW Messages", "EnvVar:eBZStepLicht_hinten_01Def", 1 );
        enableControl( "Non-GW Messages", "EnvVar:eCrcLicht_hinten_01", 1 );
    }
    else
    {
        enableControl( "Non-GW Messages", "EnvVar:eDlcLicht_hinten_01", 0 );
        enableControl( "Non-GW Messages", "EnvVar:eDlcLicht_hinten_01Dec", 0 );
        enableControl( "Non-GW Messages", "EnvVar:eDlcLicht_hinten_01Inc", 0 );
        enableControl( "Non-GW Messages", "EnvVar:eDlcLicht_hinten_01Def", 0 );
        enableControl( "Non-GW Messages", "EnvVar:eDlcOnceLicht_hinten_01", 0 );
        enableControl( "Non-GW Messages", "EnvVar:eDlcWrongLicht_hinten_01", 0 );
        enableControl( "Non-GW Messages", "EnvVar:eBZLicht_hinten_01", 0 );
        enableControl( "Non-GW Messages", "EnvVar:eBZStepLicht_hinten_01", 0 );
        enableControl( "Non-GW Messages", "EnvVar:eBZStepLicht_hinten_01Dec", 0 );
        enableControl( "Non-GW Messages", "EnvVar:eBZStepLicht_hinten_01Inc", 0 );
        enableControl( "Non-GW Messages", "EnvVar:eBZStepLicht_hinten_01Def", 0 );
        enableControl( "Non-GW Messages", "EnvVar:eCrcLicht_hinten_01", 0 );
    }
}

on envVar eChangeLicht_vorne_01
{
    if (getValue(this))
    {
        enableControl( "Non-GW Messages", "EnvVar:eDlcLicht_vorne_01", 1 );
        enableControl( "Non-GW Messages", "EnvVar:eDlcLicht_vorne_01Dec", 1 );
        enableControl( "Non-GW Messages", "EnvVar:eDlcLicht_vorne_01Inc", 1 );
        enableControl( "Non-GW Messages", "EnvVar:eDlcLicht_vorne_01Def", 1 );
        enableControl( "Non-GW Messages", "EnvVar:eDlcOnceLicht_vorne_01", 1 );
        enableControl( "Non-GW Messages", "EnvVar:eDlcWrongLicht_vorne_01", 1 );
    }
    else
    {
        enableControl( "Non-GW Messages", "EnvVar:eDlcLicht_vorne_01", 0 );
        enableControl( "Non-GW Messages", "EnvVar:eDlcLicht_vorne_01Dec", 0 );
        enableControl( "Non-GW Messages", "EnvVar:eDlcLicht_vorne_01Inc", 0 );
        enableControl( "Non-GW Messages", "EnvVar:eDlcLicht_vorne_01Def", 0 );
        enableControl( "Non-GW Messages", "EnvVar:eDlcOnceLicht_vorne_01", 0 );
        enableControl( "Non-GW Messages", "EnvVar:eDlcWrongLicht_vorne_01", 0 );
    }
}

on envVar eChangeLoGeWa_03
{
    if (getValue(this))
    {
        enableControl ("GW Messages_2", "EnvVar:eDlcLoGeWa_03", 1 );
        enableControl ("GW Messages_2", "EnvVar:eDlcLoGeWa_03Dec", 1 );
        enableControl ("GW Messages_2", "EnvVar:eDlcLoGeWa_03Inc", 1 );
        enableControl ("GW Messages_2", "EnvVar:eDlcLoGeWa_03Def", 1 );
        enableControl ("GW Messages_2", "EnvVar:eDlcOnceLoGeWa_03", 1 );
        enableControl ("GW Messages_2", "EnvVar:eDlcWrongLoGeWa_03", 1 );
    }
    else
    {
        enableControl ("GW Messages_2", "EnvVar:eDlcLoGeWa_03", 0 );
        enableControl ("GW Messages_2", "EnvVar:eDlcLoGeWa_03Dec", 0 );
        enableControl ("GW Messages_2", "EnvVar:eDlcLoGeWa_03Inc", 0 );
        enableControl ("GW Messages_2", "EnvVar:eDlcLoGeWa_03Def", 0 );
        enableControl ("GW Messages_2", "EnvVar:eDlcOnceLoGeWa_03", 0 );
        enableControl ("GW Messages_2", "EnvVar:eDlcWrongLoGeWa_03", 0 );
    }
}

on envVar eChangeLWR_AFS_01
{
    if (getValue(this))
    {
        enableControl ("GW Messages_2", "EnvVar:eDlcLWR_AFS_01", 1 );
        enableControl ("GW Messages_2", "EnvVar:eDlcLWR_AFS_01Dec", 1 );
        enableControl ("GW Messages_2", "EnvVar:eDlcLWR_AFS_01Inc", 1 );
        enableControl ("GW Messages_2", "EnvVar:eDlcLWR_AFS_01Def", 1 );
        enableControl ("GW Messages_2", "EnvVar:eDlcOnceLWR_AFS_01", 1 );
        enableControl ("GW Messages_2", "EnvVar:eDlcWrongLWR_AFS_01", 1 );
        enableControl ("GW Messages_2", "EnvVar:eBZLWR_AFS_01", 1 );
        enableControl ("GW Messages_2", "EnvVar:eBZStepLWR_AFS_01", 1 );
        enableControl ("GW Messages_2", "EnvVar:eBZStepLWR_AFS_01Dec", 1 );
        enableControl ("GW Messages_2", "EnvVar:eBZStepLWR_AFS_01Inc", 1 );
        enableControl ("GW Messages_2", "EnvVar:eBZStepLWR_AFS_01Def", 1 );
    }
    else
    {
        enableControl ("GW Messages_2", "EnvVar:eDlcLWR_AFS_01", 0 );
        enableControl ("GW Messages_2", "EnvVar:eDlcLWR_AFS_01Dec", 0 );
        enableControl ("GW Messages_2", "EnvVar:eDlcLWR_AFS_01Inc", 0 );
        enableControl ("GW Messages_2", "EnvVar:eDlcLWR_AFS_01Def", 0 );
        enableControl ("GW Messages_2", "EnvVar:eDlcOnceLWR_AFS_01", 0 );
        enableControl ("GW Messages_2", "EnvVar:eDlcWrongLWR_AFS_01", 0 );
        enableControl ("GW Messages_2", "EnvVar:eBZLWR_AFS_01", 0 );
        enableControl ("GW Messages_2", "EnvVar:eBZStepLWR_AFS_01", 0 );
        enableControl ("GW Messages_2", "EnvVar:eBZStepLWR_AFS_01Dec", 0 );
        enableControl ("GW Messages_2", "EnvVar:eBZStepLWR_AFS_01Inc", 0 );
        enableControl ("GW Messages_2", "EnvVar:eBZStepLWR_AFS_01Def", 0 );
    }
}

on envVar eChangeMem_BFS_01
{
    if (getValue(this))
    {
        enableControl( "Non-GW Messages", "EnvVar:eDlcMem_BFS_01", 1 );
        enableControl( "Non-GW Messages", "EnvVar:eDlcMem_BFS_01Dec", 1 );
        enableControl( "Non-GW Messages", "EnvVar:eDlcMem_BFS_01Inc", 1 );
        enableControl( "Non-GW Messages", "EnvVar:eDlcMem_BFS_01Def", 1 );
        enableControl( "Non-GW Messages", "EnvVar:eDlcOnceMem_BFS_01", 1 );
        enableControl( "Non-GW Messages", "EnvVar:eDlcWrongMem_BFS_01", 1 );
    }
    else
    {
        enableControl( "Non-GW Messages", "EnvVar:eDlcMem_BFS_01", 0 );
        enableControl( "Non-GW Messages", "EnvVar:eDlcMem_BFS_01Dec", 0 );
        enableControl( "Non-GW Messages", "EnvVar:eDlcMem_BFS_01Inc", 0 );
        enableControl( "Non-GW Messages", "EnvVar:eDlcMem_BFS_01Def", 0 );
        enableControl( "Non-GW Messages", "EnvVar:eDlcOnceMem_BFS_01", 0 );
        enableControl( "Non-GW Messages", "EnvVar:eDlcWrongMem_BFS_01", 0 );
    }
}

on envVar eChangeMem_FS_01
{
    if (getValue(this))
    {
        enableControl( "Non-GW Messages", "EnvVar:eDlcMem_FS_01", 1 );
        enableControl( "Non-GW Messages", "EnvVar:eDlcMem_FS_01Dec", 1 );
        enableControl( "Non-GW Messages", "EnvVar:eDlcMem_FS_01Inc", 1 );
        enableControl( "Non-GW Messages", "EnvVar:eDlcMem_FS_01Def", 1 );
        enableControl( "Non-GW Messages", "EnvVar:eDlcOnceMem_FS_01", 1 );
        enableControl( "Non-GW Messages", "EnvVar:eDlcWrongMem_FS_01", 1 );
    }
    else
    {
        enableControl( "Non-GW Messages", "EnvVar:eDlcMem_FS_01", 0 );
        enableControl( "Non-GW Messages", "EnvVar:eDlcMem_FS_01Dec", 0 );
        enableControl( "Non-GW Messages", "EnvVar:eDlcMem_FS_01Inc", 0 );
        enableControl( "Non-GW Messages", "EnvVar:eDlcMem_FS_01Def", 0 );
        enableControl( "Non-GW Messages", "EnvVar:eDlcOnceMem_FS_01", 0 );
        enableControl( "Non-GW Messages", "EnvVar:eDlcWrongMem_FS_01", 0 );
    }
}

on envVar eChangeMFG_01
{
    if (getValue(this))
    {
        enableControl( "Non-GW Messages", "EnvVar:eDlcMFG_01", 1 );
        enableControl( "Non-GW Messages", "EnvVar:eDlcMFG_01Dec", 1 );
        enableControl( "Non-GW Messages", "EnvVar:eDlcMFG_01Inc", 1 );
        enableControl( "Non-GW Messages", "EnvVar:eDlcMFG_01Def", 1 );
        enableControl( "Non-GW Messages", "EnvVar:eDlcOnceMFG_01", 1 );
        enableControl( "Non-GW Messages", "EnvVar:eDlcWrongMFG_01", 1 );
        enableControl( "Non-GW Messages", "EnvVar:eBZMFG_01", 1 );
        enableControl( "Non-GW Messages", "EnvVar:eBZStepMFG_01", 1 );
        enableControl( "Non-GW Messages", "EnvVar:eBZStepMFG_01Dec", 1 );
        enableControl( "Non-GW Messages", "EnvVar:eBZStepMFG_01Inc", 1 );
        enableControl( "Non-GW Messages", "EnvVar:eBZStepMFG_01Def", 1 );
        enableControl( "Non-GW Messages", "EnvVar:eCrcMFG_01", 1 );
    }
    else
    {
        enableControl( "Non-GW Messages", "EnvVar:eDlcMFG_01", 0 );
        enableControl( "Non-GW Messages", "EnvVar:eDlcMFG_01Dec", 0 );
        enableControl( "Non-GW Messages", "EnvVar:eDlcMFG_01Inc", 0 );
        enableControl( "Non-GW Messages", "EnvVar:eDlcMFG_01Def", 0 );
        enableControl( "Non-GW Messages", "EnvVar:eDlcOnceMFG_01", 0 );
        enableControl( "Non-GW Messages", "EnvVar:eDlcWrongMFG_01", 0 );
        enableControl( "Non-GW Messages", "EnvVar:eBZMFG_01", 0 );
        enableControl( "Non-GW Messages", "EnvVar:eBZStepMFG_01", 0 );
        enableControl( "Non-GW Messages", "EnvVar:eBZStepMFG_01Dec", 0 );
        enableControl( "Non-GW Messages", "EnvVar:eBZStepMFG_01Inc", 0 );
        enableControl( "Non-GW Messages", "EnvVar:eBZStepMFG_01Def", 0 );
        enableControl( "Non-GW Messages", "EnvVar:eCrcMFG_01", 0 );
    }
}

on envVar eChangeNMH_STSG_HBFS
{
    if (getValue(this))
    {
        enableControl ("GW Messages_1", "EnvVar:eDlcNMH_STSG_HBFS", 1 );
        enableControl ("GW Messages_1", "EnvVar:eDlcNMH_STSG_HBFSDec", 1 );
        enableControl ("GW Messages_1", "EnvVar:eDlcNMH_STSG_HBFSInc", 1 );
        enableControl ("GW Messages_1", "EnvVar:eDlcNMH_STSG_HBFSDef", 1 );
        enableControl ("GW Messages_1", "EnvVar:eDlcOnceNMH_STSG_HBFS", 1 );
        enableControl ("GW Messages_1", "EnvVar:eDlcWrongNMH_STSG_HBFS", 1 );
    }
    else
    {
        enableControl ("GW Messages_1", "EnvVar:eDlcNMH_STSG_HBFS", 0 );
        enableControl ("GW Messages_1", "EnvVar:eDlcNMH_STSG_HBFSDec", 0 );
        enableControl ("GW Messages_1", "EnvVar:eDlcNMH_STSG_HBFSInc", 0 );
        enableControl ("GW Messages_1", "EnvVar:eDlcNMH_STSG_HBFSDef", 0 );
        enableControl ("GW Messages_1", "EnvVar:eDlcOnceNMH_STSG_HBFS", 0 );
        enableControl ("GW Messages_1", "EnvVar:eDlcWrongNMH_STSG_HBFS", 0 );
    }
}

on envVar eChangeNMH_STSG_HFS
{
    if (getValue(this))
    {
        enableControl ("GW Messages_1", "EnvVar:eDlcNMH_STSG_HFS", 1 );
        enableControl ("GW Messages_1", "EnvVar:eDlcNMH_STSG_HFSDec", 1 );
        enableControl ("GW Messages_1", "EnvVar:eDlcNMH_STSG_HFSInc", 1 );
        enableControl ("GW Messages_1", "EnvVar:eDlcNMH_STSG_HFSDef", 1 );
        enableControl ("GW Messages_1", "EnvVar:eDlcOnceNMH_STSG_HFS", 1 );
        enableControl ("GW Messages_1", "EnvVar:eDlcWrongNMH_STSG_HFS", 1 );
    }
    else
    {
        enableControl ("GW Messages_1", "EnvVar:eDlcNMH_STSG_HFS", 0 );
        enableControl ("GW Messages_1", "EnvVar:eDlcNMH_STSG_HFSDec", 0 );
        enableControl ("GW Messages_1", "EnvVar:eDlcNMH_STSG_HFSInc", 0 );
        enableControl ("GW Messages_1", "EnvVar:eDlcNMH_STSG_HFSDef", 0 );
        enableControl ("GW Messages_1", "EnvVar:eDlcOnceNMH_STSG_HFS", 0 );
        enableControl ("GW Messages_1", "EnvVar:eDlcWrongNMH_STSG_HFS", 0 );
    }
}

on envVar eChangePersonalisierung_01
{
    if (getValue(this))
    {
        enableControl( "Non-GW Messages", "EnvVar:eDlcPersonalisierung_01", 1 );
        enableControl( "Non-GW Messages", "EnvVar:eDlcPersonalisierung_01Dec", 1 );
        enableControl( "Non-GW Messages", "EnvVar:eDlcPersonalisierung_01Inc", 1 );
        enableControl( "Non-GW Messages", "EnvVar:eDlcPersonalisierung_01Def", 1 );
        enableControl( "Non-GW Messages", "EnvVar:eDlcOncePersonalisierung_01", 1 );
        enableControl( "Non-GW Messages", "EnvVar:eDlcWrongPersonalisierung_01", 1 );
    }
    else
    {
        enableControl( "Non-GW Messages", "EnvVar:eDlcPersonalisierung_01", 0 );
        enableControl( "Non-GW Messages", "EnvVar:eDlcPersonalisierung_01Dec", 0 );
        enableControl( "Non-GW Messages", "EnvVar:eDlcPersonalisierung_01Inc", 0 );
        enableControl( "Non-GW Messages", "EnvVar:eDlcPersonalisierung_01Def", 0 );
        enableControl( "Non-GW Messages", "EnvVar:eDlcOncePersonalisierung_01", 0 );
        enableControl( "Non-GW Messages", "EnvVar:eDlcWrongPersonalisierung_01", 0 );
    }
}

on envVar eChangeRLS_01
{
    if (getValue(this))
    {
        enableControl( "Non-GW Messages", "EnvVar:eDlcRLS_01", 1 );
        enableControl( "Non-GW Messages", "EnvVar:eDlcRLS_01Dec", 1 );
        enableControl( "Non-GW Messages", "EnvVar:eDlcRLS_01Inc", 1 );
        enableControl( "Non-GW Messages", "EnvVar:eDlcRLS_01Def", 1 );
        enableControl( "Non-GW Messages", "EnvVar:eDlcOnceRLS_01", 1 );
        enableControl( "Non-GW Messages", "EnvVar:eDlcWrongRLS_01", 1 );
    }
    else
    {
        enableControl( "Non-GW Messages", "EnvVar:eDlcRLS_01", 0 );
        enableControl( "Non-GW Messages", "EnvVar:eDlcRLS_01Dec", 0 );
        enableControl( "Non-GW Messages", "EnvVar:eDlcRLS_01Inc", 0 );
        enableControl( "Non-GW Messages", "EnvVar:eDlcRLS_01Def", 0 );
        enableControl( "Non-GW Messages", "EnvVar:eDlcOnceRLS_01", 0 );
        enableControl( "Non-GW Messages", "EnvVar:eDlcWrongRLS_01", 0 );
    }
}

on envVar eChangeSMLS_01
{
    if (getValue(this))
    {
        enableControl( "Non-GW Messages", "EnvVar:eDlcSMLS_01", 1 );
        enableControl( "Non-GW Messages", "EnvVar:eDlcSMLS_01Dec", 1 );
        enableControl( "Non-GW Messages", "EnvVar:eDlcSMLS_01Inc", 1 );
        enableControl( "Non-GW Messages", "EnvVar:eDlcSMLS_01Def", 1 );
        enableControl( "Non-GW Messages", "EnvVar:eDlcOnceSMLS_01", 1 );
        enableControl( "Non-GW Messages", "EnvVar:eDlcWrongSMLS_01", 1 );
        enableControl( "Non-GW Messages", "EnvVar:eBZSMLS_01", 1 );
        enableControl( "Non-GW Messages", "EnvVar:eBZStepSMLS_01", 1 );
        enableControl( "Non-GW Messages", "EnvVar:eBZStepSMLS_01Dec", 1 );
        enableControl( "Non-GW Messages", "EnvVar:eBZStepSMLS_01Inc", 1 );
        enableControl( "Non-GW Messages", "EnvVar:eBZStepSMLS_01Def", 1 );
        enableControl( "Non-GW Messages", "EnvVar:eCrcSMLS_01", 1 );
    }
    else
    {
        enableControl( "Non-GW Messages", "EnvVar:eDlcSMLS_01", 0 );
        enableControl( "Non-GW Messages", "EnvVar:eDlcSMLS_01Dec", 0 );
        enableControl( "Non-GW Messages", "EnvVar:eDlcSMLS_01Inc", 0 );
        enableControl( "Non-GW Messages", "EnvVar:eDlcSMLS_01Def", 0 );
        enableControl( "Non-GW Messages", "EnvVar:eDlcOnceSMLS_01", 0 );
        enableControl( "Non-GW Messages", "EnvVar:eDlcWrongSMLS_01", 0 );
        enableControl( "Non-GW Messages", "EnvVar:eBZSMLS_01", 0 );
        enableControl( "Non-GW Messages", "EnvVar:eBZStepSMLS_01", 0 );
        enableControl( "Non-GW Messages", "EnvVar:eBZStepSMLS_01Dec", 0 );
        enableControl( "Non-GW Messages", "EnvVar:eBZStepSMLS_01Inc", 0 );
        enableControl( "Non-GW Messages", "EnvVar:eBZStepSMLS_01Def", 0 );
        enableControl( "Non-GW Messages", "EnvVar:eCrcSMLS_01", 0 );
    }
}

on envVar eChangeSOK_NoAuthenticTime_01
{
    if (getValue(this))
    {
        enableControl ("GW Messages_2", "EnvVar:eDlcSOK_NoAuthenticTime_01", 1 );
        enableControl ("GW Messages_2", "EnvVar:eDlcSOK_NoAuthenticTime_01Dec", 1 );
        enableControl ("GW Messages_2", "EnvVar:eDlcSOK_NoAuthenticTime_01Inc", 1 );
        enableControl ("GW Messages_2", "EnvVar:eDlcSOK_NoAuthenticTime_01Def", 1 );
        enableControl ("GW Messages_2", "EnvVar:eDlcOnceSOK_NoAuthenticTime_01", 1 );
        enableControl ("GW Messages_2", "EnvVar:eDlcWrongSOK_NoAuthenticTime_01", 1 );
    }
    else
    {
        enableControl ("GW Messages_2", "EnvVar:eDlcSOK_NoAuthenticTime_01", 0 );
        enableControl ("GW Messages_2", "EnvVar:eDlcSOK_NoAuthenticTime_01Dec", 0 );
        enableControl ("GW Messages_2", "EnvVar:eDlcSOK_NoAuthenticTime_01Inc", 0 );
        enableControl ("GW Messages_2", "EnvVar:eDlcSOK_NoAuthenticTime_01Def", 0 );
        enableControl ("GW Messages_2", "EnvVar:eDlcOnceSOK_NoAuthenticTime_01", 0 );
        enableControl ("GW Messages_2", "EnvVar:eDlcWrongSOK_NoAuthenticTime_01", 0 );
    }
}

on envVar eChangeTCO_01
{
    if (getValue(this))
    {
        enableControl( "Non-GW Messages", "EnvVar:eDlcTCO_01", 1 );
        enableControl( "Non-GW Messages", "EnvVar:eDlcTCO_01Dec", 1 );
        enableControl( "Non-GW Messages", "EnvVar:eDlcTCO_01Inc", 1 );
        enableControl( "Non-GW Messages", "EnvVar:eDlcTCO_01Def", 1 );
        enableControl( "Non-GW Messages", "EnvVar:eDlcOnceTCO_01", 1 );
        enableControl( "Non-GW Messages", "EnvVar:eDlcWrongTCO_01", 1 );
    }
    else
    {
        enableControl( "Non-GW Messages", "EnvVar:eDlcTCO_01", 0 );
        enableControl( "Non-GW Messages", "EnvVar:eDlcTCO_01Dec", 0 );
        enableControl( "Non-GW Messages", "EnvVar:eDlcTCO_01Inc", 0 );
        enableControl( "Non-GW Messages", "EnvVar:eDlcTCO_01Def", 0 );
        enableControl( "Non-GW Messages", "EnvVar:eDlcOnceTCO_01", 0 );
        enableControl( "Non-GW Messages", "EnvVar:eDlcWrongTCO_01", 0 );
    }
}

on envVar eChangeTimeDate
{
    if (getValue(this))
    {
        enableControl( "Non-GW Messages", "EnvVar:eDlcTimeDate", 1 );
        enableControl( "Non-GW Messages", "EnvVar:eDlcTimeDateDec", 1 );
        enableControl( "Non-GW Messages", "EnvVar:eDlcTimeDateInc", 1 );
        enableControl( "Non-GW Messages", "EnvVar:eDlcTimeDateDef", 1 );
        enableControl( "Non-GW Messages", "EnvVar:eDlcOnceTimeDate", 1 );
        enableControl( "Non-GW Messages", "EnvVar:eDlcWrongTimeDate", 1 );
    }
    else
    {
        enableControl( "Non-GW Messages", "EnvVar:eDlcTimeDate", 0 );
        enableControl( "Non-GW Messages", "EnvVar:eDlcTimeDateDec", 0 );
        enableControl( "Non-GW Messages", "EnvVar:eDlcTimeDateInc", 0 );
        enableControl( "Non-GW Messages", "EnvVar:eDlcTimeDateDef", 0 );
        enableControl( "Non-GW Messages", "EnvVar:eDlcOnceTimeDate", 0 );
        enableControl( "Non-GW Messages", "EnvVar:eDlcWrongTimeDate", 0 );
    }
}

on envVar eChangeTSG_FT_01
{
    if (getValue(this))
    {
        enableControl( "Non-GW Messages", "EnvVar:eDlcTSG_FT_01", 1 );
        enableControl( "Non-GW Messages", "EnvVar:eDlcTSG_FT_01Dec", 1 );
        enableControl( "Non-GW Messages", "EnvVar:eDlcTSG_FT_01Inc", 1 );
        enableControl( "Non-GW Messages", "EnvVar:eDlcTSG_FT_01Def", 1 );
        enableControl( "Non-GW Messages", "EnvVar:eDlcOnceTSG_FT_01", 1 );
        enableControl( "Non-GW Messages", "EnvVar:eDlcWrongTSG_FT_01", 1 );
    }
    else
    {
        enableControl( "Non-GW Messages", "EnvVar:eDlcTSG_FT_01", 0 );
        enableControl( "Non-GW Messages", "EnvVar:eDlcTSG_FT_01Dec", 0 );
        enableControl( "Non-GW Messages", "EnvVar:eDlcTSG_FT_01Inc", 0 );
        enableControl( "Non-GW Messages", "EnvVar:eDlcTSG_FT_01Def", 0 );
        enableControl( "Non-GW Messages", "EnvVar:eDlcOnceTSG_FT_01", 0 );
        enableControl( "Non-GW Messages", "EnvVar:eDlcWrongTSG_FT_01", 0 );
    }
}

on envVar eChangeTSG_FT_02
{
    if (getValue(this))
    {
        enableControl( "Non-GW Messages", "EnvVar:eDlcTSG_FT_02", 1 );
        enableControl( "Non-GW Messages", "EnvVar:eDlcTSG_FT_02Dec", 1 );
        enableControl( "Non-GW Messages", "EnvVar:eDlcTSG_FT_02Inc", 1 );
        enableControl( "Non-GW Messages", "EnvVar:eDlcTSG_FT_02Def", 1 );
        enableControl( "Non-GW Messages", "EnvVar:eDlcOnceTSG_FT_02", 1 );
        enableControl( "Non-GW Messages", "EnvVar:eDlcWrongTSG_FT_02", 1 );
        enableControl( "Non-GW Messages", "EnvVar:eBZTSG_FT_02", 1 );
        enableControl( "Non-GW Messages", "EnvVar:eBZStepTSG_FT_02", 1 );
        enableControl( "Non-GW Messages", "EnvVar:eBZStepTSG_FT_02Dec", 1 );
        enableControl( "Non-GW Messages", "EnvVar:eBZStepTSG_FT_02Inc", 1 );
        enableControl( "Non-GW Messages", "EnvVar:eBZStepTSG_FT_02Def", 1 );
        enableControl( "Non-GW Messages", "EnvVar:eCrcTSG_FT_02", 1 );
    }
    else
    {
        enableControl( "Non-GW Messages", "EnvVar:eDlcTSG_FT_02", 0 );
        enableControl( "Non-GW Messages", "EnvVar:eDlcTSG_FT_02Dec", 0 );
        enableControl( "Non-GW Messages", "EnvVar:eDlcTSG_FT_02Inc", 0 );
        enableControl( "Non-GW Messages", "EnvVar:eDlcTSG_FT_02Def", 0 );
        enableControl( "Non-GW Messages", "EnvVar:eDlcOnceTSG_FT_02", 0 );
        enableControl( "Non-GW Messages", "EnvVar:eDlcWrongTSG_FT_02", 0 );
        enableControl( "Non-GW Messages", "EnvVar:eBZTSG_FT_02", 0 );
        enableControl( "Non-GW Messages", "EnvVar:eBZStepTSG_FT_02", 0 );
        enableControl( "Non-GW Messages", "EnvVar:eBZStepTSG_FT_02Dec", 0 );
        enableControl( "Non-GW Messages", "EnvVar:eBZStepTSG_FT_02Inc", 0 );
        enableControl( "Non-GW Messages", "EnvVar:eBZStepTSG_FT_02Def", 0 );
        enableControl( "Non-GW Messages", "EnvVar:eCrcTSG_FT_02", 0 );
    }
}

on envVar eChangeVehiDist
{
    if (getValue(this))
    {
        enableControl( "Non-GW Messages", "EnvVar:eDlcVehiDist", 1 );
        enableControl( "Non-GW Messages", "EnvVar:eDlcVehiDistDec", 1 );
        enableControl( "Non-GW Messages", "EnvVar:eDlcVehiDistInc", 1 );
        enableControl( "Non-GW Messages", "EnvVar:eDlcVehiDistDef", 1 );
        enableControl( "Non-GW Messages", "EnvVar:eDlcOnceVehiDist", 1 );
        enableControl( "Non-GW Messages", "EnvVar:eDlcWrongVehiDist", 1 );
    }
    else
    {
        enableControl( "Non-GW Messages", "EnvVar:eDlcVehiDist", 0 );
        enableControl( "Non-GW Messages", "EnvVar:eDlcVehiDistDec", 0 );
        enableControl( "Non-GW Messages", "EnvVar:eDlcVehiDistInc", 0 );
        enableControl( "Non-GW Messages", "EnvVar:eDlcVehiDistDef", 0 );
        enableControl( "Non-GW Messages", "EnvVar:eDlcOnceVehiDist", 0 );
        enableControl( "Non-GW Messages", "EnvVar:eDlcWrongVehiDist", 0 );
    }
}

on envVar eChangeWFS_01
{
    if (getValue(this))
    {
        enableControl( "Non-GW Messages", "EnvVar:eDlcWFS_01", 1 );
        enableControl( "Non-GW Messages", "EnvVar:eDlcWFS_01Dec", 1 );
        enableControl( "Non-GW Messages", "EnvVar:eDlcWFS_01Inc", 1 );
        enableControl( "Non-GW Messages", "EnvVar:eDlcWFS_01Def", 1 );
        enableControl( "Non-GW Messages", "EnvVar:eDlcOnceWFS_01", 1 );
        enableControl( "Non-GW Messages", "EnvVar:eDlcWrongWFS_01", 1 );
    }
    else
    {
        enableControl( "Non-GW Messages", "EnvVar:eDlcWFS_01", 0 );
        enableControl( "Non-GW Messages", "EnvVar:eDlcWFS_01Dec", 0 );
        enableControl( "Non-GW Messages", "EnvVar:eDlcWFS_01Inc", 0 );
        enableControl( "Non-GW Messages", "EnvVar:eDlcWFS_01Def", 0 );
        enableControl( "Non-GW Messages", "EnvVar:eDlcOnceWFS_01", 0 );
        enableControl( "Non-GW Messages", "EnvVar:eDlcWrongWFS_01", 0 );
    }
}

on envVar eChangeWischer_01
{
    if (getValue(this))
    {
        enableControl( "Non-GW Messages", "EnvVar:eDlcWischer_01", 1 );
        enableControl( "Non-GW Messages", "EnvVar:eDlcWischer_01Dec", 1 );
        enableControl( "Non-GW Messages", "EnvVar:eDlcWischer_01Inc", 1 );
        enableControl( "Non-GW Messages", "EnvVar:eDlcWischer_01Def", 1 );
        enableControl( "Non-GW Messages", "EnvVar:eDlcOnceWischer_01", 1 );
        enableControl( "Non-GW Messages", "EnvVar:eDlcWrongWischer_01", 1 );
    }
    else
    {
        enableControl( "Non-GW Messages", "EnvVar:eDlcWischer_01", 0 );
        enableControl( "Non-GW Messages", "EnvVar:eDlcWischer_01Dec", 0 );
        enableControl( "Non-GW Messages", "EnvVar:eDlcWischer_01Inc", 0 );
        enableControl( "Non-GW Messages", "EnvVar:eDlcWischer_01Def", 0 );
        enableControl( "Non-GW Messages", "EnvVar:eDlcOnceWischer_01", 0 );
        enableControl( "Non-GW Messages", "EnvVar:eDlcWrongWischer_01", 0 );
    }
}

on envVar eChangeZV_02
{
    if (getValue(this))
    {
        enableControl( "Non-GW Messages", "EnvVar:eDlcZV_02", 1 );
        enableControl( "Non-GW Messages", "EnvVar:eDlcZV_02Dec", 1 );
        enableControl( "Non-GW Messages", "EnvVar:eDlcZV_02Inc", 1 );
        enableControl( "Non-GW Messages", "EnvVar:eDlcZV_02Def", 1 );
        enableControl( "Non-GW Messages", "EnvVar:eDlcOnceZV_02", 1 );
        enableControl( "Non-GW Messages", "EnvVar:eDlcWrongZV_02", 1 );
    }
    else
    {
        enableControl( "Non-GW Messages", "EnvVar:eDlcZV_02", 0 );
        enableControl( "Non-GW Messages", "EnvVar:eDlcZV_02Dec", 0 );
        enableControl( "Non-GW Messages", "EnvVar:eDlcZV_02Inc", 0 );
        enableControl( "Non-GW Messages", "EnvVar:eDlcZV_02Def", 0 );
        enableControl( "Non-GW Messages", "EnvVar:eDlcOnceZV_02", 0 );
        enableControl( "Non-GW Messages", "EnvVar:eDlcWrongZV_02", 0 );
    }
}







on envVar eChangeLog_Datenlogger_Req
{
    if (getValue(this))
    {
        enableControl( "Non-GW Messages", "EnvVar:eDlcLog_Datenlogger_Req", 1 );
        enableControl( "Non-GW Messages", "EnvVar:eDlcLog_Datenlogger_ReqDec", 1 );
        enableControl( "Non-GW Messages", "EnvVar:eDlcLog_Datenlogger_ReqInc", 1 );
        enableControl( "Non-GW Messages", "EnvVar:eDlcLog_Datenlogger_ReqDef", 1 );
        enableControl( "Non-GW Messages", "EnvVar:eDlcOnceLog_Datenlogger_Req", 1 );
        enableControl( "Non-GW Messages", "EnvVar:eDlcWrongLog_Datenlogger_Req", 1 );
    }
    else
    {
        enableControl( "Non-GW Messages", "EnvVar:eDlcLog_Datenlogger_Req", 0 );
        enableControl( "Non-GW Messages", "EnvVar:eDlcLog_Datenlogger_ReqDec", 0 );
        enableControl( "Non-GW Messages", "EnvVar:eDlcLog_Datenlogger_ReqInc", 0 );
        enableControl( "Non-GW Messages", "EnvVar:eDlcLog_Datenlogger_ReqDef", 0 );
        enableControl( "Non-GW Messages", "EnvVar:eDlcOnceLog_Datenlogger_Req", 0 );
        enableControl( "Non-GW Messages", "EnvVar:eDlcWrongLog_Datenlogger_Req", 0 );
    }
}

on envVar eChangeLog_Kombi_Req
{
    if (getValue(this))
    {
        enableControl( "Non-GW Messages", "EnvVar:eDlcLog_Kombi_Req", 1 );
        enableControl( "Non-GW Messages", "EnvVar:eDlcLog_Kombi_ReqDec", 1 );
        enableControl( "Non-GW Messages", "EnvVar:eDlcLog_Kombi_ReqInc", 1 );
        enableControl( "Non-GW Messages", "EnvVar:eDlcLog_Kombi_ReqDef", 1 );
        enableControl( "Non-GW Messages", "EnvVar:eDlcOnceLog_Kombi_Req", 1 );
        enableControl( "Non-GW Messages", "EnvVar:eDlcWrongLog_Kombi_Req", 1 );
    }
    else
    {
        enableControl( "Non-GW Messages", "EnvVar:eDlcLog_Kombi_Req", 0 );
        enableControl( "Non-GW Messages", "EnvVar:eDlcLog_Kombi_ReqDec", 0 );
        enableControl( "Non-GW Messages", "EnvVar:eDlcLog_Kombi_ReqInc", 0 );
        enableControl( "Non-GW Messages", "EnvVar:eDlcLog_Kombi_ReqDef", 0 );
        enableControl( "Non-GW Messages", "EnvVar:eDlcOnceLog_Kombi_Req", 0 );
        enableControl( "Non-GW Messages", "EnvVar:eDlcWrongLog_Kombi_Req", 0 );
    }
}

