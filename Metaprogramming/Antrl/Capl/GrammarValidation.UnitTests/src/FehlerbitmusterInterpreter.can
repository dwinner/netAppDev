  /*@!Encoding:1252*/

// Author J. Raab, Preh GmbH, 24.07.15

includes
{
  
}

variables
{
  message Traction_SDOreq_LiIoBMS m;
  int lowIndexbyte = 0x22;
  int highIndexbyte = 0x28;
  int subIndIndex = 0;
  byte subIndexes[10] = {1, 2, 4, 5, 7, 8, 10, 11, 13, 14};
  byte deleteSubIndexes[5] = {3,6,9,12,15};
  int deleteIndex = 0;
    
  dword errorBits[10];
  const int Stored = 0;
  const int Actual = 1;
  
  const int Reading = 1;
  const int Deleting = 2;
  int state = 0;
}

on start 
{
  m.DLC = 8;
  
}

on envVar(FehlerBitMusterRead) {
  if (getValue(FehlerBitMusterRead) == 1){
    state = Reading;
    subIndIndex = 0;
    m.BYTE(4) = 0;
    m.BYTE(5) = 0;
    m.BYTE(6) = 0;
    m.BYTE(7) = 0;
    readSDO();
  }
}

on envVar(FehlerBitMusterClearBoxes) {
  if (getValue(FehlerBitMusterClearBoxes) == 1){
    deleteControlContent("FehlerbitMuster","WindowA");
    deleteControlContent("FehlerBitMuster","WindowS");
  }
}

on envVar(FehlerBitMusterErase) {
  if (getValue(FehlerBitMusterErase) == 1) {
    state = Deleting;
    deleteIndex = 0;
    m.BYTE(4) = 0xFF;
    m.BYTE(5) = 0xFF;
    m.BYTE(6) = 0xFF;
    m.BYTE(7) = 0xFF;
    sendDeleteMsgs();
  }

}

void readSDO (void)
{
  m.byte(0) = 0x40;
  m.byte(1) = lowIndexbyte;
  m.byte(2) = highIndexbyte;
  m.byte(3) = subIndexes[subIndIndex];
  output(m);
}

on message LiIoBMS_SDOresp_Traction
{
  if ( (this.byte(1) == 0x22) && (this.byte(2) == 0x28) && (state == Reading) &&
       ( (this.byte(3) == 1) || (this.byte(3) == 2) || (this.byte(3) == 4) || (this.byte(3) == 5) || (this.byte(3) == 7) || (this.byte(3) == 8) ||
         (this.byte(3) == 0xA) || (this.byte(3) == 0xB) || (this.byte(3) == 0xD) || (this.byte(3) == 0xE) ) ) {
          
    errorBits[subIndIndex] = ( (this.byte(7) << 24) | (this.byte(6) << 16) | (this.byte(5) << 8) | this.byte(4) );

    if (subIndIndex < 9) {
        subIndIndex++;
        readSDO();
    }
    else {
      subIndIndex = 0;
      state = 0;
      putToEnvVars();
      displayErrors();
    }

 }
 else {
   if (state == Deleting) {
    if (deleteIndex < 4) {
      deleteIndex++;
      sendDeleteMsgs();
    }
    else {
      state = 0;
    }
   
   }
 }
}

void sendDeleteMsgs(void)
{
  m.BYTE(0) = 0x23;
  m.BYTE(1) = 0x22;
  m.BYTE(2) = 0x28;
  m.BYTE(3) = deleteSubIndexes[deleteIndex];

  output(m);
  
}

void putToEnvVars (void) 
{
  putValue(FehlerBitMusterStored1,errorBits[0]);
  putValue(FehlerBitMusterActual1,errorBits[1]);
  putValue(FehlerBitMusterStored2,errorBits[2]);
  putValue(FehlerBitMusterActual2,errorBits[3]);
  putValue(FehlerBitMusterStored3,errorBits[4]);
  putValue(FehlerBitMusterActual3,errorBits[5]);
  putValue(FehlerBitMusterStored4,errorBits[6]);
  putValue(FehlerBitMusterActual4,errorBits[7]);
  putValue(FehlerBitMusterStored5,errorBits[8]);
  putValue(FehlerBitMusterActual5,errorBits[9]);
}

void displayErrors(void)
{
  int i;
  word shiftBit = 1;
  for (i = 0; i < 32 ; i++) {
    if ((errorBits[0] & (shiftBit << i)) == (shiftBit << i)){
      Group1WriteToBox((shiftBit << i), Stored);
    }
    if ((errorBits[1] & (shiftBit << i)) == (shiftBit << i)){
      Group1WriteToBox((shiftBit << i), Actual);
    }
    if ((errorBits[2] & (shiftBit << i)) == (shiftBit << i)){
      Group2WriteToBox((shiftBit << i),Stored);
    }
    if ((errorBits[3] & (shiftBit << i)) == (shiftBit << i)){
      Group2WriteToBox((shiftBit << i),Actual);
    }
    if ((errorBits[4] & (shiftBit << i)) == (shiftBit << i)){
      Group3WriteToBox((shiftBit << i),Stored);
    }
    if ((errorBits[5] & (shiftBit << i)) == (shiftBit << i)){
      Group3WriteToBox((shiftBit << i),Actual);
    }
    if ((errorBits[6] & (shiftBit << i)) == (shiftBit << i)){
      Group4WriteToBox((shiftBit << i),Stored);
    }
    if ((errorBits[7] & (shiftBit << i)) == (shiftBit << i)){
      Group4WriteToBox((shiftBit << i),Actual);
    }
    if ((errorBits[8] & (shiftBit << i)) == (shiftBit << i)){
      Group5WriteToBox((shiftBit << i),Stored);
    }
    if ((errorBits[9] & (shiftBit << i)) == (shiftBit << i)){
      Group5WriteToBox((shiftBit << i),Actual);
    }
  }
}

void Group1WriteToBox (dword whichOne, int storedOrActual)
{
  char buffer[9];
  if (storedOrActual == Stored) {
    snprintf (buffer,elcount(buffer),"WindowS");
  }
  else {
    snprintf (buffer,elcount(buffer),"WindowA");
  }
 
  switch(whichOne) {
      case 1:            putValueToControl("FehlerbitMuster",buffer, "001    FuSi  Coretest Error\n"); break;
      case 2:            putValueToControl("FehlerbitMuster",buffer, "002    FuSi  doubled invers RAM faulty\n"); break;
      case 4:            putValueToControl("FehlerbitMuster",buffer, "003    FuSi  Error in Program Flow check\n"); break;
      case 8:            putValueToControl("FehlerbitMuster",buffer, "004    FuSi  Reset by main controller\n"); break;
      case 16:           putValueToControl("FehlerbitMuster",buffer, "005    FuSi  Reset by safety controller\n"); break;
      case 32:           putValueToControl("FehlerbitMuster",buffer, "006    FuSi  Strom Ebene 2 Out of Range\n"); break;
      case 64:           putValueToControl("FehlerbitMuster",buffer, "007    FuSi  Temperatur Ebene2 überschritten >= 70°C\n"); break;
      case 128:          putValueToControl("FehlerbitMuster",buffer, "008    FuSi  Temperatur Ebene2 Out of Range\n"); break;
      case 256:          putValueToControl("FehlerbitMuster",buffer, "009    FuSi  Zellspannung Ebene2 überschritten >=4,22V\n"); break;
      case 512:          putValueToControl("FehlerbitMuster",buffer, "010    FuSi  Ebene 2 Modultimeout\n"); break;
      case 1024:         putValueToControl("FehlerbitMuster",buffer, "011    FuSi  Zellspannung Ebene2 unterschritten <=2,05V\n"); break;
      case 2048:         putValueToControl("FehlerbitMuster",buffer, "012    FuSi  Spannung Ebene2 CVS Out of Range\n"); break;
      case 4096:         putValueToControl("FehlerbitMuster",buffer, "013    FuSi  Ebene 2 CVS Time out\n"); break;
      case 8192:         putValueToControl("FehlerbitMuster",buffer, "014    FuSi  Ebene 2 CSSU Status Meldung Fehler\n"); break;
      case 16384:        putValueToControl("FehlerbitMuster",buffer, "015    FuSi  Ebene 2 CSSU Konfigurationsfehler\n"); break;
      case 32768:        putValueToControl("FehlerbitMuster",buffer, "016    FuSi  Ebene 2 BMU Konfigurationsfehler\n"); break;
      case 65536:        putValueToControl("FehlerbitMuster",buffer, "017    HW    EEPROM Data auf Default\n"); break;
      case 131072:       putValueToControl("FehlerbitMuster",buffer, "018    HW    EEPROM Fehler beim Lesen / Schreiben\n"); break;
      case 262144:       putValueToControl("FehlerbitMuster",buffer, "019    HW    HVIL offen\n"); break;
      case 524288:       putValueToControl("FehlerbitMuster",buffer, "020    HW    HVIL Short between lines\n"); break;
      case 1048576:      putValueToControl("FehlerbitMuster",buffer, "021    HW    HVIL Short to Batt\n"); break;
      case 2097152:      putValueToControl("FehlerbitMuster",buffer, "022    HW    HVIL Short to Gnd\n"); break;
      case 4194304:      putValueToControl("FehlerbitMuster",buffer, "023    HW    Interne 5V nicht mehr stabil\n"); break;
      case 8388608:      putValueToControl("FehlerbitMuster",buffer, "024    HW    Kl30C: Überspannung\n"); break;
      case 16777216:     putValueToControl("FehlerbitMuster",buffer, "025    HW    Kl30C: Unterspannung\n"); break;
      case 33554432:     putValueToControl("FehlerbitMuster",buffer, "026    HW    Kl30F: Überspannung\n"); break;
      case 67108864:     putValueToControl("FehlerbitMuster",buffer, "027    HW    Kl30F: Unterspannung\n"); break;
      case 134217728:    putValueToControl("FehlerbitMuster",buffer, "028    HW    Reißleinentest fehlgeschlagen\n"); break;
      case 268435456:    putValueToControl("FehlerbitMuster",buffer, "029    HW    Reset Cause ECC-Fehler\n"); break;
      case 536870912:    putValueToControl("FehlerbitMuster",buffer, "030    HW    Reset Cause Unimplemented Interrupt\n"); break;
      case 1073741824:   putValueToControl("FehlerbitMuster",buffer, "031    HW    Reset Cause Watchdog Reset\n"); break;
      case 2147483648:   putValueToControl("FehlerbitMuster",buffer, "032    HW    RAM Defekt\n"); break;
    default:
    break;    
 }
}

void Group2WriteToBox (dword whichOne, int storedOrActual)
{
  char buffer[9];
  if (storedOrActual == Stored) {
    snprintf (buffer,elcount(buffer),"WindowS");
  }
  else {
    snprintf (buffer,elcount(buffer),"WindowA");
  }
    switch(whichOne) {
      case 1:           putValueToControl("FehlerbitMuster",buffer, "033    HW ROM Defekt\n"); break;
      case 2:           putValueToControl("FehlerbitMuster",buffer, "034    HW HW Version Out falsch\n"); break;
      case 4:           putValueToControl("FehlerbitMuster",buffer, "035    HW Treiber CSSU: Open Load\n"); break;
      case 8:           putValueToControl("FehlerbitMuster",buffer, "036    HW Treiber CSSU: Overload\n"); break;
      case 16:          putValueToControl("FehlerbitMuster",buffer, "037    HW Treiber CSSU: Short to Batt\n"); break;;
      case 32:          putValueToControl("FehlerbitMuster",buffer, "038    HW Treiber CSSU: Short to GND\n"); break;
      case 64:          putValueToControl("FehlerbitMuster",buffer, "039    HW Treiber CV: Open Load\n"); break;
      case 128:         putValueToControl("FehlerbitMuster",buffer, "040    HW Treiber CV: Overload\n"); break;
      case 256:         putValueToControl("FehlerbitMuster",buffer, "041    HW Treiber CV: Short to Batt\n"); break;
      case 512:         putValueToControl("FehlerbitMuster",buffer, "042    HW Treiber CV: Short to GND\n"); break;
      case 1024:        putValueToControl("FehlerbitMuster",buffer, "043    HW Treiber CVS: Open Load\n"); break;
      case 2048:        putValueToControl("FehlerbitMuster",buffer, "044    HW Treiber CVS: Overload\n"); break;
      case 4096:        putValueToControl("FehlerbitMuster",buffer, "045    HW Treiber CVS: Short to Batt\n"); break;
      case 8192:        putValueToControl("FehlerbitMuster",buffer, "046    HW Treiber CVS: Short to GND\n"); break;
      case 16384:       putValueToControl("FehlerbitMuster",buffer, "047    HW Treiber K1: Open Load\n"); break;
      case 32768:       putValueToControl("FehlerbitMuster",buffer, "048    HW Treiber K1: Overload\n"); break;
      case 65536:       putValueToControl("FehlerbitMuster",buffer, "049    HW Treiber K1: Short To Batt\n"); break;
      case 131072:      putValueToControl("FehlerbitMuster",buffer, "050    HW Treiber K1: Short To GND\n"); break;
      case 262144:      putValueToControl("FehlerbitMuster",buffer, "051    HW Treiber K2: Open Load\n"); break;
      case 524288:      putValueToControl("FehlerbitMuster",buffer, "052    HW Treiber K2: Overload\n"); break;
      case 1048576:     putValueToControl("FehlerbitMuster",buffer, "053    HW Treiber K2: Short To Batt\n"); break;
      case 2097152:     putValueToControl("FehlerbitMuster",buffer, "054    HW Treiber K2: Short To GND\n"); break;
      case 4194304:     putValueToControl("FehlerbitMuster",buffer, "055    HW Treiber K3: Open Load\n"); break;
      case 8388608:     putValueToControl("FehlerbitMuster",buffer, "056    HW Treiber K3: Overload\n"); break;
      case 16777216:    putValueToControl("FehlerbitMuster",buffer, "057    HW Treiber K3: Short To Batt\n"); break;
      case 33554432:    putValueToControl("FehlerbitMuster",buffer, "058    HW Treiber K3: Short To GND\n"); break;
      case 67108864:    putValueToControl("FehlerbitMuster",buffer, "059    HW Treiber K4: Open Load\n"); break;
      case 134217728:   putValueToControl("FehlerbitMuster",buffer, "060    HW Treiber K4: Overload\n"); break;
      case 268435456:   putValueToControl("FehlerbitMuster",buffer, "061    HW Treiber K4: Short To Batt\n"); break;
      case 536870912:   putValueToControl("FehlerbitMuster",buffer, "062    HW Treiber K4: Short To GND\n"); break;
      case 1073741824:  putValueToControl("FehlerbitMuster",buffer, "063    HW Treiber K5: Open Load\n"); break;
      case 2147483648:  putValueToControl("FehlerbitMuster",buffer, "064    HW Treiber K5: Overload\n"); break;
    default:
    break;    
  }
}

void Group3WriteToBox (dword whichOne, int storedOrActual)
{
  char buffer[9];
  if (storedOrActual == Stored) {
    snprintf (buffer,elcount(buffer),"WindowS");
  }
  else {
    snprintf (buffer,elcount(buffer),"WindowA");
  }
   write ("%d",whichOne);
    switch(whichOne) {
      case 1:          putValueToControl("FehlerbitMuster",buffer, "065    HW Treiber K5: Short To Batt\n"); break;     
      case 2:          putValueToControl("FehlerbitMuster",buffer, "066    HW Treiber K5: Short To GND\n"); break; 
      case 4:          putValueToControl("FehlerbitMuster",buffer, "067    HW Treiber K6: Open Load\n"); break; 
      case 8:          putValueToControl("FehlerbitMuster",buffer, "068    HW Treiber K6: Overload\n"); break; 
      case 16:         putValueToControl("FehlerbitMuster",buffer, "069    HW Treiber K6: Short To Batt\n"); break; 
      case 32:         putValueToControl("FehlerbitMuster",buffer, "070    HW Treiber K6: Short To GND\n"); break; 
      case 64:         putValueToControl("FehlerbitMuster",buffer, "071    HW Treiber Out1: Open Load\n"); break; 
      case 128:        putValueToControl("FehlerbitMuster",buffer, "072    HW Treiber Out1: Overload7\n"); break; 
      case 256:        putValueToControl("FehlerbitMuster",buffer, "073    HW Treiber Out1: Short to Batt\n"); break; 
      case 512:        putValueToControl("FehlerbitMuster",buffer, "074    HW Treiber Out1: Short to GND\n"); break; 
      case 1024:       putValueToControl("FehlerbitMuster",buffer, "075    HW Unerwartetes Abschalten\n"); break; 
      case 2048:       putValueToControl("FehlerbitMuster",buffer, "076    Kommunikationsfehler Bus Off CAN CSSU\n"); break; 
      case 4096:       putValueToControl("FehlerbitMuster",buffer, "077    Kommunikationsfehler Bus Off CAN1\n"); break; 
      case 8192:       putValueToControl("FehlerbitMuster",buffer, "078    Kommunikationsfehler Bus Off CAN2\n"); break; 
      case 16384:      putValueToControl("FehlerbitMuster",buffer, "079    Kommunikationsfehler Bus Off CVS\n"); break; 
      case 32768:      putValueToControl("FehlerbitMuster",buffer, "080    Kommunikationsfehler CAN:    <-> CSSU7\n"); break; 
      case 65536:      putValueToControl("FehlerbitMuster",buffer, "081    Kommunikationsfehler CAN:    <-> CSSU\n"); break; 
      case 131072:     putValueToControl("FehlerbitMuster",buffer, "082    Kommunikationsfehler CAN:    <-> CVS\n"); break; 
      case 262144:     putValueToControl("FehlerbitMuster",buffer, "083    Kommunikationsfehler CAN:    <-> CVS\n"); break; 
      case 524288:     putValueToControl("FehlerbitMuster",buffer, "084    KommunikationsfehlerCSSU antwortet nicht\n"); break; 
      case 1048576:    putValueToControl("FehlerbitMuster",buffer, "085    SystemIndizierung fehlgeschlagen\n"); break; 
      case 2097152:    putValueToControl("FehlerbitMuster",buffer, "086    SystemIndizierung verloren\n"); break; 
      case 4194304:    putValueToControl("FehlerbitMuster",buffer, "087    CSSU HW Frontend defekt\n"); break; 
      case 8388608:    putValueToControl("FehlerbitMuster",buffer, "088    CSSU HW kritsche Hw defekt, CSSU muss abgeschaltet werden\n"); break; 
      case 16777216:   putValueToControl("FehlerbitMuster",buffer, "089    CSSU HW mind ein Temperatursensor -> Open Load\n"); break; 
      case 33554432:   putValueToControl("FehlerbitMuster",buffer, "090    CSSU HW mind ein Temperatursensor -> Short to GND\n"); break; 
      case 67108864:   putValueToControl("FehlerbitMuster",buffer, "091    CSSU HW 3,3V Reference Voltage OOR\n"); break; 
      case 134217728:  putValueToControl("FehlerbitMuster",buffer, "092    CSSU HW Test: RAM defekt\n"); break; 
      case 268435456:  putValueToControl("FehlerbitMuster",buffer, "093    CSSU HW Test: ROM defekt\n"); break; 
      case 536870912:  putValueToControl("FehlerbitMuster",buffer, "094    CSSU System Konfiguration abweichend\n"); break; 
      case 1073741824: putValueToControl("FehlerbitMuster",buffer, "095    CSSU System Konfiguration nicht kompatibel\n"); break; 
      case 2147483648: putValueToControl("FehlerbitMuster",buffer, "096    CSSU System Init test not executed yet\n"); break; 
    default:
    break;    
  }
}

void Group4WriteToBox (dword whichOne, int storedOrActual)
{
  char buffer[9];
  if (storedOrActual == Stored) {
    snprintf (buffer,elcount(buffer),"WindowS");
  }
  else {
    snprintf (buffer,elcount(buffer),"WindowA");
  }
    switch(whichOne) {
      case 1:            putValueToControl("FehlerbitMuster",buffer, "097    CSSU Hardwarefehler Gespeicherte Zell-Tiefentladung\n"); break;
      case 2:            putValueToControl("FehlerbitMuster",buffer, "098    CSSU Kommunikationsfehler Fehler bei der Kommunikation mit Frontend\n"); break;                                 
      case 4:            putValueToControl("FehlerbitMuster",buffer, "099    CSSU System Ungültige Forderung von der SME erhalten\n"); break;
      case 8:            putValueToControl("FehlerbitMuster",buffer, "100    CSSU System Frontend overtemperature detected\n"); break;
      case 16:           putValueToControl("FehlerbitMuster",buffer, "101    CSSU Kommunikationsfehler Konfiguration noch nicht bestaetigt\n"); break;
      case 32:           putValueToControl("FehlerbitMuster",buffer, "102    CSSU Kommunikationsfehler CAN-bus-off detected\n"); break;
      case 64:           putValueToControl("FehlerbitMuster",buffer, "103    CSSU System Ucell plausibility error\n"); break;
      case 128:          putValueToControl("FehlerbitMuster",buffer, "104    CSSU Zellspannung Modul Y: Überspannung > 4,12 V (25°C)\n"); break;
      case 256:          putValueToControl("FehlerbitMuster",buffer, "105    CSSU Zellspannung Modul Y: Unterspannung < 2,7 V (25°C)\n"); break;
      case 512:          putValueToControl("FehlerbitMuster",buffer, "106    CSSU Zellspannung Niedrigste balanzierbare Spannung erreicht\n"); break;
      case 1024:         putValueToControl("FehlerbitMuster",buffer, "107    CSSU Zellspannung Unterspannung TOT < 2,15 V (25 °C)\n"); break;
      case 2048:         putValueToControl("FehlerbitMuster",buffer, "108    CSSU Zellspannung Zelle x: Open Wire entdeckt (Anzahl der Zellen ist variabel)\n "); break;
      case 4096:         putValueToControl("FehlerbitMuster",buffer, "109    CSSU System Mindestens ein Konfigurationswert nicht plausibel OOR\n "); break;
      case 8192:         putValueToControl("FehlerbitMuster",buffer, "110    CSSU System 5V Supply defective\n"); break;
      case 16384:        putValueToControl("FehlerbitMuster",buffer, "111    CSSU System module volt. out of range (low)\n "); break;
      case 32768:        putValueToControl("FehlerbitMuster",buffer, "112    CSSU System module volt. out of range (high)\n "); break;
      case 65536:        putValueToControl("FehlerbitMuster",buffer, "113    CSSU System No Calibration values\n "); break;
      case 131072:       putValueToControl("FehlerbitMuster",buffer, "114    CSSU System 12V Supply defective\n"); break;
      case 262144:       putValueToControl("FehlerbitMuster",buffer, "115    CVS Hardwarefehler Open Connection"); break;
      case 524288:       putValueToControl("FehlerbitMuster",buffer, "116    CVS Kommunikationsfehler Communication with FE Failure\n "); break;
      case 1048576:      putValueToControl("FehlerbitMuster",buffer, "117    CVS Messwerte Current Plausibility\n "); break;
      case 2097152:      putValueToControl("FehlerbitMuster",buffer, "118    CVS Messwerte Temperatur Plausibility\n "); break;
      case 4194304:      putValueToControl("FehlerbitMuster",buffer, "119    CVS Hardwarefehler Temperatur (elektrisch) out of range\n "); break;
      case 8388608:      putValueToControl("FehlerbitMuster",buffer, "120    CVS Kommunikationsfehler  Communication with SR Failure\n "); break;
      case 16777216:     putValueToControl("FehlerbitMuster",buffer, "121    CVS System  Shunt overload, values are limited entrusting\n "); break;
      case 33554432:     putValueToControl("FehlerbitMuster",buffer, "122    CVS System Open Connection not yet tested\n "); break;
      case 67108864:     putValueToControl("FehlerbitMuster",buffer, "123    Spez. BMZ  Schocklevel 2 übertreten\n "); break;
      case 134217728:    putValueToControl("FehlerbitMuster",buffer, "124    Spez. BMZ Balancing Inbalance\n "); break;
      case 268435456:    putValueToControl("FehlerbitMuster",buffer, "125    Spez. BMZ Untertemp( < -30 °C )\n "); break;
      case 536870912:    putValueToControl("FehlerbitMuster",buffer, "126    Spez. BMZ Untertemp ( < -25 °C ) \n"); break;
      case 1073741824:   putValueToControl("FehlerbitMuster",buffer, "127    Spez. BMZ  CAN: Master ? Sensor / Display          \n "); break;
      case 2147483648:   putValueToControl("FehlerbitMuster",buffer, "128    Spez. BMZ Ebene 1 Zellspannungen zu hoch (Ebene 1) >=4,20V\n"); break;
    default:
    break;    
  }
}

void Group5WriteToBox (dword whichOne, int storedOrActual)
{
  char buffer[9];
  if (storedOrActual == Stored) {
    snprintf (buffer,elcount(buffer),"WindowS");
  }
  else {
    snprintf (buffer,elcount(buffer),"WindowA");
  }
    switch(whichOne) {
      case 1:            putValueToControl("FehlerbitMuster",buffer, "129    Spez. BMZ Ebene 1 Zellspannungen zu niedrig (Ebene 1) <=2,15V\n"); break;
      case 2:            putValueToControl("FehlerbitMuster",buffer, "130    Spez. BMZ Ebene 1 CSSU FUSI Fehler\n"); break;       
      case 4:            putValueToControl("FehlerbitMuster",buffer, "131    Spez. BMZ Ebene 1 Time Out Fehler CSSU\n"); break;
      case 8:            putValueToControl("FehlerbitMuster",buffer, "132    Spez. BMZ Ebene 1 Zelltemperaturen zu hoch (Ebene 1) >= 65°C\n"); break;
      case 16:           putValueToControl("FehlerbitMuster",buffer, "133    Spez. BMZ Ebene 1 CSSU Modul Fehler\n"); break;
      case 32:           putValueToControl("FehlerbitMuster",buffer, "134    Spez. BMZ Ebene 1 CVS FUSI Fehler\n"); break;
      case 64:           putValueToControl("FehlerbitMuster",buffer, "135    Spez. BMZ Ebene 1 Diff. Max. Und Min. Zellspannung unplausibel\n"); break;
      case 128:          putValueToControl("FehlerbitMuster",buffer, "136    Spez. BMZ Ebene 1 CVS Stack Spannungs Fehler\n"); break;
      case 256:          putValueToControl("FehlerbitMuster",buffer, "137    Spez. BMZ Ebene 1 Time Out Fehler CVS\n"); break;
      case 512:          putValueToControl("FehlerbitMuster",buffer, "138    Spez. BMZ Ebene 1 Aktueller Strom weicht von der Stromprognose ab > 50 A\n"); break;
      case 1024:         putValueToControl("FehlerbitMuster",buffer, "139    Spez. BMZ Reißleine gezogen (CSSU)\n"); break;
      case 2048:         putValueToControl("FehlerbitMuster",buffer, "140    Spez. BMZ Statemanager Falsche nominale Spannung\n"); break;
      case 4096:         putValueToControl("FehlerbitMuster",buffer, "141    Spez. BMZ Schalten unter Last (Schützverschleiß) \n"); break;
      case 8192:         putValueToControl("FehlerbitMuster",buffer, "142    Spez. BMZ Fehler auf dem Schocksensorboard\n"); break;
      case 16384:        putValueToControl("FehlerbitMuster",buffer, "143    Spez. BMZ Schocklevel 1 überschritten\n"); break;
      case 32768:        putValueToControl("FehlerbitMuster",buffer, "144    Spez. BMZ Spannungsversorgung DC/DC Wandler Probleme Supply Out of Range\n"); break;
      case 65536:        putValueToControl("FehlerbitMuster",buffer, "145    Spez. BMZ SCHÜTZ-DIAGNOSE Schützdiagnose Relais 1 (Schütz klebt / schliesst nicht)\n"); break;
      case 131072:       putValueToControl("FehlerbitMuster",buffer, "146    Spez. BMZ SCHÜTZ-DIAGNOSE Schützdiagnose Relais 2 (Schütz klebt / schliesst nicht) \n"); break;
      case 262144:       putValueToControl("FehlerbitMuster",buffer, "147    Spez. BMZ Bremswiderstand Defekt / Ausgefallen\n"); break;
      case 524288:       putValueToControl("FehlerbitMuster",buffer, "148    Spez. BMZ Bremswiderstand Zu hohe Temp\n"); break;
      case 1048576:      putValueToControl("FehlerbitMuster",buffer, "149    Spez. BMZ Ungültiger Betriebszustand\n"); break;
      case 2097152:      putValueToControl("FehlerbitMuster",buffer, "150    Spez. BMZ Nicht zugeordnet\n"); break;
      case 4194304:      putValueToControl("FehlerbitMuster",buffer, "151    Spez. BMZ Reißleine gezogen\n"); break;
      case 8388608:      putValueToControl("FehlerbitMuster",buffer, "152    Spez. BMZ maximale zulässige Zellspannung >= 4,12V\n"); break;
      case 16777216:     putValueToControl("FehlerbitMuster",buffer, "153    Spez. BMZ Unterspannung <= 2,7V\n"); break;
      case 33554432:     putValueToControl("FehlerbitMuster",buffer, "154    Reissleinentest fehlgeschlagen\n"); break;
      case 67108864:     putValueToControl("FehlerbitMuster",buffer, "155    Abschaltpfadtest fehlerhaft \n"); break;
      case 134217728:    putValueToControl("FehlerbitMuster",buffer, "156    Abschaltpfadtest : Fehler Freigabe Sicherheitsrechner\n"); break;
      case 268435456:    putValueToControl("FehlerbitMuster",buffer, "157    Abschaltpfadtest : Fehler Relaydiagnose\n"); break;
      case 536870912:    putValueToControl("FehlerbitMuster",buffer, "158    Abschaltpfadtest : Fehler Freigabe Chrashsignal\n"); break;
      case 1073741824:   putValueToControl("FehlerbitMuster",buffer, "159    Abschaltpfadtest : Fehler NVM Test\n"); break;
      case 2147483648:   putValueToControl("FehlerbitMuster",buffer, "160    Ebene 2 - CRC Fehler CSSU "); break;
    default:
    break;    
  }
}
































