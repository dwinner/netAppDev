/*@!Encoding:1252*/
includes
{
  // Import required CAPL include files
  //--- begin generated part --- Block start #Hdr_Includes#; do not delete this line and do not add application code in this code block!
  /* #ChannelStart# |CAN1| #BusStart# |E3V_ABCANFD| */
  /* #ChannelEnd# |CAN1| #BusEnd# |E3V_ABCANFD| */
  //--- end generated part --- Block end #Hdr_Includes#; do not delete this line! Add application code below this line.
  //--- begin generated part --- Block start #Body_Includes#; do not delete this line and do not add application code in this code block!
  /* #ChannelStart# |CAN1| #BusStart# |E3V_ABCANFD| */
  #include "..\..\CAPL\VAG-IL-KL30-Helper_CAN1.cin"
  #include "..\..\CAPL\VAG-NM-Panel-Helper_CAN1.cin"
  #include "..\..\CAPL\VAG-NM-HIGH-Helper_CAN1.cin"
  /* #ChannelEnd# |CAN1| #BusEnd# |E3V_ABCANFD| */
  //--- end generated part --- Block end #Body_Includes#; do not delete this line! Add application code below this line.
}

variables
{
  // Define global variables for this CAPL file

  /*--- #GenHeader Begin# --- begin generated comment ---
  | Generated on Friday, Januar 17, 2020, 09:38:11
  | By ModelGenerator for VAG 1.4.3.7, ModelGeneratorVAGDLL 1.4.3.46
  | Package VAG 3.1.3.3 Hotfix
  | Target Bus: E3V_ABCANFD; Channel: CAN1; DB Cluster: E3_1_1_MEB_ABCANFD_KMatrix_V100604F_20191202_MB;
  | From Database: E3_1_1_MEB_ABCANFD_KMatrix_V10.06.04F_20191202_MB.dbc
  | CANoe Version 12.0.189.0
    --- #GenHeader End  # --- end generated comment --- */

  char gECU[256] = "Kombi";
  //--- begin generated part --- Block start #Hdr_GlobalVariables#; do not delete this line and do not add application code in this code block!
  /* #ChannelStart# |CAN1| #BusStart# |E3V_ABCANFD| */
  /* #ChannelEnd# |CAN1| #BusEnd# |E3V_ABCANFD| */
  //--- end generated part --- Block end #Hdr_GlobalVariables#; do not delete this line! Add application code below this line.
  //--- begin generated part --- Block start #Body_GlobalVariables#; do not delete this line and do not add application code in this code block!
  /* #ChannelStart# |CAN1| #BusStart# |E3V_ABCANFD| */
  char gCAN1BusName[256] = "AB_CAN";
  int gCAN1Channel = 1; //// The channel the bus is attached to

  long gCAN1DisturbanceMode;
  long gCAN1DisturbanceCount;
  long gCAN1DisturbanceValue;
  long gCAN1DisturbanceContinueMode;
  double gCAN1DisturbancePeriod;
  /* #ChannelEnd# |CAN1| #BusEnd# |E3V_ABCANFD| */
  //--- end generated part --- Block end #Body_GlobalVariables#; do not delete this line! Add application code below this line.
}

on preStart
{
  // Initialize CAPL includes and node's modules/DLLs
  //--- begin generated part --- Block start #Hdr_OnInit#; do not delete this line and do not add application code in this code block!
  /* #ChannelStart# |CAN1| #BusStart# |E3V_ABCANFD| */
  /* #ChannelEnd# |CAN1| #BusEnd# |E3V_ABCANFD| */
  //--- end generated part --- Block end #Hdr_OnInit#; do not delete this line! Add application code below this line.
  //--- begin generated part --- Block start #Body_OnInit#; do not delete this line and do not add application code in this code block!
  /* #ChannelStart# |CAN1| #BusStart# |E3V_ABCANFD| */
  ILCAN1_OnInit();
  NMCAN1_OnInit();
  SetBusContext(gNMCAN1_BusContext);
  // CG NMH_SetInternalParameter( 1000, 1, 0 ); // CancelOrResetSleepTimer on setting bus request
  /* #ChannelEnd# |CAN1| #BusEnd# |E3V_ABCANFD| */
  //--- end generated part --- Block end #Body_OnInit#; do not delete this line! Add application code below this line.
}

on start
{
  // Start CAPL includes and node's modules/DLLs
  //--- begin generated part --- Block start #Hdr_OnStart#; do not delete this line and do not add application code in this code block!
  /* #ChannelStart# |CAN1| #BusStart# |E3V_ABCANFD| */
  /* #ChannelEnd# |CAN1| #BusEnd# |E3V_ABCANFD| */
  //--- end generated part --- Block end #Hdr_OnStart#; do not delete this line! Add application code below this line.
  //--- begin generated part --- Block start #Body_OnStart#; do not delete this line and do not add application code in this code block!
  /* #ChannelStart# |CAN1| #BusStart# |E3V_ABCANFD| */
  ILCAN1_OnStart();
  NMCAN1_OnStart();
  /* #ChannelEnd# |CAN1| #BusEnd# |E3V_ABCANFD| */
  //--- end generated part --- Block end #Body_OnStart#; do not delete this line! Add application code below this line.
}

on preStop
{
  // Prepare stopping
  //--- begin generated part --- Block start #Hdr_OnStopping#; do not delete this line and do not add application code in this code block!
  /* #ChannelStart# |CAN1| #BusStart# |E3V_ABCANFD| */
  /* #ChannelEnd# |CAN1| #BusEnd# |E3V_ABCANFD| */
  //--- end generated part --- Block end #Hdr_OnStopping#; do not delete this line! Add application code below this line.
  //--- begin generated part --- Block start #Body_OnStopping#; do not delete this line and do not add application code in this code block!
  /* #ChannelStart# |CAN1| #BusStart# |E3V_ABCANFD| */
  /* #ChannelEnd# |CAN1| #BusEnd# |E3V_ABCANFD| */
  //--- end generated part --- Block end #Body_OnStopping#; do not delete this line! Add application code below this line.
}

on stopMeasurement
{
  // Stop actions
  //--- begin generated part --- Block start #Hdr_OnStop#; do not delete this line and do not add application code in this code block!
  /* #ChannelStart# |CAN1| #BusStart# |E3V_ABCANFD| */
  /* #ChannelEnd# |CAN1| #BusEnd# |E3V_ABCANFD| */
  //--- end generated part --- Block end #Hdr_OnStop#; do not delete this line! Add application code below this line.
  //--- begin generated part --- Block start #Body_OnStop#; do not delete this line and do not add application code in this code block!
  /* #ChannelStart# |CAN1| #BusStart# |E3V_ABCANFD| */
  /* #ChannelEnd# |CAN1| #BusEnd# |E3V_ABCANFD| */
  //--- end generated part --- Block end #Body_OnStop#; do not delete this line! Add application code below this line.
}

void StartSim(dword busContext, int busActive, int mode)
{
  // Called when ... due to ...
  //   mode == 1: ILControlResume
  //   mode == 2: ILControlStart
  //   mode == 3: ILControlSimulationOn
  //--- begin generated part --- Block start #Hdr_StartSim#; do not delete this line and do not add application code in this code block!
  /* #ChannelStart# |CAN1| #BusStart# |E3V_ABCANFD| */
  /* #ChannelEnd# |CAN1| #BusEnd# |E3V_ABCANFD| */
  //--- end generated part --- Block end #Hdr_StartSim#; do not delete this line! Add application code below this line.
  //write("[%.6f %NODE_NAME%] StartSim(0x%X, %d, %d)", TimeNowNS()/1e9, busContext, busActive, mode);
  //--- begin generated part --- Block start #Body_StartSim#; do not delete this line and do not add application code in this code block!
  /* #ChannelStart# |CAN1| #BusStart# |E3V_ABCANFD| */
  /* #ChannelEnd# |CAN1| #BusEnd# |E3V_ABCANFD| */
  //--- end generated part --- Block end #Body_StartSim#; do not delete this line! Add application code below this line.
}

void StopSim(dword busContext, int busActive, int mode)
{
  // Called when ... due to ...
  //   mode == 1: ILControlWait
  //   mode == 2: ILControlStop
  //   mode == 3: ILControlSimulationOff
  //--- begin generated part --- Block start #Hdr_StopSim#; do not delete this line and do not add application code in this code block!
  /* #ChannelStart# |CAN1| #BusStart# |E3V_ABCANFD| */
  /* #ChannelEnd# |CAN1| #BusEnd# |E3V_ABCANFD| */
  //--- end generated part --- Block end #Hdr_StopSim#; do not delete this line! Add application code below this line.
  //write("[%.6f %NODE_NAME%] StopSim(0x%X, %d, %d)", TimeNowNS()/1e9, busContext, busActive, mode);
  //--- begin generated part --- Block start #Body_StopSim#; do not delete this line and do not add application code in this code block!
  /* #ChannelStart# |CAN1| #BusStart# |E3V_ABCANFD| */
  /* #ChannelEnd# |CAN1| #BusEnd# |E3V_ABCANFD| */
  //--- end generated part --- Block end #Body_StopSim#; do not delete this line! Add application code below this line.
}

on envVar EnvKlemme15
{
  // Handle system state variable
  //--- begin generated part --- Block start #Hdr_KL15_EnvKlemme15#; do not delete this line and do not add application code in this code block!
  /* #ChannelStart# |CAN1| #BusStart# |E3V_ABCANFD| */
  /* #ChannelEnd# |CAN1| #BusEnd# |E3V_ABCANFD| */
  //--- end generated part --- Block end #Hdr_KL15_EnvKlemme15#; do not delete this line! Add application code below this line.
  //--- begin generated part --- Block start #Body_KL15_EnvKlemme15#; do not delete this line and do not add application code in this code block!
  /* #ChannelStart# |CAN1| #BusStart# |E3V_ABCANFD| */
  ILCAN1_OnEnvKlemme15(@this);
  /* #ChannelEnd# |CAN1| #BusEnd# |E3V_ABCANFD| */
  //--- end generated part --- Block end #Body_KL15_EnvKlemme15#; do not delete this line! Add application code below this line.
}

on envVar EnvStartWithoutSending
{
  // Handle system state variable
  //--- begin generated part --- Block start #Hdr_StartManner_EnvStartWithoutSending#; do not delete this line and do not add application code in this code block!
  /* #ChannelStart# |CAN1| #BusStart# |E3V_ABCANFD| */
  /* #ChannelEnd# |CAN1| #BusEnd# |E3V_ABCANFD| */
  //--- end generated part --- Block end #Hdr_StartManner_EnvStartWithoutSending#; do not delete this line! Add application code below this line.
  //--- begin generated part --- Block start #Body_StartManner_EnvStartWithoutSending#; do not delete this line and do not add application code in this code block!
  /* #ChannelStart# |CAN1| #BusStart# |E3V_ABCANFD| */
  ILCAN1_OnEnvStartWithoutSending(@this);
  /* #ChannelEnd# |CAN1| #BusEnd# |E3V_ABCANFD| */
  //--- end generated part --- Block end #Body_StartManner_EnvStartWithoutSending#; do not delete this line! Add application code below this line.
}

dword applILTxPending(long aId, dword aDlc, byte data[])
{
  dword ret = 1;
  //--- begin generated part --- Block start #Hdr_applILTxPending#; do not delete this line and do not add application code in this code block!
  /* #ChannelStart# |CAN1| #BusStart# |E3V_ABCANFD| */
  /* #ChannelEnd# |CAN1| #BusEnd# |E3V_ABCANFD| */
  //--- end generated part --- Block end #Hdr_applILTxPending#; do not delete this line! Add application code below this line.
  //--- begin generated part --- Block start #Body_applILTxPending#; do not delete this line and do not add application code in this code block!
  /* #ChannelStart# |CAN1| #BusStart# |E3V_ABCANFD| */
  /* #ChannelEnd# |CAN1| #BusEnd# |E3V_ABCANFD| */
  //--- end generated part --- Block end #Body_applILTxPending#; do not delete this line! Add application code below this line.
  return ret;
}

void NMIndNetOn()
{
  // Callback of NM-HIGH DLL
  dword lBusContext;
  //--- begin generated part --- Block start #Hdr_NMIndNetOn#; do not delete this line and do not add application code in this code block!
  /* #ChannelStart# |CAN1| #BusStart# |E3V_ABCANFD| */
  /* #ChannelEnd# |CAN1| #BusEnd# |E3V_ABCANFD| */
  //--- end generated part --- Block end #Hdr_NMIndNetOn#; do not delete this line! Add application code below this line.
  lBusContext = GetBusContext();
  //--- begin generated part --- Block start #Body_NMIndNetOn#; do not delete this line and do not add application code in this code block!
  /* #ChannelStart# |CAN1| #BusStart# |E3V_ABCANFD| */
  if (lBusContext == gNMCAN1_BusContext) NMCAN1_IndNetOn();
  /* #ChannelEnd# |CAN1| #BusEnd# |E3V_ABCANFD| */
  //--- end generated part --- Block end #Body_NMIndNetOn#; do not delete this line! Add application code below this line.
  SetBusContext(lBusContext);
}

void NMIndNetOff()
{
  // Callback of NM-HIGH DLL
  dword lBusContext;
  //--- begin generated part --- Block start #Hdr_NMIndNetOff#; do not delete this line and do not add application code in this code block!
  /* #ChannelStart# |CAN1| #BusStart# |E3V_ABCANFD| */
  /* #ChannelEnd# |CAN1| #BusEnd# |E3V_ABCANFD| */
  //--- end generated part --- Block end #Hdr_NMIndNetOff#; do not delete this line! Add application code below this line.
  lBusContext = GetBusContext();
  //--- begin generated part --- Block start #Body_NMIndNetOff#; do not delete this line and do not add application code in this code block!
  /* #ChannelStart# |CAN1| #BusStart# |E3V_ABCANFD| */
  if (lBusContext == gNMCAN1_BusContext) NMCAN1_IndNetOff();
  /* #ChannelEnd# |CAN1| #BusEnd# |E3V_ABCANFD| */
  //--- end generated part --- Block end #Body_NMIndNetOff#; do not delete this line! Add application code below this line.
  SetBusContext(lBusContext);
}

void NMIndNetSDN()
{
  // Callback of NM-HIGH DLL
  dword lBusContext;
  //--- begin generated part --- Block start #Hdr_NMIndNetSDN#; do not delete this line and do not add application code in this code block!
  /* #ChannelStart# |CAN1| #BusStart# |E3V_ABCANFD| */
  /* #ChannelEnd# |CAN1| #BusEnd# |E3V_ABCANFD| */
  //--- end generated part --- Block end #Hdr_NMIndNetSDN#; do not delete this line! Add application code below this line.
  lBusContext = GetBusContext();
  //--- begin generated part --- Block start #Body_NMIndNetSDN#; do not delete this line and do not add application code in this code block!
  /* #ChannelStart# |CAN1| #BusStart# |E3V_ABCANFD| */
  if (lBusContext == gNMCAN1_BusContext) NMCAN1_IndNetSDN();
  /* #ChannelEnd# |CAN1| #BusEnd# |E3V_ABCANFD| */
  //--- end generated part --- Block end #Body_NMIndNetSDN#; do not delete this line! Add application code below this line.
  SetBusContext(lBusContext);
}

void NMIndStateChangeNotification(long previousState, long currentState)
{
  // Callback of NM-HIGH DLL
  dword lBusContext;
  //--- begin generated part --- Block start #Hdr_NMIndStateChangeNotification#; do not delete this line and do not add application code in this code block!
  /* #ChannelStart# |CAN1| #BusStart# |E3V_ABCANFD| */
  /* #ChannelEnd# |CAN1| #BusEnd# |E3V_ABCANFD| */
  //--- end generated part --- Block end #Hdr_NMIndStateChangeNotification#; do not delete this line! Add application code below this line.
  lBusContext = GetBusContext();
  //--- begin generated part --- Block start #Body_NMIndStateChangeNotification#; do not delete this line and do not add application code in this code block!
  /* #ChannelStart# |CAN1| #BusStart# |E3V_ABCANFD| */
  if (lBusContext == gNMCAN1_BusContext) NMCAN1_IndStateChangeNotification(previousState, currentState);
  /* #ChannelEnd# |CAN1| #BusEnd# |E3V_ABCANFD| */
  //--- end generated part --- Block end #Body_NMIndStateChangeNotification#; do not delete this line! Add application code below this line.
  SetBusContext(lBusContext);
}

//--- begin generated part --- Block start <#Helper_Functions#> do not delete this line and do not add application code in this code block!
/* #ChannelStart# |CAN1| #BusStart# |E3V_ABCANFD| */
/* #ChannelEnd# |CAN1| #BusEnd# |E3V_ABCANFD| */
//--- end generated part --- Block end <#Helper_Functions#> do not delete this line! Add application code below this line.

//--- begin generated part --- Block start <#SysVar_Handler#> do not delete this line and do not add application code in this code block!
/* #ChannelStart# |CAN1| #BusStart# |E3V_ABCANFD| */
on sysvar_update sysvar::IL_CAN1::EnableNode::Kombi
{
  ILCAN1_Enable(@this && @sysvar::IL_CAN1::enable_AllNodes);
}

on sysvar_update sysvar::IL_CAN1::enable_AllNodes
{
  ILCAN1_Enable(@this && @sysvar::IL_CAN1::EnableNode::Kombi);
}

on sysvar_update sysvar::NM_CAN1::Kombi::DeactivateNM
{
  if( @this == 1 || @sysvar::NM_CAN1::StateControl::DeactivateNM == 1)
  {
    NMCAN1_Enable(0);
  }
  else
  {
    NMCAN1_Enable(1);
  }
}

on sysvar_update sysvar::NM_CAN1::StateControl::DeactivateNM
{
  if( @this == 1 || @sysvar::NM_CAN1::Kombi::DeactivateNM == 1)
  {
    NMCAN1_Enable(0);
  }
  else
  {
    NMCAN1_Enable(1);
  }
}

on sysvar_update sysvar::IL_CAN1::Message_EnableCyclic::Kombi_FAS_Anzeigen_01
{
  if (@this == 1)
  {
    SetBusContext(gILCAN1_BusContext);
    ILFaultInjectionEnableMsg  (E3V_ABCANFD::FAS_Anzeigen_01);
  }
  else
  {
    SetBusContext(gILCAN1_BusContext);
    ILFaultInjectionDisableMsg (E3V_ABCANFD::FAS_Anzeigen_01);
  }
}

on sysvar_update sysvar::IL_CAN1::Message_SetNormalCycle::Kombi_FAS_Anzeigen_01
{
  if (@this == 1 && @sysvar::IL_CAN1::Message_EnableCyclic::Kombi_FAS_Anzeigen_01)
  {
    @sysvar::IL_CAN1::Message_SelectedPeriod::Kombi_FAS_Anzeigen_01 = 0;
  }
}

on sysvar_update sysvar::IL_CAN1::Message_SetNewCycleContinously::Kombi_FAS_Anzeigen_01
{
  if (@this == 1 && @sysvar::IL_CAN1::Message_EnableCyclic::Kombi_FAS_Anzeigen_01)
  {
    @sysvar::IL_CAN1::Message_SelectedPeriod::Kombi_FAS_Anzeigen_01 = -1;
  }
}

on sysvar_update sysvar::IL_CAN1::Message_SelectedPeriod::Kombi_FAS_Anzeigen_01
{
  if (@this == 0 && @sysvar::IL_CAN1::Message_EnableCyclic::Kombi_FAS_Anzeigen_01)
  {
    SetBusContext(gILCAN1_BusContext);
    gCAN1DisturbancePeriod = @sysvar::IL_CAN1::Message_NormalCyclePeriod::Kombi_FAS_Anzeigen_01;
    ILFaultInjectionResetMsgCycleTime(E3V_ABCANFD::FAS_Anzeigen_01);
  }
  else if (@this == 1 && @sysvar::IL_CAN1::Message_EnableCyclic::Kombi_FAS_Anzeigen_01)
  {
    SetBusContext(gILCAN1_BusContext);
    gCAN1DisturbancePeriod = @sysvar::IL_CAN1::Message_ActiveCyclePeriod::Kombi_FAS_Anzeigen_01;
    ILFaultInjectionSetMsgCycleTime(E3V_ABCANFD::FAS_Anzeigen_01, gCAN1DisturbancePeriod);
  }
  else if (@this == -1 && @sysvar::IL_CAN1::Message_EnableCyclic::Kombi_FAS_Anzeigen_01)
  {
    SetBusContext(gILCAN1_BusContext);
    gCAN1DisturbancePeriod = @sysvar::IL_CAN1::Message_CyclePeriod::Kombi_FAS_Anzeigen_01;
    ILFaultInjectionSetMsgCycleTime(E3V_ABCANFD::FAS_Anzeigen_01, gCAN1DisturbancePeriod);
  }
}

on sysvar_update sysvar::IL_CAN1::Message_SendOnce::Kombi_FAS_Anzeigen_01
{
  if (@this == 1)
  {
    SetBusContext(gILCAN1_BusContext);
    ILSetMsgEvent(E3V_ABCANFD::FAS_Anzeigen_01);
  }
}

on sysvar_update sysvar::IL_CAN1::Message_EnableCyclic::Kombi_KN_Kombi
{
  if (@this == 1)
  {
    SetBusContext(gILCAN1_BusContext);
    ILFaultInjectionEnableMsg  (E3V_ABCANFD::KN_Kombi);
  }
  else
  {
    SetBusContext(gILCAN1_BusContext);
    ILFaultInjectionDisableMsg (E3V_ABCANFD::KN_Kombi);
  }
}

on sysvar_update sysvar::IL_CAN1::Message_SetNormalCycle::Kombi_KN_Kombi
{
  if (@this == 1 && @sysvar::IL_CAN1::Message_EnableCyclic::Kombi_KN_Kombi)
  {
    @sysvar::IL_CAN1::Message_SelectedPeriod::Kombi_KN_Kombi = 0;
  }
}

on sysvar_update sysvar::IL_CAN1::Message_SetNewCycleContinously::Kombi_KN_Kombi
{
  if (@this == 1 && @sysvar::IL_CAN1::Message_EnableCyclic::Kombi_KN_Kombi)
  {
    @sysvar::IL_CAN1::Message_SelectedPeriod::Kombi_KN_Kombi = -1;
  }
}

on sysvar_update sysvar::IL_CAN1::Message_SelectedPeriod::Kombi_KN_Kombi
{
  if (@this == 0 && @sysvar::IL_CAN1::Message_EnableCyclic::Kombi_KN_Kombi)
  {
    SetBusContext(gILCAN1_BusContext);
    gCAN1DisturbancePeriod = @sysvar::IL_CAN1::Message_NormalCyclePeriod::Kombi_KN_Kombi;
    ILFaultInjectionResetMsgCycleTime(E3V_ABCANFD::KN_Kombi);
  }
  else if (@this == 1 && @sysvar::IL_CAN1::Message_EnableCyclic::Kombi_KN_Kombi)
  {
    SetBusContext(gILCAN1_BusContext);
    gCAN1DisturbancePeriod = @sysvar::IL_CAN1::Message_ActiveCyclePeriod::Kombi_KN_Kombi;
    ILFaultInjectionSetMsgCycleTime(E3V_ABCANFD::KN_Kombi, gCAN1DisturbancePeriod);
  }
  else if (@this == -1 && @sysvar::IL_CAN1::Message_EnableCyclic::Kombi_KN_Kombi)
  {
    SetBusContext(gILCAN1_BusContext);
    gCAN1DisturbancePeriod = @sysvar::IL_CAN1::Message_CyclePeriod::Kombi_KN_Kombi;
    ILFaultInjectionSetMsgCycleTime(E3V_ABCANFD::KN_Kombi, gCAN1DisturbancePeriod);
  }
}

on sysvar_update sysvar::IL_CAN1::Message_SendOnce::Kombi_KN_Kombi
{
  if (@this == 1)
  {
    SetBusContext(gILCAN1_BusContext);
    ILSetMsgEvent(E3V_ABCANFD::KN_Kombi);
  }
}

on sysvar_update sysvar::IL_CAN1::Message_EnableCyclic::Kombi_Kombi_01
{
  if (@this == 1)
  {
    SetBusContext(gILCAN1_BusContext);
    ILFaultInjectionEnableMsg  (E3V_ABCANFD::Kombi_01);
  }
  else
  {
    SetBusContext(gILCAN1_BusContext);
    ILFaultInjectionDisableMsg (E3V_ABCANFD::Kombi_01);
  }
}

on sysvar_update sysvar::IL_CAN1::Message_SetNormalCycle::Kombi_Kombi_01
{
  if (@this == 1 && @sysvar::IL_CAN1::Message_EnableCyclic::Kombi_Kombi_01)
  {
    @sysvar::IL_CAN1::Message_SelectedPeriod::Kombi_Kombi_01 = 0;
  }
}

on sysvar_update sysvar::IL_CAN1::Message_SetNewCycleContinously::Kombi_Kombi_01
{
  if (@this == 1 && @sysvar::IL_CAN1::Message_EnableCyclic::Kombi_Kombi_01)
  {
    @sysvar::IL_CAN1::Message_SelectedPeriod::Kombi_Kombi_01 = -1;
  }
}

on sysvar_update sysvar::IL_CAN1::Message_SelectedPeriod::Kombi_Kombi_01
{
  if (@this == 0 && @sysvar::IL_CAN1::Message_EnableCyclic::Kombi_Kombi_01)
  {
    SetBusContext(gILCAN1_BusContext);
    gCAN1DisturbancePeriod = @sysvar::IL_CAN1::Message_NormalCyclePeriod::Kombi_Kombi_01;
    ILFaultInjectionResetMsgCycleTime(E3V_ABCANFD::Kombi_01);
  }
  else if (@this == 1 && @sysvar::IL_CAN1::Message_EnableCyclic::Kombi_Kombi_01)
  {
    SetBusContext(gILCAN1_BusContext);
    gCAN1DisturbancePeriod = @sysvar::IL_CAN1::Message_ActiveCyclePeriod::Kombi_Kombi_01;
    ILFaultInjectionSetMsgCycleTime(E3V_ABCANFD::Kombi_01, gCAN1DisturbancePeriod);
  }
  else if (@this == -1 && @sysvar::IL_CAN1::Message_EnableCyclic::Kombi_Kombi_01)
  {
    SetBusContext(gILCAN1_BusContext);
    gCAN1DisturbancePeriod = @sysvar::IL_CAN1::Message_CyclePeriod::Kombi_Kombi_01;
    ILFaultInjectionSetMsgCycleTime(E3V_ABCANFD::Kombi_01, gCAN1DisturbancePeriod);
  }
}

on sysvar_update sysvar::IL_CAN1::Message_SendOnce::Kombi_Kombi_01
{
  if (@this == 1)
  {
    SetBusContext(gILCAN1_BusContext);
    ILSetMsgEvent(E3V_ABCANFD::Kombi_01);
  }
}

on sysvar_update sysvar::IL_CAN1::Message_EnableCyclic::Kombi_Kombi_02
{
  if (@this == 1)
  {
    SetBusContext(gILCAN1_BusContext);
    ILFaultInjectionEnableMsg  (E3V_ABCANFD::Kombi_02);
  }
  else
  {
    SetBusContext(gILCAN1_BusContext);
    ILFaultInjectionDisableMsg (E3V_ABCANFD::Kombi_02);
  }
}

on sysvar_update sysvar::IL_CAN1::Message_SetNormalCycle::Kombi_Kombi_02
{
  if (@this == 1 && @sysvar::IL_CAN1::Message_EnableCyclic::Kombi_Kombi_02)
  {
    @sysvar::IL_CAN1::Message_SelectedPeriod::Kombi_Kombi_02 = 0;
  }
}

on sysvar_update sysvar::IL_CAN1::Message_SetNewCycleContinously::Kombi_Kombi_02
{
  if (@this == 1 && @sysvar::IL_CAN1::Message_EnableCyclic::Kombi_Kombi_02)
  {
    @sysvar::IL_CAN1::Message_SelectedPeriod::Kombi_Kombi_02 = -1;
  }
}

on sysvar_update sysvar::IL_CAN1::Message_SelectedPeriod::Kombi_Kombi_02
{
  if (@this == 0 && @sysvar::IL_CAN1::Message_EnableCyclic::Kombi_Kombi_02)
  {
    SetBusContext(gILCAN1_BusContext);
    gCAN1DisturbancePeriod = @sysvar::IL_CAN1::Message_NormalCyclePeriod::Kombi_Kombi_02;
    ILFaultInjectionResetMsgCycleTime(E3V_ABCANFD::Kombi_02);
  }
  else if (@this == 1 && @sysvar::IL_CAN1::Message_EnableCyclic::Kombi_Kombi_02)
  {
    SetBusContext(gILCAN1_BusContext);
    gCAN1DisturbancePeriod = @sysvar::IL_CAN1::Message_ActiveCyclePeriod::Kombi_Kombi_02;
    ILFaultInjectionSetMsgCycleTime(E3V_ABCANFD::Kombi_02, gCAN1DisturbancePeriod);
  }
  else if (@this == -1 && @sysvar::IL_CAN1::Message_EnableCyclic::Kombi_Kombi_02)
  {
    SetBusContext(gILCAN1_BusContext);
    gCAN1DisturbancePeriod = @sysvar::IL_CAN1::Message_CyclePeriod::Kombi_Kombi_02;
    ILFaultInjectionSetMsgCycleTime(E3V_ABCANFD::Kombi_02, gCAN1DisturbancePeriod);
  }
}

on sysvar_update sysvar::IL_CAN1::Message_SendOnce::Kombi_Kombi_02
{
  if (@this == 1)
  {
    SetBusContext(gILCAN1_BusContext);
    ILSetMsgEvent(E3V_ABCANFD::Kombi_02);
  }
}

on sysvar_update sysvar::IL_CAN1::Message_EnableCyclic::Kombi_Kombi_03
{
  if (@this == 1)
  {
    SetBusContext(gILCAN1_BusContext);
    ILFaultInjectionEnableMsg  (E3V_ABCANFD::Kombi_03);
  }
  else
  {
    SetBusContext(gILCAN1_BusContext);
    ILFaultInjectionDisableMsg (E3V_ABCANFD::Kombi_03);
  }
}

on sysvar_update sysvar::IL_CAN1::Message_SetNormalCycle::Kombi_Kombi_03
{
  if (@this == 1 && @sysvar::IL_CAN1::Message_EnableCyclic::Kombi_Kombi_03)
  {
    @sysvar::IL_CAN1::Message_SelectedPeriod::Kombi_Kombi_03 = 0;
  }
}

on sysvar_update sysvar::IL_CAN1::Message_SetNewCycleContinously::Kombi_Kombi_03
{
  if (@this == 1 && @sysvar::IL_CAN1::Message_EnableCyclic::Kombi_Kombi_03)
  {
    @sysvar::IL_CAN1::Message_SelectedPeriod::Kombi_Kombi_03 = -1;
  }
}

on sysvar_update sysvar::IL_CAN1::Message_SelectedPeriod::Kombi_Kombi_03
{
  if (@this == 0 && @sysvar::IL_CAN1::Message_EnableCyclic::Kombi_Kombi_03)
  {
    SetBusContext(gILCAN1_BusContext);
    gCAN1DisturbancePeriod = @sysvar::IL_CAN1::Message_NormalCyclePeriod::Kombi_Kombi_03;
    ILFaultInjectionResetMsgCycleTime(E3V_ABCANFD::Kombi_03);
  }
  else if (@this == 1 && @sysvar::IL_CAN1::Message_EnableCyclic::Kombi_Kombi_03)
  {
    SetBusContext(gILCAN1_BusContext);
    gCAN1DisturbancePeriod = @sysvar::IL_CAN1::Message_ActiveCyclePeriod::Kombi_Kombi_03;
    ILFaultInjectionSetMsgCycleTime(E3V_ABCANFD::Kombi_03, gCAN1DisturbancePeriod);
  }
  else if (@this == -1 && @sysvar::IL_CAN1::Message_EnableCyclic::Kombi_Kombi_03)
  {
    SetBusContext(gILCAN1_BusContext);
    gCAN1DisturbancePeriod = @sysvar::IL_CAN1::Message_CyclePeriod::Kombi_Kombi_03;
    ILFaultInjectionSetMsgCycleTime(E3V_ABCANFD::Kombi_03, gCAN1DisturbancePeriod);
  }
}

on sysvar_update sysvar::IL_CAN1::Message_SendOnce::Kombi_Kombi_03
{
  if (@this == 1)
  {
    SetBusContext(gILCAN1_BusContext);
    ILSetMsgEvent(E3V_ABCANFD::Kombi_03);
  }
}

on sysvar_update sysvar::IL_CAN1::Message_EnableCyclic::Kombi_Kombi_08
{
  if (@this == 1)
  {
    SetBusContext(gILCAN1_BusContext);
    ILFaultInjectionEnableMsg  (E3V_ABCANFD::Kombi_08);
  }
  else
  {
    SetBusContext(gILCAN1_BusContext);
    ILFaultInjectionDisableMsg (E3V_ABCANFD::Kombi_08);
  }
}

on sysvar_update sysvar::IL_CAN1::Message_SetNormalCycle::Kombi_Kombi_08
{
  if (@this == 1 && @sysvar::IL_CAN1::Message_EnableCyclic::Kombi_Kombi_08)
  {
    @sysvar::IL_CAN1::Message_SelectedPeriod::Kombi_Kombi_08 = 0;
  }
}

on sysvar_update sysvar::IL_CAN1::Message_SetNewCycleContinously::Kombi_Kombi_08
{
  if (@this == 1 && @sysvar::IL_CAN1::Message_EnableCyclic::Kombi_Kombi_08)
  {
    @sysvar::IL_CAN1::Message_SelectedPeriod::Kombi_Kombi_08 = -1;
  }
}

on sysvar_update sysvar::IL_CAN1::Message_SelectedPeriod::Kombi_Kombi_08
{
  if (@this == 0 && @sysvar::IL_CAN1::Message_EnableCyclic::Kombi_Kombi_08)
  {
    SetBusContext(gILCAN1_BusContext);
    gCAN1DisturbancePeriod = @sysvar::IL_CAN1::Message_NormalCyclePeriod::Kombi_Kombi_08;
    ILFaultInjectionResetMsgCycleTime(E3V_ABCANFD::Kombi_08);
  }
  else if (@this == 1 && @sysvar::IL_CAN1::Message_EnableCyclic::Kombi_Kombi_08)
  {
    SetBusContext(gILCAN1_BusContext);
    gCAN1DisturbancePeriod = @sysvar::IL_CAN1::Message_ActiveCyclePeriod::Kombi_Kombi_08;
    ILFaultInjectionSetMsgCycleTime(E3V_ABCANFD::Kombi_08, gCAN1DisturbancePeriod);
  }
  else if (@this == -1 && @sysvar::IL_CAN1::Message_EnableCyclic::Kombi_Kombi_08)
  {
    SetBusContext(gILCAN1_BusContext);
    gCAN1DisturbancePeriod = @sysvar::IL_CAN1::Message_CyclePeriod::Kombi_Kombi_08;
    ILFaultInjectionSetMsgCycleTime(E3V_ABCANFD::Kombi_08, gCAN1DisturbancePeriod);
  }
}

on sysvar_update sysvar::IL_CAN1::Message_SendOnce::Kombi_Kombi_08
{
  if (@this == 1)
  {
    SetBusContext(gILCAN1_BusContext);
    ILSetMsgEvent(E3V_ABCANFD::Kombi_08);
  }
}

on sysvar_update sysvar::IL_CAN1::Message_EnableCyclic::Kombi_Kombi_21
{
  if (@this == 1)
  {
    SetBusContext(gILCAN1_BusContext);
    ILFaultInjectionEnableMsg  (E3V_ABCANFD::Kombi_21);
  }
  else
  {
    SetBusContext(gILCAN1_BusContext);
    ILFaultInjectionDisableMsg (E3V_ABCANFD::Kombi_21);
  }
}

on sysvar_update sysvar::IL_CAN1::Message_SetNormalCycle::Kombi_Kombi_21
{
  if (@this == 1 && @sysvar::IL_CAN1::Message_EnableCyclic::Kombi_Kombi_21)
  {
    @sysvar::IL_CAN1::Message_SelectedPeriod::Kombi_Kombi_21 = 0;
  }
}

on sysvar_update sysvar::IL_CAN1::Message_SetNewCycleContinously::Kombi_Kombi_21
{
  if (@this == 1 && @sysvar::IL_CAN1::Message_EnableCyclic::Kombi_Kombi_21)
  {
    @sysvar::IL_CAN1::Message_SelectedPeriod::Kombi_Kombi_21 = -1;
  }
}

on sysvar_update sysvar::IL_CAN1::Message_SelectedPeriod::Kombi_Kombi_21
{
  if (@this == 0 && @sysvar::IL_CAN1::Message_EnableCyclic::Kombi_Kombi_21)
  {
    SetBusContext(gILCAN1_BusContext);
    gCAN1DisturbancePeriod = @sysvar::IL_CAN1::Message_NormalCyclePeriod::Kombi_Kombi_21;
    ILFaultInjectionResetMsgCycleTime(E3V_ABCANFD::Kombi_21);
  }
  else if (@this == 1 && @sysvar::IL_CAN1::Message_EnableCyclic::Kombi_Kombi_21)
  {
    SetBusContext(gILCAN1_BusContext);
    gCAN1DisturbancePeriod = @sysvar::IL_CAN1::Message_ActiveCyclePeriod::Kombi_Kombi_21;
    ILFaultInjectionSetMsgCycleTime(E3V_ABCANFD::Kombi_21, gCAN1DisturbancePeriod);
  }
  else if (@this == -1 && @sysvar::IL_CAN1::Message_EnableCyclic::Kombi_Kombi_21)
  {
    SetBusContext(gILCAN1_BusContext);
    gCAN1DisturbancePeriod = @sysvar::IL_CAN1::Message_CyclePeriod::Kombi_Kombi_21;
    ILFaultInjectionSetMsgCycleTime(E3V_ABCANFD::Kombi_21, gCAN1DisturbancePeriod);
  }
}

on sysvar_update sysvar::IL_CAN1::Message_SendOnce::Kombi_Kombi_21
{
  if (@this == 1)
  {
    SetBusContext(gILCAN1_BusContext);
    ILSetMsgEvent(E3V_ABCANFD::Kombi_21);
  }
}

on sysvar_update sysvar::IL_CAN1::Message_EnableCyclic::Kombi_Kombi_HUD_01
{
  if (@this == 1)
  {
    SetBusContext(gILCAN1_BusContext);
    ILFaultInjectionEnableMsg  (E3V_ABCANFD::Kombi_HUD_01);
  }
  else
  {
    SetBusContext(gILCAN1_BusContext);
    ILFaultInjectionDisableMsg (E3V_ABCANFD::Kombi_HUD_01);
  }
}

on sysvar_update sysvar::IL_CAN1::Message_SetNormalCycle::Kombi_Kombi_HUD_01
{
  if (@this == 1 && @sysvar::IL_CAN1::Message_EnableCyclic::Kombi_Kombi_HUD_01)
  {
    @sysvar::IL_CAN1::Message_SelectedPeriod::Kombi_Kombi_HUD_01 = 0;
  }
}

on sysvar_update sysvar::IL_CAN1::Message_SetNewCycleContinously::Kombi_Kombi_HUD_01
{
  if (@this == 1 && @sysvar::IL_CAN1::Message_EnableCyclic::Kombi_Kombi_HUD_01)
  {
    @sysvar::IL_CAN1::Message_SelectedPeriod::Kombi_Kombi_HUD_01 = -1;
  }
}

on sysvar_update sysvar::IL_CAN1::Message_SelectedPeriod::Kombi_Kombi_HUD_01
{
  if (@this == 0 && @sysvar::IL_CAN1::Message_EnableCyclic::Kombi_Kombi_HUD_01)
  {
    SetBusContext(gILCAN1_BusContext);
    gCAN1DisturbancePeriod = @sysvar::IL_CAN1::Message_NormalCyclePeriod::Kombi_Kombi_HUD_01;
    ILFaultInjectionResetMsgCycleTime(E3V_ABCANFD::Kombi_HUD_01);
  }
  else if (@this == 1 && @sysvar::IL_CAN1::Message_EnableCyclic::Kombi_Kombi_HUD_01)
  {
    SetBusContext(gILCAN1_BusContext);
    gCAN1DisturbancePeriod = @sysvar::IL_CAN1::Message_ActiveCyclePeriod::Kombi_Kombi_HUD_01;
    ILFaultInjectionSetMsgCycleTime(E3V_ABCANFD::Kombi_HUD_01, gCAN1DisturbancePeriod);
  }
  else if (@this == -1 && @sysvar::IL_CAN1::Message_EnableCyclic::Kombi_Kombi_HUD_01)
  {
    SetBusContext(gILCAN1_BusContext);
    gCAN1DisturbancePeriod = @sysvar::IL_CAN1::Message_CyclePeriod::Kombi_Kombi_HUD_01;
    ILFaultInjectionSetMsgCycleTime(E3V_ABCANFD::Kombi_HUD_01, gCAN1DisturbancePeriod);
  }
}

on sysvar_update sysvar::IL_CAN1::Message_SendOnce::Kombi_Kombi_HUD_01
{
  if (@this == 1)
  {
    SetBusContext(gILCAN1_BusContext);
    ILSetMsgEvent(E3V_ABCANFD::Kombi_HUD_01);
  }
}

on sysvar_update sysvar::IL_CAN1::Message_EnableCyclic::Kombi_Sensorik_Dimmung_01
{
  if (@this == 1)
  {
    SetBusContext(gILCAN1_BusContext);
    ILFaultInjectionEnableMsg  (E3V_ABCANFD::Sensorik_Dimmung_01);
  }
  else
  {
    SetBusContext(gILCAN1_BusContext);
    ILFaultInjectionDisableMsg (E3V_ABCANFD::Sensorik_Dimmung_01);
  }
}

on sysvar_update sysvar::IL_CAN1::Message_SetNormalCycle::Kombi_Sensorik_Dimmung_01
{
  if (@this == 1 && @sysvar::IL_CAN1::Message_EnableCyclic::Kombi_Sensorik_Dimmung_01)
  {
    @sysvar::IL_CAN1::Message_SelectedPeriod::Kombi_Sensorik_Dimmung_01 = 0;
  }
}

on sysvar_update sysvar::IL_CAN1::Message_SetNewCycleContinously::Kombi_Sensorik_Dimmung_01
{
  if (@this == 1 && @sysvar::IL_CAN1::Message_EnableCyclic::Kombi_Sensorik_Dimmung_01)
  {
    @sysvar::IL_CAN1::Message_SelectedPeriod::Kombi_Sensorik_Dimmung_01 = -1;
  }
}

on sysvar_update sysvar::IL_CAN1::Message_SelectedPeriod::Kombi_Sensorik_Dimmung_01
{
  if (@this == 0 && @sysvar::IL_CAN1::Message_EnableCyclic::Kombi_Sensorik_Dimmung_01)
  {
    SetBusContext(gILCAN1_BusContext);
    gCAN1DisturbancePeriod = @sysvar::IL_CAN1::Message_NormalCyclePeriod::Kombi_Sensorik_Dimmung_01;
    ILFaultInjectionResetMsgCycleTime(E3V_ABCANFD::Sensorik_Dimmung_01);
  }
  else if (@this == 1 && @sysvar::IL_CAN1::Message_EnableCyclic::Kombi_Sensorik_Dimmung_01)
  {
    SetBusContext(gILCAN1_BusContext);
    gCAN1DisturbancePeriod = @sysvar::IL_CAN1::Message_ActiveCyclePeriod::Kombi_Sensorik_Dimmung_01;
    ILFaultInjectionSetMsgCycleTime(E3V_ABCANFD::Sensorik_Dimmung_01, gCAN1DisturbancePeriod);
  }
  else if (@this == -1 && @sysvar::IL_CAN1::Message_EnableCyclic::Kombi_Sensorik_Dimmung_01)
  {
    SetBusContext(gILCAN1_BusContext);
    gCAN1DisturbancePeriod = @sysvar::IL_CAN1::Message_CyclePeriod::Kombi_Sensorik_Dimmung_01;
    ILFaultInjectionSetMsgCycleTime(E3V_ABCANFD::Sensorik_Dimmung_01, gCAN1DisturbancePeriod);
  }
}

on sysvar_update sysvar::IL_CAN1::Message_SendOnce::Kombi_Sensorik_Dimmung_01
{
  if (@this == 1)
  {
    SetBusContext(gILCAN1_BusContext);
    ILSetMsgEvent(E3V_ABCANFD::Sensorik_Dimmung_01);
  }
}

on sysvar_update sysvar::NM_CAN1::Kombi::OpenNodePanel
{
  OpenNodePanel("E3V_ABCANFD::Kombi", 1);
}

on sysvar_update sysvar::NM_CAN1::StateControl::CloseNodePanels
{
  OpenNodePanel("E3V_ABCANFD::Kombi", 0);
}

on sysvar_update sysvar::NM_CAN1::StateControl::Set_CABS_ForNodeId
{
  long i, lCABS[3];
  SysGetVariableLongArray(sysvar::NM_CAN1::StateControl::TNB_CABS, lCABS, 3);
  NMCAN1_SetCABS(@this, lCABS);
}

on sysvar_update sysvar::NM_CAN1::StateControl::Set_Filter_ForNodeId
{
  long i, lCABS[3];
  SysGetVariableLongArray(sysvar::NM_CAN1::StateControl::TNB_CABS, lCABS, 3);
  NMCAN1_SetFilter(@this, lCABS);
}

/* #ChannelEnd# |CAN1| #BusEnd# |E3V_ABCANFD| */
//--- end generated part --- Block end <#SysVar_Handler#> do not delete this line! Add application code below this line.

//--- begin generated part --- Block start <#MsgUpdateFcns#> do not delete this line and do not add application code in this code block!
/* #ChannelStart# |CAN1| #BusStart# |E3V_ABCANFD| */
/* #ChannelEnd# |CAN1| #BusEnd# |E3V_ABCANFD| */
//--- end generated part --- Block end <#MsgUpdateFcns#> do not delete this line! Add application code below this line.

