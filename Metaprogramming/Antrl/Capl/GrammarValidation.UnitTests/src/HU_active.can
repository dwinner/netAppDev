includes
{
  
}

variables
{
  
}

void ConnectedToHU_StopMsgs ()
{
putValue(eSendCharisma_03, 0);
putValue(eSendKlemmen_Status_01,0);
putValue(eSendGateway_73, 0);
putValue(eSendGateway_78, 0);
putValue(eSendMainUnit_01, 0);
putValue(eSendSysteminfo_01, 0);
putValue(eSendMFL_Tasten_Kon_01, 0);
putValue(eSendBEM_02, 0);
putValue(eSendDiagnose_01, 0);
//to cancel NMHTimer
putValue(HeadUnit_Present, 1);

//FPK_15S1 simulation update for Navi
//putValue (env_NaviSD_PowerOnOff, 0);
putValue (ON_OFF_FSG50_0, 0);
  
putValue (env_AudioSD_PowerOnOff, 0);
putValue (env_FSG_Schalter_OnOff, 0);
putValue (ON_OFF_FSG27_0, 0);
putValue (ON_OFF_FSG25_0, 0);
putValue (ON_OFF_FSG26_0, 0);
putValue (ON_OFF_FSG35_0, 0);
putValue (ON_OFF_FSG33_0, 0);
putValue (ON_OFF_ASG15_1, 0);
putValue (ON_OFF_ASG17_1, 0);
putValue (ON_OFF_ASG18_1, 0);
putValue (ON_OFF_ASG19_1, 0);
//FPK_15S1 simulation update for Navi
//putValue (ON_OFF_FSG7, 0);
putValue (ON_OFF_FSG7_0, 0);
putValue (ON_OFF_FSG52_0, 0);
putValue (ON_OFF_FSG29_0, 0);
putValue (ON_OFF_FSG58_0, 0);
putValue (ON_OFF_FSG13_0, 0);

//MR 80392 (GIRA:VAGF-1773)
putValue (ON_OFF_ASG69_1, 0);   //DisplayConfig

putValue (ON_OFF_FSG23_0, 0);//Charisma
putValue (ON_OFF_FSG9_0, 0); //ExteriorLight
putValue (ON_OFF_FSG8_0, 0); //InteriorLight
putValue (ON_OFF_FSG31_0, 0);//IntegralSafety
putValue (ON_OFF_FSG1_0, 0); //Klima1
putValue (ON_OFF_FSG2_0, 0); //Klima2
putValue (ON_OFF_FSG10_0, 0); //PDC
putValue (ON_OFF_FSG41_0, 0); //Telefon2
putValue (ON_OFF_FSG12_0, 0); //Wiper	
putValue (ON_OFF_FSG40_0, 0); //Telefon_v2.30
putValue (ON_OFF_FSG49_0, 0); //Audio_v2.40

}


on start
{
	ConnectedToHU_StopMsgs();
}
