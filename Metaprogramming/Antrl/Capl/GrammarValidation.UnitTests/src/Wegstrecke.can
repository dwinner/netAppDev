/*@!Encoding:1252*/
on message ESP_24
{
  update_inc_value();
}

on envVar Distance_Notification_distances_currentValue_inc
{
  update_inc_value();
}

update_inc_value()
{
  if ((@Env_GlobalAppl == 1)
  &&  ($ESP_m_Raddrehz.phys != 65.532)
  &&  (@Distance_Notification_distances_Send_cyclic == 1)
  &&  (@Distance_Notification_distances_Send_cyclic_cycletime != 0))
  {
    @Distance_Notification_distances_currentValue_inc = ($ESP_m_Raddrehz * (@Env_max_Reifenumfang/1000.0) * (@Distance_Notification_distances_Send_cyclic_cycletime/1000.0));
  }
}