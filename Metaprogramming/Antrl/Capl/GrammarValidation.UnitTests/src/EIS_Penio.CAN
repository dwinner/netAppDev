/*@@var:*/
/*
Copyright ( C ) Continental AG 2012



Based on Version  1.0, 12.05.10   from M.Dangelmeyr      IBD im Auftrag von EP/ESE   Daimler AG

Date of creation :  14.04.2011

Created by :                 Hans Jürgen Hipp


Version info

1.0        10.2013      Inital versioning introduced
1.1     04.11.2013      HMI_2013_42a database
1.2     07.01.2014      _PERI eliminated from EnvVars
1.3     11.06.2014      HMI_2014_17a database
// #VERSION#
// #VERSION_END#
*/


variables
{
    const TRUE =    0xAA;
    const FALSE =   0x00;
    const cManual = 0x00;
    const cAuto =   0xAA;

    msTimer t_DBKomTimer_20ms;      // Timer zum zyklischen Aufruf der DBKom-Task
    int c_tDBKomTimer_20ms = 20;    // msec
    msTimer t_DBKomTimer_5ms;       // Timer zum zyklischen Aufruf der DBKom-Task
    int c_tDBKomTimer_5ms = 5;      // msec


    // BA_DEF_ BO_  "GenMsgSendType" ENUM
    //  0 : cyclicX
    //  1 : spontanX
    //  2 : cyclicIfActiveX
    //  3 : spontanWithDelay
    //  4 : cyclicAndSpontanX
    //  5 : cyclicAndSpontanWithDelay
    //  6 : spontanWithRepitition
    //  7 : cyclicIfActiveAndSpontanWD
    //  8 : cyclicIfActiveFast
    //  9 : cyclicWithRepeatOnDemand
    //  10 : none

// #VAR_DEF#

    // Botschaft AB_R_Stat_AR  ID: 819 --- Sendeart 5 cyclicAndSpontanWithDelay --- 
    message AB_R_Stat_AR _mAB_R_Stat_AR;
    int _AB_R_Stat_AR_Timebase;
    int _AB_R_Stat_AR_CycleCount;
    int _AB_R_Stat_AR_Cnt;
    int _AB_R_Stat_AR_StartDelay;
    int _AB_R_Stat_AR_SpontanFlag;
    int _AB_R_Stat_AR_MinDelay;
    int _AB_R_Stat_AR_DelayCnt;
    msTimer _tAB_R_Stat_AR;

    // Botschaft Adapt_Seat_D_Stat_AR --- Sendeart 0 cyclicX --- 
    message Adapt_Seat_D_Stat_AR _mAdapt_Seat_D_Stat_AR;
    int _Adapt_Seat_D_Stat_AR_Timebase;
    int _Adapt_Seat_D_Stat_AR_CycleCount;
    int _Adapt_Seat_D_Stat_AR_StartDelay;
    int _Adapt_Seat_D_Stat_AR_Cnt;
    int _Adapt_Seat_D_Stat_AR_SpontanFlag;
    msTimer _tAdapt_Seat_D_Stat_AR;

    // Botschaft Adblue_Disp_Rq_AR ID: 734 --- Sendeart 5 cyclicAndSpontanWithDelay --- 
    message Adblue_Disp_Rq_AR _mAdblue_Disp_Rq_AR;
    int _Adblue_Disp_Rq_AR_Timebase;
    int _Adblue_Disp_Rq_AR_CycleCount;
    int _Adblue_Disp_Rq_AR_StartDelay;
    int _Adblue_Disp_Rq_AR_MinDelay;
    int _Adblue_Disp_Rq_AR_Cnt;
    int _Adblue_Disp_Rq_AR_SpontanFlag;
    int _Adblue_Disp_Rq_AR_DelayCnt;
    msTimer _tAdblue_Disp_Rq_AR;

    // Botschaft Adblue_Disp_Warn_Rq_AR ID: 1209 --- Sendeart 0 cyclicX --- 
    message Adblue_Disp_Warn_Rq_AR _mAdblue_Disp_Warn_Rq_AR;
    int _Adblue_Disp_Warn_Rq_AR_Timebase;
    int _Adblue_Disp_Warn_Rq_AR_CycleCount;
    int _Adblue_Disp_Warn_Rq_AR_StartDelay;
    int _Adblue_Disp_Warn_Rq_AR_Cnt;
    msTimer _tAdblue_Disp_Warn_Rq_AR;

    // Botschaft APPL_ECU_HIL_TO_IC1 --- Sendeart 1 spontanX --- 
    message APPL_ECU_HIL_TO_IC1 _mAPPL_ECU_HIL_TO_IC1;
    int _APPL_ECU_HIL_TO_IC1_Timebase;
    int _APPL_ECU_HIL_TO_IC1_SpontanFlag;

    // Botschaft Assyst_Stat_AR ID: 487 --- Sendeart 0 cyclicX --- 
    message Assyst_Stat_AR _mAssyst_Stat_AR;
    int _Assyst_Stat_AR_Timebase;
    int _Assyst_Stat_AR_CycleCount;
    int _Assyst_Stat_AR_StartDelay;
    int _Assyst_Stat_AR_Cnt;
    msTimer _tAssyst_Stat_AR;

    // Botschaft Assyst_Stat2_AR ID: 485 --- Sendeart 5 cyclicAndSpontanWithDelay --- 
    message Assyst_Stat2_AR _mAssyst_Stat2_AR;
    int _Assyst_Stat2_AR_Timebase;
    int _Assyst_Stat2_AR_CycleCount;
    int _Assyst_Stat2_AR_StartDelay;
    int _Assyst_Stat2_AR_MinDelay;
    int _Assyst_Stat2_AR_Cnt;
    int _Assyst_Stat2_AR_SpontanFlag;
    int _Assyst_Stat2_AR_DelayCnt;
    msTimer _tAssyst_Stat2_AR;

    // Botschaft Assyst_Stat3_AR ID: 1065 --- Sendeart 0 cyclicX --- 
    message Assyst_Stat3_AR _mAssyst_Stat3_AR;
    int _Assyst_Stat3_AR_Timebase;
    int _Assyst_Stat3_AR_CycleCount;
    int _Assyst_Stat3_AR_StartDelay;
    int _Assyst_Stat3_AR_MinDelay;
    int _Assyst_Stat3_AR_Cnt;
    int _Assyst_Stat3_AR_SpontanFlag;
    int _Assyst_Stat3_AR_DelayCnt;
    msTimer _tAssyst_Stat3_AR;

    // Botschaft AWD_TCASE_Disp_Rq_AR ID: 1184 --- Sendeart 5 cyclicAndSpontanWithDelay --- 
    message AWD_TCASE_Disp_Rq_AR _mAWD_TCASE_Disp_Rq_AR;
    int _AWD_TCASE_Disp_Rq_AR_Timebase;
    int _AWD_TCASE_Disp_Rq_AR_CycleCount;
    int _AWD_TCASE_Disp_Rq_AR_StartDelay;
    int _AWD_TCASE_Disp_Rq_AR_MinDelay;
    int _AWD_TCASE_Disp_Rq_AR_Cnt;
    int _AWD_TCASE_Disp_Rq_AR_SpontanFlag;
    int _AWD_TCASE_Disp_Rq_AR_DelayCnt;
    msTimer _tAWD_TCASE_Disp_Rq_AR;

    // Botschaft BC_F_Disp_Rq_AR ID: 823 --- Sendeart 5 cyclicAndSpontanWithDelay --- 
    message BC_F_Disp_Rq_AR _mBC_F_Disp_Rq_AR;
    int _BC_F_Disp_Rq_AR_Timebase;
    int _BC_F_Disp_Rq_AR_CycleCount;
    int _BC_F_Disp_Rq_AR_StartDelay;
    int _BC_F_Disp_Rq_AR_Cnt;
    int _BC_F_Disp_Rq_AR_SpontanFlag;
    msTimer _tBC_F_Disp_Rq_AR;

    // Botschaft BC_F_Stat1_AR ID: 825 --- Sendeart 5 cyclicAndSpontanWithDelay --- 
    message BC_F_Stat1_AR _mBC_F_Stat1_AR;
    int _BC_F_Stat1_AR_Timebase;
    int _BC_F_Stat1_AR_CycleCount;
    int _BC_F_Stat1_AR_StartDelay;
    int _BC_F_Stat1_AR_MinDelay;
    int _BC_F_Stat1_AR_Cnt;
    int _BC_F_Stat1_AR_SpontanFlag;
    int _BC_F_Stat1_AR_DelayCnt;
    msTimer _tBC_F_Stat1_AR;

    // Botschaft BC_F_Stat2_AR ID: 821 --- Sendeart 5 cyclicAndSpontanWithDelay --- 
    message BC_F_Stat2_AR _mBC_F_Stat2_AR;
    int _BC_F_Stat2_AR_Timebase;
    int _BC_F_Stat2_AR_CycleCount;
    int _BC_F_Stat2_AR_StartDelay;
    int _BC_F_Stat2_AR_Cnt;
    int _BC_F_Stat2_AR_SpontanFlag;
    msTimer _tBC_F_Stat2_AR;

    // Botschaft BC_F_Stat4_AR ID: 661 --- Sendeart 5 cyclicAndSpontanWithDelay --- 
    message BC_F_Stat4_AR _mBC_F_Stat4_AR;
    int _BC_F_Stat4_AR_Timebase;
    int _BC_F_Stat4_AR_CycleCount;
    int _BC_F_Stat4_AR_StartDelay;
    int _BC_F_Stat4_AR_Cnt;
    int _BC_F_Stat4_AR_SpontanFlag;
    byte _BC_F_Stat4_AR_CRC_Offset[16] = { 231,  22,  64, 106, 148, 190, 232,  23,  65, 107, 149, 191, 233,  24,  66, 108 };
    msTimer _tBC_F_Stat4_AR;

    // Botschaft BC_R_Stat1_AR ID: 849 --- Sendeart 5 cyclicAndSpontanWithDelay --- 
    message BC_R_Stat1_AR _mBC_R_Stat1_AR;
    int _BC_R_Stat1_AR_Timebase;
    int _BC_R_Stat1_AR_CycleCount;
    int _BC_R_Stat1_AR_StartDelay;
    int _BC_R_Stat1_AR_Cnt;
    int _BC_R_Stat1_AR_SpontanFlag;
    msTimer _tBC_R_Stat1_AR;

    // Botschaft BC_R_Stat2_AR ID: 869 --- Sendeart 5 cyclicAndSpontanWithDelay --- 
    message BC_R_Stat2_AR _mBC_R_Stat2_AR;
    int _BC_R_Stat2_AR_Timebase;
    int _BC_R_Stat2_AR_CycleCount;
    int _BC_R_Stat2_AR_StartDelay;
    int _BC_R_Stat2_AR_Cnt;
    int _BC_R_Stat2_AR_SpontanFlag;
    msTimer _tBC_R_Stat2_AR;

    // Botschaft BODY_HMI_R0_AR ID: 1111 --- Sendeart 5 cyclicAndSpontanWithDelay --- 
    message BODY_HMI_R0_AR _mBODY_HMI_R0_AR;
    int _BODY_HMI_R0_AR_Timebase;
    int _BODY_HMI_R0_AR_CycleCount;
    int _BODY_HMI_R0_AR_StartDelay;
    int _BODY_HMI_R0_AR_Cnt;
    int _BODY_HMI_R0_AR_SpontanFlag;
    msTimer _tBODY_HMI_R0_AR;

    // Botschaft BODY_HMI_R1_AR ID: 543 --- Sendeart 5 cyclicAndSpontanWithDelay --- 
    message BODY_HMI_R1_AR _mBODY_HMI_R1_AR;
    int _BODY_HMI_R1_AR_Timebase;
    int _BODY_HMI_R1_AR_CycleCount;
    int _BODY_HMI_R1_AR_StartDelay;
    int _BODY_HMI_R1_AR_Cnt;
    int _BODY_HMI_R1_AR_SpontanFlag;
    msTimer _tBODY_HMI_R1_AR;

    // Botschaft BODY_HMI_R2_AR --- Sendeart 5 cyclicAndSpontanWithDelay --- 
    message BODY_HMI_R2_AR _mBODY_HMI_R2_AR;
    int _BODY_HMI_R2_AR_Timebase;
    int _BODY_HMI_R2_AR_CycleCount;
    int _BODY_HMI_R2_AR_StartDelay;
    int _BODY_HMI_R2_AR_Cnt;
    int _BODY_HMI_R2_AR_SpontanFlag;
    msTimer _tBODY_HMI_R2_AR;

    // Botschaft BSM_Disp_Warn_Rq_AR ID: 1049 --- Sendeart 5 cyclicAndSpontanWithDelay --- 
    message BSM_Disp_Warn_Rq_AR _mBSM_Disp_Warn_Rq_AR;
    int _BSM_Disp_Warn_Rq_AR_Timebase;
    int _BSM_Disp_Warn_Rq_AR_CycleCount;
    int _BSM_Disp_Warn_Rq_AR_StartDelay;
    int _BSM_Disp_Warn_Rq_AR_MinDelay;
    int _BSM_Disp_Warn_Rq_AR_Cnt;
    int _BSM_Disp_Warn_Rq_AR_SpontanFlag;
    int _BSM_Disp_Warn_Rq_AR_DelayCnt;
    msTimer _tBSM_Disp_Warn_Rq_AR;

    // Botschaft CamLane_Disp_Warn_Rq_AR  ID: 1035 --- Sendeart 5 cyclicAndSpontanWithDelay --- 
    message CamLane_Disp_Warn_Rq_AR _mCamLane_Disp_Warn_Rq_AR;
    int _CamLane_Disp_Warn_Rq_AR_Timebase;
    int _CamLane_Disp_Warn_Rq_AR_CycleCount;
    int _CamLane_Disp_Warn_Rq_AR_StartDelay;
    int _CamLane_Disp_Warn_Rq_AR_MinDelay;
    int _CamLane_Disp_Warn_Rq_AR_Cnt;
    int _CamLane_Disp_Warn_Rq_AR_SpontanFlag;
    int _CamLane_Disp_Warn_Rq_AR_DelayCnt;
    byte _CamLane_Disp_Warn_Rq_AR_CRC_Offset[16] = { 227,  71, 166, 10, 105, 200,  44, 139, 234,  78, 173,  17, 112, 207,  51, 146 };
    msTimer _tCamLane_Disp_Warn_Rq_AR;

    // Botschaft CHASSIS_HMI_R0_AR --- Sendeart 5 cyclicAndSpontanWithDelay --- 
    message CHASSIS_HMI_R0_AR _mCHASSIS_HMI_R0_AR;
    int _CHASSIS_HMI_R0_AR_Timebase;
    int _CHASSIS_HMI_R0_AR_CycleCount;
    int _CHASSIS_HMI_R0_AR_StartDelay;
    int _CHASSIS_HMI_R0_AR_Cnt;
    int _CHASSIS_HMI_R0_AR_SpontanFlag;
    msTimer _tCHASSIS_HMI_R0_AR;

    // Botschaft CHASSIS_HMI_R1_AR ID: 1107 --- Sendeart 5 cyclicAndSpontanWithDelay --- 
    message CHASSIS_HMI_R1_AR _mCHASSIS_HMI_R1_AR;
    int _CHASSIS_HMI_R1_AR_Timebase;
    int _CHASSIS_HMI_R1_AR_CycleCount;
    int _CHASSIS_HMI_R1_AR_StartDelay;
    int _CHASSIS_HMI_R1_AR_Cnt;
    int _CHASSIS_HMI_R1_AR_SpontanFlag;
    msTimer _tCHASSIS_HMI_R1_AR;

    // Botschaft CHASSIS_HMI_R2_AR ID: 615 --- Sendeart 5 cyclicAndSpontanWithDelay --- 
    message CHASSIS_HMI_R2_AR _mCHASSIS_HMI_R2_AR;
    int _CHASSIS_HMI_R2_AR_Timebase;
    int _CHASSIS_HMI_R2_AR_CycleCount;
    int _CHASSIS_HMI_R2_AR_StartDelay;
    int _CHASSIS_HMI_R2_AR_Cnt;
    int _CHASSIS_HMI_R2_AR_SpontanFlag;
    msTimer _tCHASSIS_HMI_R2_AR;

    // Botschaft CHASSIS_HMI_R3_AR ID: 617 --- Sendeart 0 cyclic --- 
    message CHASSIS_HMI_R3_AR _mCHASSIS_HMI_R3_AR;
    int _CHASSIS_HMI_R3_AR_Timebase;
    int _CHASSIS_HMI_R3_AR_CycleCount;
    int _CHASSIS_HMI_R3_AR_StartDelay;
    int _CHASSIS_HMI_R3_AR_Cnt;
    int _CHASSIS_HMI_R3_AR_SpontanFlag;
    byte _CHASSIS_HMI_R3_AR_CRC_Offset[16] = {  18,  46,  74, 102, 130, 158, 186, 214, 242,  19,  47,  75, 103, 131, 159, 187 };
    msTimer _tCHASSIS_HMI_R3_AR;

    // Botschaft CHASSIS_HMI_R4_AR ID: 619 --- Sendeart 0 cyclic --- 
    message CHASSIS_HMI_R4_AR _mCHASSIS_HMI_R4_AR;
    int _CHASSIS_HMI_R4_AR_Timebase;
    int _CHASSIS_HMI_R4_AR_CycleCount;
    int _CHASSIS_HMI_R4_AR_StartDelay;
    int _CHASSIS_HMI_R4_AR_Cnt;
    msTimer _tCHASSIS_HMI_R4_AR;

    // Botschaft CHASSISPERIPHERY_HMI_R1_AR --- Sendeart 0 cyclic --- 
    message CHASSISPERIPHERY_HMI_R1_AR _mCHASSISPERIPHERY_HMI_R1_AR;
    int _CHASSISPERIPHERY_HMI_R1_AR_Timebase;
    int _CHASSISPERIPHERY_HMI_R1_AR_CycleCount = 2;
    int _CHASSISPERIPHERY_HMI_R1_AR_StartDelay;
    int _CHASSISPERIPHERY_HMI_R1_AR_Cnt;
    msTimer _tCHASSISPERIPHERY_HMI_R1_AR;

    // Botschaft CLkS_Rq_AR ID: 775 --- Sendeart 8 cyclicIfActiveFast --- 
    message CLkS_Rq_AR _mCLkS_Rq_AR;
    int _CLkS_Rq_AR_Timebase;
    int _CLkS_Rq_AR_CycleCountSlow;
    int _CLkS_Rq_AR_CycleCountFast;
    int _CLkS_Rq_AR_StartDelay;
    int _CLkS_Rq_AR_Cnt;
    int _CLkS_Rq_AR_SigActivity;

    int _CLkS_Rq_AR_CLkS_DL_Act_Rq_LastState = 0;
    int _CLkS_Rq_AR_CLkS_DL_Rq_LastState = 0;
    int _CLkS_Rq_AR_CLkS_Dr_FL_Rq_LastState = 0;
    int _CLkS_Rq_AR_CLkS_Dr_FR_Rq_LastState = 0;
    int _CLkS_Rq_AR_CLkS_Dr_RL_Rq_LastState = 0;
    int _CLkS_Rq_AR_CLkS_Dr_RR_Rq_LastState = 0;
    int _CLkS_Rq_AR_CLkS_Ext_Rq_LastState = 0;
    int _CLkS_Rq_AR_CLkS_Gas_Dr_Rq_LastState = 0;
    int _CLkS_Rq_AR_CLkS_Src_V2_LastState = 0;
    int _CLkS_Rq_AR_CLkS_TurnLmp_Rq_LastState = 0;
    int _CLkS_Rq_AR_Key_Sw4_Psd_LastState = 0;
    int _CLkS_Rq_AR_KeyLine_LastState = 0;
    int _CLkS_Rq_AR_RemAlm_Rq_MPM_LastState = 0;
    int _CLkS_Rq_AR_TDP_Sw_Cls_Rq_EIS_LastState = 0;
    msTimer _tCLkS_Ext_Rq_Auto;
    msTimer _tCLkS_Rq_AR;

    // Botschaft CLkS_State_AR ID: 763 --- Sendeart 5 cyclicAndSpontanWithDelay --- 
    message CLkS_State_AR _mCLkS_State_AR;
    int _CLkS_State_AR_Timebase;
    int _CLkS_State_AR_CycleCount;
    int _CLkS_State_AR_StartDelay;
    int _CLkS_State_AR_Cnt;
    int _CLkS_State_AR_SpontanFlag;
    msTimer _tCLkS_State_AR;

    // Botschaft ClockSync_Stat_AR ID: 427 --- Sendeart 1 spontanX --- 
    message ClockSync_Stat_AR _mClockSync_Stat_AR;
    int _ClockSync_Stat_AR_Timebase;
    int _ClockSync_Stat_AR_CycleCount;
    int _ClockSync_Stat_AR_StartDelay;
    int _ClockSync_Stat_AR_Cnt;
    int _ClockSync_Stat_AR_SpontanFlag;
    byte _ClockSync_Stat_AR_CRC_Offset[16] = { 1,2,3,4,5,6,7,8,9,10,11,12,13,14,15,16 }; // DUMMY !!!
    msTimer _tClockSync_Stat_AR;

    // Botschaft CMS_PI_Sd_Stat_AR --- Sendeart 8 cyclicIfActiveFast --- 
    message CMS_PI_Sd_Stat_MMR_F1_AR _mCMS_PI_Sd_Stat_AR;
    int _CMS_PI_Sd_Stat_AR_Timebase;
    int _CMS_PI_Sd_Stat_AR_CycleCountSlow;
    int _CMS_PI_Sd_Stat_AR_CycleCountFast;
    int _CMS_PI_Sd_Stat_AR_StartDelay;
    int _CMS_PI_Sd_Stat_AR_Cnt;
    int _CMS_PI_Sd_Stat_AR_SigActivity;
    
    int _CMS_PI_Sd_Stat_AR_PI_Sd_Lt_Enbl_LastState = 0;
    int _CMS_PI_Sd_Stat_AR_PI_Sd_Obj_Lt_RelSpd_LastState = 0;
    int _CMS_PI_Sd_Stat_AR_PI_Sd_Obj_Rt_RelSpd_LastState = 0;
    int _CMS_PI_Sd_Stat_AR_PI_Sd_RelsRcmmnd_Pyro_Lt_LastState = 0;
    int _CMS_PI_Sd_Stat_AR_PI_Sd_RelsRcmmnd_Pyro_Rt_LastState = 0;
    int _CMS_PI_Sd_Stat_AR_PI_Sd_RelsRcmmnd_Rev_Lt_LastState = 0;
    int _CMS_PI_Sd_Stat_AR_PI_Sd_RelsRcmmnd_Rev_Rt_LastState = 0;
    int _CMS_PI_Sd_Stat_AR_PI_Sd_Rt_Enbl_LastState = 0;
    int _CMS_PI_Sd_Stat_AR_PI_Sd_TTI_Lt_LastState = 0;
    int _CMS_PI_Sd_Stat_AR_PI_Sd_TTI_Rt_LastState = 0;
    int _CMS_PI_Sd_Stat_AR_Rsrv1_CMS_PI_Sd_Lt_Stat_LastState = 0;
    int _CMS_PI_Sd_Stat_AR_Rsrv1_CMS_PI_Sd_Rt_Stat_LastState = 0;
    byte _CMS_PI_Sd_Stat_AR_CRC_Offset_L[16] = {   9,  60, 111, 162, 213,  13,  64, 115, 166, 217,  17,  68, 119, 170, 221,  21 };
    byte _CMS_PI_Sd_Stat_AR_CRC_Offset_R[16] = { 178, 120,  62,   4, 197, 139,  81,  23, 216, 158, 100,  42, 235, 177, 119,  61 };
    msTimer _tCMS_PI_Sd_Stat_AR;

    // Botschaft CMS_PI_Stat_AR ID: 165 --- Sendeart 0 cyclicX --- 
    message CMS_PI_Stat_AR _mCMS_PI_Stat_AR;
    int _CMS_PI_Stat_AR_Timebase;
    int _CMS_PI_Stat_AR_CycleCount;
    int _CMS_PI_Stat_AR_StartDelay;
    int _CMS_PI_Stat_AR_Cnt;
    byte _CMS_PI_Stat_AR_CRC_Offset[16] = { 240, 207, 174, 141, 108,  75,  42,   9, 227, 194, 161, 128,  95,  62,  29, 247 };
    msTimer _tCMS_PI_Stat_AR;

    // Botschaft CNG_Disp_Rq_AR --- Sendeart 5 cyclicAndSpontanWithDelay --- 
    message CNG_Disp_Rq_AR _mCNG_Disp_Rq_AR;
    int _CNG_Disp_Rq_AR_Timebase;
    int _CNG_Disp_Rq_AR_CycleCount;
    int _CNG_Disp_Rq_AR_StartDelay;
    int _CNG_Disp_Rq_AR_MinDelay;
    int _CNG_Disp_Rq_AR_Cnt;
    int _CNG_Disp_Rq_AR_SpontanFlag;
    int _CNG_Disp_Rq_AR_DelayCnt;
    msTimer _tCNG_Disp_Rq_AR;

    // Botschaft COM_Call_Stat_AR ID: 708 --- Sendeart 5 cyclicAndSpontanWithDelay --- 
    message COM_Call_Stat_AR _mCOM_Call_Stat_AR;
    int _COM_Call_Stat_AR_Timebase;
    int _COM_Call_Stat_AR_CycleCount;
    int _COM_Call_Stat_AR_StartDelay;
    int _COM_Call_Stat_AR_Cnt;
    int _COM_Call_Stat_AR_SpontanFlag;
    msTimer _tCOM_Call_Stat_AR;

    // Botschaft COMM_EIS_WMI_AR ID: 122 --- Sendeart 1 spontanX --- 
    message COMM_EIS_WMI_AR _mCOMM_EIS_WMI_AR;
    int _COMM_EIS_WMI_AR_Timebase;
    int _COMM_EIS_WMI_AR_SpontanFlag;
    msTimer _tCOMM_EIS_WMI_AR;

    // Botschaft CRCM_Disp_Rq_AR ID: 1147 --- Sendeart 5 cyclicAndSpontanWithDelay --- 
    message CRCM_Disp_Rq_AR _mCRCM_Disp_Rq_AR;
    int _CRCM_Disp_Rq_AR_Timebase;
    int _CRCM_Disp_Rq_AR_CycleCount;
    int _CRCM_Disp_Rq_AR_StartDelay;
    int _CRCM_Disp_Rq_AR_Cnt;
    int _CRCM_Disp_Rq_AR_SpontanFlag;
    msTimer _tCRCM_Disp_Rq_AR;

    // Botschaft CU_RemFunc_Rq3_AR ID: 956 --- Sendeart 0 cyclicX --- 
    message CU_RemFunc_Rq3_AR _mCU_RemFunc_Rq3_AR;
    int _CU_RemFunc_Rq3_AR_Timebase;
    int _CU_RemFunc_Rq3_AR_CycleCount;
    int _CU_RemFunc_Rq3_AR_StartDelay;
    int _CU_RemFunc_Rq3_AR_Cnt;
    msTimer _tCU_RemFunc_Rq3_AR;

    // Botschaft DidA_MBContact_State_AR ID: 1119 --- Sendeart 5 cyclicAndSpontanWithDelay --- 
    message DidA_MBContact_State_AR _mDidA_MBContact_State_AR;
    int _DidA_MBContact_State_AR_Timebase;
    int _DidA_MBContact_State_AR_CycleCount;
    int _DidA_MBContact_State_AR_StartDelay;
    int _DidA_MBContact_State_AR_Cnt;
    int _DidA_MBContact_State_AR_SpontanFlag;
    msTimer _tDidA_MBContact_State_AR;

    // Botschaft Door_FL_Stat_AR ID: 919 --- Sendeart 5 cyclicAndSpontanWithDelay --- 
    message Door_FL_Stat_AR _mDoor_FL_Stat_AR;
    int _Door_FL_Stat_AR_Timebase;
    int _Door_FL_Stat_AR_CycleCount;
    int _Door_FL_Stat_AR_StartDelay;
    int _Door_FL_Stat_AR_MinDelay;
    int _Door_FL_Stat_AR_Cnt;
    int _Door_FL_Stat_AR_SpontanFlag;
    int _Door_FL_Stat_AR_DelayCnt;
    byte _Door_FL_Stat_AR_CRC_Offset[16] = {  51, 140, 229,  67, 156, 245,  83, 172,  10,  99, 188,  26, 115, 204,  42, 131 };
    msTimer _tDoor_FL_Stat_AR;

    // Botschaft Door_FR_Stat_AR ID: 923 --- Sendeart 5 cyclicAndSpontanWithDelay --- 
    message Door_FR_Stat_AR _mDoor_FR_Stat_AR;
    int _Door_FR_Stat_AR_Timebase;
    int _Door_FR_Stat_AR_CycleCount;
    int _Door_FR_Stat_AR_StartDelay;
    int _Door_FR_Stat_AR_MinDelay;
    int _Door_FR_Stat_AR_Cnt;
    int _Door_FR_Stat_AR_SpontanFlag;
    int _Door_FR_Stat_AR_DelayCnt;
    byte _Door_FR_Stat_AR_CRC_Offset[16] = { 156,  86,  16, 197, 127,  57, 238, 168,  98,  28, 209, 139,  69, 250, 180, 110 };
    msTimer _tDoor_FR_Stat_AR;

    // Botschaft Door_RL_Stat_AR ID: 931 --- Sendeart 5 cyclicAndSpontanWithDelay --- 
    message Door_RL_Stat_AR _mDoor_RL_Stat_AR;
    int _Door_RL_Stat_AR_Timebase;
    int _Door_RL_Stat_AR_CycleCount;
    int _Door_RL_Stat_AR_StartDelay;
    int _Door_RL_Stat_AR_MinDelay;
    int _Door_RL_Stat_AR_Cnt;
    int _Door_RL_Stat_AR_SpontanFlag;
    int _Door_RL_Stat_AR_DelayCnt;
    byte _Door_RL_Stat_AR_CRC_Offset[16] = {  72, 221, 119,  17, 166,  64, 213, 111,   9, 158,  56, 205, 103, 252, 150,  48 };
    msTimer _tDoor_RL_Stat_AR;

    // Botschaft Door_RR_Stat_AR ID: 933 --- Sendeart 5 cyclicAndSpontanWithDelay --- 
    message Door_RR_Stat_AR _mDoor_RR_Stat_AR;
    int _Door_RR_Stat_AR_Timebase;
    int _Door_RR_Stat_AR_CycleCount;
    int _Door_RR_Stat_AR_StartDelay;
    int _Door_RR_Stat_AR_MinDelay;
    int _Door_RR_Stat_AR_Cnt;
    int _Door_RR_Stat_AR_SpontanFlag;
    int _Door_RR_Stat_AR_DelayCnt;
    byte _Door_RR_Stat_AR_CRC_Offset[16] = { 184, 165, 146, 127, 108,  89,  70,  51,  32,  13, 245, 226, 207, 188, 169, 150 };
    msTimer _tDoor_RR_Stat_AR;

    // Botschaft DPC_Disp_Rq_AR ID: 629 --- Sendeart 5 cyclicAndSpontanWithDelay --- 
    message DPC_Disp_Rq_AR _mDPC_Disp_Rq_AR;
    int _DPC_Disp_Rq_AR_Timebase;
    int _DPC_Disp_Rq_AR_CycleCount;
    int _DPC_Disp_Rq_AR_StartDelay;
    int _DPC_Disp_Rq_AR_MinDelay;
    int _DPC_Disp_Rq_AR_Cnt;
    int _DPC_Disp_Rq_AR_SpontanFlag;
    int _DPC_Disp_Rq_AR_DelayCnt;
    byte _DPC_Disp_Rq_AR_CRC_Offset[16] = {  12, 195, 127,  59, 242, 174, 106,  38, 221, 153,  85,  17, 200, 132,  64, 247 };
    msTimer _tDPC_Disp_Rq_AR;

    // Botschaft DPC_IndMd_Stat_AR ID: 633 --- Sendeart 5 cyclicAndSpontanWithDelay --- 
    message DPC_IndMd_Stat_AR _mDPC_IndMd_Stat_AR;
    int _DPC_IndMd_Stat_AR_Timebase;
    int _DPC_IndMd_Stat_AR_CycleCount;
    int _DPC_IndMd_Stat_AR_StartDelay;
    int _DPC_IndMd_Stat_AR_MinDelay;
    int _DPC_IndMd_Stat_AR_Cnt;
    int _DPC_IndMd_Stat_AR_SpontanFlag;
    int _DPC_IndMd_Stat_AR_DelayCnt;
    byte _DPC_IndMd_Stat_AR_CRC_Offset[16] = { 175, 159, 143, 127, 111,  95,  79,  63,  47,  31,  15, 250, 234, 218, 202, 186 };
    msTimer _tDPC_IndMd_Stat_AR;

    // Botschaft DPC_IndMd_Style_AR ID: 778 --- Sendeart 0 cyclic --- 
    message DPC_IndMd_Style_AR _mDPC_IndMd_Style_AR;
    int _DPC_IndMd_Style_AR_Timebase;
    int _DPC_IndMd_Style_AR_CycleCount;
    int _DPC_IndMd_Style_AR_StartDelay;
    int _DPC_IndMd_Style_AR_Cnt;
    int _DPC_IndMd_Style_AR_DelayCnt;
    byte _DPC_IndMd_Style_AR_CRC_Offset[16] = {  18,  30,  42,  54,  66,  78,  90, 102, 114, 126, 138, 150, 162, 174, 186, 198 };
    msTimer _tDPC_IndMd_Style_AR;

    // Botschaft DPC_IndMd_Style2_AR --- Sendeart 0 cyclic --- 
    message DPC_IndMd_Style2_AR _mDPC_IndMd_Style2_AR;
    int _DPC_IndMd_Style2_AR_Timebase;
    int _DPC_IndMd_Style2_AR_CycleCount;
    int _DPC_IndMd_Style2_AR_StartDelay;
    int _DPC_IndMd_Style2_AR_Cnt;
    byte _DPC_IndMd_Style2_AR_CRC_Offset[16] = {  44,  42,  40,  38,  36,  34,  32,  30,  28,  26,  24,  22,  20,  18,  16,  14 };
    msTimer _tDPC_IndMd_Style2_AR;

    // Botschaft DPC_Master_Rq_AR ID: 625 --- Sendeart 5 cyclicAndSpontanWithDelay --- 
    message DPC_Master_Rq_AR _mDPC_Master_Rq_AR;
    int _DPC_Master_Rq_AR_Timebase;
    int _DPC_Master_Rq_AR_CycleCount;
    int _DPC_Master_Rq_AR_StartDelay;
    int _DPC_Master_Rq_AR_MinDelay;
    int _DPC_Master_Rq_AR_Cnt;
    int _DPC_Master_Rq_AR_SpontanFlag;
    int _DPC_Master_Rq_AR_DelayCnt;
    byte _DPC_Master_Rq_AR_CRC_Offset[16] = { 109, 219,  78, 188,  47, 157,  16, 126, 236,  95, 205,  64, 174,  33, 143, 253 };
    msTimer _tDPC_Master_Rq_AR;

    // Botschaft ECO_Score_Disp_Rq_AR ID: 1129 --- Sendeart 0 cyclic --- 
    message ECO_Score_Disp_Rq_AR _mECO_Score_Disp_Rq_AR;
    int _ECO_Score_Disp_Rq_AR_Timebase;
    int _ECO_Score_Disp_Rq_AR_CycleCount;
    int _ECO_Score_Disp_Rq_AR_StartDelay;
    int _ECO_Score_Disp_Rq_AR_Cnt;
    int _ECO_Score_Disp_Rq_AR_DelayCnt;
    msTimer _tECO_Score_Disp_Rq_AR;

    // Botschaft EL_Ft_Disp_Rq_AR ID: 827 --- Sendeart 5 cyclicAndSpontanWithDelay --- 
    message EL_Ft_Disp_Rq_AR _mEL_Ft_Disp_Rq_AR;
    int _EL_Ft_Disp_Rq_AR_Timebase;
    int _EL_Ft_Disp_Rq_AR_CycleCount;
    int _EL_Ft_Disp_Rq_AR_StartDelay;
    int _EL_Ft_Disp_Rq_AR_Cnt;
    int _EL_Ft_Disp_Rq_AR_SpontanFlag;
    byte _EL_Ft_Disp_Rq_AR_CRC_Offset[16] = { 165,  31, 148,  14, 131, 248, 114, 231,  97, 214,  80, 197,  63, 180,  46, 163 };
    msTimer _tEL_Ft_Disp_Rq_AR;

    // Botschaft EL_R_Disp_Rq_AR ID: 897 --- Sendeart 5 cyclicAndSpontanWithDelay --- 
    message EL_R_Disp_Rq_AR _mEL_R_Disp_Rq_AR;
    int _EL_R_Disp_Rq_AR_Timebase;
    int _EL_R_Disp_Rq_AR_CycleCount;
    int _EL_R_Disp_Rq_AR_StartDelay;
    int _EL_R_Disp_Rq_AR_Cnt;
    int _EL_R_Disp_Rq_AR_SpontanFlag;
    byte _EL_R_Disp_Rq_AR_CRC_Offset[16] = { 124, 172, 220,  17,  65, 113, 161, 209,   6,  54, 102, 150, 198, 246,  43,  91 };
    msTimer _tEL_R_Disp_Rq_AR;

    // Botschaft EL_Stat_AR ID: 829 --- Sendeart 5 cyclicAndSpontanWithDelay --- 
    message EL_Stat_AR _mEL_Stat_AR;
    int _EL_Stat_AR_Timebase;
    int _EL_Stat_AR_CycleCount;
    int _EL_Stat_AR_StartDelay;
    int _EL_Stat_AR_Cnt;
    int _EL_Stat_AR_SpontanFlag;
    byte _EL_Stat_AR_CRC_Offset[16] = { 189,  99,   9, 170,  80, 241, 151,  61, 222, 132,  42, 203, 113,  23, 184,  94 };
    msTimer _tEL_Stat_AR;

    // Botschaft EL_TurnInd_Rq_AR ID: 287 --- Sendeart 1 spontanX --- 
    message EL_TurnInd_Rq_AR _mEL_TurnInd_Rq_AR;
    int _EL_TurnInd_Rq_AR_Timebase;
    int _EL_TurnInd_Rq_AR_SpontanFlag;
    byte _EL_TurnInd_Rq_AR_CRC_Offset[16] = { 242, 201, 160, 119,  78,  37, 247, 206, 165, 124,  83,  42, 252, 211, 170, 129 };
    msTimer _tEL_TurnInd_Rq_AR;

    // Botschaft Eng_Rs_EngCtrl_AR ID: 177 --- Sendeart 0 cyclicX --- 
    message Eng_Rs_EngCtrl_AR _mEng_Rs_EngCtrl_AR;
    int _Eng_Rs_EngCtrl_AR_Timebase;
    int _Eng_Rs_EngCtrl_AR_CycleCount;
    int _Eng_Rs_EngCtrl_AR_StartDelay;
    int _Eng_Rs_EngCtrl_AR_Cnt;
    byte _Eng_Rs_EngCtrl_AR_CRC_Offset[16] = { 199, 227,   4,  32,  60,  88, 116, 144, 172, 200, 228,   5,  33,  61, 89, 117 };
    msTimer _tEng_Rs_EngCtrl_AR;

    // Botschaft Eng_Rs2_AR ID: 119 --- Sendeart 0 cyclicX --- 
    message Eng_Rs2_AR _mEng_Rs2_AR;
    int _Eng_Rs2_AR_Timebase;
    int _Eng_Rs2_AR_CycleCount;
    int _Eng_Rs2_AR_StartDelay;
    int _Eng_Rs2_AR_Cnt;
    byte _Eng_Rs2_AR_CRC_Offset[16] = {  88, 240, 141,  42, 194,  95, 247, 148,  49, 201, 102,   3, 155,  56, 208, 109 };
    msTimer _tEng_Rs2_AR;

    // Botschaft EngCtrl_Disp_Rq_AR ID: 327 --- Sendeart 0 cyclicX --- 
    message EngCtrl_Disp_Rq_AR _mEngCtrl_Disp_Rq_AR;
    int _EngCtrl_Disp_Rq_AR_Timebase;
    int _EngCtrl_Disp_Rq_AR_CycleCount;
    int _EngCtrl_Disp_Rq_AR_StartDelay;
    int _EngCtrl_Disp_Rq_AR_Cnt;
    msTimer _tEngCtrl_Disp_Rq_AR;

    // Botschaft EngCtrl_Stat_AR ID: 697 --- Sendeart 5 cyclicAndSpontanWithDelay --- 
    message EngCtrl_Stat_AR _mEngCtrl_Stat_AR;
    int _EngCtrl_Stat_AR_Timebase;
    int _EngCtrl_Stat_AR_CycleCount;
    int _EngCtrl_Stat_AR_StartDelay;
    int _EngCtrl_Stat_AR_Cnt;
    int _EngCtrl_Stat_AR_SpontanFlag;
    msTimer _tEngCtrl_Stat_AR;

    // Botschaft EPKB_Disp_IndLmp_Rq_2_AR ID: 1041 --- Sendeart 5 cyclicAndSpontanWithDelay --- 
    message EPKB_Disp_IndLmp_Rq_2_AR _mEPKB_Disp_IndLmp_Rq_2_AR;
    int _EPKB_Disp_IndLmp_Rq_2_AR_Timebase;
    int _EPKB_Disp_IndLmp_Rq_2_AR_CycleCount;
    int _EPKB_Disp_IndLmp_Rq_2_AR_StartDelay;
    int _EPKB_Disp_IndLmp_Rq_2_AR_Cnt;
    int _EPKB_Disp_IndLmp_Rq_2_AR_SpontanFlag;
    byte _EPKB_Disp_IndLmp_Rq_2_AR_CRC_Offset[16] = {   5,  63, 121, 179, 237,  44, 102, 160, 218,  25,  83, 141, 199,   6,  64, 122 };
    msTimer _tEPKB_Disp_IndLmp_Rq_2_AR;

    // Botschaft EPS_Stat_Disp_Rq_AR ID: 1069 --- Sendeart 5 cyclicAndSpontanWithDelay --- 
    message EPS_Stat_Disp_Rq_AR _mEPS_Stat_Disp_Rq_AR;
    int _EPS_Stat_Disp_Rq_AR_Timebase;
    int _EPS_Stat_Disp_Rq_AR_CycleCount;
    int _EPS_Stat_Disp_Rq_AR_StartDelay;
    int _EPS_Stat_Disp_Rq_AR_Cnt;
    int _EPS_Stat_Disp_Rq_AR_SpontanFlag;
    byte _EPS_Stat_Disp_Rq_AR_CRC_Offset[16] = { 156, 188, 220, 252,  33,  65,  97, 129, 161, 193, 225,   6,  38, 70, 102, 134 };
    msTimer _tEPS_Stat_Disp_Rq_AR;

    // Botschaft ESP_Disp_Rq_AR ID: 555 --- Sendeart 5 cyclicAndSpontanWithDelay --- 
    message ESP_Disp_Rq_AR _mESP_Disp_Rq_AR;
    int _ESP_Disp_Rq_AR_Timebase;
    int _ESP_Disp_Rq_AR_CycleCount;
    int _ESP_Disp_Rq_AR_StartDelay;
    int _ESP_Disp_Rq_AR_Cnt;
    int _ESP_Disp_Rq_AR_SpontanFlag;
    byte _ESP_Disp_Rq_AR_CRC_Offset[16] = { 117,  92,  67,  42,  17, 243, 218, 193, 168, 143, 118,  93,  68,  43,  18, 244 };
    msTimer _tESP_Disp_Rq_AR;

    // Botschaft ESP_Disp_Rq2_AR ID: 1177 --- Sendeart 5 cyclicAndSpontanWithDelay --- 
    message ESP_Disp_Rq2_AR _mESP_Disp_Rq2_AR;
    int _ESP_Disp_Rq2_AR_Timebase;
    int _ESP_Disp_Rq2_AR_CycleCount;
    int _ESP_Disp_Rq2_AR_StartDelay;
    int _ESP_Disp_Rq2_AR_Cnt;
    int _ESP_Disp_Rq2_AR_SpontanFlag;
    byte _ESP_Disp_Rq2_AR_CRC_Offset[16] = { 161,   8, 106, 204,  51, 149, 247,  94, 192,  39, 137, 235,  82, 180,  27, 125 };
    msTimer _tESP_Disp_Rq2_AR;

    // Botschaft ESP_Disp_Rq3_AR ID: 920 --- Sendeart 0 cyclicX --- 
    message ESP_Disp_Rq3_AR _mESP_Disp_Rq3_AR;
    int _ESP_Disp_Rq3_AR_Timebase;
    int _ESP_Disp_Rq3_AR_CycleCount;
    int _ESP_Disp_Rq3_AR_StartDelay;
    int _ESP_Disp_Rq3_AR_Cnt;
    msTimer _tESP_Disp_Rq3_AR;

    // Botschaft ESP_Disp_Rq_AMG_AR ID: 365 --- Sendeart 0 cyclicX --- 
    message ESP_Disp_Rq_AMG_AR _mESP_Disp_Rq_AMG_AR;
    int _ESP_Disp_Rq_AMG_AR_Timebase;
    int _ESP_Disp_Rq_AMG_AR_CycleCount;
    int _ESP_Disp_Rq_AMG_AR_StartDelay;
    int _ESP_Disp_Rq_AMG_AR_Cnt;
    msTimer _tESP_Disp_Rq_AMG_AR;

    // Botschaft EVC_CfgBit_01_32_AR ID: 753 --- Sendeart 0 cyclicX --- 
    message EVC_CfgBit_01_32_AR _mEVC_CfgBit_01_32_AR;
    int _EVC_CfgBit_01_32_AR_Timebase;
    int _EVC_CfgBit_01_32_AR_CycleCount;
    int _EVC_CfgBit_01_32_AR_StartDelay;
    int _EVC_CfgBit_01_32_AR_Cnt;
    byte _EVC_CfgBit_01_32_AR_CRC_Offset[16] = { 153, 210,  16,  73, 130, 187, 244,  50, 107, 164, 221,  27,  84, 141, 198,   4 };
    msTimer _tEVC_CfgBit_01_32_AR;

    // Botschaft EVC_CfgBit_33_64_AR ID: 755 --- Sendeart 0 cyclicX --- 
    message EVC_CfgBit_33_64_AR _mEVC_CfgBit_33_64_AR;
    int _EVC_CfgBit_33_64_AR_Timebase;
    int _EVC_CfgBit_33_64_AR_CycleCount;
    int _EVC_CfgBit_33_64_AR_StartDelay;
    int _EVC_CfgBit_33_64_AR_Cnt;
    byte _EVC_CfgBit_33_64_AR_CRC_Offset[16] = {  83, 104, 125, 146, 167, 188, 209, 230, 251,  21,  42,  63,  84, 105, 126, 147 };
    msTimer _tEVC_CfgBit_33_64_AR;

    // Botschaft EVC_CfgBit_65_96_AR ID: 757 --- Sendeart 0 cyclicX --- 
    message EVC_CfgBit_65_96_AR _mEVC_CfgBit_65_96_AR;
    int _EVC_CfgBit_65_96_AR_Timebase;
    int _EVC_CfgBit_65_96_AR_CycleCount;
    int _EVC_CfgBit_65_96_AR_StartDelay;
    int _EVC_CfgBit_65_96_AR_Cnt;
    byte _EVC_CfgBit_65_96_AR_CRC_Offset[16] = {  35,  85, 135, 185, 235,  34,  84, 134, 184, 234,  33,  83, 133, 183, 233,  32 };
    msTimer _tEVC_CfgBit_65_96_AR;

    // Botschaft EVC_CfgBit_97_C8_AR ID: 910 --- Sendeart 0 cyclicX --- 
    message EVC_CfgBit_97_C8_AR _mEVC_CfgBit_97_C8_AR;
    int _EVC_CfgBit_97_C8_AR_Timebase;
    int _EVC_CfgBit_97_C8_AR_CycleCount;
    int _EVC_CfgBit_97_C8_AR_StartDelay;
    int _EVC_CfgBit_97_C8_AR_Cnt;
    byte _EVC_CfgBit_97_C8_AR_CRC_Offset[16] = {  13, 128, 243, 107, 222,  86, 201,  65, 180,  44, 159,  23, 138, 253, 117, 232 };
    msTimer _tEVC_CfgBit_97_C8_AR;

    // Botschaft EVC_CfgList_01_0C_AR ID: 759 --- Sendeart 0 cyclicX --- 
    message EVC_CfgList_01_0C_AR _mEVC_CfgList_01_0C_AR;
    int _EVC_CfgList_01_0C_AR_Timebase;
    int _EVC_CfgList_01_0C_AR_CycleCount;
    int _EVC_CfgList_01_0C_AR_StartDelay;
    int _EVC_CfgList_01_0C_AR_Cnt;
    byte _EVC_CfgList_01_0C_AR_CRC_Offset[16] = { 198,  92, 237, 131,  25, 170,  64, 209, 103, 248, 142,  36, 181,  75, 220, 114 };
    msTimer _tEVC_CfgList_01_0C_AR;

    // Botschaft FBL_CFG_Star2_AR ID: 104 --- Sendeart 0 cyclicX --- 
    message FBL_CFG_Star2_AR _mFBL_CFG_Star2_AR;
    int _FBL_CFG_Star2_AR_Timebase;
    int _FBL_CFG_Star2_AR_CycleCount;
    int _FBL_CFG_Star2_AR_StartDelay;
    int _FBL_CFG_Star2_AR_Cnt;
    msTimer _tFBL_CFG_Star2_AR;

    // Botschaft FCW_Disp_Rq_AR ID: 1173 --- Sendeart 5 cyclicAndSpontanWithDelay --- 
    message FCW_Disp_Rq_AR _mFCW_Disp_Rq_AR;
    int _FCW_Disp_Rq_AR_Timebase;
    int _FCW_Disp_Rq_AR_CycleCount;
    int _FCW_Disp_Rq_AR_StartDelay;
    int _FCW_Disp_Rq_AR_MinDelay;
    int _FCW_Disp_Rq_AR_Cnt;
    int _FCW_Disp_Rq_AR_SpontanFlag;
    int _FCW_Disp_Rq_AR_DelayCnt;
    msTimer _tFCW_Disp_Rq_AR;

    // Botschaft FuelLvl_Stat_AR ID: 766 --- Sendeart 0 cyclicX --- 
    message FuelLvl_Stat_AR _mFuelLvl_Stat_AR;
    int _FuelLvl_Stat_AR_Timebase;
    int _FuelLvl_Stat_AR_CycleCount;
    int _FuelLvl_Stat_AR_StartDelay;
    int _FuelLvl_Stat_AR_Cnt;
    msTimer _tFuelLvl_Stat_AR;

    // Botschaft Fuel_Stat2_AR ID: 1190 --- Sendeart 0 cyclicX --- 
    message Fuel_Stat2_AR _mFuel_Stat2_AR;
    int _Fuel_Stat2_AR_Timebase;
    int _Fuel_Stat2_AR_CycleCount;
    int _Fuel_Stat2_AR_StartDelay;
    int _Fuel_Stat2_AR_Cnt;
    msTimer _tFuel_Stat2_AR;

    // Botschaft FWLP_D_AR ID: 1191 --- Sendeart 5 cyclicAndSpontanWithDelay --- 
    message FWLP_D_AR _mFWLP_D_AR;
    int _FWLP_D_AR_Timebase;
    int _FWLP_D_AR_CycleCount;
    int _FWLP_D_AR_StartDelay;
    int _FWLP_D_AR_MinDelay;
    int _FWLP_D_AR_Cnt;
    int _FWLP_D_AR_SpontanFlag;
    int _FWLP_D_AR_DelayCnt;
    msTimer _tFWLP_D_AR;

    // Botschaft FWLP_P_AR ID: 1189 --- Sendeart 5 cyclicAndSpontanWithDelay --- 
    message FWLP_P_AR _mFWLP_P_AR;
    int _FWLP_P_AR_Timebase;
    int _FWLP_P_AR_CycleCount;
    int _FWLP_P_AR_StartDelay;
    int _FWLP_P_AR_MinDelay;
    int _FWLP_P_AR_Cnt;
    int _FWLP_P_AR_SpontanFlag;
    int _FWLP_P_AR_DelayCnt;
    msTimer _tFWLP_P_AR;

    // Botschaft HumanMachineIfc_AR ID:489 --- Sendeart 0 cyclicX --- 
    message HumanMachineIfc_AR _mHumanMachineIfc_AR;
    int _HumanMachineIfc_AR_Timebase;
    int _HumanMachineIfc_AR_CycleCount;
    int _HumanMachineIfc_AR_StartDelay;
    int _HumanMachineIfc_AR_Cnt;
    msTimer _tHumanMachineIfc_AR;

    // Botschaft HumanMachineIfc_Rq_AR ID: 269 --- Sendeart 0 cyclicX --- 
    message HumanMachineIfc_Rq_AR _mHumanMachineIfc_Rq_AR;
    int _HumanMachineIfc_Rq_AR_Timebase;
    int _HumanMachineIfc_Rq_AR_CycleCount;
    int _HumanMachineIfc_Rq_AR_StartDelay;
    int _HumanMachineIfc_Rq_AR_Cnt;
    msTimer _tHumanMachineIfc_Rq_AR;

    // Botschaft HVAC_Disp_Stat1_AR ID: 851 --- Sendeart 5 cyclicAndSpontanWithDelay --- 
    message HVAC_Disp_Stat1_AR _mHVAC_Disp_Stat1_AR;
    int _HVAC_Disp_Stat1_AR_Timebase;
    int _HVAC_Disp_Stat1_AR_CycleCount;
    int _HVAC_Disp_Stat1_AR_StartDelay;
    int _HVAC_Disp_Stat1_AR_Cnt;
    int _HVAC_Disp_Stat1_AR_SpontanFlag;
    msTimer _tHVAC_Disp_Stat1_AR;

    // Botschaft HVAC_Disp_Stat2_AR ID: 853 --- Sendeart 5 cyclicAndSpontanWithDelay --- 
    message HVAC_Disp_Stat2_AR _mHVAC_Disp_Stat2_AR;
    int _HVAC_Disp_Stat2_AR_Timebase;
    int _HVAC_Disp_Stat2_AR_CycleCount;
    int _HVAC_Disp_Stat2_AR_StartDelay;
    int _HVAC_Disp_Stat2_AR_Cnt;
    int _HVAC_Disp_Stat2_AR_SpontanFlag;
    msTimer _tHVAC_Disp_Stat2_AR;

    // Botschaft HVAC_Disp_Stat3_AR ID: 855 --- Sendeart 5 cyclicAndSpontanWithDelay --- 
    message HVAC_Disp_Stat3_AR _mHVAC_Disp_Stat3_AR;
    int _HVAC_Disp_Stat3_AR_Timebase;
    int _HVAC_Disp_Stat3_AR_CycleCount;
    int _HVAC_Disp_Stat3_AR_StartDelay;
    int _HVAC_Disp_Stat3_AR_MinDelay;
    int _HVAC_Disp_Stat3_AR_Cnt;
    int _HVAC_Disp_Stat3_AR_SpontanFlag;
    int _HVAC_Disp_Stat3_AR_DelayCnt;
    msTimer _tHVAC_Disp_Stat3_AR;

    // Botschaft HVAC_State1_AR ID: 895 --- Sendeart 5 cyclicAndSpontanWithDelay --- 
    message HVAC_State1_AR _mHVAC_State1_AR;
    int _HVAC_State1_AR_Timebase;
    int _HVAC_State1_AR_CycleCount;
    int _HVAC_State1_AR_StartDelay;
    int _HVAC_State1_AR_Cnt;
    int _HVAC_State1_AR_SpontanFlag;
    msTimer _tHVAC_State1_AR;

    // Botschaft ICH_PreTime_Stat_AR ID: 889 --- Sendeart 5 cyclicAndSpontanWithDelay --- 
    message ICH_PreTime_Stat_AR _mICH_PreTime_Stat_AR;
    int _ICH_PreTime_Stat_AR_Timebase;
    int _ICH_PreTime_Stat_AR_CycleCount;
    int _ICH_PreTime_Stat_AR_StartDelay;
    int _ICH_PreTime_Stat_AR_Cnt;
    int _ICH_PreTime_Stat_AR_SpontanFlag;
    msTimer _tICH_PreTime_Stat_AR;

    // Botschaft ICH_Stat_AR ID: 887 --- Sendeart 5 cyclicAndSpontanWithDelay --- 
    message ICH_Stat_AR _mICH_Stat_AR;
    int _ICH_Stat_AR_Timebase;
    int _ICH_Stat_AR_CycleCount;
    int _ICH_Stat_AR_StartDelay;
    int _ICH_Stat_AR_Cnt;
    int _ICH_Stat_AR_SpontanFlag;
    msTimer _tICH_Stat_AR;

    // Botschaft Ign_Veh_Stat_AR ID: 32 --- Sendeart 5 cyclicAndSpontanWithDelay --- 
    message Ign_Veh_Stat_AR _mIgn_Veh_Stat_AR;
    int _Ign_Veh_Stat_AR_Timebase;
    int _Ign_Veh_Stat_AR_CycleCount;
    int _Ign_Veh_Stat_AR_StartDelay;
    int _Ign_Veh_Stat_AR_Cnt;
    int _Ign_Veh_Stat_AR_SpontanFlag;
    byte _Ign_Veh_Stat_AR_CRC_Offset[16] = { 167, 211,   4,  48,  92, 136, 180, 224,  17,  61, 105, 149, 193, 237,  30,  74 };
    msTimer _tIgn_Veh_Stat_AR;

    // Botschaft IHC_Lgt_Stat_MPC_AR ID: 551 --- Sendeart 0 cyclicX --- 
      message IHC_Lgt_Stat_MPC_AR _mIHC_Lgt_Stat_MPC_AR;
    int _IHC_Lgt_Stat_MPC_AR_Timebase;
    int _IHC_Lgt_Stat_MPC_AR_CycleCount;
    int _IHC_Lgt_Stat_MPC_AR_StartDelay;
    int _IHC_Lgt_Stat_MPC_AR_Cnt;
    byte _IHC_Lgt_Stat_MPC_AR_CRC_Offset[16] = {  79, 195,  60, 176,  41, 157,  22, 138,   3, 119, 235, 100, 216,  81, 197,  62 };
    msTimer _tIHC_Lgt_Stat_MPC_AR;

    // Botschaft IL_AmbLgt_Disp_AR ID: 1067 --- Sendeart 5 cyclicAndSpontanWithDelay --- 
    message IL_AmbLgt_Disp_AR _mIL_AmbLgt_Disp_AR;
    int _IL_AmbLgt_Disp_AR_Timebase;
    int _IL_AmbLgt_Disp_AR_CycleCount;
    int _IL_AmbLgt_Disp_AR_StartDelay;
    int _IL_AmbLgt_Disp_AR_Cnt;
    int _IL_AmbLgt_Disp_AR_SpontanFlag;
    msTimer _tIL_AmbLgt_Disp_AR;

    // Botschaft IL_AmbLgtCfg_Stat_AR --- Sendeart 5 cyclicAndSpontanWithDelay --- 
    message IL_AmbLgtCfg_Stat_AR _mIL_AmbLgtCfg_Stat_AR;
    int _IL_AmbLgtCfg_Stat_AR_Timebase;
    int _IL_AmbLgtCfg_Stat_AR_CycleCount;
    int _IL_AmbLgtCfg_Stat_AR_StartDelay;
    int _IL_AmbLgtCfg_Stat_AR_Cnt;
    int _IL_AmbLgtCfg_Stat_AR_SpontanFlag;
    msTimer _tIL_AmbLgtCfg_Stat_AR;

    // Botschaft IL_AmbLgtCfg_Stat_AR ID: 846 --- Sendeart 5 cyclicAndSpontanWithDelay --- 
    message IL_AmbLgtCfg_Stat2_AR _mIL_AmbLgtCfg_Stat2_AR;
    int _IL_AmbLgtCfg_Stat2_AR_Timebase;
    int _IL_AmbLgtCfg_Stat2_AR_CycleCount;
    int _IL_AmbLgtCfg_Stat2_AR_StartDelay;
    int _IL_AmbLgtCfg_Stat2_AR_Cnt;
    int _IL_AmbLgtCfg_Stat2_AR_SpontanFlag;
    msTimer _tIL_AmbLgtCfg_Stat2_AR;

    // Botschaft Immobilizer_Disp_Rq_AR ID: 1037 --- Sendeart 5 cyclicAndSpontanWithDelay --- 
    message Immobilizer_Disp_Rq_AR _mImmobilizer_Disp_Rq_AR;
    int _Immobilizer_Disp_Rq_AR_Timebase;
    int _Immobilizer_Disp_Rq_AR_CycleCount;
    int _Immobilizer_Disp_Rq_AR_StartDelay;
    int _Immobilizer_Disp_Rq_AR_Cnt;
    int _Immobilizer_Disp_Rq_AR_SpontanFlag;
    msTimer _tImmobilizer_Disp_Rq_AR;

    // Botschaft Immobilizer_IC_AR ID: 1039 --- Sendeart 0 cyclicX --- 
    message Immobilizer_IC_AR _mImmobilizer_IC_AR;
    int _Immobilizer_IC_AR_Timebase;
    int _Immobilizer_IC_AR_CycleCount;
    int _Immobilizer_IC_AR_StartDelay;
    int _Immobilizer_IC_AR_Cnt;
    msTimer _tImmobilizer_IC_AR;

    // Botschaft Immobilizer_KeyID_AR ID: 1038 --- Sendeart 5 cyclicAndSpontanWithDelay --- 
    message Immobilizer_KeyID_AR _mImmobilizer_KeyID_AR;
    int _Immobilizer_KeyID_AR_Timebase;
    int _Immobilizer_KeyID_AR_CycleCount;
    int _Immobilizer_KeyID_AR_StartDelay;
    int _Immobilizer_KeyID_AR_MinDelay;
    int _Immobilizer_KeyID_AR_Cnt;
    int _Immobilizer_KeyID_AR_SpontanFlag;
    int _Immobilizer_KeyID_AR_DelayCnt;
    byte _Immobilizer_KeyID_AR_CRC_Offset[16] = {  20,  57,  94, 131, 168, 205, 242,  28,  65, 102, 139, 176, 213, 250,  36,  73 };
    msTimer _tImmobilizer_KeyID_AR;

    // Botschaft KG_Msg_Disp_Rq_AR ID: 857 --- Sendeart 5 cyclicAndSpontanWithDelay --- 
    message KG_Msg_Disp_Rq_AR _mKG_Msg_Disp_Rq_AR;
    int _KG_Msg_Disp_Rq_AR_Timebase;
    int _KG_Msg_Disp_Rq_AR_CycleCount;
    int _KG_Msg_Disp_Rq_AR_StartDelay;
    int _KG_Msg_Disp_Rq_AR_Cnt;
    int _KG_Msg_Disp_Rq_AR_SpontanFlag;
    msTimer _tKG_Msg_Disp_Rq_AR;

    // Botschaft LDC_Disp_Rq_ESP_AR ID: 1047 --- Sendeart 5 cyclicAndSpontanWithDelay --- 
    message LDC_Disp_Rq_ESP_AR _mLDC_Disp_Rq_ESP_AR;
    int _LDC_Disp_Rq_ESP_AR_Timebase;
    int _LDC_Disp_Rq_ESP_AR_CycleCount;
    int _LDC_Disp_Rq_ESP_AR_StartDelay;
    int _LDC_Disp_Rq_ESP_AR_Cnt;
    int _LDC_Disp_Rq_ESP_AR_SpontanFlag;
    msTimer _tLDC_Disp_Rq_ESP_AR;

    // Botschaft LDC_Disp_Rq_RDU_AR ID: 1027 --- Sendeart 5 cyclicAndSpontanWithDelay --- 
    message LDC_Disp_Rq_RDU_AR _mLDC_Disp_Rq_RDU_AR;
    int _LDC_Disp_Rq_RDU_AR_Timebase;
    int _LDC_Disp_Rq_RDU_AR_CycleCount;
    int _LDC_Disp_Rq_RDU_AR_StartDelay;
    int _LDC_Disp_Rq_RDU_AR_Cnt;
    int _LDC_Disp_Rq_RDU_AR_SpontanFlag;
    msTimer _tLDC_Disp_Rq_RDU_AR;

    // Botschaft LDP_Warn_Rq_AR ID: 1026 --- Sendeart 5 cyclicAndSpontanWithDelay --- 
    message LDP_Warn_Rq_AR _mLDP_Warn_Rq_AR;
    int _LDP_Warn_Rq_AR_Timebase;
    int _LDP_Warn_Rq_AR_CycleCount;
    int _LDP_Warn_Rq_AR_StartDelay;
    int _LDP_Warn_Rq_AR_MinDelay;
    int _LDP_Warn_Rq_AR_Cnt;
    int _LDP_Warn_Rq_AR_SpontanFlag;
    int _LDP_Warn_Rq_AR_DelayCnt;
    msTimer _tLDP_Warn_Rq_AR;

    // Botschaft LgtSens_State_AR ID: 783 --- Sendeart 5 cyclicAndSpontanWithDelay --- 
    message LgtSens_State_AR _mLgtSens_State_AR;
    int _LgtSens_State_AR_Timebase;
    int _LgtSens_State_AR_CycleCount;
    int _LgtSens_State_AR_StartDelay;
    int _LgtSens_State_AR_MinDelay;
    int _LgtSens_State_AR_Cnt;
    int _LgtSens_State_AR_SpontanFlag;
    int _LgtSens_State_AR_DelayCnt;
    msTimer _tLgtSens_State_AR;

    // Botschaft MCMS_FL_AR ID: 793 --- Sendeart 5 cyclicAndSpontanWithDelay --- 
    message MCMS_FL_AR _mMCMS_FL_AR;
    int _MCMS_FL_AR_Timebase;
    int _MCMS_FL_AR_CycleCount;
    int _MCMS_FL_AR_StartDelay;
    int _MCMS_FL_AR_Cnt;
    int _MCMS_FL_AR_SpontanFlag;
    msTimer _tMCMS_FL_AR;

    // Botschaft MCMS_FL_Stat_AR ID: 795 --- Sendeart 5 cyclicAndSpontanWithDelay --- 
    message MCMS_FL_Stat_AR _mMCMS_FL_Stat_AR;
    int _MCMS_FL_Stat_AR_Timebase;
    int _MCMS_FL_Stat_AR_CycleCount;
    int _MCMS_FL_Stat_AR_StartDelay;
    int _MCMS_FL_Stat_AR_Cnt;
    int _MCMS_FL_Stat_AR_SpontanFlag;
    msTimer _tMCMS_FL_Stat_AR;

    // Botschaft MCMS_FR_AR ID: 799 --- Sendeart 5 cyclicAndSpontanWithDelay --- 
    message MCMS_FR_AR _mMCMS_FR_AR;
    int _MCMS_FR_AR_Timebase;
    int _MCMS_FR_AR_CycleCount;
    int _MCMS_FR_AR_StartDelay;
    int _MCMS_FR_AR_Cnt;
    int _MCMS_FR_AR_SpontanFlag;
    msTimer _tMCMS_FR_AR;

    // Botschaft MCMS_FR_Stat_AR ID: 801 --- Sendeart 5 cyclicAndSpontanWithDelay --- 
    message MCMS_FR_Stat_AR _mMCMS_FR_Stat_AR;
    int _MCMS_FR_Stat_AR_Timebase;
    int _MCMS_FR_Stat_AR_CycleCount;
    int _MCMS_FR_Stat_AR_StartDelay;
    int _MCMS_FR_Stat_AR_Cnt;
    int _MCMS_FR_Stat_AR_SpontanFlag;
    msTimer _tMCMS_FR_Stat_AR;

    // Botschaft MCMS_RL_AR ID: 807 --- Sendeart 5 cyclicAndSpontanWithDelay --- 
    message MCMS_RL_AR _mMCMS_RL_AR;
    int _MCMS_RL_AR_Timebase;
    int _MCMS_RL_AR_CycleCount;
    int _MCMS_RL_AR_StartDelay;
    int _MCMS_RL_AR_Cnt;
    int _MCMS_RL_AR_SpontanFlag;
    msTimer _tMCMS_RL_AR;

    // Botschaft MCMS_RL_Stat_AR ID: 809 --- Sendeart 5 cyclicAndSpontanWithDelay --- 
    message MCMS_RL_Stat_AR _mMCMS_RL_Stat_AR;
    int _MCMS_RL_Stat_AR_Timebase;
    int _MCMS_RL_Stat_AR_CycleCount;
    int _MCMS_RL_Stat_AR_StartDelay;
    int _MCMS_RL_Stat_AR_Cnt;
    int _MCMS_RL_Stat_AR_SpontanFlag;
    msTimer _tMCMS_RL_Stat_AR;

    // Botschaft MCMS_RR_AR ID: 813 --- Sendeart 5 cyclicAndSpontanWithDelay --- 
    message MCMS_RR_AR _mMCMS_RR_AR;
    int _MCMS_RR_AR_Timebase;
    int _MCMS_RR_AR_CycleCount;
    int _MCMS_RR_AR_StartDelay;
    int _MCMS_RR_AR_Cnt;
    int _MCMS_RR_AR_SpontanFlag;
    msTimer _tMCMS_RR_AR;

    // Botschaft MCMS_RR_Stat_AR ID: 815 --- Sendeart 5 cyclicAndSpontanWithDelay --- 
    message MCMS_RR_Stat_AR _mMCMS_RR_Stat_AR;
    int _MCMS_RR_Stat_AR_Timebase;
    int _MCMS_RR_Stat_AR_CycleCount;
    int _MCMS_RR_Stat_AR_StartDelay;
    int _MCMS_RR_Stat_AR_Cnt;
    int _MCMS_RR_Stat_AR_SpontanFlag;
    msTimer _tMCMS_RR_Stat_AR;

    // Botschaft OffRoad_Disp_Rq_AR ID:  918 --- Sendeart 0 cyclicX --- 
    message OffRoad_Disp_Rq_AR _mOffRoad_Disp_Rq_AR;
    int _OffRoad_Disp_Rq_AR_Timebase;
    int _OffRoad_Disp_Rq_AR_CycleCount;
    int _OffRoad_Disp_Rq_AR_StartDelay;
    int _OffRoad_Disp_Rq_AR_Cnt;
    int _OffRoad_Disp_Rq_AR_SpontanFlag;
    msTimer _tOffRoad_Disp_Rq_AR;

    // Botschaft Park_Disp_Rq_AR ID: 393 --- Sendeart 5 cyclicAndSpontanWithDelay --- 
    message Park_Disp_Rq_AR _mPark_Disp_Rq_AR;
    int _Park_Disp_Rq_AR_Timebase;
    int _Park_Disp_Rq_AR_CycleCount;
    int _Park_Disp_Rq_AR_StartDelay;
    int _Park_Disp_Rq_AR_MinDelay;
    int _Park_Disp_Rq_AR_Cnt;
    int _Park_Disp_Rq_AR_SpontanFlag;
    int _Park_Disp_Rq_AR_DelayCnt;
    byte _Park_Disp_Rq_AR_CRC_Offset[16] = { 216,  19,  73, 127, 181, 235,  38,  92, 146, 200,   3,  57, 111, 165, 219,  22 };
    msTimer _tPark_Disp_Rq_AR;

    // Botschaft Park_Set_Stat_AR ID: 1092 --- Sendeart 5 cyclicAndSpontanWithDelay --- 
    message Park_Set_Stat_AR _mPark_Set_Stat_AR;
    int _Park_Set_Stat_AR_Timebase;
    int _Park_Set_Stat_AR_CycleCount;
    int _Park_Set_Stat_AR_StartDelay;
    int _Park_Set_Stat_AR_MinDelay;
    int _Park_Set_Stat_AR_Cnt;
    int _Park_Set_Stat_AR_SpontanFlag;
    int _Park_Set_Stat_AR_DelayCnt;
    msTimer _tPark_Set_Stat_AR;

    // Botschaft ParkSpaceMeas_Stat_AR ID: 675 --- Sendeart 5 cyclicAndSpontanWithDelay --- 
    message ParkSpaceMeas_Stat_AR _mParkSpaceMeas_Stat_AR;
    int _ParkSpaceMeas_Stat_AR_Timebase;
    int _ParkSpaceMeas_Stat_AR_CycleCount;
    int _ParkSpaceMeas_Stat_AR_StartDelay;
    int _ParkSpaceMeas_Stat_AR_MinDelay;
    int _ParkSpaceMeas_Stat_AR_Cnt;
    int _ParkSpaceMeas_Stat_AR_SpontanFlag;
    int _ParkSpaceMeas_Stat_AR_DelayCnt;
    msTimer _tParkSpaceMeas_Stat_AR;

    // Botschaft ParkWarn_AR ID: 1075 --- Sendeart 5 cyclicAndSpontanWithDelay --- 
    message ParkWarn_AR _mParkWarn_AR;
    int _ParkWarn_AR_Timebase;
    int _ParkWarn_AR_CycleCount;
    int _ParkWarn_AR_StartDelay;
    int _ParkWarn_AR_Cnt;
    int _ParkWarn_AR_SpontanFlag;
    msTimer _tParkWarn_AR;

    // Botschaft PERIPHERY_HMI_R1_AR ID: 611 --- Sendeart 5 cyclicAndSpontanWithDelay --- 
    message PERIPHERY_HMI_R1_AR _mPERIPHERY_HMI_R1_AR;
    int _PERIPHERY_HMI_R1_AR_Timebase;
    int _PERIPHERY_HMI_R1_AR_CycleCount;
    int _PERIPHERY_HMI_R1_AR_StartDelay;
    int _PERIPHERY_HMI_R1_AR_Cnt;
    int _PERIPHERY_HMI_R1_AR_SpontanFlag;
    msTimer _tPERIPHERY_HMI_R1_AR;

    // Botschaft PN14_Disp_Rq_AR ID: 833 --- Sendeart 5 cyclicAndSpontanWithDelay --- 
    message PN14_Disp_Rq_AR _mPN14_Disp_Rq_AR;
    int _PN14_Disp_Rq_AR_Timebase;
    int _PN14_Disp_Rq_AR_CycleCount;
    int _PN14_Disp_Rq_AR_StartDelay;
    int _PN14_Disp_Rq_AR_MinDelay;
    int _PN14_Disp_Rq_AR_Cnt;
    int _PN14_Disp_Rq_AR_SpontanFlag;
    int _PN14_Disp_Rq_AR_DelayCnt;
    msTimer _tPN14_Disp_Rq_AR;

    // Botschaft PN14_Disp_Rq2_AR --- Sendeart 5 cyclicAndSpontanWithDelay --- 
    message PN14_Disp_Rq2_AR _mPN14_Disp_Rq2_AR;
    int _PN14_Disp_Rq2_AR_Timebase;
    int _PN14_Disp_Rq2_AR_CycleCount;
    int _PN14_Disp_Rq2_AR_StartDelay;
    int _PN14_Disp_Rq2_AR_MinDelay;
    int _PN14_Disp_Rq2_AR_Cnt;
    int _PN14_Disp_Rq2_AR_SpontanFlag;
    int _PN14_Disp_Rq2_AR_DelayCnt;
    byte _PN14_Disp_Rq2_AR_CRC_Offset[16] = { 220, 170, 120,  70,  20, 221, 171, 121,  71,  21, 222, 172, 122,  72,  22, 223 };
    msTimer _tPN14_Disp_Rq2_AR;

    // Botschaft PN14_Stat_AR ID: 290 --- Sendeart 5 cyclicAndSpontanWithDelay --- 
    message PN14_Stat_AR _mPN14_Stat_AR;
    int _PN14_Stat_AR_Timebase;
    int _PN14_Stat_AR_CycleCount;
    int _PN14_Stat_AR_StartDelay;
    int _PN14_Stat_AR_Cnt;
    int _PN14_Stat_AR_SpontanFlag;
    msTimer _tPN14_Stat_AR;

    // Botschaft PN48_Disp_Rq_AR ID: 1185 --- Sendeart 5 cyclicAndSpontanWithDelay --- 
    message PN48_Disp_Rq_AR _mPN48_Disp_Rq_AR;
    int _PN48_Disp_Rq_AR_Timebase;
    int _PN48_Disp_Rq_AR_CycleCount;
    int _PN48_Disp_Rq_AR_StartDelay;
    int _PN48_Disp_Rq_AR_MinDelay;
    int _PN48_Disp_Rq_AR_Cnt;
    int _PN48_Disp_Rq_AR_SpontanFlag;
    int _PN48_Disp_Rq_AR_DelayCnt;
    msTimer _tPN48_Disp_Rq_AR;

    // Botschaft PnHt_Stat_AR ID: 905 --- Sendeart 5 cyclicAndSpontanWithDelay --- 
    message PnHt_Stat_AR _mPnHt_Stat_AR;
    int _PnHt_Stat_AR_Timebase;
    int _PnHt_Stat_AR_CycleCount;
    int _PnHt_Stat_AR_StartDelay;
    int _PnHt_Stat_AR_Cnt;
    int _PnHt_Stat_AR_SpontanFlag;
    msTimer _tPnHt_Stat_AR;

    // Botschaft PNHV_EnergyMngmnt_Disp_Rq_AR ID: 1061 --- Sendeart 5 cyclicAndSpontanWithDelay --- 
    message PNHV_EnergyMngmnt_Disp_Rq_AR _mPNHV_EnergyMngmnt_Disp_Rq_AR;
    int _PNHV_EnergyMngmnt_Disp_Rq_AR_Timebase;
    int _PNHV_EnergyMngmnt_Disp_Rq_AR_CycleCount;
    int _PNHV_EnergyMngmnt_Disp_Rq_AR_StartDelay;
    int _PNHV_EnergyMngmnt_Disp_Rq_AR_MinDelay;
    int _PNHV_EnergyMngmnt_Disp_Rq_AR_Cnt;
    int _PNHV_EnergyMngmnt_Disp_Rq_AR_SpontanFlag;
    int _PNHV_EnergyMngmnt_Disp_Rq_AR_DelayCnt;
    msTimer _tPNHV_EnergyMngmnt_Disp_Rq_AR;

    // Botschaft PNHV_EnergyMngmnt_Stat2_AR ID: 339 --- Sendeart 5 cyclicAndSpontanWithDelay --- 
    message PNHV_EnergyMngmnt_Stat2_AR _mPNHV_EnergyMngmnt_Stat2_AR;
    int _PNHV_EnergyMngmnt_Stat2_AR_Timebase;
    int _PNHV_EnergyMngmnt_Stat2_AR_CycleCount;
    int _PNHV_EnergyMngmnt_Stat2_AR_StartDelay;
    int _PNHV_EnergyMngmnt_Stat2_AR_MinDelay;
    int _PNHV_EnergyMngmnt_Stat2_AR_Cnt;
    int _PNHV_EnergyMngmnt_Stat2_AR_SpontanFlag;
    int _PNHV_EnergyMngmnt_Stat2_AR_DelayCnt;
    msTimer _tPNHV_EnergyMngmnt_Stat2_AR;

    // Botschaft PNHV_EnergyMngmntSet_Rs1_AR ID: 1155 --- Sendeart 5 cyclicAndSpontanWithDelay --- 
    message PNHV_EnergyMngmntSet_Rs1_AR _mPNHV_EnergyMngmntSet_Rs1_AR;
    int _PNHV_EnergyMngmntSet_Rs1_AR_Timebase;
    int _PNHV_EnergyMngmntSet_Rs1_AR_CycleCount;
    int _PNHV_EnergyMngmntSet_Rs1_AR_StartDelay;
    int _PNHV_EnergyMngmntSet_Rs1_AR_MinDelay;
    int _PNHV_EnergyMngmntSet_Rs1_AR_Cnt;
    int _PNHV_EnergyMngmntSet_Rs1_AR_SpontanFlag;
    int _PNHV_EnergyMngmntSet_Rs1_AR_DelayCnt;
    msTimer _tPNHV_EnergyMngmntSet_Rs1_AR;

    // Botschaft PNHV_EnergyMngmntSet_Rs2_AR ID: 1073 --- Sendeart 5 cyclicAndSpontanWithDelay --- 
    message PNHV_EnergyMngmntSet_Rs2_AR _mPNHV_EnergyMngmntSet_Rs2_AR;
    int _PNHV_EnergyMngmntSet_Rs2_AR_Timebase;
    int _PNHV_EnergyMngmntSet_Rs2_AR_CycleCount;
    int _PNHV_EnergyMngmntSet_Rs2_AR_StartDelay;
    int _PNHV_EnergyMngmntSet_Rs2_AR_Cnt;
    int _PNHV_EnergyMngmntSet_Rs2_AR_SpontanFlag;
    msTimer _tPNHV_EnergyMngmntSet_Rs2_AR;

    // Botschaft PNHV_WeekDepTmTbl_Stat_AR ID: 447 --- Sendeart 2 cyclicIfActive --- 
    message PNHV_WeekDepTmTbl_Stat_AR _mPNHV_WeekDepTmTbl_Stat_AR;
    int _PNHV_WeekDepTmTbl_Stat_AR_Timebase;
    int _PNHV_WeekDepTmTbl_Stat_AR_CycleCount;
    int _PNHV_WeekDepTmTbl_Stat_AR_StartDelay;
    int _PNHV_WeekDepTmTbl_Stat_AR_Cnt;
    int _PNHV_WeekDepTmTbl_Stat_AR_Active;
    int _PNHV_WeekDepTmTbl_Stat_AR_SigActivity;

    int _PNHV_WeekDepTmTbl_Stat_AR_PNHV_DepTm01_LastState = 0;
    int _PNHV_WeekDepTmTbl_Stat_AR_PNHV_DepTm02_LastState = 0;
    int _PNHV_WeekDepTmTbl_Stat_AR_PNHV_DepTm03_LastState = 0;
    int _PNHV_WeekDepTmTbl_Stat_AR_PNHV_DepTm04_LastState = 0;
    int _PNHV_WeekDepTmTbl_Stat_AR_PNHV_DepTm05_LastState = 0;
    int _PNHV_WeekDepTmTbl_Stat_AR_PNHV_DepTm06_LastState = 0;
    int _PNHV_WeekDepTmTbl_Stat_AR_PNHV_DepTm07_LastState = 0;
    int _PNHV_WeekDepTmTbl_Stat_AR_PNHV_DepTm08_LastState = 0;
    int _PNHV_WeekDepTmTbl_Stat_AR_PNHV_DepTm09_LastState = 0;
    int _PNHV_WeekDepTmTbl_Stat_AR_PNHV_DepTm10_LastState = 0;
    int _PNHV_WeekDepTmTbl_Stat_AR_PNHV_DepTm11_LastState = 0;
    int _PNHV_WeekDepTmTbl_Stat_AR_PNHV_DepTm12_LastState = 0;
    int _PNHV_WeekDepTmTbl_Stat_AR_PNHV_DepTm13_LastState = 0;
    int _PNHV_WeekDepTmTbl_Stat_AR_PNHV_DepTm14_LastState = 0;
    int _PNHV_WeekDepTmTbl_Stat_AR_PNHV_DepTm15_LastState = 0;
    int _PNHV_WeekDepTmTbl_Stat_AR_PNHV_DepTm16_LastState = 0;
    int _PNHV_WeekDepTmTbl_Stat_AR_PNHV_DepTm17_LastState = 0;
    int _PNHV_WeekDepTmTbl_Stat_AR_PNHV_DepTm18_LastState = 0;
    int _PNHV_WeekDepTmTbl_Stat_AR_PNHV_DepTm19_LastState = 0;
    int _PNHV_WeekDepTmTbl_Stat_AR_PNHV_DepTm20_LastState = 0;
    int _PNHV_WeekDepTmTbl_Stat_AR_PNHV_DepTm21_LastState = 0;
    int _PNHV_WeekDepTmTbl_Stat_AR_PNHV_DepTmUpdtCnt_1To4_LastState = 0;
    int _PNHV_WeekDepTmTbl_Stat_AR_PNHV_DepTmUpdtCnt_5To8_LastState = 0;
    int _PNHV_WeekDepTmTbl_Stat_AR_PNHV_DepTmUpdtCnt_9To12_LastState = 0;
    int _PNHV_WeekDepTmTbl_Stat_AR_PNHV_DepTmUpdtCnt_13To16_LastState = 0;
    int _PNHV_WeekDepTmTbl_Stat_AR_PNHV_DepTmUpdtCnt_17To20_LastState = 0;
    int _PNHV_WeekDepTmTbl_Stat_AR_PNHV_DepTmUpdtCnt_21_LastState = 0;
    int _PNHV_WeekDepTmTbl_Stat_AR_PNHV_WeekDepTmTbl_New_LastState = 0;
    int _PNHV_WeekDepTmTbl_Stat_AR_PNHV_WeekDepTmTbl_PartId_LastState = 0;
    int _PNHV_WeekDepTmTbl_Stat_AR_PNHV_WeekDepTmTbl_TxActv_LastState = 0;
    msTimer _tPNHV_WeekDepTmTbl_Stat_AR;

    // Botschaft PreCond_CfgStat_AR ID: 1179 --- Sendeart 5 cyclicAndSpontanWithDelay --- 
    message PreCond_CfgStat_AR _mPreCond_CfgStat_AR;
    int _PreCond_CfgStat_AR_Timebase;
    int _PreCond_CfgStat_AR_CycleCount;
    int _PreCond_CfgStat_AR_StartDelay;
    int _PreCond_CfgStat_AR_Cnt;
    int _PreCond_CfgStat_AR_SpontanFlag;
    msTimer _tPreCond_CfgStat_AR;

    // Botschaft PresfCtrl_Rq_ESP_AR ID: 33 --- Sendeart 8 cyclicIfActiveFast --- 
    message PresfCtrl_Rq_ESP_AR _mPresfCtrl_Rq_ESP_AR;
    int _PresfCtrl_Rq_ESP_AR_Timebase;
    int _PresfCtrl_Rq_ESP_AR_CycleCountSlow;
    int _PresfCtrl_Rq_ESP_AR_CycleCountFast;
    int _PresfCtrl_Rq_ESP_AR_StartDelay;
    int _PresfCtrl_Rq_ESP_AR_Cnt;
    int _PresfCtrl_Rq_ESP_AR_SigActivity;

    int _PresfCtrl_Rq_ESP_AR_Rsrv6_PresfCtrl_Rq_ESP_LastState = 0;
    int _PresfCtrl_Rq_ESP_AR_Rsrv5_PresfCtrl_Rq_ESP_LastState = 0;
    int _PresfCtrl_Rq_ESP_AR_Rsrv4_PresfCtrl_Rq_ESP_LastState = 0;
    int _PresfCtrl_Rq_ESP_AR_Rsrv3_PresfCtrl_Rq_ESP_LastState = 0;
    int _PresfCtrl_Rq_ESP_AR_Rsrv2_PresfCtrl_Rq_ESP_LastState = 0;
    int _PresfCtrl_Rq_ESP_AR_Rsrv1_PresfCtrl_Rq_ESP_LastState = 0;
    int _PresfCtrl_Rq_ESP_AR_Presf_Lvl_V2_LastState = 0;
    byte _PresfCtrl_Rq_ESP_AR_CRC_Offset[16] = { 103, 114, 125, 136, 147, 158, 169, 180, 191, 202, 213, 224, 235, 246,   6,  17 };
    msTimer _tPresfCtrl_Rq_ESP_AR;

    // Botschaft PT_DataContain_Rq_AR ID: 1178 --- Sendeart 5 cyclicAndSpontanWithDelay --- 
    message PT_DataContain_Rq_AR _mPT_DataContain_Rq_AR;
    int _PT_DataContain_Rq_AR_Timebase;
    int _PT_DataContain_Rq_AR_CycleCount;
    int _PT_DataContain_Rq_AR_StartDelay;
    int _PT_DataContain_Rq_AR_MinDelay;
    int _PT_DataContain_Rq_AR_Cnt;
    int _PT_DataContain_Rq_AR_SpontanFlag;
    int _PT_DataContain_Rq_AR_DelayCnt;
    msTimer _tPT_DataContain_Rq_AR;

    // Botschaft PT_Disp_Rq2_AR ID: 656 --- Sendeart 0 cyclicX --- 
    message PT_Disp_Rq2_AR _mPT_Disp_Rq2_AR;
    int _PT_Disp_Rq2_AR_Timebase;
    int _PT_Disp_Rq2_AR_CycleCount;
    int _PT_Disp_Rq2_AR_StartDelay;
    int _PT_Disp_Rq2_AR_Cnt;
    msTimer _tPT_Disp_Rq2_AR;

    // Botschaft PtHyb_Mngmnt_Rq_AR ID: 1279 --- Sendeart 5 cyclicAndSpontanWithDelay --- 
    message PtHyb_Mngmnt_Rq_AR _mPtHyb_Mngmnt_Rq_AR;
    int _PtHyb_Mngmnt_Rq_AR_Timebase;
    int _PtHyb_Mngmnt_Rq_AR_CycleCount;
    int _PtHyb_Mngmnt_Rq_AR_StartDelay;
    int _PtHyb_Mngmnt_Rq_AR_MinDelay;
    int _PtHyb_Mngmnt_Rq_AR_Cnt;
    int _PtHyb_Mngmnt_Rq_AR_SpontanFlag;
    int _PtHyb_Mngmnt_Rq_AR_DelayCnt;
    msTimer _tPtHyb_Mngmnt_Rq_AR;

    // Botschaft PtMngmnt_Disp_Rq_AR ID: 321 --- Sendeart 0 cyclicX --- 
    message PtMngmnt_Disp_Rq_AR _mPtMngmnt_Disp_Rq_AR;
    int _PtMngmnt_Disp_Rq_AR_Timebase;
    int _PtMngmnt_Disp_Rq_AR_CycleCount;
    int _PtMngmnt_Disp_Rq_AR_StartDelay;
    int _PtMngmnt_Disp_Rq_AR_Cnt;
    msTimer _tPtMngmnt_Disp_Rq_AR;

    // Botschaft RDU_Disp_Rq_AR ID: 812 --- Sendeart 5 cyclicAndSpontanWithDelay --- 
    message RDU_Disp_Rq_AR _mRDU_Disp_Rq_AR;
    int _RDU_Disp_Rq_AR_Timebase;
    int _RDU_Disp_Rq_AR_CycleCount;
    int _RDU_Disp_Rq_AR_StartDelay;
    int _RDU_Disp_Rq_AR_MinDelay;
    int _RDU_Disp_Rq_AR_Cnt;
    int _RDU_Disp_Rq_AR_SpontanFlag;
    int _RDU_Disp_Rq_AR_DelayCnt;
    msTimer _tRDU_Disp_Rq_AR;

    // Botschaft RVC_SVS_Park_Stat_AR --- Sendeart 5 cyclicAndSpontanWithDelay --- 
    message RVC_SVS_Park_Stat_AR _mRVC_SVS_Park_Stat_AR;
    int _RVC_SVS_Park_Stat_AR_Timebase;
    int _RVC_SVS_Park_Stat_AR_CycleCount;
    int _RVC_SVS_Park_Stat_AR_StartDelay;
    int _RVC_SVS_Park_Stat_AR_MinDelay;
    int _RVC_SVS_Park_Stat_AR_Cnt;
    int _RVC_SVS_Park_Stat_AR_SpontanFlag;
    int _RVC_SVS_Park_Stat_AR_DelayCnt;
    msTimer _tRVC_SVS_Park_Stat_AR;

    // Botschaft SBW_DrvPosn_Disp_Rq_ISM_AR ID: 323 --- Sendeart 5 cyclicAndSpontanWithDelay --- 
    message SBW_DrvPosn_Disp_Rq_ISM_AR _mSBW_DrvPosn_Disp_Rq_ISM_AR;
    int _SBW_DrvPosn_Disp_Rq_ISM_AR_Timebase;
    int _SBW_DrvPosn_Disp_Rq_ISM_AR_CycleCount;
    int _SBW_DrvPosn_Disp_Rq_ISM_AR_StartDelay;
    int _SBW_DrvPosn_Disp_Rq_ISM_AR_Cnt;
    int _SBW_DrvPosn_Disp_Rq_ISM_AR_SpontanFlag;
    byte _SBW_DrvPosn_Disp_Rq_ISM_AR_CRC_Offset[16] = {  97, 226, 104, 233, 111, 240, 118, 247, 125,   3, 132,  10, 139,  17, 146,  24 };
    msTimer _tSBW_DrvPosn_Disp_Rq_ISM_AR;

    // Botschaft SBW_DrvPosn_Disp_Rq_TCM_AR ID: 711 --- Sendeart 5 cyclicAndSpontanWithDelay --- 
    message SBW_DrvPosn_Disp_Rq_TCM_AR _mSBW_DrvPosn_Disp_Rq_TCM_AR;
    int _SBW_DrvPosn_Disp_Rq_TCM_AR_Timebase;
    int _SBW_DrvPosn_Disp_Rq_TCM_AR_CycleCount;
    int _SBW_DrvPosn_Disp_Rq_TCM_AR_StartDelay;
    int _SBW_DrvPosn_Disp_Rq_TCM_AR_Cnt;
    int _SBW_DrvPosn_Disp_Rq_TCM_AR_SpontanFlag;
    byte _SBW_DrvPosn_Disp_Rq_TCM_AR_CRC_Offset[16] = { 239, 121,   3, 136,  18, 151,  33, 166,  48, 181,  63, 196,  78, 211,  93, 226 };
    msTimer _tSBW_DrvPosn_Disp_Rq_TCM_AR;

    // Botschaft Seat_D_Stat_AR ID: 937 --- Sendeart 5 cyclicAndSpontanWithDelay --- 
    message Seat_D_Stat_AR _mSeat_D_Stat_AR;
    int _Seat_D_Stat_AR_Timebase;
    int _Seat_D_Stat_AR_CycleCount;
    int _Seat_D_Stat_AR_StartDelay;
    int _Seat_D_Stat_AR_Cnt;
    int _Seat_D_Stat_AR_SpontanFlag;
    msTimer _tSeat_D_Stat_AR;

    // Botschaft Seat_P_Stat_AR ID: 939 --- Sendeart 5 cyclicAndSpontanWithDelay --- 
    message Seat_P_Stat_AR _mSeat_P_Stat_AR;
    int _Seat_P_Stat_AR_Timebase;
    int _Seat_P_Stat_AR_CycleCount;
    int _Seat_P_Stat_AR_StartDelay;
    int _Seat_P_Stat_AR_Cnt;
    int _Seat_P_Stat_AR_SpontanFlag;
    msTimer _tSeat_P_Stat_AR;

    // Botschaft Seat_RL_Stat_AR ID: 941 --- Sendeart 5 cyclicAndSpontanWithDelay --- 
    message Seat_RL_Stat_AR _mSeat_RL_Stat_AR;
    int _Seat_RL_Stat_AR_Timebase;
    int _Seat_RL_Stat_AR_CycleCount;
    int _Seat_RL_Stat_AR_StartDelay;
    int _Seat_RL_Stat_AR_Cnt;
    int _Seat_RL_Stat_AR_SpontanFlag;
    msTimer _tSeat_RL_Stat_AR;

    // Botschaft Seat_RR_Stat_AR ID: 943 --- Sendeart 5 cyclicAndSpontanWithDelay --- 
    message Seat_RR_Stat_AR _mSeat_RR_Stat_AR;
    int _Seat_RR_Stat_AR_Timebase;
    int _Seat_RR_Stat_AR_CycleCount;
    int _Seat_RR_Stat_AR_StartDelay;
    int _Seat_RR_Stat_AR_Cnt;
    int _Seat_RR_Stat_AR_SpontanFlag;
    msTimer _tSeat_RR_Stat_AR;

    // Botschaft SeatHtVn_Stat_AR ID: 915 --- Sendeart 5 cyclicAndSpontanWithDelay --- 
    message SeatHtVn_Stat_AR _mSeatHtVn_Stat_AR;
    int _SeatHtVn_Stat_AR_Timebase;
    int _SeatHtVn_Stat_AR_CycleCount;
    int _SeatHtVn_Stat_AR_StartDelay;
    int _SeatHtVn_Stat_AR_Cnt;
    int _SeatHtVn_Stat_AR_SpontanFlag;
    msTimer _tSeatHtVn_Stat_AR;

    // Botschaft SeatHtVn_Stat2_AR ID: 916 --- Sendeart 5 cyclicAndSpontanWithDelay --- 
    message SeatHtVn_Stat2_AR _mSeatHtVn_Stat2_AR;
    int _SeatHtVn_Stat2_AR_Timebase;
    int _SeatHtVn_Stat2_AR_CycleCount;
    int _SeatHtVn_Stat2_AR_StartDelay;
    int _SeatHtVn_Stat2_AR_MinDelay;
    int _SeatHtVn_Stat2_AR_Cnt;
    int _SeatHtVn_Stat2_AR_SpontanFlag;
    int _SeatHtVn_Stat2_AR_DelayCnt;
    msTimer _tSeatHtVn_Stat2_AR;

    // Botschaft SeatMem_D_Rq_AR ID: 297 --- Sendeart 2 cyclicIfActive --- 
    message SeatMem_D_Rq_AR _mSeatMem_D_Rq_AR;
    int _SeatMem_D_Rq_AR_Timebase;
    int _SeatMem_D_Rq_AR_CycleCount;
    int _SeatMem_D_Rq_AR_StartDelay;
    int _SeatMem_D_Rq_AR_Cnt;
    int _SeatMem_D_Rq_AR_Active;
    int _SeatMem_D_Rq_AR_SigActivity;

    int _SeatMem_D_Rq_AR_MCMS_DrvPosn_D_Rq_LastState = 0;
    int _SeatMem_D_Rq_AR_MCMS_DrvPosn_D_Sv_Rq_LastState = 0;
    int _SeatMem_D_Rq_AR_MCMS_EEH_Posn_Rq_LastState = 0;
    int _SeatMem_D_Rq_AR_MCMS_HomePosn_D_Rq_LastState = 0;
    int _SeatMem_D_Rq_AR_MCMS_HomePosn_D_Sv_Rq_LastState = 0;
    int _SeatMem_D_Rq_AR_Mem_D_Posn_Rq_LastState = 0;
    int _SeatMem_D_Rq_AR_Mem_D_Prof_Posn_Rq_LastState = 0;
    int _SeatMem_D_Rq_AR_Mem_D_Rc_Rq_LastState = 0;
    int _SeatMem_D_Rq_AR_Mem_D_Sv_Rq_LastState = 0;
    int _SeatMem_D_Rq_AR_MirrDrvPosn_Rq_LastState = 0;
    int _SeatMem_D_Rq_AR_MirrDrvPosn_Sv_Rq_LastState = 0;
    msTimer _tSeatMem_D_Rq_AR;

    // Botschaft SeatPosn_Abs_D_AR ID: 961 --- Sendeart 5 cyclicAndSpontanWithDelay --- 
    message SeatPosn_Abs_D_AR _mSeatPosn_Abs_D_AR;
    int _SeatPosn_Abs_D_AR_Timebase;
    int _SeatPosn_Abs_D_AR_CycleCount;
    int _SeatPosn_Abs_D_AR_StartDelay;
    int _SeatPosn_Abs_D_AR_MinDelay;
    int _SeatPosn_Abs_D_AR_Cnt;
    int _SeatPosn_Abs_D_AR_SpontanFlag;
    int _SeatPosn_Abs_D_AR_DelayCnt;
    byte _SeatPosn_Abs_D_AR_CRC_Offset[16] = { 225, 124,  23, 173,  72, 222, 121,  20, 170,  69, 219, 118,  17, 167,  66, 216 };
    msTimer _tSeatPosn_Abs_D_AR;

    // Botschaft SeatPosn_Abs_P_AR ID: 963 --- Sendeart 5 cyclicAndSpontanWithDelay --- 
    message SeatPosn_Abs_P_AR _mSeatPosn_Abs_P_AR;
    int _SeatPosn_Abs_P_AR_Timebase;
    int _SeatPosn_Abs_P_AR_CycleCount;
    int _SeatPosn_Abs_P_AR_StartDelay;
    int _SeatPosn_Abs_P_AR_MinDelay;
    int _SeatPosn_Abs_P_AR_Cnt;
    int _SeatPosn_Abs_P_AR_SpontanFlag;
    int _SeatPosn_Abs_P_AR_DelayCnt;
    byte _SeatPosn_Abs_P_AR_CRC_Offset[16] = {  47, 134, 221,  57, 144, 231,  67, 154, 241,  77, 164, 251,  87, 174,  10,  97 };
    msTimer _tSeatPosn_Abs_P_AR;

    // Botschaft SND_GEN_Stat_AR ID: 1210 --- Sendeart 5 cyclicAndSpontanWithDelay --- 
    message SND_GEN_Stat_AR _mSND_GEN_Stat_AR;
    int _SND_GEN_Stat_AR_Timebase;
    int _SND_GEN_Stat_AR_CycleCount;
    int _SND_GEN_Stat_AR_StartDelay;
    int _SND_GEN_Stat_AR_MinDelay;
    int _SND_GEN_Stat_AR_Cnt;
    int _SND_GEN_Stat_AR_SpontanFlag;
    int _SND_GEN_Stat_AR_DelayCnt;
    msTimer _tSND_GEN_Stat_AR;

    // Botschaft SPC_Disp_Rq_AR ID: 635 --- Sendeart 0 cyclicX --- 
    message SPC_Disp_Rq_AR _mSPC_Disp_Rq_AR;
    int _SPC_Disp_Rq_AR_Timebase;
    int _SPC_Disp_Rq_AR_CycleCount;
    int _SPC_Disp_Rq_AR_Cnt;
    int _SPC_Disp_Rq_AR_StartDelay;
    msTimer _tSPC_Disp_Rq_AR;

    // Botschaft SPC_SwLED_Msg_Rq_AR --- Sendeart 5 cyclicAndSpontanWithDelay --- 
    message SPC_SwLED_Msg_Rq_AR _mSPC_SwLED_Msg_Rq_AR;
    int _SPC_SwLED_Msg_Rq_AR_Timebase;
    int _SPC_SwLED_Msg_Rq_AR_CycleCount;
    int _SPC_SwLED_Msg_Rq_AR_StartDelay;
    int _SPC_SwLED_Msg_Rq_AR_Cnt;
    int _SPC_SwLED_Msg_Rq_AR_SpontanFlag;
    byte _SPC_SwLED_Msg_Rq_AR_CRC_Offset[16] = {  94, 113, 132, 151, 170, 189, 208, 227, 246,  14,  33,  52,  71,  90, 109, 128 };
    msTimer _tSPC_SwLED_Msg_Rq_AR;

    // Botschaft SPV_Rq_AR ID: 789 --- Sendeart 8 cyclicIfActiveFast --- 
    message SPV_Rq_AR _mSPV_Rq_AR;
    int _SPV_Rq_AR_Timebase;
    int _SPV_Rq_AR_CycleCountSlow;
    int _SPV_Rq_AR_CycleCountFast;
    int _SPV_Rq_AR_StartDelay;
    int _SPV_Rq_AR_Cnt;
    int _SPV_Rq_AR_SigActivity;

    int _SPV_Rq_AR_AcustWarn_Rq_MPM_LastState = 0;
    int _SPV_Rq_AR_AudioMute_1_Rq_LastState = 0;
    int _SPV_Rq_AR_AudioMute_2_Rq_LastState = 0;
    int _SPV_Rq_AR_AuthRadio_Actv_LastState = 0;
    int _SPV_Rq_AR_FBAS_VideoIn_Rq_LastState = 0;
    int _SPV_Rq_AR_Gas_Dr_Unlk_Rq_MPM_LastState = 0;
    int _SPV_Rq_AR_RadioHdFree_Actv_LastState = 0;
    int _SPV_Rq_AR_Radio_NumPad_Rq_LastState = 0;
    int _SPV_Rq_AR_SPV_Rem_UI_Rq_LastState = 0;
    msTimer _tSPV_Rq_AR;

    // Botschaft SPV_Stat_AR ID: 791 --- Sendeart 5 cyclicAndSpontanWithDelay --- 
    message SPV_Stat_AR _mSPV_Stat_AR;
    int _SPV_Stat_AR_Timebase;
    int _SPV_Stat_AR_CycleCount;
    int _SPV_Stat_AR_StartDelay;
    int _SPV_Stat_AR_MinDelay;
    int _SPV_Stat_AR_Cnt;
    int _SPV_Stat_AR_SpontanFlag;
    int _SPV_Stat_AR_DelayCnt;
    msTimer _tSPV_Stat_AR;

    // Botschaft StWhl_Angl_Stat_AR ID: 47 --- Sendeart 0 cyclicX --- 
    message StWhl_Angl_Stat_AR _mStWhl_Angl_Stat_AR;
    int _StWhl_Angl_Stat_AR_Timebase;
    int _StWhl_Angl_Stat_AR_CycleCount;
    int _StWhl_Angl_Stat_AR_StartDelay;
    int _StWhl_Angl_Stat_AR_Cnt;
    byte _StWhl_Angl_Stat_AR_CRC_Offset[16] = {  39,   7, 226, 194, 162, 130,  98,  66,  34, 253, 221, 189, 157, 125,  93,  61 };
    msTimer _tStWhl_Angl_Stat_AR;

    // Botschaft StWhl_OFN_Stat_AR --- Sendeart 5 cyclicAndSpontanWithDelay --- 
    message StWhl_OFN_Stat_AR _mStWhl_OFN_Stat_AR;
    int _StWhl_OFN_Stat_AR_Timebase;
    int _StWhl_OFN_Stat_AR_CycleCount;
    int _StWhl_OFN_Stat_AR_StartDelay;
    int _StWhl_OFN_Stat_AR_MinDelay;
    int _StWhl_OFN_Stat_AR_Cnt;
    int _StWhl_OFN_Stat_AR_SpontanFlag;
    int _StWhl_OFN_Stat_AR_DelayCnt;
    msTimer _tStWhl_OFN_Stat_AR;

    // Botschaft StWhl_Sw_Stat_AR ID: 1025 --- Sendeart 5 cyclicAndSpontanWithDelay --- 
    message StWhl_Sw_Stat_AR _mStWhl_Sw_Stat_AR;
    int _StWhl_Sw_Stat_AR_Timebase;
    int _StWhl_Sw_Stat_AR_CycleCount;
    int _StWhl_Sw_Stat_AR_StartDelay;
    int _StWhl_Sw_Stat_AR_Cnt;
    int _StWhl_Sw_Stat_AR_SpontanFlag;
    byte _StWhl_Sw_Stat_AR_CRC_Offset[16] = { 189, 144, 99,  54,   9, 215, 170, 125,  80,  35, 241, 196, 151, 106,  61,  16 };
    msTimer _tStWhl_Sw_Stat_AR;

    // Botschaft TC_Disp_Rq_ECM_AR ID: 331 --- Sendeart 0 cyclicX --- 
    message TC_Disp_Rq_ECM_AR _mTC_Disp_Rq_ECM_AR;
    int _TC_Disp_Rq_ECM_AR_Timebase;
    int _TC_Disp_Rq_ECM_AR_CycleCount;
    int _TC_Disp_Rq_ECM_AR_StartDelay;
    int _TC_Disp_Rq_ECM_AR_Cnt;
    int _TC_Disp_Rq_ECM_AR_SigActivity;

    int _TC_Disp_Rq_ECM_AR_TC_FuelType_ActState = 0;
    msTimer _tTC_Disp_Rq_ECM_AR;

    // Botschaft TC_EBBC_Disp_Rq_ECM_AR ID: 333 --- Sendeart 0 cyclicX --- 
    message TC_EBBC_Disp_Rq_ECM_AR _mTC_EBBC_Disp_Rq_ECM_AR;
    int _TC_EBBC_Disp_Rq_ECM_AR_Timebase;
    int _TC_EBBC_Disp_Rq_ECM_AR_CycleCount;
    int _TC_EBBC_Disp_Rq_ECM_AR_StartDelay;
    int _TC_EBBC_Disp_Rq_ECM_AR_Cnt;
    msTimer _tTC_EBBC_Disp_Rq_ECM_AR;

    // Botschaft TC_EEBBC_Disp_Rq_AR ID: 647 --- Sendeart 0 cyclicX --- 
    message TC_EEBBC_Disp_Rq_AR _mTC_EEBBC_Disp_Rq_AR;
    int _TC_EEBBC_Disp_Rq_AR_Timebase;
    int _TC_EEBBC_Disp_Rq_AR_CycleCount;
    int _TC_EEBBC_Disp_Rq_AR_StartDelay;
    int _TC_EEBBC_Disp_Rq_AR_Cnt;
    msTimer _tTC_EEBBC_Disp_Rq_AR;

    // Botschaft TCM_Disp_Rq_AMG_AR ID: 653 --- Sendeart 5 cyclicAndSpontanWithDelay --- 
    message TCM_Disp_Rq_AMG_AR _mTCM_Disp_Rq_AMG_AR;
    int _TCM_Disp_Rq_AMG_AR_Timebase;
    int _TCM_Disp_Rq_AMG_AR_CycleCount;
    int _TCM_Disp_Rq_AMG_AR_StartDelay;
    int _TCM_Disp_Rq_AMG_AR_MinDelay;
    int _TCM_Disp_Rq_AMG_AR_Cnt;
    int _TCM_Disp_Rq_AMG_AR_SpontanFlag;
    int _TCM_Disp_Rq_AMG_AR_DelayCnt;
    msTimer _tTCM_Disp_Rq_AMG_AR;

    // Botschaft Teleaid_WRN_AR ID: 1199 --- Sendeart 5 cyclicAndSpontanWithDelay --- 
    message Teleaid_WRN_AR _mTeleaid_WRN_AR;
    int _Teleaid_WRN_AR_Timebase;
    int _Teleaid_WRN_AR_CycleCount;
    int _Teleaid_WRN_AR_StartDelay;
    int _Teleaid_WRN_AR_Cnt;
    int _Teleaid_WRN_AR_SpontanFlag;
    msTimer _tTeleaid_WRN_AR;

    // Botschaft TP_EIS_IC_SecOdo --- Sendeart 0 cyclicX --- 
    message TP_EIS_IC_SecOdo _mTP_EIS_IC_SecOdo;
    int _TP_EIS_IC_SecOdo_Timebase;
    int _TP_EIS_IC_SecOdo_SpontanFlag;
    msTimer _tTP_EIS_IC_SecOdo;

    // Botschaft TP_COM_TGW_Adapt --- Sendeart 0 cyclicX --- 
    message TP_COM_TGW_Adapt _mTP_COM_TGW_Adapt;
    int _TP_COM_TGW_Adapt_Timebase;
    int _TP_COM_TGW_Adapt_SpontanFlag;
    msTimer _tTP_COM_TGW_Adapt;

    // Botschaft TP_MPM_TGW_Nav ID: 745 --- Sendeart 0 cyclicX --- 
    message TP_MPM_TGW_Nav _mTP_MPM_TGW_Nav;
    int _TP_MPM_TGW_Nav_Timebase;
    int _TP_MPM_TGW_Nav_SpontanFlag;
    msTimer _tTP_MPM_TGW_Nav;

    // Botschaft TP_PARK_TGW --- Sendeart 0 cyclicX --- 
    message TP_PARK_TGW _mTP_PARK_TGW;
    int _TP_PARK_TGW_Timebase;
    int _TP_PARK_TGW_SpontanFlag;
    msTimer _tTP_PARK_TGW;

    // Botschaft TP_TELEAID_TGW ID: 739 --- Sendeart 0 cyclicX --- 
    message TP_TELEAID_TGW _mTP_TELEAID_TGW;
    int _TP_TELEAID_TGW_Timebase;
    int _TP_TELEAID_TGW_SpontanFlag;
    msTimer _tTP_TELEAID_TGW;

    // Botschaft TP_WPT_IC ID: 1230 --- Sendeart 0 cyclicX --- 
    message TP_WPT_IC _mTP_WPT_IC;
    int _TP_WPT_IC_Timebase;
    int _TP_WPT_IC_SpontanFlag;
    msTimer _tTP_WPT_IC;

    // Botschaft TP_WPT_TGW ID: 643 --- Sendeart 0 cyclicX --- 
    message TP_WPT_TGW _mTP_WPT_TGW;
    int _TP_WPT_TGW_Timebase;
    int _TP_WPT_TGW_SpontanFlag;
    msTimer _tTP_WPT_TGW;

    // Botschaft Trailer_Stat_AR ID: 865 --- Sendeart 5 cyclicAndSpontanWithDelay --- 
    message Trailer_Stat_AR _mTrailer_Stat_AR;
    int _Trailer_Stat_AR_Timebase;
    int _Trailer_Stat_AR_CycleCount;
    int _Trailer_Stat_AR_StartDelay;
    int _Trailer_Stat_AR_Cnt;
    int _Trailer_Stat_AR_SpontanFlag;
    byte _Trailer_Stat_AR_CRC_Offset[16] = { 164, 239,  63, 138, 213,  37, 112, 187,  11,  86, 161, 236,  60, 135, 210,  34 };
    msTimer _tTrailer_Stat_AR;

    // Botschaft TSA_Disp_Rq1_AR ID: 213 --- Sendeart 0 cyclicX --- 
    message TSA_Disp_Rq1_AR _mTSA_Disp_Rq1_AR;
    int _TSA_Disp_Rq1_AR_Timebase;
    int _TSA_Disp_Rq1_AR_CycleCount;
    int _TSA_Disp_Rq1_AR_StartDelay;
    int _TSA_Disp_Rq1_AR_MinDelay;
    int _TSA_Disp_Rq1_AR_Cnt;
    int _TSA_Disp_Rq1_AR_DelayCnt;
    int _TSA_Disp_Rq1_AR_SpontanFlag;
    msTimer _tTSA_Disp_Rq1_AR;

    // Botschaft TSA_Disp_Rq2_AR ID: 1051 --- Sendeart 0 cyclicX --- 
    message TSA_Disp_Rq2_AR _mTSA_Disp_Rq2_AR;
    int _TSA_Disp_Rq2_AR_Timebase;
    int _TSA_Disp_Rq2_AR_CycleCount;
    int _TSA_Disp_Rq2_AR_StartDelay;
    int _TSA_Disp_Rq2_AR_Cnt;
    byte _TSA_Disp_Rq2_AR_framecount;
    msTimer _tTSA_Disp_Rq2_AR;

    // Botschaft VehDyn_Stat1_AR --- Sendeart 0 cyclicX --- 
    message VehDyn_Stat1_AR _mVehDyn_Stat1_AR;
    int _VehDyn_Stat1_AR_Timebase;
    int _VehDyn_Stat1_AR_CycleCount;
    int _VehDyn_Stat1_AR_StartDelay;
    int _VehDyn_Stat1_AR_Cnt;
    byte _VehDyn_Stat1_AR_CRC_Offset[16] = { 124, 120, 116, 112, 108, 104, 100,  96,  92,  88,  84,  80,  76,  72,  68,  64 };
    msTimer _tVehDyn_Stat1_AR;

    // Botschaft VehDyn_Stat2_AR --- Sendeart 0 cyclicX --- 
    message VehDyn_Stat2_AR _mVehDyn_Stat2_AR;
    int _VehDyn_Stat2_AR_Timebase;
    int _VehDyn_Stat2_AR_CycleCount;
    int _VehDyn_Stat2_AR_StartDelay;
    int _VehDyn_Stat2_AR_Cnt;
    byte _VehDyn_Stat2_AR_CRC_Offset[16] = { 163,  16, 120, 224,  77, 181,  34, 138, 242,  95, 199,  52, 156,   9, 113, 217 };
    msTimer _tVehDyn_Stat2_AR;

    // Botschaft VehLvl_Stat_AR ID: 172 --- Sendeart 0 cyclicX --- 
    message VehLvl_Stat_AR _mVehLvl_Stat_AR;
    int _VehLvl_Stat_AR_Timebase;
    int _VehLvl_Stat_AR_CycleCount;
    int _VehLvl_Stat_AR_StartDelay;
    int _VehLvl_Stat_AR_Cnt;
    byte _VehLvl_Stat_AR_CRC_Offset[16] = { 114,  51, 239, 176, 113,  50, 238, 175, 112,  49, 237, 174, 111,  48, 236, 173 };
    msTimer _tVehLvl_Stat_AR;

    // Botschaft VehPwrMngmnt_EMM_Stat2_AR ID: 1185 --- Sendeart 5 cyclicAndSpontanWithDelay --- 
    message VehPwrMngmnt_EMM_Stat2_AR _mVehPwrMngmnt_EMM_Stat2_AR;
    int _VehPwrMngmnt_EMM_Stat2_AR_Timebase;
    int _VehPwrMngmnt_EMM_Stat2_AR_CycleCount;
    int _VehPwrMngmnt_EMM_Stat2_AR_StartDelay;
    int _VehPwrMngmnt_EMM_Stat2_AR_MinDelay;
    int _VehPwrMngmnt_EMM_Stat2_AR_Cnt;
    int _VehPwrMngmnt_EMM_Stat2_AR_SpontanFlag;
    int _VehPwrMngmnt_EMM_Stat2_AR_DelayCnt;
    byte _VehPwrMngmnt_EMM_Stat2_AR_CRC_Offset[16] = {  18,  90, 162, 234,  55, 127, 199,  20,  92, 164, 236,  57, 129, 201,  22,  94 };
    msTimer _tVehPwrMngmnt_EMM_Stat2_AR;

    // Botschaft VehSpd_X_AR --- Sendeart 0 cyclicX --- 
    message VehSpd_X_AR _mVehSpd_X_AR;
    int _VehSpd_X_AR_Timebase;
    int _VehSpd_X_AR_CycleCount;
    int _VehSpd_X_AR_StartDelay;
    int _VehSpd_X_AR_Cnt;
    byte _VehSpd_X_AR_CRC_Offset[16] = { 59, 75, 91, 107, 123, 139, 155, 171, 187, 203, 219, 235, 251, 16, 32, 48 };
    msTimer _tVehSpd_X_AR;

    // Botschaft VIN_AR ID: 113 --- Sendeart 1 spontanX --- 
    message VIN_AR _mVIN_AR;
    int _VIN_AR_Timebase;
    int _VIN_AR_SpontanFlag;
    msTimer _tVIN_AR;

    // Botschaft VTA_Event_Disp_AR ID: 1194 --- Sendeart 5 cyclicAndSpontanWithDelay --- 
    message VTA_Event_Disp_AR _mVTA_Event_Disp_AR;
    int _VTA_Event_Disp_AR_Timebase;
    int _VTA_Event_Disp_AR_CycleCount;
    int _VTA_Event_Disp_AR_StartDelay;
    int _VTA_Event_Disp_AR_MinDelay;
    int _VTA_Event_Disp_AR_Cnt;
    int _VTA_Event_Disp_AR_SpontanFlag;
    int _VTA_Event_Disp_AR_DelayCnt;
    msTimer _tVTA_Event_Disp_AR;

    // Botschaft Whl_Lt_Stat_AR ID: 161 --- Sendeart 0 cyclicX --- 
    message Whl_Lt_Stat_AR _mWhl_Lt_Stat_AR;
    int _Whl_Lt_Stat_AR_Timebase;
    int _Whl_Lt_Stat_AR_CycleCount;
    int _Whl_Lt_Stat_AR_StartDelay;
    int _Whl_Lt_Stat_AR_Cnt;
    byte _Whl_Lt_Stat_AR_CRC_Offset[16] = { 135, 212,  38, 115, 192,  18,  95, 172, 249,  75, 152, 229,  55, 132, 209,  35 };
    msTimer _tWhl_Lt_Stat_AR;

    // Botschaft Whl_Rt_Stat_AR ID: 163 --- Sendeart 0 cyclicX --- 
    message Whl_Rt_Stat_AR _mWhl_Rt_Stat_AR;
    int _Whl_Rt_Stat_AR_Timebase;
    int _Whl_Rt_Stat_AR_CycleCount;
    int _Whl_Rt_Stat_AR_StartDelay;
    int _Whl_Rt_Stat_AR_Cnt;
    byte _Whl_Rt_Stat_AR_CRC_Offset[16] = {  39, 128, 217,  55, 144, 233,  71, 160, 249,  87, 176,  14, 103, 192,  30, 119 };
    msTimer _tWhl_Rt_Stat_AR;

    // Botschaft WhlPlsCnt_TPM_AR --- Sendeart 0 cyclicX --- 
    message WhlPlsCnt_TPM_AR _mWhlPlsCnt_TPM_AR;
    int _WhlPlsCnt_TPM_AR_Timebase;
    int _WhlPlsCnt_TPM_AR_CycleCount;
    int _WhlPlsCnt_TPM_AR_StartDelay;
    int _WhlPlsCnt_TPM_AR_Cnt;
    byte _WhlPlsCnt_TPM_AR_CRC_Offset[16] = { 136, 194, 252,  59, 117, 175, 233,  40,  98, 156, 214,  21,  79, 137, 195, 253 };
    msTimer _tWhlPlsCnt_TPM_AR;

    // Botschaft WIA_EngTrq_AR ID: 1149 --- Sendeart 5 cyclicAndSpontanWithDelay --- 
    message WIA_EngTrq_AR _mWIA_EngTrq_AR;
    int _WIA_EngTrq_AR_Timebase;
    int _WIA_EngTrq_AR_CycleCount;
    int _WIA_EngTrq_AR_StartDelay;
    int _WIA_EngTrq_AR_Cnt;
    int _WIA_EngTrq_AR_SpontanFlag;
    msTimer _tWIA_EngTrq_AR;

    // Botschaft Wpr_Stat_AR ID: 845 --- Sendeart 5 cyclicAndSpontanWithDelay --- 
    message Wpr_Stat_AR _mWpr_Stat_AR;
    int _Wpr_Stat_AR_Timebase;
    int _Wpr_Stat_AR_CycleCount;
    int _Wpr_Stat_AR_StartDelay;
    int _Wpr_Stat_AR_Cnt;
    int _Wpr_Stat_AR_SpontanFlag;
    msTimer _tWpr_Stat_AR;

    // Botschaft WPT_Stat2_AR ID: 634 --- Sendeart 5 cyclicAndSpontanWithDelay --- 
    message WPT_Stat2_AR _mWPT_Stat2_AR;
    int _WPT_Stat2_AR_Timebase;
    int _WPT_Stat2_AR_CycleCount;
    int _WPT_Stat2_AR_StartDelay;
    int _WPT_Stat2_AR_Cnt;
    int _WPT_Stat2_AR_SpontanFlag;
    msTimer _tWPT_Stat2_AR;

    // Botschaft XCP_Rq_RBTM_FL --- Sendeart 5 cyclicAndSpontanWithDelay --- 
    message XCP_Rq_RBTM_FL _mXCP_Rq_RBTM_FL;
    int _XCP_Rq_RBTM_FL_Timebase;
    int _XCP_Rq_RBTM_FL_CycleCount = 50;
    int _XCP_Rq_RBTM_FL_StartDelay;
    int _XCP_Rq_RBTM_FL_MinDelay = 5;
    int _XCP_Rq_RBTM_FL_Cnt;
    int _XCP_Rq_RBTM_FL_SpontanFlag = 0;
    int _XCP_Rq_RBTM_FL_DelayCnt;

    // Botschaft XCP_Rq_RBTM_FR --- Sendeart 5 cyclicAndSpontanWithDelay --- 
    message XCP_Rq_RBTM_FR _mXCP_Rq_RBTM_FR;
    int _XCP_Rq_RBTM_FR_Timebase;
    int _XCP_Rq_RBTM_FR_CycleCount = 50;
    int _XCP_Rq_RBTM_FR_StartDelay;
    int _XCP_Rq_RBTM_FR_MinDelay = 5;
    int _XCP_Rq_RBTM_FR_Cnt;
    int _XCP_Rq_RBTM_FR_SpontanFlag = 0;
    int _XCP_Rq_RBTM_FR_DelayCnt;

// #VAR_DEF_END#
    Timer t_DoorNMCancelTimer;
    Timer t_KeyInLockNMCancelTimer;
    Timer t_StWhlButtonNMCancelTimer;
    Timer t_WakeWarningNMCancelTimer;
    Timer t_CarClosureNMCancelTimer;
    Timer t_EPKBWarningNMCancelTimer;
    Timer t_IlluNMCancelTimer;
    Timer t_GearIndNMCancelTimer;
    const byte c_NMCancelTimer_05sec = 5;
    const byte c_NMCancelTimer_30sec = 30;

    char buffer[1024], stringbuffer[512];
    int bActiveHelper;    // Hilfsvariable für "Aktive Signale"

//--------------------------------------- AUTOSAR NM ------------------------------------------------

    const byte cAUTO =   0;
    const byte cMANUAL = 1;

    msTimer t_NM_Transmit;
    long  NM_Transmit_Cycle;
    msTimer t_NM_Wait_Bus_Sleep_Time;
    const c_NM_Wait_Bus_Sleep_Time = 1500;
//    msTimer t_NM_Remote_Sleep_Ind_Time;
    const c_NM_Remote_Sleep_Ind_Time = 5000;
    msTimer t_NM_Repeat_Message_Time;
    const c_NM_Repeat_Message_Time = 6000;
    msTimer t_NM_Timeout_Time;
    const c_NM_Timeout_Time = 5000;

    byte NM_Mode = 0;
    const byte cNM_Mode_Init = 0;
    const byte cNM_Mode_Sleep = 1;
    const byte cNM_Mode_Prepare_Bus_Sleep = 2;
    const byte cNM_Mode_Ready_Sleep = 3;
    const byte cNM_Mode_Normal_Operation_State = 4;
    const byte cNM_Mode_RepeatMsg = 5;

    byte boCanNM_Rx_Indication = 0;
    byte boCanNM_Tx_Confirmation = 0;
    byte boCanNM_WaitBusSleep_Timer_Expired = 0;
    byte boCanNM_RepeatMessage_Timer_Expired = 0;
    byte boCanNM_NM_Timeout_Timer_Expired = 0;
    byte boCanNM_RepeatMessage_Requested = 0;

    const word cFLDoorNMRequest =       0x0001;
    const word cFRDoorNMRequest =       0x0002;
    const word cRLDoorNMRequest =       0x0004;
    const word cRRDoorNMRequest =       0x0008;
    const word cAllDoorNMRequest =      0x000F;
    const word cIgnitionNMRequest =     0x0010;
    const word cStWhlButtonNMRequest =  0x0020;
    const word cWakeWarningNMRequest =  0x0040;
    const word cEPKBWarningNMRequest =  0x0080;
    const word cIlluNMRequest =         0x0100;
    const word cCarClosureNMRequest =   0x0200;
    const word cGearIndNMRequest =      0x0400;
    const word cLowBeamNMRequest =      0x0800;

    const word cManualNMRequest =       0x8000;
    const word cAllNMRequest =          0xFFFF;

    const CanNmNodeId_Base =       1280; //  =  07h
    const CanNmNodeId_APM =          76; //  =  4Ch
    const CanNmNodeId_DRVU =         77; //  =  4Dh
    const CanNmNodeId_EIS =           7; //  =  07h
    const CanNmNodeId_HGW =          27; //  =  07h
    const CanNmNodeId_TGW =          56; //  =  38h
    const CanNmNodeId_RBTM_FR =      64; //  =  40h
    const CanNmNodeId_IC =           65; //  =  41h
    const CanNmNodeId_HUD =          66; //  =  42h
    const CanNmNodeId_NV =           67; //  =  43h
    const CanNmNodeId_RVC_SVS =      68; //  =  44h
    const CanNmNodeId_ORC =          69; //  =  45h
    const CanNmNodeId_RBTM_FL =      71; //  =  47h
    const CanNmNodeId_TPM =          82; //  =  52h

    const CanNmNodeDetectionEnabled          = 0; //false
    const CanNmNodeIdEnabled                 = 1; //true
    const CanNmUserDataEnabled               = 1; //true;
    const CanNmUserDataLentgh                = 7;
    const CanNmRepeatMsgIndEnabled           = 1; //true;
    const CanNmDevErrorDetect                = 0; //false
//    const CanNmUserDataEnabled             = 1; //true
    const CanNmRemoteSleepIndEnabled         = 0; //false
    const CanNmMsgReducedtime                = 80; //ms
    const CanNmPduRxIndicationEnabled        = 0; //false
    const CanNmStateChangeIndEnabled         = 0; //false
    const CanNmImmediateTxconfEnabled        = 0;// false
    const CanNmMsgTimeoutTime                = 5000; //ms
    const CanNmPduNidPosition                = 0; //CANNM_PDU_BYTE_0;
    const CanNmPduCbvPosition                = 0xFF; //ANNM_PDU_OFF;
    const CanNmPduLength                     = 8;
    const cCanNmPassiveModeEnabled           = 0; //false
    const CanNmBusSynchronizationEnabled     = 0; //false
    const CanNmBusLoadReductionEnabled       = 1; //true
//    const CanNmRemoteSleepIndEnabled       = 0; //false
//    const CanNmNodeDetectionEnabled        = 0; //false
    const CanNmComControlEnabled             = 1; //true    

    const NmAsrCanMsgStandardCycle =          2000;
    const NmAsrCanMsgCycleOffset_APM =          40;
    const NmAsrCanMsgReducedTime_APM =        1760;
    const NmAsrCanMsgCycleOffset_DRVU =         50;
    const NmAsrCanMsgReducedTime_DRVU =       1770;
    const NmAsrCanMsgCycleOffset_EIS =          70;
    const NmAsrCanMsgReducedTime_EIS =        1070;
    const NmAsrCanMsgCycleOffset_HGW =          30;
    const NmAsrCanMsgReducedTime_HGW =        1270;
    const NmAsrCanMsgCycleOffset_HUD =          20;
    const NmAsrCanMsgReducedTime_HUD =        1660;
    const NmAsrCanMsgCycleOffset_IC =           10;
    const NmAsrCanMsgReducedTime_IC =         1650;
    const NmAsrCanMsgCycleOffset_NV =           30;
    const NmAsrCanMsgReducedTime_NV =         1670;
    const NmAsrCanMsgCycleOffset_ORC =          50;
    const NmAsrCanMsgReducedTime_ORC =        1690;
    const NmAsrCanMsgCycleOffset_RBTM_FL =       0;
    const NmAsrCanMsgReducedTime_RBTM_FL =    1640;
    const NmAsrCanMsgCycleOffset_RBTM_FR =      70;
    const NmAsrCanMsgReducedTime_RBTM_FR =    1710;
    const NmAsrCanMsgCycleOffset_RVC =          40;
    const NmAsrCanMsgReducedTime_RVC =        1680;
    const NmAsrCanMsgCycleOffset_SVS =          40;
    const NmAsrCanMsgReducedTime_SVS =        1680;
    const NmAsrCanMsgCycleOffset_TGW =           0;
    const NmAsrCanMsgReducedTime_TGW =        1560;
    const NmAsrCanMsgCycleOffset_TPM =          20;
    const NmAsrCanMsgReducedTime_TPM =        1820;

    char gECU[12] = "HMI_EIS";

    byte CanNmNodeId            = CanNmNodeId_EIS;
    word NmNodeIdentifier       = CanNmNodeId_Base + CanNmNodeId_EIS;
    word NmAsrCanMsgCycleOffset = NmAsrCanMsgCycleOffset_EIS;
    word NmAsrCanMsgReducedTime = NmAsrCanMsgReducedTime_EIS;
    word NmAsrCanMsgCycleTime   = 2000;
    byte NM_Repeat_Message_State_Active = 0;
    byte NM_AutomaticModeActive = 0;

    // Botschaft NM_xxx_AR --- Sendeart cyclicX --- 
    message NM_EIS_AR _mNM_xxx_AR;
    byte _mNM_xxx_Transmit_Allowed = 1;

//--------------------------------------- AUTOSAR NM ------------------------------------------------

    byte  crctable[256] = {
        0x00, 0x1D, 0x3A, 0x27, 0x74, 0x69, 0x4E, 0x53, 0xE8, 0xF5, 0xD2, 0xCF, 0x9C, 0x81, 0xA6, 0xBB,
        0xCD, 0xD0, 0xF7, 0xEA, 0xB9, 0xA4, 0x83, 0x9E, 0x25, 0x38, 0x1F, 0x02, 0x51, 0x4C, 0x6B, 0x76,
        0x87, 0x9A, 0xBD, 0xA0, 0xF3, 0xEE, 0xC9, 0xD4, 0x6F, 0x72, 0x55, 0x48, 0x1B, 0x06, 0x21, 0x3C,
        0x4A, 0x57, 0x70, 0x6D, 0x3E, 0x23, 0x04, 0x19, 0xA2, 0xBF, 0x98, 0x85, 0xD6, 0xCB, 0xEC, 0xF1,
        0x13, 0x0E, 0x29, 0x34, 0x67, 0x7A, 0x5D, 0x40, 0xFB, 0xE6, 0xC1, 0xDC, 0x8F, 0x92, 0xB5, 0xA8,
        0xDE, 0xC3, 0xE4, 0xF9, 0xAA, 0xB7, 0x90, 0x8D, 0x36, 0x2B, 0x0C, 0x11, 0x42, 0x5F, 0x78, 0x65,
        0x94, 0x89, 0xAE, 0xB3, 0xE0, 0xFD, 0xDA, 0xC7, 0x7C, 0x61, 0x46, 0x5B, 0x08, 0x15, 0x32, 0x2F,
        0x59, 0x44, 0x63, 0x7E, 0x2D, 0x30, 0x17, 0x0A, 0xB1, 0xAC, 0x8B, 0x96, 0xC5, 0xD8, 0xFF, 0xE2,
        0x26, 0x3B, 0x1C, 0x01, 0x52, 0x4F, 0x68, 0x75, 0xCE, 0xD3, 0xF4, 0xE9, 0xBA, 0xA7, 0x80, 0x9D,
        0xEB, 0xF6, 0xD1, 0xCC, 0x9F, 0x82, 0xA5, 0xB8, 0x03, 0x1E, 0x39, 0x24, 0x77, 0x6A, 0x4D, 0x50,
        0xA1, 0xBC, 0x9B, 0x86, 0xD5, 0xC8, 0xEF, 0xF2, 0x49, 0x54, 0x73, 0x6E, 0x3D, 0x20, 0x07, 0x1A,
        0x6C, 0x71, 0x56, 0x4B, 0x18, 0x05, 0x22, 0x3F, 0x84, 0x99, 0xBE, 0xA3, 0xF0, 0xED, 0xCA, 0xD7,
        0x35, 0x28, 0x0F, 0x12, 0x41, 0x5C, 0x7B, 0x66, 0xDD, 0xC0, 0xE7, 0xFA, 0xA9, 0xB4, 0x93, 0x8E,
        0xF8, 0xE5, 0xC2, 0xDF, 0x8C, 0x91, 0xB6, 0xAB, 0x10, 0x0D, 0x2A, 0x37, 0x64, 0x79, 0x5E, 0x43,
        0xB2, 0xAF, 0x88, 0x95, 0xC6, 0xDB, 0xFC, 0xE1, 0x5A, 0x47, 0x60, 0x7D, 0x2E, 0x33, 0x14, 0x09,
        0x7F, 0x62, 0x45, 0x58, 0x0B, 0x16, 0x31, 0x2C, 0x97, 0x8A, 0xAD, 0xB0, 0xE3, 0xFE, 0xD9, 0xC4
    };

    byte  crctable_profile02[256] = {
        0x00, 0x2F, 0x5E, 0x71, 0xBC, 0x93, 0xE2, 0xCD, 0x57, 0x78, 0x09, 0x26, 0xEB, 0xC4, 0xB5, 0x9A,
        0xAE, 0x81, 0xF0, 0xDF, 0x12, 0x3D, 0x4C, 0x63, 0xF9, 0xD6, 0xA7, 0x88, 0x45, 0x6A, 0x1B, 0x34,
        0x73, 0x5C, 0x2D, 0x02, 0xCF, 0xE0, 0x91, 0xBE, 0x24, 0x0B, 0x7A, 0x55, 0x98, 0xB7, 0xC6, 0xE9,
        0xDD, 0xF2, 0x83, 0xAC, 0x61, 0x4E, 0x3F, 0x10, 0x8A, 0xA5, 0xD4, 0xFB, 0x36, 0x19, 0x68, 0x47,
        0xE6, 0xC9, 0xB8, 0x97, 0x5A, 0x75, 0x04, 0x2B, 0xB1, 0x9E, 0xEF, 0xC0, 0x0D, 0x22, 0x53, 0x7C,
        0x48, 0x67, 0x16, 0x39, 0xF4, 0xDB, 0xAA, 0x85, 0x1F, 0x30, 0x41, 0x6E, 0xA3, 0x8C, 0xFD, 0xD2,
        0x95, 0xBA, 0xCB, 0xE4, 0x29, 0x06, 0x77, 0x58, 0xC2, 0xED, 0x9C, 0xB3, 0x7E, 0x51, 0x20, 0x0F,
        0x3B, 0x14, 0x65, 0x4A, 0x87, 0xA8, 0xD9, 0xF6, 0x6C, 0x43, 0x32, 0x1D, 0xD0, 0xFF, 0x8E, 0xA1,
        0xE3, 0xCC, 0xBD, 0x92, 0x5F, 0x70, 0x01, 0x2E, 0xB4, 0x9B, 0xEA, 0xC5, 0x08, 0x27, 0x56, 0x79,
        0x4D, 0x62, 0x13, 0x3C, 0xF1, 0xDE, 0xAF, 0x80, 0x1A, 0x35, 0x44, 0x6B, 0xA6, 0x89, 0xF8, 0xD7,
        0x90, 0xBF, 0xCE, 0xE1, 0x2C, 0x03, 0x72, 0x5D, 0xC7, 0xE8, 0x99, 0xB6, 0x7B, 0x54, 0x25, 0x0A,
        0x3E, 0x11, 0x60, 0x4F, 0x82, 0xAD, 0xDC, 0xF3, 0x69, 0x46, 0x37, 0x18, 0xD5, 0xFA, 0x8B, 0xA4,
        0x05, 0x2A, 0x5B, 0x74, 0xB9, 0x96, 0xE7, 0xC8, 0x52, 0x7D, 0x0C, 0x23, 0xEE, 0xC1, 0xB0, 0x9F,
        0xAB, 0x84, 0xF5, 0xDA, 0x17, 0x38, 0x49, 0x66, 0xFC, 0xD3, 0xA2, 0x8D, 0x40, 0x6F, 0x1E, 0x31,
        0x76, 0x59, 0x28, 0x07, 0xCA, 0xE5, 0x94, 0xBB, 0x21, 0x0E, 0x7F, 0x50, 0x9D, 0xB2, 0xC3, 0xEC,
        0xD8, 0xF7, 0x86, 0xA9, 0x64, 0x4B, 0x3A, 0x15, 0x8F, 0xA0, 0xD1, 0xFE, 0x33, 0x1C, 0x6D, 0x42
    };
}
/*@@end*/

/*@@startStart:Start:*/
on start
{
    putValue( HMI__NM_EIS_NM_Request, 0 );  // reset all requests
    _NM_Switch_NM_Mode();
    
    __EIS_Init_Msg();
    __EIS_Startup_Delay();
    __EIS_Reset_E2E_SQC();
   
    putValue( HMI__NM_EIS_AutomaticModeActive, 0 );
    putValue( HMI__NM_EIS_AutomaticModeActive, 1 );
}
/*@@end*/

/*@@caplFunc:__EIS_Init_Msg():*/
__EIS_Init_Msg()
{
// #START_INIT#
    AB_R_Stat_AR_init();                 // Botschaft AB_R_Stat_AR                 --- Sendeart 5 cyclicAndSpontanWithDelay --- 
    Adapt_Seat_D_Stat_AR_init();                 // Botschaft Adapt_Seat_D_Stat_AR                 --- Sendeart 5 cyclicAndSpontanWithDelay --- 
    Adblue_Disp_Rq_AR_init();                 // Botschaft Adblue_Disp_Rq_AR                 --- Sendeart 5 cyclicAndSpontanWithDelay --- 
    Adblue_Disp_Warn_Rq_AR_init();                 // Botschaft Adblue_Disp_Warn_Rq_AR                 --- Sendeart 5 cyclicAndSpontanWithDelay --- 
    Assyst_Stat_AR_init();                 // Botschaft Assyst_Stat_AR                 --- Sendeart 5 cyclicAndSpontanWithDelay --- 
    Assyst_Stat2_AR_init();                 // Botschaft Assyst_Stat2_AR                 --- Sendeart 5 cyclicAndSpontanWithDelay --- 
    Assyst_Stat3_AR_init();                 // Botschaft Assyst_Stat3_AR                 --- Sendeart  --- 
    AWD_TCASE_Disp_Rq_AR_init();                 // Botschaft AWD_TCASE_Disp_Rq_AR                 --- Sendeart  --- 
    BC_F_Disp_Rq_AR_init();                 // Botschaft BC_F_Disp_Rq_AR                 --- Sendeart 5 cyclicAndSpontanWithDelay --- 
    BC_F_Stat1_AR_init();                 // Botschaft BC_F_Stat1_AR                 --- Sendeart 5 cyclicAndSpontanWithDelay --- 
    BC_F_Stat2_AR_init();                 // Botschaft BC_F_Stat2_AR                 --- Sendeart 5 cyclicAndSpontanWithDelay --- 
    BC_R_Stat1_AR_init();                 // Botschaft BC_R_Stat1_AR                 --- Sendeart 5 cyclicAndSpontanWithDelay --- 
    BC_R_Stat2_AR_init();                 // Botschaft BC_R_Stat2_AR                 --- Sendeart 5 cyclicAndSpontanWithDelay --- 
    BODY_HMI_R0_AR_init();                 // Botschaft BODY_HMI_R0_AR                 --- Sendeart 5 cyclicAndSpontanWithDelay --- 
    BODY_HMI_R1_AR_init();                 // Botschaft BODY_HMI_R1_AR                 --- Sendeart 5 cyclicAndSpontanWithDelay --- 
    BODY_HMI_R2_AR_init();                 // Botschaft BODY_HMI_R2_AR                 --- Sendeart 5 cyclicAndSpontanWithDelay --- 
    BSM_Disp_Warn_Rq_AR_init();                 // Botschaft BSM_Disp_Warn_Rq_AR                 --- Sendeart 5 cyclicAndSpontanWithDelay --- 
    CamLane_Disp_Warn_Rq_AR_init();                 // Botschaft CamLane_Disp_Warn_Rq_AR                 --- Sendeart 5 cyclicAndSpontanWithDelay --- 
    CHASSIS_HMI_R0_AR_init();                 // Botschaft CHASSIS_HMI_R0_AR                 --- Sendeart 5 cyclicAndSpontanWithDelay --- 
    CHASSIS_HMI_R1_AR_init();                 // Botschaft CHASSIS_HMI_R1_AR                 --- Sendeart 5 cyclicAndSpontanWithDelay --- 
    CHASSIS_HMI_R2_AR_init();                 // Botschaft CHASSIS_HMI_R2_AR                 --- Sendeart 5 cyclicAndSpontanWithDelay --- 
    CHASSIS_HMI_R3_AR_init();                 // Botschaft CHASSIS_HMI_R3_AR                 --- Sendeart 5 cyclicAndSpontanWithDelay --- 
    CHASSIS_HMI_R4_AR_init();                 // Botschaft CHASSIS_HMI_R4_AR                 --- Sendeart 5 cyclicAndSpontanWithDelay --- 
    CHASSISPERIPHERY_HMI_R1_AR_init();                 // Botschaft CHASSISPERIPHERY_HMI_R1_AR                 --- Sendeart 5 cyclicAndSpontanWithDelay --- 
    CLkS_Rq_AR_init();                 // Botschaft CLkS_Rq_AR                 --- Sendeart 5 cyclicAndSpontanWithDelay --- 
    CLkS_State_AR_init();                 // Botschaft CLkS_State_AR                 --- Sendeart 5 cyclicAndSpontanWithDelay --- 
    ClockSync_Stat_AR_init();                 // Botschaft ClockSync_Stat_AR                 --- Sendeart 5 cyclicAndSpontanWithDelay --- 
    CMS_PI_Sd_Stat_AR_init();                 // Botschaft CMS_PI_Sd_Stat_AR                 --- Sendeart 5 cyclicAndSpontanWithDelay --- 
    CMS_PI_Stat_AR_init();                 // Botschaft CMS_PI_Stat_AR                 --- Sendeart 5 cyclicAndSpontanWithDelay --- 
    CNG_Disp_Rq_AR_init();                 // Botschaft CNG_Disp_Rq_AR                 --- Sendeart 5 cyclicAndSpontanWithDelay --- 
    COM_Call_Stat_AR_init();                 // Botschaft COM_Call_Stat_AR                 --- Sendeart 5 cyclicAndSpontanWithDelay --- 
    COMM_EIS_WMI_AR_init();                 // Botschaft COMM_EIS_WMI_AR                 --- Sendeart 5 cyclicAndSpontanWithDelay --- 
    CRCM_Disp_Rq_AR_init();                 // Botschaft CRCM_Disp_Rq_AR                 --- Sendeart 5 cyclicAndSpontanWithDelay --- 
    CU_RemFunc_Rq3_AR_init();
    DidA_MBContact_State_AR_init();                 // Botschaft DidA_MBContact_State_AR                 --- Sendeart 5 cyclicAndSpontanWithDelay --- 
    Door_FL_Stat_AR_init();                 // Botschaft Door_FL_Stat_AR                 --- Sendeart 5 cyclicAndSpontanWithDelay --- 
    Door_FR_Stat_AR_init();                 // Botschaft Door_FR_Stat_AR                 --- Sendeart 5 cyclicAndSpontanWithDelay --- 
    Door_RL_Stat_AR_init();                 // Botschaft Door_RL_Stat_AR                 --- Sendeart 5 cyclicAndSpontanWithDelay --- 
    Door_RR_Stat_AR_init();                 // Botschaft Door_RR_Stat_AR                 --- Sendeart 5 cyclicAndSpontanWithDelay --- 
    DPC_Disp_Rq_AR_init();                 // Botschaft DPC_Disp_Rq_AR                 --- Sendeart 5 cyclicAndSpontanWithDelay --- 
    DPC_IndMd_Stat_AR_init();                 // Botschaft DPC_IndMd_Stat_AR                 --- Sendeart 5 cyclicAndSpontanWithDelay --- 
    DPC_IndMd_Style_AR_init();                 // Botschaft DPC_IndMd_Style_AR                 --- Sendeart 5 cyclicAndSpontanWithDelay --- 
    DPC_IndMd_Style2_AR_init();                 // Botschaft DPC_IndMd_Style2_AR                 --- Sendeart 5 cyclicAndSpontanWithDelay --- 
    DPC_Master_Rq_AR_init();                 // Botschaft DPC_Master_Rq_AR                 --- Sendeart 5 cyclicAndSpontanWithDelay --- 
    ECO_Score_Disp_Rq_AR_init();                 // Botschaft ECO_Score_Disp_Rq_AR                 --- Sendeart 5 cyclicAndSpontanWithDelay --- 
    EL_Ft_Disp_Rq_AR_init();                 // Botschaft EL_Ft_Disp_Rq_AR                 --- Sendeart 5 cyclicAndSpontanWithDelay --- 
    EL_R_Disp_Rq_AR_init();                 // Botschaft EL_R_Disp_Rq_AR                 --- Sendeart 5 cyclicAndSpontanWithDelay --- 
    EL_Stat_AR_init();                 // Botschaft EL_Stat_AR                 --- Sendeart 5 cyclicAndSpontanWithDelay --- 
    EL_TurnInd_Rq_AR_init();                 // Botschaft EL_TurnInd_Rq_AR                 --- Sendeart 5 cyclicAndSpontanWithDelay --- 
    Eng_Rs_EngCtrl_AR_init();                 // Botschaft Eng_Rs_EngCtrl_AR                 --- Sendeart 5 cyclicAndSpontanWithDelay --- 
    Eng_Rs2_AR_init();                 // Botschaft Eng_Rs2_AR                 --- Sendeart 5 cyclicAndSpontanWithDelay --- 
    EngCtrl_Disp_Rq_AR_init();                 // Botschaft EngCtrl_Disp_Rq_AR                 --- Sendeart 5 cyclicAndSpontanWithDelay --- 
    EngCtrl_Stat_AR_init();                 // Botschaft EngCtrl_Stat_AR                 --- Sendeart 5 cyclicAndSpontanWithDelay --- 
    EPKB_Disp_IndLmp_Rq_2_AR_init();                 // Botschaft EPKB_Disp_IndLmp_Rq_2_AR                 --- Sendeart 5 cyclicAndSpontanWithDelay --- 
    EPS_Stat_Disp_Rq_AR_init();                 // Botschaft EPS_Stat_Disp_Rq_AR                 --- Sendeart 5 cyclicAndSpontanWithDelay --- 
    ESP_Disp_Rq_AR_init();                 // Botschaft ESP_Disp_Rq_AR                 --- Sendeart 5 cyclicAndSpontanWithDelay --- 
    ESP_Disp_Rq2_AR_init();                 // Botschaft ESP_Disp_Rq2_AR                 --- Sendeart 5 cyclicAndSpontanWithDelay --- 
    ESP_Disp_Rq3_AR_init();                 // Botschaft ESP_Disp_Rq3_AR                 --- Sendeart 5 cyclicAndSpontanWithDelay --- 
    ESP_Disp_Rq_AMG_AR_init();
    EVC_CfgBit_01_32_AR_init();
    EVC_CfgBit_33_64_AR_init();
    EVC_CfgBit_65_96_AR_init();
    EVC_CfgBit_97_C8_AR_init();
    EVC_CfgList_01_0C_AR_init();
    FBL_CFG_Star2_AR_init();
    FCW_Disp_Rq_AR_init();
    Fuel_Stat2_AR_init();
    FuelLvl_Stat_AR_init();
    FWLP_D_AR_init();
    FWLP_P_AR_init();
    HumanMachineIfc_AR_init();
    HumanMachineIfc_Rq_AR_init();
    HVAC_Disp_Stat1_AR_init();
    HVAC_Disp_Stat2_AR_init();
    HVAC_Disp_Stat3_AR_init();
    HVAC_State1_AR_init();
    ICH_PreTime_Stat_AR_init();
    ICH_Stat_AR_init();
    Ign_Veh_Stat_AR_init();
    IL_AmbLgt_Disp_AR_init();                 // Botschaft IL_AmbLgt_Disp_AR                 --- Sendeart 5 cyclicAndSpontanWithDelay --- 
    IL_AmbLgtCfg_Stat_AR_init();                 // Botschaft IL_AmbLgtCfg_Stat_AR                 --- Sendeart 5 cyclicAndSpontanWithDelay --- 
    Immobilizer_Disp_Rq_AR_init();                 // Botschaft Immobilizer_Disp_Rq_AR                 --- Sendeart 5 cyclicAndSpontanWithDelay --- 
    Immobilizer_IC_AR_init();                 // Botschaft Immobilizer_IC_AR                 --- Sendeart 5 cyclicAndSpontanWithDelay --- 
    Immobilizer_KeyID_AR_init();                 // Botschaft Immobilizer_KeyID_AR                 --- Sendeart 5 cyclicAndSpontanWithDelay --- 
    KG_Msg_Disp_Rq_AR_init();                 // Botschaft KG_Msg_Disp_Rq_AR                 --- Sendeart 5 cyclicAndSpontanWithDelay --- 
    LDC_Disp_Rq_ESP_AR_init();                 // Botschaft LDC_Disp_Rq_ESP_AR                 --- Sendeart 5 cyclicAndSpontanWithDelay --- 
    LDC_Disp_Rq_RDU_AR_init();                 // Botschaft LDC_Disp_Rq_RDU_AR                 --- Sendeart 5 cyclicAndSpontanWithDelay --- 
    LDP_Warn_Rq_AR_init();                 // Botschaft LDP_Warn_Rq_AR                 --- Sendeart 5 cyclicAndSpontanWithDelay --- 
    LgtSens_State_AR_init();                 // Botschaft LgtSens_State_AR                 --- Sendeart 5 cyclicAndSpontanWithDelay --- 
    MCMS_FL_AR_init();                 // Botschaft MCMS_FL_AR                 --- Sendeart 5 cyclicAndSpontanWithDelay --- 
    MCMS_FL_Stat_AR_init();                 // Botschaft MCMS_FL_Stat_AR                 --- Sendeart 5 cyclicAndSpontanWithDelay --- 
    MCMS_FR_AR_init();                 // Botschaft MCMS_FR_AR                 --- Sendeart 5 cyclicAndSpontanWithDelay --- 
    MCMS_FR_Stat_AR_init();                 // Botschaft MCMS_FR_Stat_AR                 --- Sendeart 5 cyclicAndSpontanWithDelay --- 
    MCMS_RL_AR_init();                 // Botschaft MCMS_RL_AR                 --- Sendeart 5 cyclicAndSpontanWithDelay --- 
    MCMS_RL_Stat_AR_init();                 // Botschaft MCMS_RL_Stat_AR                 --- Sendeart 5 cyclicAndSpontanWithDelay --- 
    MCMS_RR_AR_init();                 // Botschaft MCMS_RR_AR                 --- Sendeart 5 cyclicAndSpontanWithDelay --- 
    MCMS_RR_Stat_AR_init();                 // Botschaft MCMS_RR_Stat_AR                 --- Sendeart 5 cyclicAndSpontanWithDelay --- 
    OffRoad_Disp_Rq_AR_init();                 // Botschaft OffRoad_Disp_Rq_AR                 --- Sendeart 5 cyclicAndSpontanWithDelay --- 
    Park_Disp_Rq_AR_init();                 // Botschaft Park_Disp_Rq_AR                 --- Sendeart 5 cyclicAndSpontanWithDelay --- 
    Park_Set_Stat_AR_init();                 // Botschaft Park_Set_Stat_AR                 --- Sendeart 5 cyclicAndSpontanWithDelay --- 
    ParkSpaceMeas_Stat_AR_init();                 // Botschaft ParkSpaceMeas_Stat_AR                 --- Sendeart 5 cyclicAndSpontanWithDelay --- 
    ParkWarn_AR_init();                 // Botschaft ParkWarn_AR                 --- Sendeart 5 cyclicAndSpontanWithDelay --- 
    PERIPHERY_HMI_R1_AR_init();                 // Botschaft PERIPHERY_HMI_R1_AR                 --- Sendeart 5 cyclicAndSpontanWithDelay --- 
    PN14_Disp_Rq_AR_init();                 // Botschaft PN14_Disp_Rq_AR                 --- Sendeart 5 cyclicAndSpontanWithDelay --- 
    PN14_Disp_Rq2_AR_init();                 // Botschaft PN14_Disp_Rq2_AR                 --- Sendeart 5 cyclicAndSpontanWithDelay --- 
    PN14_Stat_AR_init();                 // Botschaft PN14_Stat_AR                 --- Sendeart 5 cyclicAndSpontanWithDelay --- 
    PN48_Disp_Rq_AR_init();                 // Botschaft PN48_Disp_Rq_AR                 --- Sendeart 5 cyclicAndSpontanWithDelay --- 
    PnHt_Stat_AR_init();                 // Botschaft PnHt_Stat_AR                 --- Sendeart 5 cyclicAndSpontanWithDelay --- 
    PNHV_EnergyMngmnt_Disp_Rq_AR_init();
    PNHV_EnergyMngmnt_Stat2_AR_init();                 // Botschaft PNHV_EnergyMngmnt_Stat2_AR                 --- Sendeart 5 cyclicAndSpontanWithDelay --- 
    PNHV_EnergyMngmntSet_Rs1_AR_init();                 // Botschaft PNHV_EnergyMngmntSet_Rs1_AR                 --- Sendeart 5 cyclicAndSpontanWithDelay --- 
    PNHV_EnergyMngmntSet_Rs2_AR_init();                 // Botschaft PNHV_EnergyMngmntSet_Rs2_AR                 --- Sendeart 5 cyclicAndSpontanWithDelay --- 
    PNHV_WeekDepTmTbl_Stat_AR_init();                 // Botschaft PNHV_WeekDepTmTbl_Stat_AR                 --- Sendeart 5 cyclicAndSpontanWithDelay --- 
    PreCond_CfgStat_AR_init();                 // Botschaft PreCond_CfgStat_AR                 --- Sendeart 5 cyclicAndSpontanWithDelay --- 
    PresfCtrl_Rq_ESP_AR_init();                 // Botschaft PresfCtrl_Rq_ESP_AR                 --- Sendeart 5 cyclicAndSpontanWithDelay --- 
    PT_DataContain_Rq_AR_init();                 // Botschaft PT_DataContain_Rq_AR                 --- Sendeart  --- 
    PT_Disp_Rq2_AR_init();                 // Botschaft PT_Disp_Rq2_AR                 --- Sendeart 5 cyclicAndSpontanWithDelay --- 
    PtHyb_Mngmnt_Rq_AR_init();                 // Botschaft PtHyb_Mngmnt_Rq_AR                 --- Sendeart 5 cyclicAndSpontanWithDelay --- 
    PtMngmnt_Disp_Rq_AR_init();                 // Botschaft PtMngmnt_Disp_Rq_AR                 --- Sendeart 5 cyclicAndSpontanWithDelay --- 
    RDU_Disp_Rq_AR_init();                 // Botschaft RDU_Disp_Rq_AR                 --- Sendeart 5 cyclicAndSpontanWithDelay --- 
    RVC_SVS_Park_Stat_AR_init();                 // Botschaft RVC_SVS_Park_Stat_AR                 --- Sendeart 5 cyclicAndSpontanWithDelay --- 
    SBW_DrvPosn_Disp_Rq_ISM_AR_init();                 // Botschaft SBW_DrvPosn_Disp_Rq_ISM_AR                 --- Sendeart 5 cyclicAndSpontanWithDelay --- 
    SBW_DrvPosn_Disp_Rq_TCM_AR_init();                 // Botschaft SBW_DrvPosn_Disp_Rq_TCM_AR                 --- Sendeart 5 cyclicAndSpontanWithDelay --- 
    Seat_D_Stat_AR_init();                 // Botschaft Seat_D_Stat_AR                 --- Sendeart 5 cyclicAndSpontanWithDelay --- 
    Seat_P_Stat_AR_init();                 // Botschaft Seat_P_Stat_AR                 --- Sendeart 5 cyclicAndSpontanWithDelay --- 
    Seat_RL_Stat_AR_init();                 // Botschaft Seat_RL_Stat_AR                 --- Sendeart 5 cyclicAndSpontanWithDelay --- 
    Seat_RR_Stat_AR_init();                 // Botschaft Seat_RR_Stat_AR                 --- Sendeart 5 cyclicAndSpontanWithDelay --- 
    SeatHtVn_Stat_AR_init();                 // Botschaft SeatHtVn_Stat_AR                 --- Sendeart 5 cyclicAndSpontanWithDelay --- 
    SeatHtVn_Stat2_AR_init();                 // Botschaft SeatHtVn_Stat2_AR                 --- Sendeart 5 cyclicAndSpontanWithDelay --- 
    SeatMem_D_Rq_AR_init();                 // Botschaft SeatMem_D_Rq_AR                 --- Sendeart 5 cyclicAndSpontanWithDelay --- 
    SeatPosn_Abs_D_AR_init();                 // Botschaft SeatPosn_Abs_D_AR                 --- Sendeart 5 cyclicAndSpontanWithDelay --- 
    SeatPosn_Abs_P_AR_init();                 // Botschaft SeatPosn_Abs_P_AR                 --- Sendeart 5 cyclicAndSpontanWithDelay --- 
    SND_GEN_Stat_AR_init();                 // Botschaft SND_GEN_Stat_AR                 --- Sendeart 5 cyclicAndSpontanWithDelay --- 
    SPC_Disp_Rq_AR_init();                 // Botschaft SPC_Disp_Rq_AR                 --- Sendeart 5 cyclicAndSpontanWithDelay --- 
    SPC_SwLED_Msg_Rq_AR_init();                 // Botschaft SPC_SwLED_Msg_Rq_AR                 --- Sendeart 5 cyclicAndSpontanWithDelay --- 
    SPV_Rq_AR_init();                 // Botschaft SPV_Rq_AR                 --- Sendeart 5 cyclicAndSpontanWithDelay --- 
    SPV_Stat_AR_init();                 // Botschaft SPV_Stat_AR                 --- Sendeart 5 cyclicAndSpontanWithDelay --- 
    StWhl_Angl_Stat_AR_init();                 // Botschaft StWhl_Angl_Stat_AR                 --- Sendeart 5 cyclicAndSpontanWithDelay --- 
    StWhl_OFN_Stat_AR_init();                 // Botschaft StWhl_OFN_Stat_AR                 --- Sendeart 5 cyclicAndSpontanWithDelay --- 
    StWhl_Sw_Stat_AR_init();                 // Botschaft StWhl_Sw_Stat_AR                 --- Sendeart 5 cyclicAndSpontanWithDelay --- 
    TC_Disp_Rq_ECM_AR_init();                 // Botschaft TC_Disp_Rq_ECM_AR                 --- Sendeart 5 cyclicAndSpontanWithDelay --- 
    TC_EBBC_Disp_Rq_ECM_AR_init();                 // Botschaft TC_EBBC_Disp_Rq_ECM_AR                 --- Sendeart 5 cyclicAndSpontanWithDelay --- 
    TC_EEBBC_Disp_Rq_AR_init();                 // Botschaft TC_EEBBC_Disp_Rq_AR                 --- Sendeart  --- 
    TCM_Disp_Rq_AMG_AR_init();                 // Botschaft TCM_Disp_Rq_AMG_AR                 --- Sendeart 5 cyclicAndSpontanWithDelay --- 
    Teleaid_WRN_AR_init();                 // Botschaft Teleaid_WRN_AR                 --- Sendeart 5 cyclicAndSpontanWithDelay --- 
//    TP_COM_TGW_Adapt_init();                 // Botschaft TP_COM_TGW_Adapt                 --- Sendeart 5 cyclicAndSpontanWithDelay --- 
//    TP_EIS_IC_SecOdo_init();                 // Botschaft TP_EIS_IC_SecOdo                 --- Sendeart 5 cyclicAndSpontanWithDelay --- 
//    TP_MPM_TGW_Nav_init();                 // Botschaft TP_MPM_TGW_Nav                 --- Sendeart 5 cyclicAndSpontanWithDelay --- 
//    TP_PARK_TGW_init();                 // Botschaft TP_PARK_TGW                 --- Sendeart 5 cyclicAndSpontanWithDelay --- 
//    TP_TELEAID_TGW_init();                 // Botschaft TP_TELEAID_TGW                 --- Sendeart 5 cyclicAndSpontanWithDelay --- 
//    TP_WPT_IC_init();                 // Botschaft TP_WPT_IC                 --- Sendeart  --- 
//    TP_WPT_TGW_init();                 // Botschaft TP_WPT_TGW                 --- Sendeart  --- 
    Trailer_Stat_AR_init();                 // Botschaft Trailer_Stat_AR                 --- Sendeart 5 cyclicAndSpontanWithDelay --- 
    TSA_Disp_Rq1_AR_init();                 // Botschaft TSA_Disp_Rq1_AR                 --- Sendeart 5 cyclicAndSpontanWithDelay --- 
    TSA_Disp_Rq2_AR_init();                 // Botschaft TSA_Disp_Rq2_AR                 --- Sendeart 5 cyclicAndSpontanWithDelay --- 
    VehDyn_Stat1_AR_init();                 // Botschaft VehDyn_Stat1_AR                 --- Sendeart 5 cyclicAndSpontanWithDelay --- 
    VehDyn_Stat2_AR_init();                 // Botschaft VehDyn_Stat2_AR                 --- Sendeart 5 cyclicAndSpontanWithDelay --- 
    VehLvl_Stat_AR_init();                 // Botschaft VehLvl_Stat_AR                 --- Sendeart 5 cyclicAndSpontanWithDelay --- 
    VehPwrMngmnt_EMM_Stat2_AR_init();                 // Botschaft VehPwrMngmnt_EMM_Stat2_AR                 --- Sendeart 5 cyclicAndSpontanWithDelay --- 
    VehSpd_X_AR_init();                 // Botschaft VehSpd_X_AR                 --- Sendeart 5 cyclicAndSpontanWithDelay --- 
    VIN_AR_init();                 // Botschaft VIN_AR                 --- Sendeart 5 cyclicAndSpontanWithDelay --- 
    VTA_Event_Disp_AR_init();
    Whl_Lt_Stat_AR_init();                 // Botschaft Whl_Lt_Stat_AR                 --- Sendeart 5 cyclicAndSpontanWithDelay --- 
    Whl_Rt_Stat_AR_init();                 // Botschaft Whl_Rt_Stat_AR                 --- Sendeart 5 cyclicAndSpontanWithDelay --- 
    WhlPlsCnt_TPM_AR_init();                 // Botschaft WhlPlsCnt_TPM_AR                 --- Sendeart 5 cyclicAndSpontanWithDelay --- 
    WIA_EngTrq_AR_init();                 // Botschaft WIA_EngTrq_AR                 --- Sendeart 5 cyclicAndSpontanWithDelay --- 
    Wpr_Stat_AR_init();                 // Botschaft Wpr_Stat_AR                 --- Sendeart 5 cyclicAndSpontanWithDelay --- 
    WPT_Stat2_AR_init();                 // Botschaft WPT_Stat2_AR                 --- Sendeart  --- 
// #START_INIT_END#
//    APPL_ECU_APM_1_init();               // Botschaft APPL_ECU_APM_1               --- Sendeart  --- 
//    APPL_ECU_APM_2_init();               // Botschaft APPL_ECU_APM_2               --- Sendeart  --- 
//    APPL_ECU_DRVU_1_init();              // Botschaft APPL_ECU_DRVU_1              --- Sendeart  --- 
//    APPL_ECU_DRVU_2_init();              // Botschaft APPL_ECU_DRVU_2              --- Sendeart  --- 
    APPL_ECU_HIL_TO_IC1_init();          // Botschaft APPL_ECU_HIL_TO_IC1          --- Sendeart 1 spontanX --- 
//    APPL_ECU_ORC1_init();                // Botschaft APPL_ECU_ORC1                --- Sendeart  --- 
//    APPL_ECU_RVC_SVS1_init();            // Botschaft APPL_ECU_RVC_SVS1            --- Sendeart  --- 
//    APPL_ECU_TGW1_init();                // Botschaft APPL_ECU_TGW1                --- Sendeart  --- 
//    NM_APPL_AR_init();                   // Botschaft NM_APPL_AR                   --- Sendeart  --- 
    NM_xxx_AR_init();                    // Botschaft NM_EIS_AR                    --- Sendeart  --- 
//    XCP_Rq_DRVU_1_init();                // Botschaft XCP_Rq_DRVU_1                --- Sendeart  --- 
//    XCP_Rq_DRVU_2_init();                // Botschaft XCP_Rq_DRVU_2                --- Sendeart  --- 
//    XCP_Rq_RBTM_FL_init();               // Botschaft XCP_Rq_RBTM_FL               --- Sendeart  --- 
//    XCP_Rq_RBTM_FR_init();               // Botschaft XCP_Rq_RBTM_FR               --- Sendeart  --- 
//    XCP_Rq_RVC_SVS_init();               // Botschaft XCP_Rq_RVC_SVS               --- Sendeart  --- 
//    XCP_Rq_TPM_init();                   // Botschaft XCP_Rq_TPM                   --- Sendeart  --- 
}
/*@@end*/

/*@@envVar:HMI__STOP_All_MESSAGES_DEFAULT_STARTDELAY:*/
on envVar HMI__STOP_All_MESSAGES_DEFAULT_STARTDELAY
{
    if( getValue( this ) )
    {
        __EIS_Init_Msg();
        __EIS_Startup_Delay();
    }
}
/*@@end*/

/*@@envVar:HMI__STOP_All_MESSAGES_SET_STARTDELAY:*/
on envVar HMI__STOP_All_MESSAGES_SET_STARTDELAY
{
    if( getValue( this ) )
    {
        __EIS_Startup_Delay();
    }
}
/*@@end*/

/*@@caplFunc:__EIS_Startup_Delay():*/
__EIS_Startup_Delay()
{
    write(" Delay setzen :__EIS_Startup_Delay");
// #START_DELAY#
    _AB_R_Stat_AR_Cnt                 = getValue( HMI__STMSGSD_AB_R_Stat_AR                 ) / _AB_R_Stat_AR_Timebase;
    _Adapt_Seat_D_Stat_AR_Cnt         = getValue( HMI__STMSGSD_Adapt_Seat_D_Stat_AR         ) / _Adapt_Seat_D_Stat_AR_Timebase;
    _Adblue_Disp_Rq_AR_Cnt            = getValue( HMI__STMSGSD_Adblue_Disp_Rq_AR            ) / _Adblue_Disp_Rq_AR_Timebase;
    _Adblue_Disp_Warn_Rq_AR_Cnt       = getValue( HMI__STMSGSD_Adblue_Disp_Warn_Rq_AR       ) / _Adblue_Disp_Warn_Rq_AR_Timebase;
    _Assyst_Stat_AR_Cnt               = getValue( HMI__STMSGSD_Assyst_Stat_AR               ) / _Assyst_Stat_AR_Timebase;
    _Assyst_Stat2_AR_Cnt              = getValue( HMI__STMSGSD_Assyst_Stat2_AR              ) / _Assyst_Stat2_AR_Timebase;
    _Assyst_Stat3_AR_Cnt              = getValue( HMI__STMSGSD_Assyst_Stat3_AR              ) / _Assyst_Stat3_AR_Timebase;
    _AWD_TCASE_Disp_Rq_AR_Cnt         = getValue( HMI__STMSGSD_AWD_TCASE_Disp_Rq_AR         ) / _AWD_TCASE_Disp_Rq_AR_Timebase;
    _BC_F_Disp_Rq_AR_Cnt              = getValue( HMI__STMSGSD_BC_F_Disp_Rq_AR              ) / _BC_F_Disp_Rq_AR_Timebase;
    _BC_F_Stat1_AR_Cnt                = getValue( HMI__STMSGSD_BC_F_Stat1_AR                ) / _BC_F_Stat1_AR_Timebase;
    _BC_F_Stat2_AR_Cnt                = getValue( HMI__STMSGSD_BC_F_Stat2_AR                ) / _BC_F_Stat2_AR_Timebase;
    _BC_R_Stat1_AR_Cnt                = getValue( HMI__STMSGSD_BC_R_Stat1_AR                ) / _BC_R_Stat1_AR_Timebase;
    _BC_R_Stat2_AR_Cnt                = getValue( HMI__STMSGSD_BC_R_Stat2_AR                ) / _BC_R_Stat2_AR_Timebase;
    _BODY_HMI_R0_AR_Cnt               = getValue( HMI__STMSGSD_BODY_HMI_R0_AR               ) / _BODY_HMI_R0_AR_Timebase;
    _BODY_HMI_R1_AR_Cnt               = getValue( HMI__STMSGSD_BODY_HMI_R1_AR               ) / _BODY_HMI_R1_AR_Timebase;
    _BODY_HMI_R2_AR_Cnt               = getValue( HMI__STMSGSD_BODY_HMI_R2_AR               ) / _BODY_HMI_R2_AR_Timebase;
    _BSM_Disp_Warn_Rq_AR_Cnt          = getValue( HMI__STMSGSD_BSM_Disp_Warn_Rq_AR          ) / _BSM_Disp_Warn_Rq_AR_Timebase;
    _CamLane_Disp_Warn_Rq_AR_Cnt      = getValue( HMI__STMSGSD_CamLane_Disp_Warn_Rq_AR      ) / _CamLane_Disp_Warn_Rq_AR_Timebase;
    _CHASSIS_HMI_R0_AR_Cnt            = getValue( HMI__STMSGSD_CHASSIS_HMI_R0_AR            ) / _CHASSIS_HMI_R0_AR_Timebase;
    _CHASSIS_HMI_R1_AR_Cnt            = getValue( HMI__STMSGSD_CHASSIS_HMI_R1_AR            ) / _CHASSIS_HMI_R1_AR_Timebase;
    _CHASSIS_HMI_R2_AR_Cnt            = getValue( HMI__STMSGSD_CHASSIS_HMI_R2_AR            ) / _CHASSIS_HMI_R2_AR_Timebase;
    _CHASSIS_HMI_R3_AR_Cnt            = getValue( HMI__STMSGSD_CHASSIS_HMI_R3_AR            ) / _CHASSIS_HMI_R3_AR_Timebase;
    _CHASSIS_HMI_R4_AR_Cnt            = getValue( HMI__STMSGSD_CHASSIS_HMI_R4_AR            ) / _CHASSIS_HMI_R4_AR_Timebase;
    _CHASSISPERIPHERY_HMI_R1_AR_Cnt   = getValue( HMI__STMSGSD_CHASSISPERIPHERY_HMI_R1_AR   ) / _CHASSISPERIPHERY_HMI_R1_AR_Timebase;
    _CLkS_Rq_AR_Cnt                   = getValue( HMI__STMSGSD_CLkS_Rq_AR                   ) / _CLkS_Rq_AR_Timebase;
    _CLkS_State_AR_Cnt                = getValue( HMI__STMSGSD_CLkS_State_AR                ) / _CLkS_State_AR_Timebase;
    _ClockSync_Stat_AR_Cnt            = getValue( HMI__STMSGSD_ClockSync_Stat_AR            ) / _ClockSync_Stat_AR_Timebase;
    _CMS_PI_Sd_Stat_AR_Cnt            = getValue( HMI__STMSGSD_CMS_PI_Sd_Stat_AR            ) / _CMS_PI_Sd_Stat_AR_Timebase;
    _CMS_PI_Stat_AR_Cnt               = getValue( HMI__STMSGSD_CMS_PI_Stat_AR               ) / _CMS_PI_Stat_AR_Timebase;
    _CNG_Disp_Rq_AR_Cnt               = getValue( HMI__STMSGSD_CNG_Disp_Rq_AR               ) / _CNG_Disp_Rq_AR_Timebase;
    _COM_Call_Stat_AR_Cnt             = getValue( HMI__STMSGSD_COM_Call_Stat_AR             ) / _COM_Call_Stat_AR_Timebase;
//  _COMM_EIS_WMI_AR_Cnt              = getValue( HMI__STMSGSD_COMM_EIS_WMI_AR              ) / _COMM_EIS_WMI_AR_Timebase;
    _CRCM_Disp_Rq_AR_Cnt              = getValue( HMI__STMSGSD_CRCM_Disp_Rq_AR              ) / _CRCM_Disp_Rq_AR_Timebase;
    _CU_RemFunc_Rq3_AR_Cnt            = getValue( HMI__STMSGSD_CU_RemFunc_Rq3_AR            ) / _CU_RemFunc_Rq3_AR_Timebase;
    _DidA_MBContact_State_AR_Cnt      = getValue( HMI__STMSGSD_DidA_MBContact_State_AR      ) / _DidA_MBContact_State_AR_Timebase;
    _Door_FL_Stat_AR_Cnt              = getValue( HMI__STMSGSD_Door_FL_Stat_AR              ) / _Door_FL_Stat_AR_Timebase;
    _Door_FR_Stat_AR_Cnt              = getValue( HMI__STMSGSD_Door_FR_Stat_AR              ) / _Door_FR_Stat_AR_Timebase;
    _Door_RL_Stat_AR_Cnt              = getValue( HMI__STMSGSD_Door_RL_Stat_AR              ) / _Door_RL_Stat_AR_Timebase;
    _Door_RR_Stat_AR_Cnt              = getValue( HMI__STMSGSD_Door_RR_Stat_AR              ) / _Door_RR_Stat_AR_Timebase;
    _DPC_Disp_Rq_AR_Cnt               = getValue( HMI__STMSGSD_DPC_Disp_Rq_AR               ) / _DPC_Disp_Rq_AR_Timebase;
    _DPC_IndMd_Stat_AR_Cnt            = getValue( HMI__STMSGSD_DPC_IndMd_Stat_AR            ) / _DPC_IndMd_Stat_AR_Timebase;
    _DPC_IndMd_Style_AR_Cnt           = getValue( HMI__STMSGSD_DPC_IndMd_Style_AR           ) / _DPC_IndMd_Style_AR_Timebase;
    _DPC_IndMd_Style2_AR_Cnt          = getValue( HMI__STMSGSD_DPC_IndMd_Style2_AR          ) / _DPC_IndMd_Style2_AR_Timebase;
    _DPC_Master_Rq_AR_Cnt             = getValue( HMI__STMSGSD_DPC_Master_Rq_AR             ) / _DPC_Master_Rq_AR_Timebase;
    _ECO_Score_Disp_Rq_AR_Cnt         = getValue( HMI__STMSGSD_ECO_Score_Disp_Rq_AR         ) / _ECO_Score_Disp_Rq_AR_Timebase;
    _EL_Ft_Disp_Rq_AR_Cnt             = getValue( HMI__STMSGSD_EL_Ft_Disp_Rq_AR             ) / _EL_Ft_Disp_Rq_AR_Timebase;
    _EL_R_Disp_Rq_AR_Cnt              = getValue( HMI__STMSGSD_EL_R_Disp_Rq_AR              ) / _EL_R_Disp_Rq_AR_Timebase;
    _EL_Stat_AR_Cnt                   = getValue( HMI__STMSGSD_EL_Stat_AR                   ) / _EL_Stat_AR_Timebase;
//  _EL_TurnInd_Rq_AR_Cnt             = getValue( HMI__STMSGSD_EL_TurnInd_Rq_AR             ) / _EL_TurnInd_Rq_AR_Timebase;
    _Eng_Rs_EngCtrl_AR_Cnt            = getValue( HMI__STMSGSD_Eng_Rs_EngCtrl_AR            ) / _Eng_Rs_EngCtrl_AR_Timebase;
    _Eng_Rs2_AR_Cnt                   = getValue( HMI__STMSGSD_Eng_Rs2_AR                   ) / _Eng_Rs2_AR_Timebase;
    _EngCtrl_Disp_Rq_AR_Cnt           = getValue( HMI__STMSGSD_EngCtrl_Disp_Rq_AR           ) / _EngCtrl_Disp_Rq_AR_Timebase;
    _EngCtrl_Stat_AR_Cnt              = getValue( HMI__STMSGSD_EngCtrl_Stat_AR              ) / _EngCtrl_Stat_AR_Timebase;
    _EPKB_Disp_IndLmp_Rq_2_AR_Cnt     = getValue( HMI__STMSGSD_EPKB_Disp_IndLmp_Rq_2_AR     ) / _EPKB_Disp_IndLmp_Rq_2_AR_Timebase;
    _EPS_Stat_Disp_Rq_AR_Cnt          = getValue( HMI__STMSGSD_EPS_Stat_Disp_Rq_AR          ) / _EPS_Stat_Disp_Rq_AR_Timebase;
    _ESP_Disp_Rq_AR_Cnt               = getValue( HMI__STMSGSD_ESP_Disp_Rq_AR               ) / _ESP_Disp_Rq_AR_Timebase;
    _ESP_Disp_Rq2_AR_Cnt              = getValue( HMI__STMSGSD_ESP_Disp_Rq2_AR              ) / _ESP_Disp_Rq2_AR_Timebase;
    _ESP_Disp_Rq3_AR_Cnt              = getValue( HMI__STMSGSD_ESP_Disp_Rq3_AR              ) / _ESP_Disp_Rq3_AR_Timebase;
    _ESP_Disp_Rq_AMG_AR_Cnt           = getValue( HMI__STMSGSD_ESP_Disp_Rq_AMG_AR           ) / _ESP_Disp_Rq_AMG_AR_Timebase;  
    _EVC_CfgBit_01_32_AR_Cnt          = getValue( HMI__STMSGSD_EVC_CfgBit_01_32_AR          ) / _EVC_CfgBit_01_32_AR_Timebase;
    _EVC_CfgBit_33_64_AR_Cnt          = getValue( HMI__STMSGSD_EVC_CfgBit_33_64_AR          ) / _EVC_CfgBit_33_64_AR_Timebase;
    _EVC_CfgBit_65_96_AR_Cnt          = getValue( HMI__STMSGSD_EVC_CfgBit_65_96_AR          ) / _EVC_CfgBit_65_96_AR_Timebase;
    _EVC_CfgBit_97_C8_AR_Cnt          = getValue( HMI__STMSGSD_EVC_CfgBit_97_C8_AR          ) / _EVC_CfgBit_97_C8_AR_Timebase;
    _EVC_CfgList_01_0C_AR_Cnt         = getValue( HMI__STMSGSD_EVC_CfgList_01_0C_AR         ) / _EVC_CfgList_01_0C_AR_Timebase;
    _FBL_CFG_Star2_AR_Cnt             = getValue( HMI__STMSGSD_FBL_CFG_Star2_AR             ) / _FBL_CFG_Star2_AR_Timebase;
    _FCW_Disp_Rq_AR_Cnt               = getValue( HMI__STMSGSD_FCW_Disp_Rq_AR               ) / _FCW_Disp_Rq_AR_Timebase;
    _FuelLvl_Stat_AR_Cnt              = getValue( HMI__STMSGSD_FuelLvl_Stat_AR              ) / _FuelLvl_Stat_AR_Timebase;
    _Fuel_Stat2_AR_Cnt                = getValue( HMI__STMSGSD_Fuel_Stat2_AR                ) / _Fuel_Stat2_AR_Timebase;
    _FWLP_D_AR_Cnt                    = getValue( HMI__STMSGSD_FWLP_D_AR                    ) / _FWLP_D_AR_Timebase;
    _FWLP_P_AR_Cnt                    = getValue( HMI__STMSGSD_FWLP_P_AR                    ) / _FWLP_P_AR_Timebase;
    _HumanMachineIfc_AR_Cnt           = getValue( HMI__STMSGSD_HumanMachineIfc_AR           ) / _HumanMachineIfc_AR_Timebase;
    _HumanMachineIfc_Rq_AR_Cnt        = getValue( HMI__STMSGSD_HumanMachineIfc_Rq_AR        ) / _HumanMachineIfc_Rq_AR_Timebase;
    _HVAC_Disp_Stat1_AR_Cnt           = getValue( HMI__STMSGSD_HVAC_Disp_Stat1_AR           ) / _HVAC_Disp_Stat1_AR_Timebase;
    _HVAC_Disp_Stat2_AR_Cnt           = getValue( HMI__STMSGSD_HVAC_Disp_Stat2_AR           ) / _HVAC_Disp_Stat2_AR_Timebase;
    _HVAC_Disp_Stat3_AR_Cnt           = getValue( HMI__STMSGSD_HVAC_Disp_Stat3_AR           ) / _HVAC_Disp_Stat3_AR_Timebase;
    _HVAC_State1_AR_Cnt               = getValue( HMI__STMSGSD_HVAC_State1_AR               ) / _HVAC_State1_AR_Timebase;
    _ICH_PreTime_Stat_AR_Cnt          = getValue( HMI__STMSGSD_ICH_PreTime_Stat_AR          ) / _ICH_PreTime_Stat_AR_Timebase;
    _ICH_Stat_AR_Cnt                  = getValue( HMI__STMSGSD_ICH_Stat_AR                  ) / _ICH_Stat_AR_Timebase;
    _Ign_Veh_Stat_AR_Cnt              = getValue( HMI__STMSGSD_Ign_Veh_Stat_AR              ) / _Ign_Veh_Stat_AR_Timebase;
    _IL_AmbLgt_Disp_AR_Cnt            = getValue( HMI__STMSGSD_IL_AmbLgt_Disp_AR            ) / _IL_AmbLgt_Disp_AR_Timebase;
    _IL_AmbLgtCfg_Stat_AR_Cnt         = getValue( HMI__STMSGSD_IL_AmbLgtCfg_Stat_AR         ) / _IL_AmbLgtCfg_Stat_AR_Timebase;
    _Immobilizer_Disp_Rq_AR_Cnt       = getValue( HMI__STMSGSD_Immobilizer_Disp_Rq_AR       ) / _Immobilizer_Disp_Rq_AR_Timebase;
    _Immobilizer_IC_AR_Cnt            = getValue( HMI__STMSGSD_Immobilizer_IC_AR            ) / _Immobilizer_IC_AR_Timebase;
    _Immobilizer_KeyID_AR_Cnt         = getValue( HMI__STMSGSD_Immobilizer_KeyID_AR         ) / _Immobilizer_KeyID_AR_Timebase;
    _KG_Msg_Disp_Rq_AR_Cnt            = getValue( HMI__STMSGSD_KG_Msg_Disp_Rq_AR            ) / _KG_Msg_Disp_Rq_AR_Timebase;
    _LDC_Disp_Rq_ESP_AR_Cnt           = getValue( HMI__STMSGSD_LDC_Disp_Rq_ESP_AR           ) / _LDC_Disp_Rq_ESP_AR_Timebase;
    _LDC_Disp_Rq_RDU_AR_Cnt           = getValue( HMI__STMSGSD_LDC_Disp_Rq_RDU_AR           ) / _LDC_Disp_Rq_RDU_AR_Timebase;
    _LDP_Warn_Rq_AR_Cnt               = getValue( HMI__STMSGSD_LDP_Warn_Rq_AR               ) / _LDP_Warn_Rq_AR_Timebase;
    _LgtSens_State_AR_Cnt             = getValue( HMI__STMSGSD_LgtSens_State_AR             ) / _LgtSens_State_AR_Timebase;
    _MCMS_FL_AR_Cnt                   = getValue( HMI__STMSGSD_MCMS_FL_AR                   ) / _MCMS_FL_AR_Timebase;
    _MCMS_FL_Stat_AR_Cnt              = getValue( HMI__STMSGSD_MCMS_FL_Stat_AR              ) / _MCMS_FL_Stat_AR_Timebase;
    _MCMS_FR_AR_Cnt                   = getValue( HMI__STMSGSD_MCMS_FR_AR                   ) / _MCMS_FR_AR_Timebase;
    _MCMS_FR_Stat_AR_Cnt              = getValue( HMI__STMSGSD_MCMS_FR_Stat_AR              ) / _MCMS_FR_Stat_AR_Timebase;
    _MCMS_RL_AR_Cnt                   = getValue( HMI__STMSGSD_MCMS_RL_AR                   ) / _MCMS_RL_AR_Timebase;
    _MCMS_RL_Stat_AR_Cnt              = getValue( HMI__STMSGSD_MCMS_RL_Stat_AR              ) / _MCMS_RL_Stat_AR_Timebase;
    _MCMS_RR_AR_Cnt                   = getValue( HMI__STMSGSD_MCMS_RR_AR                   ) / _MCMS_RR_AR_Timebase;
    _MCMS_RR_Stat_AR_Cnt              = getValue( HMI__STMSGSD_MCMS_RR_Stat_AR              ) / _MCMS_RR_Stat_AR_Timebase;
    _OffRoad_Disp_Rq_AR_Cnt           = getValue( HMI__STMSGSD_OffRoad_Disp_Rq_AR           ) / _OffRoad_Disp_Rq_AR_Timebase;
    _Park_Disp_Rq_AR_Cnt              = getValue( HMI__STMSGSD_Park_Disp_Rq_AR              ) / _Park_Disp_Rq_AR_Timebase;
    _Park_Set_Stat_AR_Cnt             = getValue( HMI__STMSGSD_Park_Set_Stat_AR             ) / _Park_Set_Stat_AR_Timebase;
    _ParkSpaceMeas_Stat_AR_Cnt        = getValue( HMI__STMSGSD_ParkSpaceMeas_Stat_AR        ) / _ParkSpaceMeas_Stat_AR_Timebase;
    _ParkWarn_AR_Cnt                  = getValue( HMI__STMSGSD_ParkWarn_AR                  ) / _ParkWarn_AR_Timebase;
    _PERIPHERY_HMI_R1_AR_Cnt          = getValue( HMI__STMSGSD_PERIPHERY_HMI_R1_AR          ) / _PERIPHERY_HMI_R1_AR_Timebase;
    _PN14_Disp_Rq_AR_Cnt              = getValue( HMI__STMSGSD_PN14_Disp_Rq_AR              ) / _PN14_Disp_Rq_AR_Timebase;
    _PN14_Disp_Rq2_AR_Cnt             = getValue( HMI__STMSGSD_PN14_Disp_Rq2_AR             ) / _PN14_Disp_Rq2_AR_Timebase;
    _PN14_Stat_AR_Cnt                 = getValue( HMI__STMSGSD_PN14_Stat_AR                 ) / _PN14_Stat_AR_Timebase;
    _PN48_Disp_Rq_AR_Cnt              = getValue( HMI__STMSGSD_PN48_Disp_Rq_AR              ) / _PN48_Disp_Rq_AR_Timebase;
    _PnHt_Stat_AR_Cnt                 = getValue( HMI__STMSGSD_PnHt_Stat_AR                 ) / _PnHt_Stat_AR_Timebase;
    _PNHV_EnergyMngmnt_Disp_Rq_AR_Cnt = getValue( HMI__STMSGSD_PNHV_EnergyMngmnt_Disp_Rq_AR ) / _PNHV_EnergyMngmnt_Disp_Rq_AR_Timebase;
    _PNHV_EnergyMngmnt_Stat2_AR_Cnt   = getValue( HMI__STMSGSD_PNHV_EnergyMngmnt_Stat2_AR   ) / _PNHV_EnergyMngmnt_Stat2_AR_Timebase;
    _PNHV_EnergyMngmntSet_Rs1_AR_Cnt  = getValue( HMI__STMSGSD_PNHV_EnergyMngmntSet_Rs1_AR  ) / _PNHV_EnergyMngmntSet_Rs1_AR_Timebase;
    _PNHV_EnergyMngmntSet_Rs2_AR_Cnt  = getValue( HMI__STMSGSD_PNHV_EnergyMngmntSet_Rs2_AR  ) / _PNHV_EnergyMngmntSet_Rs2_AR_Timebase;
//    _PNHV_WeekDepTmTbl_Stat_AR_Cnt    = getValue( HMI__STMSGSD_PNHV_WeekDepTmTbl_Stat_AR    ) / _PNHV_WeekDepTmTbl_Stat_AR_Timebase;
    _PreCond_CfgStat_AR_Cnt           = getValue( HMI__STMSGSD_PreCond_CfgStat_AR           ) / _PreCond_CfgStat_AR_Timebase;
    _PresfCtrl_Rq_ESP_AR_Cnt          = getValue( HMI__STMSGSD_PresfCtrl_Rq_ESP_AR          ) / _PresfCtrl_Rq_ESP_AR_Timebase;
    _PT_DataContain_Rq_AR_Cnt         = getValue( HMI__STMSGSD_PT_DataContain_Rq_AR         ) / _PT_DataContain_Rq_AR_Timebase;
    _PT_Disp_Rq2_AR_Cnt               = getValue( HMI__STMSGSD_PT_Disp_Rq2_AR               ) / _PT_Disp_Rq2_AR_Timebase;
    _PtHyb_Mngmnt_Rq_AR_Cnt           = getValue( HMI__STMSGSD_PtHyb_Mngmnt_Rq_AR           ) / _PtHyb_Mngmnt_Rq_AR_Timebase;
    _PtMngmnt_Disp_Rq_AR_Cnt          = getValue( HMI__STMSGSD_PtMngmnt_Disp_Rq_AR          ) / _PtMngmnt_Disp_Rq_AR_Timebase;
    _RDU_Disp_Rq_AR_Cnt               = getValue( HMI__STMSGSD_RDU_Disp_Rq_AR               ) / _RDU_Disp_Rq_AR_Timebase;
    _RVC_SVS_Park_Stat_AR_Cnt         = getValue( HMI__STMSGSD_RVC_SVS_Park_Stat_AR         ) / _RVC_SVS_Park_Stat_AR_Timebase;
    _SBW_DrvPosn_Disp_Rq_ISM_AR_Cnt   = getValue( HMI__STMSGSD_SBW_DrvPosn_Disp_Rq_ISM_AR   ) / _SBW_DrvPosn_Disp_Rq_ISM_AR_Timebase;
    _SBW_DrvPosn_Disp_Rq_TCM_AR_Cnt   = getValue( HMI__STMSGSD_SBW_DrvPosn_Disp_Rq_TCM_AR   ) / _SBW_DrvPosn_Disp_Rq_TCM_AR_Timebase;
    _Seat_D_Stat_AR_Cnt               = getValue( HMI__STMSGSD_Seat_D_Stat_AR               ) / _Seat_D_Stat_AR_Timebase;
    _Seat_P_Stat_AR_Cnt               = getValue( HMI__STMSGSD_Seat_P_Stat_AR               ) / _Seat_P_Stat_AR_Timebase;
    _Seat_RL_Stat_AR_Cnt              = getValue( HMI__STMSGSD_Seat_RL_Stat_AR              ) / _Seat_RL_Stat_AR_Timebase;
    _Seat_RR_Stat_AR_Cnt              = getValue( HMI__STMSGSD_Seat_RR_Stat_AR              ) / _Seat_RR_Stat_AR_Timebase;
    _SeatHtVn_Stat_AR_Cnt             = getValue( HMI__STMSGSD_SeatHtVn_Stat_AR             ) / _SeatHtVn_Stat_AR_Timebase;
    _SeatHtVn_Stat2_AR_Cnt            = getValue( HMI__STMSGSD_SeatHtVn_Stat2_AR            ) / _SeatHtVn_Stat2_AR_Timebase;
    _SeatMem_D_Rq_AR_Cnt              = getValue( HMI__STMSGSD_SeatMem_D_Rq_AR              ) / _SeatMem_D_Rq_AR_Timebase;
    _SeatPosn_Abs_D_AR_Cnt            = getValue( HMI__STMSGSD_SeatPosn_Abs_D_AR            ) / _SeatPosn_Abs_D_AR_Timebase;
    _SeatPosn_Abs_P_AR_Cnt            = getValue( HMI__STMSGSD_SeatPosn_Abs_P_AR            ) / _SeatPosn_Abs_P_AR_Timebase;
    _SND_GEN_Stat_AR_Cnt              = getValue( HMI__STMSGSD_SND_GEN_Stat_AR              ) / _SND_GEN_Stat_AR_Timebase;
//    _SPC_Disp_Rq_AR_Cnt               = getValue( HMI__STMSGSD_SPC_Disp_Rq_AR               ) / _SPC_Disp_Rq_AR_Timebase;
    _SPC_SwLED_Msg_Rq_AR_Cnt          = getValue( HMI__STMSGSD_SPC_SwLED_Msg_Rq_AR          ) / _SPC_SwLED_Msg_Rq_AR_Timebase;
    _SPV_Rq_AR_Cnt                    = getValue( HMI__STMSGSD_SPV_Rq_AR                    ) / _SPV_Rq_AR_Timebase;
    _SPV_Stat_AR_Cnt                  = getValue( HMI__STMSGSD_SPV_Stat_AR                  ) / _SPV_Stat_AR_Timebase;
    _StWhl_Angl_Stat_AR_Cnt           = getValue( HMI__STMSGSD_StWhl_Angl_Stat_AR           ) / _StWhl_Angl_Stat_AR_Timebase;
    _StWhl_OFN_Stat_AR_Cnt            = getValue( HMI__STMSGSD_StWhl_OFN_Stat_AR            ) / _StWhl_OFN_Stat_AR_Timebase;
    _StWhl_Sw_Stat_AR_Cnt             = getValue( HMI__STMSGSD_StWhl_Sw_Stat_AR             ) / _StWhl_Sw_Stat_AR_Timebase;
    _TC_Disp_Rq_ECM_AR_Cnt            = getValue( HMI__STMSGSD_TC_Disp_Rq_ECM_AR            ) / _TC_Disp_Rq_ECM_AR_Timebase;
    _TC_EBBC_Disp_Rq_ECM_AR_Cnt       = getValue( HMI__STMSGSD_TC_EBBC_Disp_Rq_ECM_AR       ) / _TC_EBBC_Disp_Rq_ECM_AR_Timebase;
    _TC_EEBBC_Disp_Rq_AR_Cnt          = getValue( HMI__STMSGSD_TC_EEBBC_Disp_Rq_AR          ) / _TC_EEBBC_Disp_Rq_AR_Timebase;
    _TCM_Disp_Rq_AMG_AR_Cnt           = getValue( HMI__STMSGSD_TCM_Disp_Rq_AMG_AR           ) / _TCM_Disp_Rq_AMG_AR_Timebase;
    _Teleaid_WRN_AR_Cnt               = getValue( HMI__STMSGSD_Teleaid_WRN_AR               ) / _Teleaid_WRN_AR_Timebase;
//    _TP_COM_TGW_Adapt_Cnt             = getValue( HMI__STMSGSD_TP_COM_TGW_Adapt             ) / _TP_COM_TGW_Adapt_Timebase;
//    _TP_EIS_IC_SecOdo_Cnt             = getValue( HMI__STMSGSD_TP_EIS_IC_SecOdo             ) / _TP_EIS_IC_SecOdo_Timebase;
//    _TP_MPM_TGW_Nav_Cnt               = getValue( HMI__STMSGSD_TP_MPM_TGW_Nav               ) / _TP_MPM_TGW_Nav_Timebase;
//    _TP_PARK_TGW_Cnt                  = getValue( HMI__STMSGSD_TP_PARK_TGW                  ) / _TP_PARK_TGW_Timebase;
//    _TP_TELEAID_TGW_Cnt               = getValue( HMI__STMSGSD_TP_TELEAID_TGW               ) / _TP_TELEAID_TGW_Timebase;
//    _TP_WPT_IC_Cnt                    = getValue( HMI__STMSGSD_TP_WPT_IC                    ) / _TP_WPT_IC_Timebase;
//    _TP_WPT_TGW_Cnt                   = getValue( HMI__STMSGSD_TP_WPT_TGW                   ) / _TP_WPT_TGW_Timebase;
    _Trailer_Stat_AR_Cnt              = getValue( HMI__STMSGSD_Trailer_Stat_AR              ) / _Trailer_Stat_AR_Timebase;
    _TSA_Disp_Rq1_AR_Cnt              = getValue( HMI__STMSGSD_TSA_Disp_Rq1_AR              ) / _TSA_Disp_Rq1_AR_Timebase;
    _TSA_Disp_Rq2_AR_Cnt              = getValue( HMI__STMSGSD_TSA_Disp_Rq2_AR              ) / _TSA_Disp_Rq2_AR_Timebase;
    _VehDyn_Stat1_AR_Cnt              = getValue( HMI__STMSGSD_VehDyn_Stat1_AR              ) / _VehDyn_Stat1_AR_Timebase;
    _VehDyn_Stat2_AR_Cnt              = getValue( HMI__STMSGSD_VehDyn_Stat2_AR              ) / _VehDyn_Stat2_AR_Timebase;
    _VehLvl_Stat_AR_Cnt               = getValue( HMI__STMSGSD_VehLvl_Stat_AR               ) / _VehLvl_Stat_AR_Timebase;
    _VehPwrMngmnt_EMM_Stat2_AR_Cnt    = getValue( HMI__STMSGSD_VehPwrMngmnt_EMM_Stat2_AR    ) / _VehPwrMngmnt_EMM_Stat2_AR_Timebase;
    _VehSpd_X_AR_Cnt                  = getValue( HMI__STMSGSD_VehSpd_X_AR                  ) / _VehSpd_X_AR_Timebase;
//  _VIN_AR_Cnt                       = getValue( HMI__STMSGSD_VIN_AR                       ) / _VIN_AR_Timebase;
    _VTA_Event_Disp_AR_Cnt            = getValue( HMI__STMSGSD_VTA_Event_Disp_AR            ) / _VTA_Event_Disp_AR_Timebase;
    _Whl_Lt_Stat_AR_Cnt               = getValue( HMI__STMSGSD_Whl_Lt_Stat_AR               ) / _Whl_Lt_Stat_AR_Timebase;
    _Whl_Rt_Stat_AR_Cnt               = getValue( HMI__STMSGSD_Whl_Rt_Stat_AR               ) / _Whl_Rt_Stat_AR_Timebase;
    _WhlPlsCnt_TPM_AR_Cnt             = getValue( HMI__STMSGSD_WhlPlsCnt_TPM_AR             ) / _WhlPlsCnt_TPM_AR_Timebase;
    _WIA_EngTrq_AR_Cnt                = getValue( HMI__STMSGSD_WIA_EngTrq_AR                ) / _WIA_EngTrq_AR_Timebase;
    _Wpr_Stat_AR_Cnt                  = getValue( HMI__STMSGSD_Wpr_Stat_AR                  ) / _Wpr_Stat_AR_Timebase;
    _WPT_Stat2_AR_Cnt                 = getValue( HMI__STMSGSD_WPT_Stat2_AR                 ) / _WPT_Stat2_AR_Timebase;
// #START_DELAY_END#
}
/*@@end*/

/*@@caplFunc:__EIS_Reset_E2E_SQC():*///function
__EIS_Reset_E2E_SQC()
{
    putValue( HMI_SQC_Airbag_LED_Stat_ASBM, 15 );
    putValue( HMI_SQC_CamLane_Disp_Warn_Rq, 15 );
    putValue( HMI_SQC_PT_Stat, 15 );
    putValue( HMI_SQC_ClockSync_Stat1, 15 );
    putValue( HMI_SQC_ClockSync_Stat2, 15 );
    putValue( HMI_SQC_CMS_PI_Sd_Lt_Stat, 15 );
    putValue( HMI_SQC_CMS_PI_Sd_Rt_Stat, 15 );
    putValue( HMI_SQC_CMS_PI_Stat, 15 );
    putValue( HMI_SQC_Airbag_LED_Stat, 15 );
    putValue( HMI_SQC_CTRL_L_Stat, 15 );
    putValue( HMI_SQC_CTRL_L2_Stat, 15 );
    putValue( HMI_SQC_Door_FL_Stat, 15 );
    putValue( HMI_SQC_Door_FR_Stat, 15 );
    putValue( HMI_SQC_Door_RL_Stat, 15 );
    putValue( HMI_SQC_Door_RR_Stat, 15 );
    putValue( HMI_SQC_DPC_Disp_Rq, 15 );
    putValue( HMI_SQC_DPC_IndMd_Stat, 15 );
    putValue( HMI_SQC_DPC_IndMd_Style, 15 );
    putValue( HMI_SQC_DPC_IndMd_Style2, 15 );
    putValue( HMI_SQC_DPC_Master_Rq, 15 );
    putValue( HMI_SQC_EL_Ft_FltDisp_Rq, 15 );
    putValue( HMI_SQC_EL_R_FltDisp_Rq, 15 );
    putValue( HMI_SQC_ExtLgt_Lmp_On_Rq, 15 );
    putValue( HMI_SQC_EL_TurnInd_On_Rq, 15 );
    putValue( HMI_SQC_Eng_Rs_EngCtrl, 15 );
    putValue( HMI_SQC_Eng_Rs2, 15 );
    putValue( HMI_SQC_EPKB_Disp_IndLmp_Rq, 15 );                _mEPKB_Disp_IndLmp_Rq_2_AR.SQC_EPKB_Disp_IndLmp_Rq = 15;
    putValue( HMI_SQC_EPS_CtrlLmp_Disp_Rq, 15 );
    putValue( HMI_SQC_ESP_Disp_Rq, 15 );                        _mESP_Disp_Rq_AR.SQC_ESP_Disp_Rq =15;
    putValue( HMI_SQC_DSR_Disp_Rq, 15 );
    putValue( HMI_SQC_EVC_CfgBit_01_32, 15 );
    putValue( HMI_SQC_EVC_CfgBit_33_64, 15 );
    putValue( HMI_SQC_EVC_CfgBit_65_96, 15 );
    putValue( HMI_SQC_EVC_CfgBit_97_C8, 15 );
    putValue( HMI_SQC_EVC_CfgList_01_0C, 15 );
    putValue( HMI_SQC_RollTestMd_SPCR_Stat_IC, 15 );
    putValue( HMI_SQC_Ign_Stat, 15 );
    putValue( HMI_SQC_IHC_Lgt_Stat_MPC, 15 );
    putValue( HMI_SQC_Immobilizer_KeyID, 15 );
    putValue( HMI_SQC_NVP_Stat1, 15 );
    putValue( HMI_SQC_Bckl_Sw_Ft_Stat, 15 );
    putValue( HMI_SQC_Impact, 15 );
    putValue( HMI_SQC_Park_Disp_Rq, 15 );
    putValue( HMI_SQC_PN14_Disp_Rq2, 15 );
    putValue( HMI_SQC_PresfCtrl_Rq_ESP, 15 );
    putValue( HMI_SQC_ISM_TxDrvPosn_Disp_Rq, 15 );
    putValue( HMI_SQC_SBW_Drv_Pk_Posn_TCM, 15 );
    putValue( HMI_SQC_SeatPosn_Abs_D, 15 );
    putValue( HMI_SQC_SeatPosn_Abs_P, 15 );
    putValue( HMI_SQC_SPC_Msg_Rq, 15 );
    putValue( HMI_SQC_SPL_Obj1_Obj2_NV, 15 );
    putValue( HMI_SQC_StWhl_Angl_Stat, 15 );
    putValue( HMI_SQC_StWhl_Sw_Ok1_Ok2_Psd, 15 );
    putValue( HMI_SQC_TPM_Lmp_On_Rq, 15 );
    putValue( HMI_SQC_ElecTrlrHtch_Stat, 15 );
    putValue( HMI_SQC_VehDyn_Stat1, 15 );
    putValue( HMI_SQC_VehDyn_Stat2, 15 );
    putValue( HMI_SQC_VehLvl_Stat, 15 );
    putValue( HMI_SQC_EMM_Disp_Rq, 15 );
    putValue( HMI_SQC_VehSpd_X, 15 );
    putValue( HMI_SQC_Whl_Lt_Stat, 15 );
    putValue( HMI_SQC_Whl_Rt_Stat, 15 );
    putValue( HMI_SQC_WhlPlsCnt_TPM, 15 );
    write(" E2E-simu: Reset SQC to 15 ");
}
/*@@end*/

/*@@timer:t_DBKomTimer_5ms:*/
on Timer t_DBKomTimer_5ms
{
// *** DBKom-Sendefunktion ***
    // timer aufziehen für nächsten Zyklus
    if( getValue( HMI__NM_EIS_CommActive        ) |
        getValue( HMI__NM_EIS_RequestBusCom )   )
    {
        setTimer( t_DBKomTimer_5ms, c_tDBKomTimer_5ms );
    }
// #CYC_TIMER_5_MS_START#
    BC_F_Stat1_AR_check_output();                // Botschaft BC_F_Stat1_AR                --- Sendeart 5 cyclicAndSpontanWithDelay --- 
    CLkS_Rq_AR_check_output();                   // Botschaft CLkS_Rq_AR                   --- Sendeart 8 cyclicIfActiveFast --- 
    EL_TurnInd_Rq_AR_check_output();             // Botschaft EL_TurnInd_Rq_AR             --- Sendeart 1 spontanX --- 
    Eng_Rs_EngCtrl_AR_check_output();            // Botschaft Eng_Rs_EngCtrl_AR            --- Sendeart 0 cyclicX --- 
    PN48_Disp_Rq_AR_check_output();              // Botschaft PN48_Disp_Rq_AR              --- Sendeart 5 cyclicAndSpontanWithDelay --- 
    RDU_Disp_Rq_AR_check_output();               // Botschaft RDU_Disp_Rq_AR               --- Sendeart 5 cyclicAndSpontanWithDelay --- 
    SeatMem_D_Rq_AR_check_output();              // Botschaft SeatMem_D_Rq_AR              --- Sendeart 2 cyclicIfActiveX ---
    SPC_Disp_Rq_AR_check_output();               // Botschaft SPC_Disp_Rq_AR               --- Sendeart 0 cyclicX --- 
    SPV_Rq_AR_check_output();                    // Botschaft SPV_Rq_AR                    --- Sendeart 8 cyclicIfActiveFast --- 
    SPV_Stat_AR_check_output();                  // Botschaft SPV_Stat_AR                  --- Sendeart 5 cyclicAndSpontanWithDelay --- 
    StWhl_Angl_Stat_AR_check_output();           // Botschaft StWhl_Angl_Stat_AR           --- Sendeart 0 cyclicX --- 
    StWhl_OFN_Stat_AR_check_output();            // Botschaft StWhl_OFN_Stat_AR            --- Sendeart  --- 
    TSA_Disp_Rq1_AR_check_output();              // Botschaft TSA_Disp_Rq1_AR              --- Sendeart 5 cyclicAndSpontanWithDelay --- 
// #CYC_TIMER_5_MS_END#
}
/*@@end*/

/*@@timer:t_DBKomTimer_20ms:*/
on Timer t_DBKomTimer_20ms
{
// *** DBKom-Sendefunktion ***
    // timer aufziehen für nächsten Zyklus
    if( getValue( HMI__NM_EIS_CommActive    )/* |
        getValue( HMI__NM_EIS_RequestBusCom ) */  )
    {
        setTimer( t_DBKomTimer_20ms, c_tDBKomTimer_20ms );
    }
// #CYC_TIMER_20_MS#
    AB_R_Stat_AR_check_output();
    Adapt_Seat_D_Stat_AR_check_output();
    Adblue_Disp_Rq_AR_check_output();
    Adblue_Disp_Warn_Rq_AR_check_output();
    Assyst_Stat_AR_check_output();
    Assyst_Stat2_AR_check_output();
    Assyst_Stat3_AR_check_output();
    AWD_TCASE_Disp_Rq_AR_check_output();
    BC_F_Disp_Rq_AR_check_output();
// 5ms    BC_F_Stat1_AR_check_output();
    BC_F_Stat2_AR_check_output();
    BC_R_Stat1_AR_check_output();
    BC_R_Stat2_AR_check_output();
    BODY_HMI_R0_AR_check_output();
    BODY_HMI_R1_AR_check_output();
    BODY_HMI_R2_AR_check_output();
    BSM_Disp_Warn_Rq_AR_check_output();
    CamLane_Disp_Warn_Rq_AR_check_output();
    CHASSIS_HMI_R0_AR_check_output();
    CHASSIS_HMI_R1_AR_check_output();
    CHASSIS_HMI_R2_AR_check_output();
    CHASSIS_HMI_R3_AR_check_output();
    CHASSIS_HMI_R4_AR_check_output();
    CHASSISPERIPHERY_HMI_R1_AR_check_output();
// 5ms    CLkS_Rq_AR_check_output();
    CLkS_State_AR_check_output();
    ClockSync_Stat_AR_check_output();
    CMS_PI_Sd_Stat_AR_check_output();
    CMS_PI_Stat_AR_check_output();
    CNG_Disp_Rq_AR_check_output();
    COM_Call_Stat_AR_check_output();
//    COMM_EIS_WMI_AR_check_output();
    CRCM_Disp_Rq_AR_check_output();
    CU_RemFunc_Rq3_AR_check_output();
    DidA_MBContact_State_AR_check_output();
    Door_FL_Stat_AR_check_output();
    Door_FR_Stat_AR_check_output();
    Door_RL_Stat_AR_check_output();
    Door_RR_Stat_AR_check_output();
    DPC_Disp_Rq_AR_check_output();
    DPC_IndMd_Stat_AR_check_output();
    DPC_IndMd_Style_AR_check_output();
    DPC_IndMd_Style2_AR_check_output();
    DPC_Master_Rq_AR_check_output();   
    ECO_Score_Disp_Rq_AR_check_output();
    EL_Ft_Disp_Rq_AR_check_output();
    EL_R_Disp_Rq_AR_check_output();
    EL_Stat_AR_check_output();
// 5ms    EL_TurnInd_Rq_AR_check_output();
// 5ms    Eng_Rs_EngCtrl_AR_check_output();
    Eng_Rs2_AR_check_output();
    EngCtrl_Disp_Rq_AR_check_output();
    EngCtrl_Stat_AR_check_output();
    EPKB_Disp_IndLmp_Rq_2_AR_check_output();
    EPS_Stat_Disp_Rq_AR_check_output();
    ESP_Disp_Rq_AR_check_output();
    ESP_Disp_Rq2_AR_check_output();
    ESP_Disp_Rq3_AR_check_output();
    ESP_Disp_Rq_AMG_AR_check_output();
    EVC_CfgBit_01_32_AR_check_output();
    EVC_CfgBit_33_64_AR_check_output();
    EVC_CfgBit_65_96_AR_check_output();
    EVC_CfgBit_97_C8_AR_check_output();
    EVC_CfgList_01_0C_AR_check_output();
    FBL_CFG_Star2_AR_check_output();
    FCW_Disp_Rq_AR_check_output();
    Fuel_Stat2_AR_check_output();
    FuelLvl_Stat_AR_check_output();
    FWLP_D_AR_check_output();
    FWLP_P_AR_check_output();
    HumanMachineIfc_AR_check_output();           // Botschaft HumanMachineIfc_AR           --- Sendeart  --- 
    HumanMachineIfc_Rq_AR_check_output();        // Botschaft HumanMachineIfc_Rq_AR        --- Sendeart  --- 
    HVAC_Disp_Stat1_AR_check_output();           // Botschaft HVAC_Disp_Stat1_AR           --- Sendeart  --- 
    HVAC_Disp_Stat2_AR_check_output();           // Botschaft HVAC_Disp_Stat2_AR           --- Sendeart  --- 
    HVAC_Disp_Stat3_AR_check_output();           // Botschaft HVAC_Disp_Stat3_AR           --- Sendeart  --- 
    HVAC_State1_AR_check_output();               // Botschaft HVAC_State1_AR               --- Sendeart  --- 
    ICH_PreTime_Stat_AR_check_output();          // Botschaft ICH_PreTime_Stat_AR          --- Sendeart  --- 
    ICH_Stat_AR_check_output();                  // Botschaft ICH_Stat_AR                  --- Sendeart  --- 
    Ign_Veh_Stat_AR_check_output();              // Botschaft Ign_Veh_Stat_AR              --- Sendeart  --- 
    IL_AmbLgt_Disp_AR_check_output();            // Botschaft IL_AmbLgt_Disp_AR            --- Sendeart  --- 
    IL_AmbLgtCfg_Stat_AR_check_output();         // Botschaft IL_AmbLgtCfg_Stat_AR         --- Sendeart  --- 
    Immobilizer_Disp_Rq_AR_check_output();       // Botschaft Immobilizer_Disp_Rq_AR       --- Sendeart  --- 
    Immobilizer_IC_AR_check_output();            // Botschaft Immobilizer_IC_AR            --- Sendeart  --- 
    Immobilizer_KeyID_AR_check_output();         // Botschaft Immobilizer_KeyID_AR         --- Sendeart  --- 
    KG_Msg_Disp_Rq_AR_check_output();            // Botschaft KG_Msg_Disp_Rq_AR            --- Sendeart  --- 
    LDC_Disp_Rq_ESP_AR_check_output();           // Botschaft LDC_Disp_Rq_ESP_AR           --- Sendeart  --- 
    LDC_Disp_Rq_RDU_AR_check_output();           // Botschaft LDC_Disp_Rq_RDU_AR           --- Sendeart  --- 
    LDP_Warn_Rq_AR_check_output();               // Botschaft LDP_Warn_Rq_AR               --- Sendeart  --- 
    LgtSens_State_AR_check_output();             // Botschaft LgtSens_State_AR             --- Sendeart  --- 
    MCMS_FL_AR_check_output();                   // Botschaft MCMS_FL_AR                   --- Sendeart  --- 
    MCMS_FL_Stat_AR_check_output();              // Botschaft MCMS_FL_Stat_AR              --- Sendeart  --- 
    MCMS_FR_AR_check_output();                   // Botschaft MCMS_FR_AR                   --- Sendeart  --- 
    MCMS_FR_Stat_AR_check_output();              // Botschaft MCMS_FR_Stat_AR              --- Sendeart  --- 
    MCMS_RL_AR_check_output();                   // Botschaft MCMS_RL_AR                   --- Sendeart  --- 
    MCMS_RL_Stat_AR_check_output();              // Botschaft MCMS_RL_Stat_AR              --- Sendeart  --- 
    MCMS_RR_AR_check_output();                   // Botschaft MCMS_RR_AR                   --- Sendeart  --- 
    MCMS_RR_Stat_AR_check_output();              // Botschaft MCMS_RR_Stat_AR              --- Sendeart  --- 
    OffRoad_Disp_Rq_AR_check_output();           // Botschaft OffRoad_Disp_Rq_AR           --- Sendeart  --- 
    Park_Disp_Rq_AR_check_output();              // Botschaft Park_Disp_Rq_AR              --- Sendeart  --- 
    Park_Set_Stat_AR_check_output();             // Botschaft Park_Set_Stat_AR             --- Sendeart  --- 
    ParkSpaceMeas_Stat_AR_check_output();
    ParkWarn_AR_check_output();
    PERIPHERY_HMI_R1_AR_check_output();
    PN14_Disp_Rq_AR_check_output();
    PN14_Disp_Rq2_AR_check_output();
    PN14_Stat_AR_check_output();
// 5ms    PN48_Disp_Rq_AR_check_output();
    PnHt_Stat_AR_check_output();
    PNHV_EnergyMngmnt_Disp_Rq_AR_check_output();
    PNHV_EnergyMngmnt_Stat2_AR_check_output();
    PNHV_EnergyMngmntSet_Rs1_AR_check_output();
    PNHV_EnergyMngmntSet_Rs2_AR_check_output();
    PNHV_WeekDepTmTbl_Stat_AR_check_output();
    PreCond_CfgStat_AR_check_output();
    PresfCtrl_Rq_ESP_AR_check_output();
    PT_DataContain_Rq_AR_check_output();
    PtHyb_Mngmnt_Rq_AR_check_output();
    PT_Disp_Rq2_AR_check_output();
    PtMngmnt_Disp_Rq_AR_check_output();
// 5ms    RDU_Disp_Rq_AR_check_output();
    RVC_SVS_Park_Stat_AR_check_output();
    SBW_DrvPosn_Disp_Rq_ISM_AR_check_output();
    SBW_DrvPosn_Disp_Rq_TCM_AR_check_output();
    Seat_D_Stat_AR_check_output();
    Seat_P_Stat_AR_check_output();
    Seat_RL_Stat_AR_check_output();
    Seat_RR_Stat_AR_check_output();
    SeatHtVn_Stat_AR_check_output();
    SeatHtVn_Stat2_AR_check_output();
// 5ms    SeatMem_D_Rq_AR_check_output();
    SeatPosn_Abs_D_AR_check_output();
    SeatPosn_Abs_P_AR_check_output();
    SND_GEN_Stat_AR_check_output();
// 5ms    SPC_Disp_Rq_AR_check_output();
    SPC_SwLED_Msg_Rq_AR_check_output();
// 5ms    SPV_Rq_AR_check_output();
// 5ms    SPV_Stat_AR_check_output();
// 5ms    StWhl_Angl_Stat_AR_check_output();
// 5ms    StWhl_OFN_Stat_AR_check_output();
    StWhl_Sw_Stat_AR_check_output();
    TC_Disp_Rq_ECM_AR_check_output();
    TC_EBBC_Disp_Rq_ECM_AR_check_output();
    TC_EEBBC_Disp_Rq_AR_check_output();
    TCM_Disp_Rq_AMG_AR_check_output();
    Teleaid_WRN_AR_check_output();
    TP_COM_TGW_Adapt_check_output();
//    TP_EIS_IC_SecOdo_check_output();
    TP_MPM_TGW_Nav_check_output();
    TP_PARK_TGW_check_output();
    TP_TELEAID_TGW_check_output();
    TP_WPT_IC_check_output();
    TP_WPT_TGW_check_output();
    Trailer_Stat_AR_check_output();
// 5ms    TSA_Disp_Rq1_AR_check_output();
    TSA_Disp_Rq2_AR_check_output();
    VehDyn_Stat1_AR_check_output();
    VehDyn_Stat2_AR_check_output();
    VehLvl_Stat_AR_check_output();
    VehPwrMngmnt_EMM_Stat2_AR_check_output();
    VehSpd_X_AR_check_output();
    VIN_AR_check_output();
    VTA_Event_Disp_AR_check_output();
    Whl_Lt_Stat_AR_check_output();
    Whl_Rt_Stat_AR_check_output();
    WhlPlsCnt_TPM_AR_check_output();
    WIA_EngTrq_AR_check_output();
    Wpr_Stat_AR_check_output();
    WPT_Stat2_AR_check_output();
// #CYC_TIMER_20_MS_END#
//    APPL_ECU_APM_1_check_output();               // Botschaft APPL_ECU_APM_1               --- Sendeart  --- 
//    APPL_ECU_APM_2_check_output();               // Botschaft APPL_ECU_APM_2               --- Sendeart  --- 
//    APPL_ECU_DRVU_1_check_output();              // Botschaft APPL_ECU_DRVU_1              --- Sendeart  --- 
//    APPL_ECU_DRVU_2_check_output();              // Botschaft APPL_ECU_DRVU_2              --- Sendeart  --- 
    APPL_ECU_HIL_TO_IC1_check_output();          // Botschaft APPL_ECU_HIL_TO_IC1          --- Sendeart  --- 
//    APPL_ECU_ORC1_check_output();                // Botschaft APPL_ECU_ORC1                --- Sendeart  --- 
//    APPL_ECU_RVC_SVS1_check_output();            // Botschaft APPL_ECU_RVC_SVS1            --- Sendeart  --- 
//    APPL_ECU_TGW1_check_output();                // Botschaft APPL_ECU_TGW1                --- Sendeart  --- 
//    NM_APPL_AR_check_output();                   // Botschaft NM_APPL_AR                   --- Sendeart  --- 
//    NM_EIS_AR_check_output();                    // Botschaft NM_EIS_AR                    --- Sendeart  --- 
//    XCP_Rq_DRVU_1_check_output();                // Botschaft XCP_Rq_DRVU_1                --- Sendeart  --- 
//    XCP_Rq_DRVU_2_check_output();                // Botschaft XCP_Rq_DRVU_2                --- Sendeart  --- 
//    XCP_Rq_RBTM_FL_check_output();               // Botschaft XCP_Rq_RBTM_FL               --- Sendeart  --- 
//    XCP_Rq_RBTM_FR_check_output();               // Botschaft XCP_Rq_RBTM_FR               --- Sendeart  --- 
//    XCP_Rq_RVC_SVS_check_output();               // Botschaft XCP_Rq_RVC_SVS               --- Sendeart  --- 
//    XCP_Rq_TPM_check_output();                   // Botschaft XCP_Rq_TPM                   --- Sendeart  --- 
}
/*@@end*/

/*@@envVar:HMI__SAVE_PANEL_CONFIG_EIS:*/
on EnvVar HMI__SAVE_PANEL_CONFIG_EIS
{
    dword hFile;

    if( getValue(this) )
    {
        write("Saving HMI Panel Variables ...");

        hFile = openFileWrite( "CONFIG\\HMI_PRESETS.ASC", 0 );
        filePutString( "base hex timestamps absolute\n", 31, hFile );

// #MSG_SAVEENVVAR#
        AB_R_Stat_AR_saveEnvVars( hFile );
        Adapt_Seat_D_Stat_AR_saveEnvVars( hFile );
        Adblue_Disp_Rq_AR_saveEnvVars( hFile );
        Adblue_Disp_Warn_Rq_AR_saveEnvVars( hFile );
        Assyst_Stat_AR_saveEnvVars( hFile );
        Assyst_Stat2_AR_saveEnvVars( hFile );
        Assyst_Stat3_AR_saveEnvVars( hFile );
        AWD_TCASE_Disp_Rq_AR_saveEnvVars( hFile );
        BC_F_Disp_Rq_AR_saveEnvVars( hFile );
        BC_F_Stat1_AR_saveEnvVars( hFile );
        BC_F_Stat2_AR_saveEnvVars( hFile );
        BC_R_Stat1_AR_saveEnvVars( hFile );
        BC_R_Stat2_AR_saveEnvVars( hFile );
        BODY_HMI_R0_AR_saveEnvVars( hFile );
        BODY_HMI_R1_AR_saveEnvVars( hFile );
        BODY_HMI_R2_AR_saveEnvVars( hFile );
        BSM_Disp_Warn_Rq_AR_saveEnvVars( hFile );
        CamLane_Disp_Warn_Rq_AR_saveEnvVars( hFile );
        CHASSIS_HMI_R0_AR_saveEnvVars( hFile );
        CHASSIS_HMI_R1_AR_saveEnvVars( hFile );
        CHASSIS_HMI_R2_AR_saveEnvVars( hFile );
        CHASSIS_HMI_R3_AR_saveEnvVars( hFile );
        CHASSIS_HMI_R4_AR_saveEnvVars( hFile );
        CHASSISPERIPHERY_HMI_R1_AR_saveEnvVars( hFile );
        CLkS_Rq_AR_saveEnvVars( hFile );
        CLkS_State_AR_saveEnvVars( hFile );
        ClockSync_Stat_AR_saveEnvVars( hFile );
        CMS_PI_Sd_Stat_AR_saveEnvVars( hFile );
        CMS_PI_Stat_AR_saveEnvVars( hFile );
        CNG_Disp_Rq_AR_saveEnvVars( hFile );
        COM_Call_Stat_AR_saveEnvVars( hFile );
        COMM_EIS_WMI_AR_saveEnvVars( hFile );
        CRCM_Disp_Rq_AR_saveEnvVars( hFile );
        DidA_MBContact_State_AR_saveEnvVars( hFile );
        Door_FL_Stat_AR_saveEnvVars( hFile );
        Door_FR_Stat_AR_saveEnvVars( hFile );
        Door_RL_Stat_AR_saveEnvVars( hFile );
        Door_RR_Stat_AR_saveEnvVars( hFile );
        DPC_Disp_Rq_AR_saveEnvVars( hFile );
        DPC_IndMd_Stat_AR_saveEnvVars( hFile );
        DPC_IndMd_Style_AR_saveEnvVars( hFile );
        DPC_IndMd_Style2_AR_saveEnvVars( hFile );
        DPC_Master_Rq_AR_saveEnvVars( hFile );
        ECO_Score_Disp_Rq_AR_saveEnvVars( hFile );
        EL_Ft_Disp_Rq_AR_saveEnvVars( hFile );
        EL_R_Disp_Rq_AR_saveEnvVars( hFile );
        EL_Stat_AR_saveEnvVars( hFile );
        EL_TurnInd_Rq_AR_saveEnvVars( hFile );
        Eng_Rs_EngCtrl_AR_saveEnvVars( hFile );
        Eng_Rs2_AR_saveEnvVars( hFile );
        EngCtrl_Disp_Rq_AR_saveEnvVars( hFile );
        EngCtrl_Stat_AR_saveEnvVars( hFile );
        EPKB_Disp_IndLmp_Rq_2_AR_saveEnvVars( hFile );
        EPS_Stat_Disp_Rq_AR_saveEnvVars( hFile );
        ESP_Disp_Rq_AR_saveEnvVars( hFile );
        ESP_Disp_Rq2_AR_saveEnvVars( hFile );
        ESP_Disp_Rq3_AR_saveEnvVars( hFile );
        ESP_Disp_Rq_AMG_AR_saveEnvVars( hFile );
        EVC_CfgBit_01_32_AR_saveEnvVars( hFile );
        EVC_CfgBit_33_64_AR_saveEnvVars( hFile );
        EVC_CfgBit_65_96_AR_saveEnvVars( hFile );
        EVC_CfgBit_97_C8_AR_saveEnvVars( hFile );
        EVC_CfgList_01_0C_AR_saveEnvVars( hFile );
        FBL_CFG_Star2_AR_saveEnvVars( hFile );
        FCW_Disp_Rq_AR_saveEnvVars( hFile );
        Fuel_Stat2_AR_saveEnvVars( hFile );
        FuelLvl_Stat_AR_saveEnvVars( hFile );
        FWLP_D_AR_saveEnvVars( hFile );
        FWLP_P_AR_saveEnvVars( hFile );
        HumanMachineIfc_AR_saveEnvVars( hFile );
        HumanMachineIfc_Rq_AR_saveEnvVars( hFile );
        HVAC_Disp_Stat1_AR_saveEnvVars( hFile );
        HVAC_Disp_Stat2_AR_saveEnvVars( hFile );
        HVAC_Disp_Stat3_AR_saveEnvVars( hFile );
        HVAC_State1_AR_saveEnvVars( hFile );
        ICH_PreTime_Stat_AR_saveEnvVars( hFile );
        ICH_Stat_AR_saveEnvVars( hFile );
        Ign_Veh_Stat_AR_saveEnvVars( hFile );
        IL_AmbLgt_Disp_AR_saveEnvVars( hFile );
        IL_AmbLgtCfg_Stat_AR_saveEnvVars( hFile );
        Immobilizer_Disp_Rq_AR_saveEnvVars( hFile );
        Immobilizer_IC_AR_saveEnvVars( hFile );
        Immobilizer_KeyID_AR_saveEnvVars( hFile );
        KG_Msg_Disp_Rq_AR_saveEnvVars( hFile );
        LDC_Disp_Rq_ESP_AR_saveEnvVars( hFile );
        LDC_Disp_Rq_RDU_AR_saveEnvVars( hFile );
        LDP_Warn_Rq_AR_saveEnvVars( hFile );
        LgtSens_State_AR_saveEnvVars( hFile );
        MCMS_FL_AR_saveEnvVars( hFile );
        MCMS_FL_Stat_AR_saveEnvVars( hFile );
        MCMS_FR_AR_saveEnvVars( hFile );
        MCMS_FR_Stat_AR_saveEnvVars( hFile );
        MCMS_RL_AR_saveEnvVars( hFile );
        MCMS_RL_Stat_AR_saveEnvVars( hFile );
        MCMS_RR_AR_saveEnvVars( hFile );
        MCMS_RR_Stat_AR_saveEnvVars( hFile );
        OffRoad_Disp_Rq_AR_saveEnvVars( hFile );
        Park_Disp_Rq_AR_saveEnvVars( hFile );
        Park_Set_Stat_AR_saveEnvVars( hFile );
        ParkSpaceMeas_Stat_AR_saveEnvVars( hFile );
        ParkWarn_AR_saveEnvVars( hFile );
        PERIPHERY_HMI_R1_AR_saveEnvVars( hFile );
        PN14_Disp_Rq_AR_saveEnvVars( hFile );
        PN14_Disp_Rq2_AR_saveEnvVars( hFile );
        PN14_Stat_AR_saveEnvVars( hFile );
        PN48_Disp_Rq_AR_saveEnvVars( hFile );
        PnHt_Stat_AR_saveEnvVars( hFile );
        PNHV_EnergyMngmnt_Disp_Rq_AR_saveEnvVars( hFile );
        PNHV_EnergyMngmnt_Stat2_AR_saveEnvVars( hFile );
        PNHV_EnergyMngmntSet_Rs1_AR_saveEnvVars( hFile );
        PNHV_EnergyMngmntSet_Rs2_AR_saveEnvVars( hFile );
//        PNHV_WeekDepTmTbl_Stat_AR_saveEnvVars( hFile );
        PreCond_CfgStat_AR_saveEnvVars( hFile );
        PresfCtrl_Rq_ESP_AR_saveEnvVars( hFile );
        PT_DataContain_Rq_AR_saveEnvVars( hFile );
        PT_Disp_Rq2_AR_saveEnvVars( hFile );
        PtHyb_Mngmnt_Rq_AR_saveEnvVars( hFile );
        PtMngmnt_Disp_Rq_AR_saveEnvVars( hFile );
        RDU_Disp_Rq_AR_saveEnvVars( hFile );
        RVC_SVS_Park_Stat_AR_saveEnvVars( hFile );
        SBW_DrvPosn_Disp_Rq_ISM_AR_saveEnvVars( hFile );
        SBW_DrvPosn_Disp_Rq_TCM_AR_saveEnvVars( hFile );
        Seat_D_Stat_AR_saveEnvVars( hFile );
        Seat_P_Stat_AR_saveEnvVars( hFile );
        Seat_RL_Stat_AR_saveEnvVars( hFile );
        Seat_RR_Stat_AR_saveEnvVars( hFile );
        SeatHtVn_Stat_AR_saveEnvVars( hFile );
        SeatHtVn_Stat2_AR_saveEnvVars( hFile );
        SeatMem_D_Rq_AR_saveEnvVars( hFile );
        SeatPosn_Abs_D_AR_saveEnvVars( hFile );
        SeatPosn_Abs_P_AR_saveEnvVars( hFile );
        SND_GEN_Stat_AR_saveEnvVars( hFile );
        SPC_Disp_Rq_AR_saveEnvVars( hFile );
        SPC_SwLED_Msg_Rq_AR_saveEnvVars( hFile );
        SPV_Rq_AR_saveEnvVars( hFile );
        SPV_Stat_AR_saveEnvVars( hFile );
        StWhl_Angl_Stat_AR_saveEnvVars( hFile );
        StWhl_OFN_Stat_AR_saveEnvVars( hFile );
        StWhl_Sw_Stat_AR_saveEnvVars( hFile );
        TC_Disp_Rq_ECM_AR_saveEnvVars( hFile );
        TC_EBBC_Disp_Rq_ECM_AR_saveEnvVars( hFile );
        TC_EEBBC_Disp_Rq_AR_saveEnvVars( hFile );
        TCM_Disp_Rq_AMG_AR_saveEnvVars( hFile );
        Teleaid_WRN_AR_saveEnvVars( hFile );
        TP_COM_TGW_Adapt_saveEnvVars( hFile );
//        TP_EIS_IC_SecOdo_saveEnvVars( hFile );
        TP_MPM_TGW_Nav_saveEnvVars( hFile );
        TP_PARK_TGW_saveEnvVars( hFile );
        TP_TELEAID_TGW_saveEnvVars( hFile );
        TP_WPT_IC_saveEnvVars( hFile );
        TP_WPT_TGW_saveEnvVars( hFile );
        Trailer_Stat_AR_saveEnvVars( hFile );
        TSA_Disp_Rq1_AR_saveEnvVars( hFile );
        TSA_Disp_Rq2_AR_saveEnvVars( hFile );
        VehDyn_Stat1_AR_saveEnvVars( hFile );
        VehDyn_Stat2_AR_saveEnvVars( hFile );
        VehLvl_Stat_AR_saveEnvVars( hFile );
        VehPwrMngmnt_EMM_Stat2_AR_saveEnvVars( hFile );
        VehSpd_X_AR_saveEnvVars( hFile );
        VIN_AR_saveEnvVars( hFile );
        VTA_Event_Disp_AR_saveEnvVars( hFile );
        Whl_Lt_Stat_AR_saveEnvVars( hFile );
        Whl_Rt_Stat_AR_saveEnvVars( hFile );
        WhlPlsCnt_TPM_AR_saveEnvVars( hFile );
        WIA_EngTrq_AR_saveEnvVars( hFile );
        Wpr_Stat_AR_saveEnvVars( hFile );
        WPT_Stat2_AR_saveEnvVars( hFile );
// #MSG_SAVEENVVAR_END#

//        APPL_ECU_APM_1_saveEnvVars( hFile );
//        APPL_ECU_APM_2_saveEnvVars( hFile );
//        APPL_ECU_DRVU_1_saveEnvVars( hFile );
//        APPL_ECU_DRVU_2_saveEnvVars( hFile );
        APPL_ECU_HIL_TO_IC1_saveEnvVars( hFile );
//        APPL_ECU_ORC1_saveEnvVars( hFile );
//        APPL_ECU_RVC_SVS1_saveEnvVars( hFile );
//        APPL_ECU_TGW1_saveEnvVars( hFile );
//        NM_APPL_AR_saveEnvVars( hFile );
        NM_xxx_AR_saveEnvVars( hFile );
//        XCP_Rq_DRVU_1_saveEnvVars( hFile );
//        XCP_Rq_DRVU_2_saveEnvVars( hFile );
//        XCP_Rq_RBTM_FL_saveEnvVars( hFile );
//        XCP_Rq_RBTM_FR_saveEnvVars( hFile );
//        XCP_Rq_RVC_SVS_saveEnvVars( hFile );
//        XCP_Rq_TPM_saveEnvVars( hFile );

        fileClose(hFile );
    }
}
/*@@end*/

/*@@envVar:HMI__STOP_EIS_MESSAGES_OFF:*/
on EnvVar HMI__STOP_EIS_MESSAGES_OFF
{
    if( getValue(this) )
    {
// #MSG_OFF#
        putValue( HMI__STMSG_AB_R_Stat_AR, 1 );
        putValue( HMI__STMSG_Adapt_Seat_D_Stat_AR, 1 );
        putValue( HMI__STMSG_Adblue_Disp_Rq_AR, 1 );
        putValue( HMI__STMSG_Adblue_Disp_Warn_Rq_AR, 1 );
        putValue( HMI__STMSG_Assyst_Stat_AR, 1 );
        putValue( HMI__STMSG_Assyst_Stat2_AR, 1 );
        putValue( HMI__STMSG_Assyst_Stat3_AR, 1 );
        putValue( HMI__STMSG_AWD_TCASE_Disp_Rq_AR, 1 );
        putValue( HMI__STMSG_BC_F_Disp_Rq_AR, 1 );
        putValue( HMI__STMSG_BC_F_Stat1_AR, 1 );
        putValue( HMI__STMSG_BC_F_Stat2_AR, 1 );
        putValue( HMI__STMSG_BC_F_Stat4_AR, 1 );
        putValue( HMI__STMSG_BC_R_Stat1_AR, 1 );
        putValue( HMI__STMSG_BC_R_Stat2_AR, 1 );
        putValue( HMI__STMSG_BODY_HMI_R0_AR, 1 );
        putValue( HMI__STMSG_BODY_HMI_R1_AR, 1 );
        putValue( HMI__STMSG_BODY_HMI_R2_AR, 1 );
        putValue( HMI__STMSG_BSM_Disp_Warn_Rq_AR, 1 );
        putValue( HMI__STMSG_CamLane_Disp_Warn_Rq_AR, 1 );
        putValue( HMI__STMSG_CHASSIS_HMI_R0_AR, 1 );
        putValue( HMI__STMSG_CHASSIS_HMI_R1_AR, 1 );
        putValue( HMI__STMSG_CHASSIS_HMI_R2_AR, 1 );
        putValue( HMI__STMSG_CHASSIS_HMI_R3_AR, 1 );
        putValue( HMI__STMSG_CHASSIS_HMI_R4_AR, 1 );
        putValue( HMI__STMSG_CHASSISPERIPHERY_HMI_R1_AR, 1 );
        putValue( HMI__STMSG_CLkS_Rq_AR, 1 );
        putValue( HMI__STMSG_CLkS_State_AR, 1 );
        putValue( HMI__STMSG_ClockSync_Stat_AR, 1 );
        putValue( HMI__STMSG_CMS_PI_Sd_Stat_AR, 1 );
        putValue( HMI__STMSG_CMS_PI_Stat_AR, 1 );
        putValue( HMI__STMSG_CNG_Disp_Rq_AR, 1 );
        putValue( HMI__STMSG_COM_Call_Stat_AR, 1 );
        putValue( HMI__STMSG_COMM_EIS_WMI_AR, 1 );
        putValue( HMI__STMSG_CRCM_Disp_Rq_AR, 1 );
        putValue( HMI__STMSG_CU_RemFunc_Rq3_AR, 1 );
        putValue( HMI__STMSG_DidA_MBContact_State_AR, 1 );
        putValue( HMI__STMSG_Door_FL_Stat_AR, 1 );
        putValue( HMI__STMSG_Door_FR_Stat_AR, 1 );
        putValue( HMI__STMSG_Door_RL_Stat_AR, 1 );
        putValue( HMI__STMSG_Door_RR_Stat_AR, 1 );
        putValue( HMI__STMSG_DPC_Disp_Rq_AR, 1 );
        putValue( HMI__STMSG_DPC_IndMd_Stat_AR, 1 );
        putValue( HMI__STMSG_DPC_IndMd_Style_AR, 1 );
        putValue( HMI__STMSG_DPC_IndMd_Style2_AR, 1 );
        putValue( HMI__STMSG_DPC_Master_Rq_AR, 1 );
        putValue( HMI__STMSG_ECO_Score_Disp_Rq_AR, 1 );
        putValue( HMI__STMSG_EL_Ft_Disp_Rq_AR, 1 );
        putValue( HMI__STMSG_EL_R_Disp_Rq_AR, 1 );
        putValue( HMI__STMSG_EL_Stat_AR, 1 );
        putValue( HMI__STMSG_EL_TurnInd_Rq_AR, 1 );
        putValue( HMI__STMSG_Eng_Rs_EngCtrl_AR, 1 );
        putValue( HMI__STMSG_Eng_Rs2_AR, 1 );
        putValue( HMI__STMSG_EngCtrl_Disp_Rq_AR, 1 );
        putValue( HMI__STMSG_EngCtrl_Stat_AR, 1 );
        putValue( HMI__STMSG_EPKB_Disp_IndLmp_Rq_2_AR, 1 );
        putValue( HMI__STMSG_EPS_Stat_Disp_Rq_AR, 1 );
        putValue( HMI__STMSG_ESP_Disp_Rq_AR, 1 );
        putValue( HMI__STMSG_ESP_Disp_Rq2_AR, 1 );
        putValue( HMI__STMSG_ESP_Disp_Rq3_AR, 1 );
        putValue( HMI__STMSG_ESP_Disp_Rq_AMG_AR, 1 );
        putValue( HMI__STMSG_EVC_CfgBit_01_32_AR, 1 );
        putValue( HMI__STMSG_EVC_CfgBit_33_64_AR, 1 );
        putValue( HMI__STMSG_EVC_CfgBit_65_96_AR, 1 );
        putValue( HMI__STMSG_EVC_CfgBit_97_C8_AR, 1 );
        putValue( HMI__STMSG_EVC_CfgList_01_0C_AR, 1 );
        putValue( HMI__STMSG_FBL_CFG_Star2_AR, 1 );
        putValue( HMI__STMSG_FCW_Disp_Rq_AR, 1 );
        putValue( HMI__STMSG_Fuel_Stat2_AR, 1 );
        putValue( HMI__STMSG_FuelLvl_Stat_AR, 1 );
        putValue( HMI__STMSG_FWLP_D_AR, 1 );
        putValue( HMI__STMSG_FWLP_P_AR, 1 );
        putValue( HMI__STMSG_HumanMachineIfc_AR, 1 );
        putValue( HMI__STMSG_HumanMachineIfc_Rq_AR, 1 );
        putValue( HMI__STMSG_HVAC_Disp_Stat1_AR, 1 );
        putValue( HMI__STMSG_HVAC_Disp_Stat2_AR, 1 );
        putValue( HMI__STMSG_HVAC_Disp_Stat3_AR, 1 );
        putValue( HMI__STMSG_HVAC_State1_AR, 1 );
        putValue( HMI__STMSG_ICH_PreTime_Stat_AR, 1 );
        putValue( HMI__STMSG_ICH_Stat_AR, 1 );
        putValue( HMI__STMSG_Ign_Veh_Stat_AR, 1 );
        putValue( HMI__STMSG_IHC_Lgt_Stat_MPC_AR, 1 );
        putValue( HMI__STMSG_IL_AmbLgt_Disp_AR, 1 );
        putValue( HMI__STMSG_IL_AmbLgtCfg_Stat_AR, 1 );
        putValue( HMI__STMSG_IL_AmbLgtCfg_Stat2_AR, 1 );
        putValue( HMI__STMSG_Immobilizer_Disp_Rq_AR, 1 );
        putValue( HMI__STMSG_Immobilizer_IC_AR, 1 );
        putValue( HMI__STMSG_Immobilizer_KeyID_AR, 1 );
        putValue( HMI__STMSG_KG_Msg_Disp_Rq_AR, 1 );
        putValue( HMI__STMSG_LDC_Disp_Rq_ESP_AR, 1 );
        putValue( HMI__STMSG_LDC_Disp_Rq_RDU_AR, 1 );
        putValue( HMI__STMSG_LDP_Warn_Rq_AR, 1 );
        putValue( HMI__STMSG_LgtSens_State_AR, 1 );
        putValue( HMI__STMSG_MCMS_FL_AR, 1 );
        putValue( HMI__STMSG_MCMS_FL_Stat_AR, 1 );
        putValue( HMI__STMSG_MCMS_FR_AR, 1 );
        putValue( HMI__STMSG_MCMS_FR_Stat_AR, 1 );
        putValue( HMI__STMSG_MCMS_RL_AR, 1 );
        putValue( HMI__STMSG_MCMS_RL_Stat_AR, 1 );
        putValue( HMI__STMSG_MCMS_RR_AR, 1 );
        putValue( HMI__STMSG_MCMS_RR_Stat_AR, 1 );
        putValue( HMI__STMSG_OffRoad_Disp_Rq_AR, 1 );
        putValue( HMI__STMSG_Park_Disp_Rq_AR, 1 );
        putValue( HMI__STMSG_Park_Set_Stat_AR, 1 );
        putValue( HMI__STMSG_ParkSpaceMeas_Stat_AR, 1 );
        putValue( HMI__STMSG_ParkWarn_AR, 1 );
        putValue( HMI__STMSG_PERIPHERY_HMI_R1_AR, 1 );
        putValue( HMI__STMSG_PN14_Disp_Rq_AR, 1 );
        putValue( HMI__STMSG_PN14_Disp_Rq2_AR, 1 );
        putValue( HMI__STMSG_PN14_Stat_AR, 1 );
        putValue( HMI__STMSG_PN48_Disp_Rq_AR, 1 );
        putValue( HMI__STMSG_PnHt_Stat_AR, 1 );
        putValue( HMI__STMSG_PNHV_EnergyMngmnt_Disp_Rq_AR, 1 );
        putValue( HMI__STMSG_PNHV_EnergyMngmnt_Stat2_AR, 1 );
        putValue( HMI__STMSG_PNHV_EnergyMngmntSet_Rs1_AR, 1 );
        putValue( HMI__STMSG_PNHV_EnergyMngmntSet_Rs2_AR, 1 );
        putValue( HMI__STMSG_PNHV_WeekDepTmTbl_Stat_AR, 1 );
        putValue( HMI__STMSG_PreCond_CfgStat_AR, 1 );
        putValue( HMI__STMSG_PresfCtrl_Rq_ESP_AR, 1 );
        putValue( HMI__STMSG_PT_DataContain_Rq_AR, 1 );
        putValue( HMI__STMSG_PT_Disp_Rq2_AR, 1 );
        putValue( HMI__STMSG_PtHyb_Mngmnt_Rq_AR, 1 );
        putValue( HMI__STMSG_PtMngmnt_Disp_Rq_AR, 1 );
        putValue( HMI__STMSG_RDU_Disp_Rq_AR, 1 );
        putValue( HMI__STMSG_RVC_SVS_Park_Stat_AR, 1 );
        putValue( HMI__STMSG_SBW_DrvPosn_Disp_Rq_ISM_AR, 1 );
        putValue( HMI__STMSG_SBW_DrvPosn_Disp_Rq_TCM_AR, 1 );
        putValue( HMI__STMSG_Seat_D_Stat_AR, 1 );
        putValue( HMI__STMSG_Seat_P_Stat_AR, 1 );
        putValue( HMI__STMSG_Seat_RL_Stat_AR, 1 );
        putValue( HMI__STMSG_Seat_RR_Stat_AR, 1 );
        putValue( HMI__STMSG_SeatHtVn_Stat_AR, 1 );
        putValue( HMI__STMSG_SeatHtVn_Stat2_AR, 1 );
        putValue( HMI__STMSG_SeatMem_D_Rq_AR, 1 );
        putValue( HMI__STMSG_SeatPosn_Abs_D_AR, 1 );
        putValue( HMI__STMSG_SeatPosn_Abs_P_AR, 1 );
        putValue( HMI__STMSG_SND_GEN_Stat_AR, 1 );
        putValue( HMI__STMSG_SPC_Disp_Rq_AR, 1 );
        putValue( HMI__STMSG_SPC_SwLED_Msg_Rq_AR, 1 );
        putValue( HMI__STMSG_SPV_Rq_AR, 1 );
        putValue( HMI__STMSG_SPV_Stat_AR, 1 );
        putValue( HMI__STMSG_StWhl_Angl_Stat_AR, 1 );
        putValue( HMI__STMSG_StWhl_OFN_Stat_AR, 1 );
        putValue( HMI__STMSG_StWhl_Sw_Stat_AR, 1 );
        putValue( HMI__STMSG_TC_Disp_Rq_ECM_AR, 1 );
        putValue( HMI__STMSG_TC_EBBC_Disp_Rq_ECM_AR, 1 );
        putValue( HMI__STMSG_TC_EEBBC_Disp_Rq_AR, 1 );
        putValue( HMI__STMSG_TCM_Disp_Rq_AMG_AR, 1 );
        putValue( HMI__STMSG_Teleaid_WRN_AR, 1 );
        putValue( HMI__STMSG_TP_COM_TGW_Adapt, 1 );
        putValue( HMI__STMSG_TP_EIS_IC_SecOdo, 1 );
        putValue( HMI__STMSG_TP_MPM_TGW_Nav, 1 );
        putValue( HMI__STMSG_TP_PARK_TGW, 1 );
        putValue( HMI__STMSG_TP_TELEAID_TGW, 1 );
        putValue( HMI__STMSG_TP_WPT_IC, 1 );
        putValue( HMI__STMSG_TP_WPT_TGW, 1 );
        putValue( HMI__STMSG_Trailer_Stat_AR, 1 );
        putValue( HMI__STMSG_TSA_Disp_Rq1_AR, 1 );
        putValue( HMI__STMSG_TSA_Disp_Rq2_AR, 1 );
        putValue( HMI__STMSG_VehDyn_Stat1_AR, 1 );
        putValue( HMI__STMSG_VehDyn_Stat2_AR, 1 );
        putValue( HMI__STMSG_VehLvl_Stat_AR, 1 );
        putValue( HMI__STMSG_VehPwrMngmnt_EMM_Stat2_AR, 1 );
        putValue( HMI__STMSG_VehSpd_X_AR, 1 );
        putValue( HMI__STMSG_VIN_AR, 1 );
        putValue( HMI__STMSG_VTA_Event_Disp_AR, 1 );
        putValue( HMI__STMSG_Whl_Lt_Stat_AR, 1 );
        putValue( HMI__STMSG_Whl_Rt_Stat_AR, 1 );
        putValue( HMI__STMSG_WhlPlsCnt_TPM_AR, 1 );
        putValue( HMI__STMSG_WIA_EngTrq_AR, 1 );
        putValue( HMI__STMSG_Wpr_Stat_AR, 1 );
        putValue( HMI__STMSG_WPT_Stat2_AR, 1 );
// #MSG_OFF_END#

//        putValue( HMI__STMSG_APPL_ECU_APM_1, 1 );
//        putValue( HMI__STMSG_APPL_ECU_APM_2, 1 );
//        putValue( HMI__STMSG_APPL_ECU_DRVU_1, 1 );
//        putValue( HMI__STMSG_APPL_ECU_DRVU_2, 1 );
//        putValue( HMI__STMSG_APPL_ECU_HIL_TO_IC1, 1 );   only on event
//        putValue( HMI__STMSG_APPL_ECU_ORC1, 1 );
//        putValue( HMI__STMSG_APPL_ECU_RVC_SVS1, 1 );
//        putValue( HMI__STMSG_APPL_ECU_TGW1, 1 );
//        putValue( HMI__STMSG_NM_APPL_AR, 1 );
        putValue( HMI__STMSG_NM_EIS_AR, 1 );
//        putValue( HMI__STMSG_XCP_Rq_DRVU_1, 1 );
//        putValue( HMI__STMSG_XCP_Rq_DRVU_2, 1 );
//        putValue( HMI__STMSG_XCP_Rq_RBTM_FL, 1 );
//        putValue( HMI__STMSG_XCP_Rq_RBTM_FR, 1 );
//        putValue( HMI__STMSG_XCP_Rq_RVC_SVS, 1 );
//        putValue( HMI__STMSG_XCP_Rq_TPM, 1 );
    }
}
/*@@end*/

/*@@envVar:HMI__STOP_EIS_MESSAGES_ON:*/
on envVar HMI__STOP_EIS_MESSAGES_ON
{
    if( getValue(this) )
    {
// #MSG_ON#
        putValue( HMI__STMSG_AB_R_Stat_AR, 0 );
        putValue( HMI__STMSG_Adapt_Seat_D_Stat_AR, 0 );
        putValue( HMI__STMSG_Adblue_Disp_Rq_AR, 0 );
        putValue( HMI__STMSG_Adblue_Disp_Warn_Rq_AR, 0 );
        putValue( HMI__STMSG_Assyst_Stat_AR, 0 );
        putValue( HMI__STMSG_Assyst_Stat2_AR, 0 );
        putValue( HMI__STMSG_Assyst_Stat3_AR, 0 );
        putValue( HMI__STMSG_AWD_TCASE_Disp_Rq_AR, 0 );
        putValue( HMI__STMSG_BC_F_Disp_Rq_AR, 0 );
        putValue( HMI__STMSG_BC_F_Stat1_AR, 0 );
        putValue( HMI__STMSG_BC_F_Stat2_AR, 0 );
        putValue( HMI__STMSG_BC_F_Stat4_AR, 0 );
        putValue( HMI__STMSG_BC_R_Stat1_AR, 0 );
        putValue( HMI__STMSG_BC_R_Stat2_AR, 0 );
        putValue( HMI__STMSG_BODY_HMI_R0_AR, 0 );
        putValue( HMI__STMSG_BODY_HMI_R1_AR, 0 );
        putValue( HMI__STMSG_BODY_HMI_R2_AR, 0 );
        putValue( HMI__STMSG_BSM_Disp_Warn_Rq_AR, 0 );
        putValue( HMI__STMSG_CamLane_Disp_Warn_Rq_AR, 0 );
        putValue( HMI__STMSG_CHASSIS_HMI_R0_AR, 0 );
        putValue( HMI__STMSG_CHASSIS_HMI_R1_AR, 0 );
        putValue( HMI__STMSG_CHASSIS_HMI_R2_AR, 0 );
        putValue( HMI__STMSG_CHASSIS_HMI_R3_AR, 0 );
        putValue( HMI__STMSG_CHASSIS_HMI_R4_AR, 0 );
        putValue( HMI__STMSG_CHASSISPERIPHERY_HMI_R1_AR, 0 );
        putValue( HMI__STMSG_CLkS_Rq_AR, 0 );
        putValue( HMI__STMSG_CLkS_State_AR, 0 );
        putValue( HMI__STMSG_ClockSync_Stat_AR, 0 );
        putValue( HMI__STMSG_CMS_PI_Sd_Stat_AR, 0 );
        putValue( HMI__STMSG_CMS_PI_Stat_AR, 0 );
        putValue( HMI__STMSG_CNG_Disp_Rq_AR, 0 );
        putValue( HMI__STMSG_COM_Call_Stat_AR, 0 );
        putValue( HMI__STMSG_COMM_EIS_WMI_AR, 0 );
        putValue( HMI__STMSG_CRCM_Disp_Rq_AR, 0 );
        putValue( HMI__STMSG_CU_RemFunc_Rq3_AR, 0 );
        putValue( HMI__STMSG_DidA_MBContact_State_AR, 0 );
        putValue( HMI__STMSG_Door_FL_Stat_AR, 0 );
        putValue( HMI__STMSG_Door_FR_Stat_AR, 0 );
        putValue( HMI__STMSG_Door_RL_Stat_AR, 0 );
        putValue( HMI__STMSG_Door_RR_Stat_AR, 0 );
        putValue( HMI__STMSG_DPC_Disp_Rq_AR, 0 );
        putValue( HMI__STMSG_DPC_IndMd_Stat_AR, 0 );
        putValue( HMI__STMSG_DPC_IndMd_Style_AR, 0 );
        putValue( HMI__STMSG_DPC_IndMd_Style2_AR, 0 );
        putValue( HMI__STMSG_DPC_Master_Rq_AR, 0 );
        putValue( HMI__STMSG_ECO_Score_Disp_Rq_AR, 0 );
        putValue( HMI__STMSG_EL_Ft_Disp_Rq_AR, 0 );
        putValue( HMI__STMSG_EL_R_Disp_Rq_AR, 0 );
        putValue( HMI__STMSG_EL_Stat_AR, 0 );
        putValue( HMI__STMSG_EL_TurnInd_Rq_AR, 0 );
        putValue( HMI__STMSG_Eng_Rs_EngCtrl_AR, 0 );
        putValue( HMI__STMSG_Eng_Rs2_AR, 0 );
        putValue( HMI__STMSG_EngCtrl_Disp_Rq_AR, 0 );
        putValue( HMI__STMSG_EngCtrl_Stat_AR, 0 );
        putValue( HMI__STMSG_EPKB_Disp_IndLmp_Rq_2_AR, 0 );
        putValue( HMI__STMSG_EPS_Stat_Disp_Rq_AR, 0 );
        putValue( HMI__STMSG_ESP_Disp_Rq_AR, 0 );
        putValue( HMI__STMSG_ESP_Disp_Rq2_AR, 0 );
        putValue( HMI__STMSG_ESP_Disp_Rq3_AR, 0 );
        putValue( HMI__STMSG_ESP_Disp_Rq_AMG_AR, 0 );
        putValue( HMI__STMSG_EVC_CfgBit_01_32_AR, 0 );
        putValue( HMI__STMSG_EVC_CfgBit_33_64_AR, 0 );
        putValue( HMI__STMSG_EVC_CfgBit_65_96_AR, 0 );
        putValue( HMI__STMSG_EVC_CfgBit_97_C8_AR, 0 );
        putValue( HMI__STMSG_EVC_CfgList_01_0C_AR, 0 );
        putValue( HMI__STMSG_FBL_CFG_Star2_AR, 0 );
        putValue( HMI__STMSG_FCW_Disp_Rq_AR, 0 );
        putValue( HMI__STMSG_Fuel_Stat2_AR, 0 );
        putValue( HMI__STMSG_FuelLvl_Stat_AR, 0 );
        putValue( HMI__STMSG_FWLP_D_AR, 0 );
        putValue( HMI__STMSG_FWLP_P_AR, 0 );
        putValue( HMI__STMSG_HumanMachineIfc_AR, 0 );
        putValue( HMI__STMSG_HumanMachineIfc_Rq_AR, 0 );
        putValue( HMI__STMSG_HVAC_Disp_Stat1_AR, 0 );
        putValue( HMI__STMSG_HVAC_Disp_Stat2_AR, 0 );
        putValue( HMI__STMSG_HVAC_Disp_Stat3_AR, 0 );
        putValue( HMI__STMSG_HVAC_State1_AR, 0 );
        putValue( HMI__STMSG_ICH_PreTime_Stat_AR, 0 );
        putValue( HMI__STMSG_ICH_Stat_AR, 0 );
        putValue( HMI__STMSG_Ign_Veh_Stat_AR, 0 );
        putValue( HMI__STMSG_IHC_Lgt_Stat_MPC_AR, 0 );
        putValue( HMI__STMSG_IL_AmbLgt_Disp_AR, 0 );
        putValue( HMI__STMSG_IL_AmbLgtCfg_Stat_AR, 0 );
        putValue( HMI__STMSG_IL_AmbLgtCfg_Stat2_AR, 0 );
        putValue( HMI__STMSG_Immobilizer_Disp_Rq_AR, 0 );
        putValue( HMI__STMSG_Immobilizer_IC_AR, 0 );
        putValue( HMI__STMSG_Immobilizer_KeyID_AR, 0 );
        putValue( HMI__STMSG_KG_Msg_Disp_Rq_AR, 0 );
        putValue( HMI__STMSG_LDC_Disp_Rq_ESP_AR, 0 );
        putValue( HMI__STMSG_LDC_Disp_Rq_RDU_AR, 0 );
        putValue( HMI__STMSG_LDP_Warn_Rq_AR, 0 );
        putValue( HMI__STMSG_LgtSens_State_AR, 0 );
        putValue( HMI__STMSG_MCMS_FL_AR, 0 );
        putValue( HMI__STMSG_MCMS_FL_Stat_AR, 0 );
        putValue( HMI__STMSG_MCMS_FR_AR, 0 );
        putValue( HMI__STMSG_MCMS_FR_Stat_AR, 0 );
        putValue( HMI__STMSG_MCMS_RL_AR, 0 );
        putValue( HMI__STMSG_MCMS_RL_Stat_AR, 0 );
        putValue( HMI__STMSG_MCMS_RR_AR, 0 );
        putValue( HMI__STMSG_MCMS_RR_Stat_AR, 0 );
        putValue( HMI__STMSG_OffRoad_Disp_Rq_AR, 0 );
        putValue( HMI__STMSG_Park_Disp_Rq_AR, 0 );
        putValue( HMI__STMSG_Park_Set_Stat_AR, 0 );
        putValue( HMI__STMSG_ParkSpaceMeas_Stat_AR, 0 );
        putValue( HMI__STMSG_ParkWarn_AR, 0 );
        putValue( HMI__STMSG_PERIPHERY_HMI_R1_AR, 0 );
        putValue( HMI__STMSG_PN14_Disp_Rq_AR, 0 );
        putValue( HMI__STMSG_PN14_Disp_Rq2_AR, 0 );
        putValue( HMI__STMSG_PN14_Stat_AR, 0 );
        putValue( HMI__STMSG_PN48_Disp_Rq_AR, 0 );
        putValue( HMI__STMSG_PnHt_Stat_AR, 0 );
        putValue( HMI__STMSG_PNHV_EnergyMngmnt_Disp_Rq_AR, 0 );
        putValue( HMI__STMSG_PNHV_EnergyMngmnt_Stat2_AR, 0 );
        putValue( HMI__STMSG_PNHV_EnergyMngmntSet_Rs1_AR, 0 );
        putValue( HMI__STMSG_PNHV_EnergyMngmntSet_Rs2_AR, 0 );
        putValue( HMI__STMSG_PNHV_WeekDepTmTbl_Stat_AR, 0 );
        putValue( HMI__STMSG_PreCond_CfgStat_AR, 0 );
        putValue( HMI__STMSG_PresfCtrl_Rq_ESP_AR, 0 );
        putValue( HMI__STMSG_PT_DataContain_Rq_AR, 0 );
        putValue( HMI__STMSG_PT_Disp_Rq2_AR, 0 );
        putValue( HMI__STMSG_PtHyb_Mngmnt_Rq_AR, 0 );
        putValue( HMI__STMSG_PtMngmnt_Disp_Rq_AR, 0 );
        putValue( HMI__STMSG_RDU_Disp_Rq_AR, 0 );
        putValue( HMI__STMSG_RVC_SVS_Park_Stat_AR, 0 );
        putValue( HMI__STMSG_SBW_DrvPosn_Disp_Rq_ISM_AR, 0 );
        putValue( HMI__STMSG_SBW_DrvPosn_Disp_Rq_TCM_AR, 0 );
        putValue( HMI__STMSG_Seat_D_Stat_AR, 0 );
        putValue( HMI__STMSG_Seat_P_Stat_AR, 0 );
        putValue( HMI__STMSG_Seat_RL_Stat_AR, 0 );
        putValue( HMI__STMSG_Seat_RR_Stat_AR, 0 );
        putValue( HMI__STMSG_SeatHtVn_Stat_AR, 0 );
        putValue( HMI__STMSG_SeatHtVn_Stat2_AR, 0 );
        putValue( HMI__STMSG_SeatMem_D_Rq_AR, 0 );
        putValue( HMI__STMSG_SeatPosn_Abs_D_AR, 0 );
        putValue( HMI__STMSG_SeatPosn_Abs_P_AR, 0 );
        putValue( HMI__STMSG_SND_GEN_Stat_AR, 0 );
        putValue( HMI__STMSG_SPC_Disp_Rq_AR, 0 );
        putValue( HMI__STMSG_SPC_SwLED_Msg_Rq_AR, 0 );
        putValue( HMI__STMSG_SPV_Rq_AR, 0 );
        putValue( HMI__STMSG_SPV_Stat_AR, 0 );
        putValue( HMI__STMSG_StWhl_Angl_Stat_AR, 0 );
        putValue( HMI__STMSG_StWhl_OFN_Stat_AR, 0 );
        putValue( HMI__STMSG_StWhl_Sw_Stat_AR, 0 );
        putValue( HMI__STMSG_TC_Disp_Rq_ECM_AR, 0 );
        putValue( HMI__STMSG_TC_EBBC_Disp_Rq_ECM_AR, 0 );
        putValue( HMI__STMSG_TC_EEBBC_Disp_Rq_AR, 0 );
        putValue( HMI__STMSG_TCM_Disp_Rq_AMG_AR, 0 );
        putValue( HMI__STMSG_Teleaid_WRN_AR, 0 );
        putValue( HMI__STMSG_TP_COM_TGW_Adapt, 0 );
        putValue( HMI__STMSG_TP_EIS_IC_SecOdo, 0 );
        putValue( HMI__STMSG_TP_MPM_TGW_Nav, 0 );
        putValue( HMI__STMSG_TP_PARK_TGW, 0 );
        putValue( HMI__STMSG_TP_TELEAID_TGW, 0 );
        putValue( HMI__STMSG_TP_WPT_IC, 1 );
        putValue( HMI__STMSG_TP_WPT_TGW, 1 );
        putValue( HMI__STMSG_Trailer_Stat_AR, 0 );
        putValue( HMI__STMSG_TSA_Disp_Rq1_AR, 0 );
        putValue( HMI__STMSG_TSA_Disp_Rq2_AR, 0 );
        putValue( HMI__STMSG_VehDyn_Stat1_AR, 0 );
        putValue( HMI__STMSG_VehDyn_Stat2_AR, 0 );
        putValue( HMI__STMSG_VehLvl_Stat_AR, 0 );
        putValue( HMI__STMSG_VehPwrMngmnt_EMM_Stat2_AR, 0 );
        putValue( HMI__STMSG_VehSpd_X_AR, 0 );
        putValue( HMI__STMSG_VIN_AR, 0 );
        putValue( HMI__STMSG_VTA_Event_Disp_AR, 0 );
        putValue( HMI__STMSG_Whl_Lt_Stat_AR, 0 );
        putValue( HMI__STMSG_Whl_Rt_Stat_AR, 0 );
        putValue( HMI__STMSG_WhlPlsCnt_TPM_AR, 0 );
        putValue( HMI__STMSG_WIA_EngTrq_AR, 0 );
        putValue( HMI__STMSG_Wpr_Stat_AR, 0 );
        putValue( HMI__STMSG_WPT_Stat2_AR, 0 );
// #MSG_ON_END#

//        putValue( HMI__STMSG_APPL_ECU_APM_1, 0 );
//        putValue( HMI__STMSG_APPL_ECU_APM_2, 0 );
//        putValue( HMI__STMSG_APPL_ECU_DRVU_1, 0 );
//        putValue( HMI__STMSG_APPL_ECU_DRVU_2, 0 );
        putValue( HMI__STMSG_APPL_ECU_HIL_TO_IC1, 0 );
//        putValue( HMI__STMSG_APPL_ECU_ORC1, 0 );
//        putValue( HMI__STMSG_APPL_ECU_RVC_SVS1, 0 );
//        putValue( HMI__STMSG_APPL_ECU_TGW1, 0 );
//        putValue( HMI__STMSG_NM_APPL_AR, 0 );
        putValue( HMI__STMSG_NM_EIS_AR, 0 );
//        putValue( HMI__STMSG_XCP_Rq_DRVU_1, 0 );
//        putValue( HMI__STMSG_XCP_Rq_DRVU_2, 0 );
//        putValue( HMI__STMSG_XCP_Rq_RBTM_FL, 0 );
//        putValue( HMI__STMSG_XCP_Rq_RBTM_FR, 0 );
//        putValue( HMI__STMSG_XCP_Rq_RVC_SVS, 0 );
//        putValue( HMI__STMSG_XCP_Rq_TPM, 0 );
    }
}
/*@@end*/

/*@@envVar:HMI__STOP_All_MESSAGES_OFF:*/
on EnvVar HMI__STOP_All_MESSAGES_OFF
{
    if( getValue(this) )
    {
        putValue( HMI__STOP_DRVU_MESSAGES_OFF, 1 );
        putValue( HMI__STOP_EIS_MESSAGES_OFF, 1 );
        putValue( HMI__STOP_HUD_MESSAGES_OFF, 1 );
        putValue( HMI__STOP_IC_MESSAGES_OFF, 1 );
        putValue( HMI__STOP_NV_MESSAGES_OFF, 1 );
        putValue( HMI__STOP_ORC_MESSAGES_OFF, 1 );
        putValue( HMI__STOP_RBTM_FL_MESSAGES_OFF, 1 );
        putValue( HMI__STOP_RBTM_FR_MESSAGES_OFF, 1 );
        putValue( HMI__STOP_SVS_MESSAGES_OFF, 1 );
        putValue( HMI__STOP_TGW_MESSAGES_OFF, 1 );
        putValue( HMI__STOP_TPM_MESSAGES_OFF, 1 );
    }
    else
    {
        putValue( HMI__STOP_DRVU_MESSAGES_OFF, 0 );
        putValue( HMI__STOP_EIS_MESSAGES_OFF, 0 );
        putValue( HMI__STOP_HUD_MESSAGES_OFF, 0 );
        putValue( HMI__STOP_IC_MESSAGES_OFF, 0 );
        putValue( HMI__STOP_NV_MESSAGES_OFF, 0 );
        putValue( HMI__STOP_ORC_MESSAGES_OFF, 0 );
        putValue( HMI__STOP_RBTM_FL_MESSAGES_OFF, 0 );
        putValue( HMI__STOP_RBTM_FR_MESSAGES_OFF, 0 );
        putValue( HMI__STOP_SVS_MESSAGES_OFF, 0 );
        putValue( HMI__STOP_TGW_MESSAGES_OFF, 0 );
        putValue( HMI__STOP_TPM_MESSAGES_OFF, 0 );
    }
}
/*@@end*/

/*@@envVar:HMI__STOP_All_MESSAGES_ON:*/
on EnvVar HMI__STOP_All_MESSAGES_ON
{
    if( getValue(this) )
    {
        putValue( HMI__STOP_DRVU_MESSAGES_ON, 1 );
        putValue( HMI__STOP_EIS_MESSAGES_ON, 1 );
        putValue( HMI__STOP_HUD_MESSAGES_ON, 1 );
        putValue( HMI__STOP_IC_MESSAGES_ON, 1 );
        putValue( HMI__STOP_NV_MESSAGES_ON, 1 );
        putValue( HMI__STOP_ORC_MESSAGES_ON, 1 );
        putValue( HMI__STOP_RBTM_FL_MESSAGES_ON, 1 );
        putValue( HMI__STOP_RBTM_FR_MESSAGES_ON, 1 );
        putValue( HMI__STOP_SVS_MESSAGES_ON, 1 );
        putValue( HMI__STOP_TGW_MESSAGES_ON, 1 );
        putValue( HMI__STOP_TPM_MESSAGES_ON, 1 );
    }
    else
    {
        putValue( HMI__STOP_DRVU_MESSAGES_ON, 0 );
        putValue( HMI__STOP_EIS_MESSAGES_ON, 0 );
        putValue( HMI__STOP_HUD_MESSAGES_ON, 0 );
        putValue( HMI__STOP_IC_MESSAGES_ON, 0 );
        putValue( HMI__STOP_NV_MESSAGES_ON, 0 );
        putValue( HMI__STOP_ORC_MESSAGES_ON, 0 );
        putValue( HMI__STOP_RBTM_FL_MESSAGES_ON, 0 );
        putValue( HMI__STOP_RBTM_FR_MESSAGES_ON, 0 );
        putValue( HMI__STOP_SVS_MESSAGES_ON, 0 );
        putValue( HMI__STOP_TGW_MESSAGES_ON, 0 );
        putValue( HMI__STOP_TPM_MESSAGES_ON, 0 );
    }
}
/*@@end*/

/*@@busOff:BusOff:*/
on busOff
{
    resetCan();
    write("CAN has been resetted due to BUSOFF    ( coded version )");
}
/*@@end*/

/*@@msg:0x500-0x57F:*/
on message 0x500-0x57F
{
    byte Identifier;

    Identifier = this.byte( 1 );

    if( this.byte( 1 ) == CanNmNodeId )    // check, wether the received NM-Frame is an own one
    {
        boCanNM_Tx_Confirmation = TRUE;    // so it is a TX-confirmation
    }
    else
    {
        boCanNM_Rx_Indication = TRUE;     // else it is a NM-Frame from another ECU
    }
    _NM_Switch_NM_Mode();     // inform the state-mashine
}
/*@@end*/

/*@@timer:t_DoorNMCancelTimer:*/
on timer t_DoorNMCancelTimer
{
    if( getValue( HMI__NM_EIS_AutomaticModeActive ) == 1 )
    {
        _ReleaseCommRequest( 15 );  // all doors reset their requests
    }
}
/*@@end*/

/*@@timer:t_KeyInLockNMCancelTimer:*/
on timer t_KeyInLockNMCancelTimer
{
    if( getValue( HMI__NM_EIS_AutomaticModeActive ) == 1 )
    {
        _ReleaseCommRequest( cIgnitionNMRequest );
    }
}
/*@@end*/

/*@@timer:t_StWhlButtonNMCancelTimer:*/
on timer t_StWhlButtonNMCancelTimer
{
    if( getValue( HMI__NM_EIS_AutomaticModeActive ) == 1 )
    {
        _ReleaseCommRequest( cStWhlButtonNMRequest );  // all keys reset their requests
    }
}
/*@@end*/

/*@@timer:t_WakeWarningNMCancelTimer:*/
on timer t_WakeWarningNMCancelTimer
{
    if( getValue( HMI__NM_EIS_AutomaticModeActive ) == 1 )
    {
        _ReleaseCommRequest( cWakeWarningNMRequest );  // all keys reset their requests
    }
}
/*@@end*/

/*@@timer:t_EPKBWarningNMCancelTimer:*/
on timer t_EPKBWarningNMCancelTimer
{
    if( getValue( HMI__NM_EIS_AutomaticModeActive ) == 1 )
    {
        _ReleaseCommRequest( cEPKBWarningNMRequest );  // all keys reset their requests
    }
}
/*@@end*/

/*@@timer:t_IlluNMCancelTimer:*/
on timer t_IlluNMCancelTimer
{
    if( getValue( HMI__NM_EIS_AutomaticModeActive ) == 1 )
    {
        _ReleaseCommRequest( cIlluNMRequest );  // all keys reset their requests
    }
}
/*@@end*/

/*@@timer:t_CarClosureNMCancelTimer:*/
on timer t_CarClosureNMCancelTimer
{
    if( getValue( HMI__NM_EIS_AutomaticModeActive ) == 1 )
    {
        _ReleaseCommRequest( cCarClosureNMRequest );  // all keys reset their requests
    }
}
/*@@end*/

/*@@timer:t_GearIndNMCancelTimer:*/
on timer t_GearIndNMCancelTimer
{
    if( getValue( HMI__NM_EIS_AutomaticModeActive ) == 1 )
    {
        _ReleaseCommRequest( cGearIndNMRequest );  // all keys reset their requests
    }
}
/*@@end*/

/*@@timer:t_NM_Repeat_Message_Time:*/
on timer t_NM_Repeat_Message_Time
{
    boCanNM_RepeatMessage_Timer_Expired = TRUE;
    _NM_Switch_NM_Mode();     // inform the state-mashine
}
/*@@end*/

/*@@timer:t_NM_Timeout_Time:*/
on timer t_NM_Timeout_Time
{
    boCanNM_NM_Timeout_Timer_Expired = TRUE;
    _NM_Switch_NM_Mode();     // inform the state-mashine
}
/*@@end*/

/*@@timer:t_NM_Transmit:*/
on timer t_NM_Transmit
{
    setTimer( t_NM_Transmit, NM_Transmit_Cycle );
    _mNM_xxx_AR.byte( 1 ) = CanNmNodeId;
    if( _mNM_xxx_Transmit_Allowed )
        output( _mNM_xxx_AR );
}
/*@@end*/

/*@@timer:t_NM_Wait_Bus_Sleep_Time:*/
on timer t_NM_Wait_Bus_Sleep_Time
{
    boCanNM_WaitBusSleep_Timer_Expired = TRUE;
    _NM_Switch_NM_Mode();     // inform the state-mashine
}
/*@@end*/

/*@@caplFunc:NM_xxx_AR_init():*/
NM_xxx_AR_init()
{
    _mNM_xxx_AR.Awake_Diag_Actv.phys = getValue( HMI_Awake_Diag_Actv_EIS );
    _mNM_xxx_AR.Awake_Ignition_On.phys = getValue( HMI_Awake_Ignition_On_EIS );
    _mNM_xxx_AR.Awake_IgnitionAccessory_On.phys = getValue( HMI_Awake_IgnitionAccessory_On_EIS );
    _mNM_xxx_AR.Awake_ISw_Stat_Chg.phys = getValue( HMI_Awake_ISw_Stat_Chg_EIS );
    _mNM_xxx_AR.Awake_TXPkPosn_Rq.phys = getValue( HMI_Awake_TXPkPosn_Rq_EIS );
    _mNM_xxx_AR.WakeupRsn_EIS.phys = getValue( HMI_WakeupRsn_EIS );
}
/*@@end*/

/*@@caplFunc:NM_xxx_AR_saveEnvVars(dword):*/
NM_xxx_AR_saveEnvVars( dword hFile )
{
    filePutString("\n// Knoten NM_EIS_AR\n", 33, hFile );
    snprintf(buffer, elcount(buffer), "0.0000 HMI__STMSG_NM_EIS_AR := %X\n", getValue(HMI__STMSG_NM_EIS_AR ));        filePutString (buffer, elcount(buffer), hFile);
    snprintf(buffer, elcount(buffer), "0.0000 HMI__STMSGT_NM_EIS_AR := %X\n", getValue(HMI__STMSGT_NM_EIS_AR ));        filePutString (buffer, elcount(buffer), hFile);
    snprintf(buffer, elcount(buffer), "0.0000 HMI_Awake_Diag_Actv := %X\n", getValue( HMI_Awake_Diag_Actv_EIS ) );        filePutString (buffer, elcount(buffer), hFile);
    snprintf(buffer, elcount(buffer), "0.0000 HMI_Awake_Ignition_On := %X\n", getValue( HMI_Awake_Ignition_On_EIS ) );        filePutString (buffer, elcount(buffer), hFile);
    snprintf(buffer, elcount(buffer), "0.0000 HMI_Awake_IgnitionAccessory_On := %X\n", getValue( HMI_Awake_IgnitionAccessory_On_EIS ) );        filePutString (buffer, elcount(buffer), hFile);
    snprintf(buffer, elcount(buffer), "0.0000 HMI_Awake_ISw_Stat_Chg := %X\n", getValue( HMI_Awake_ISw_Stat_Chg_EIS ) );        filePutString (buffer, elcount(buffer), hFile);
    snprintf(buffer, elcount(buffer), "0.0000 HMI_Awake_TXPkPosn_Rq := %X\n", getValue( HMI_Awake_TXPkPosn_Rq_EIS ) );        filePutString (buffer, elcount(buffer), hFile);
    snprintf(buffer, elcount(buffer), "0.0000 HMI_WakeupRsn_EIS := %X\n", getValue( HMI_WakeupRsn_EIS ) );        filePutString (buffer, elcount(buffer), hFile);
}
/*@@end*/

/*@@envVar:HMI__STMSG_NM_EIS_AR:*/
on envVar HMI__STMSG_NM_EIS_AR
{
    if( getValue( this ) == 0 )
        _mNM_xxx_Transmit_Allowed = 1;
    else
        _mNM_xxx_Transmit_Allowed = 0;    
}
/*@@end*/

/*@@envVar:HMI_Awake_Diag_Actv_EIS:*/
on EnvVar HMI_Awake_Diag_Actv_EIS
{
    _mNM_xxx_AR.Awake_Diag_Actv.phys = getValue(this);
}
/*@@end*/

/*@@envVar:HMI_Awake_Ignition_On_EIS:*/
on EnvVar HMI_Awake_Ignition_On_EIS
{
    _mNM_xxx_AR.Awake_Ignition_On.phys = getValue(this);
}
/*@@end*/

/*@@envVar:HMI_Awake_IgnitionAccessory_On_EIS:*/
on EnvVar HMI_Awake_IgnitionAccessory_On_EIS
{
    _mNM_xxx_AR.Awake_IgnitionAccessory_On.phys = getValue(this);
}
/*@@end*/

/*@@envVar:HMI_Awake_ISw_Stat_Chg_EIS:*/
on EnvVar HMI_Awake_ISw_Stat_Chg_EIS
{
    _mNM_xxx_AR.Awake_ISw_Stat_Chg.phys = getValue(this);
}
/*@@end*/

/*@@envVar:HMI_Awake_TXPkPosn_Rq_EIS:*/
on EnvVar HMI_Awake_TXPkPosn_Rq_EIS
{
    _mNM_xxx_AR.Awake_TXPkPosn_Rq.phys = getValue(this);
}
/*@@end*/

/*@@envVar:HMI_WakeupRsn_EIS:*/
on EnvVar HMI_WakeupRsn_EIS
{
    _mNM_xxx_AR.WakeupRsn_EIS.phys = getValue(this);
}
/*@@end*/

/*@@envVar:HMI__NM_EIS_AutomaticModeActive:*/
on envVar HMI__NM_EIS_AutomaticModeActive
{
    byte temp; // actual NM request status

    if( getValue( this ) )
    {
        EnableControl( "Hauptpanel", "EnvVar:HMI__NM_EIS_Manually_Request_NM", 0 );

        temp = getValue( HMI_ISw_Stat );
        write( "HMI_ISw_Stat is %d", temp );
        if( temp > 1 ) // IGN not Lock
        {
            putValue( HMI__NM_EIS_Manually_Request_NM, 1 );
            putValue( HMI__NM_EIS_NM_Request, cIgnitionNMRequest );
            _NM_Switch_NM_Mode();
        }
        else
        {
            putValue( HMI__NM_EIS_Manually_Request_NM, 0 );
            _ReleaseCommRequest( cAllNMRequest );  // release all requests
            _NM_Switch_NM_Mode();
        }
    }
    else
    {
        EnableControl( "Hauptpanel", "EnvVar:HMI__NM_EIS_Manually_Request_NM", 1 );
        if( getValue( HMI_ISw_Stat ) > 1 )
        {
            _SetCommRequest( cIgnitionNMRequest );
            _NM_Switch_NM_Mode();
            putValue( HMI__NM_EIS_Manually_Request_NM, 1 );
        }
    }
    NM_AutomaticModeActive = getValue( this );
}
/*@@end*/

/*@@envVar:HMI__NM_EIS_Manually_Request_NM:*/
on envVar HMI__NM_EIS_Manually_Request_NM
{
    if( getValue ( HMI__NM_EIS_AutomaticModeActive ) == 0 )
    {
        if( getValue( this ) )
        {
            _SetCommRequest( cManualNMRequest );
        }
        else
        {
            _ReleaseCommRequest( cAllNMRequest );// all
        }
    }
}
/*@@end*/

/*@@caplFunc:_NM_Switch_NM_Mode():*/
_NM_Switch_NM_Mode()
{
    byte bOld_NM_Mode;
    word NM_Request_State;

    bOld_NM_Mode = NM_Mode;
    NM_Request_State = getValue( HMI__NM_EIS_NM_Request );
    switch( NM_Mode )
    {
        case cNM_Mode_Init:                   _NM_Init();
                                              NM_Mode = cNM_Mode_Sleep;
                                              break;
        case cNM_Mode_Sleep:                  if( boCanNM_Rx_Indication == TRUE )
                                              {
                                                  // _NM_NetworkStartIndication();   nothing to do
                                                  // _NM_PassiveStartUp();    is content of _NM_NetworkMode();
                                                  setTimer( t_NM_Transmit, NmAsrCanMsgCycleOffset );    // send NM-Frame delayed
                                                  boCanNM_Rx_Indication = FALSE;
                                                  cancelTimer( t_NM_Timeout_Time );
                                                  setTimer( t_NM_Timeout_Time, c_NM_Timeout_Time );
                                                  setTimer( t_NM_Repeat_Message_Time, c_NM_Repeat_Message_Time );
                                                  NM_Transmit_Cycle = NmAsrCanMsgStandardCycle;
                                                  _NM_NetworkMode();
                                                  NM_Mode = cNM_Mode_RepeatMsg;
                                              }
                                              if( NM_Request_State )
                                              {
                                                  setTimer( t_NM_Transmit, 1 );    //send NM-Franme immediately
                                                  NM_Transmit_Cycle = NmAsrCanMsgStandardCycle;
                                                  cancelTimer( t_NM_Timeout_Time );
                                                  setTimer( t_NM_Timeout_Time, c_NM_Timeout_Time );
                                                  setTimer( t_NM_Repeat_Message_Time, c_NM_Repeat_Message_Time );
                                                  NM_Transmit_Cycle = NmAsrCanMsgStandardCycle;
                                                  _NM_NetworkMode();
                                                  NM_Mode = cNM_Mode_RepeatMsg;
                                              }
                                              break;
        case cNM_Mode_Prepare_Bus_Sleep:      if( boCanNM_WaitBusSleep_Timer_Expired == TRUE )
                                              {
                                                  _NM_BusSleepModeInd();   // set message startup delay
                                                  NM_Mode = cNM_Mode_Sleep;
                                                  boCanNM_WaitBusSleep_Timer_Expired = FALSE;
                                              }
                                              if( boCanNM_NM_Timeout_Timer_Expired == TRUE )
                                                  boCanNM_NM_Timeout_Timer_Expired = FALSE;
                                              if( ( boCanNM_Rx_Indication == TRUE ) ||  NM_Request_State )
                                              {
                                                  boCanNM_Rx_Indication = FALSE;
                                                  if( NM_Request_State )
                                                  {
                                                      setTimer( t_NM_Transmit, 1 );    //send NM-Franme immediately
                                                  }
                                                  cancelTimer( t_NM_Timeout_Time );
                                                  setTimer( t_NM_Timeout_Time, c_NM_Timeout_Time );
                                                  setTimer( t_NM_Repeat_Message_Time, c_NM_Repeat_Message_Time );
                                                  _NM_NetworkMode();
                                                  NM_Transmit_Cycle = NmAsrCanMsgStandardCycle;
                                                  NM_Mode = cNM_Mode_RepeatMsg;
                                              }
                                              break;
        case cNM_Mode_Ready_Sleep:            if( boCanNM_Rx_Indication == TRUE )
                                              {
                                                  cancelTimer( t_NM_Timeout_Time );
                                                  setTimer( t_NM_Timeout_Time, c_NM_Timeout_Time );
                                                  boCanNM_Rx_Indication = FALSE;
                                              }
                                              if( boCanNM_Tx_Confirmation == TRUE )
                                              {
                                                  cancelTimer( t_NM_Timeout_Time );
                                                  setTimer( t_NM_Timeout_Time, c_NM_Timeout_Time );
                                                  boCanNM_Tx_Confirmation = FALSE;
                                              }
                                              if( NM_Request_State )
                                              {
                                                  setTimer( t_NM_Transmit, 1 );    //send NM-Franme immediately
                                                  cancelTimer( t_NM_Timeout_Time );
                                                  setTimer( t_NM_Timeout_Time, c_NM_Timeout_Time );
                                                  NM_Transmit_Cycle = NmAsrCanMsgReducedTime;
                                                  NM_Mode = cNM_Mode_Normal_Operation_State;
                                              }
                                              if( boCanNM_RepeatMessage_Requested == TRUE )
                                              {
                                                  setTimer( t_NM_Transmit, NmAsrCanMsgCycleOffset );    // send NM-Frame delayed
                                                  cancelTimer( t_NM_Timeout_Time );
                                                  setTimer( t_NM_Timeout_Time, c_NM_Timeout_Time );
                                                  setTimer( t_NM_Repeat_Message_Time, c_NM_Repeat_Message_Time );
                                                  NM_Transmit_Cycle = NmAsrCanMsgStandardCycle;
                                                  boCanNM_RepeatMessage_Requested = FALSE;
                                                  NM_Mode = cNM_Mode_RepeatMsg;
                                              }
                                              if( boCanNM_NM_Timeout_Timer_Expired == TRUE )
                                              {
                                                  setTimer( t_NM_Wait_Bus_Sleep_Time, c_NM_Wait_Bus_Sleep_Time );
                                                  _NM_PrepareBusSleepModeInd();    // here t_DBKonTimer is stopped
                                                  NM_Mode = cNM_Mode_Prepare_Bus_Sleep;
                                                  boCanNM_NM_Timeout_Timer_Expired = FALSE;
                                              }
                                              break;
        case cNM_Mode_Normal_Operation_State: if( boCanNM_NM_Timeout_Timer_Expired == TRUE )
                                              {
                                                  setTimer( t_NM_Timeout_Time, c_NM_Timeout_Time );
                                                  // _NM_TimeoutExeption();    // no action to be done
                                                  boCanNM_NM_Timeout_Timer_Expired = FALSE;
                                              }
                                              if( boCanNM_Rx_Indication == TRUE )
                                              {
                                                  cancelTimer( t_NM_Timeout_Time );
                                                  setTimer( t_NM_Timeout_Time, c_NM_Timeout_Time );
                                                  cancelTimer( t_NM_Transmit );
                                                  setTimer( t_NM_Transmit, NmAsrCanMsgReducedTime );
                                                  boCanNM_Rx_Indication = FALSE;
                                              }
                                              if( boCanNM_Tx_Confirmation == TRUE )
                                              {
                                                  cancelTimer( t_NM_Timeout_Time );
                                                  setTimer( t_NM_Timeout_Time, c_NM_Timeout_Time );
                                                  cancelTimer( t_NM_Transmit );
                                                  setTimer( t_NM_Transmit, NmAsrCanMsgStandardCycle );
                                                  boCanNM_Tx_Confirmation = FALSE;
                                              }
                                              if( NM_Request_State == 0 )    //no network requested
                                              {
                                                  cancelTimer( t_NM_Transmit );    // stop NM-Franme immediately
                                                  NM_Mode = cNM_Mode_Ready_Sleep;
                                              }
                                              if( boCanNM_RepeatMessage_Requested == TRUE )
                                              {
                                                  setTimer( t_NM_Transmit, NmAsrCanMsgCycleOffset );    // send NM-Frame delayed
                                                  cancelTimer( t_NM_Timeout_Time );
                                                  setTimer( t_NM_Timeout_Time, c_NM_Timeout_Time );
                                                  setTimer( t_NM_Repeat_Message_Time, c_NM_Repeat_Message_Time );
                                                  boCanNM_RepeatMessage_Requested = FALSE;
                                                  NM_Transmit_Cycle = NmAsrCanMsgStandardCycle;
                                                  NM_Mode = cNM_Mode_RepeatMsg;
                                              }
                                              break;
        case cNM_Mode_RepeatMsg:              if( boCanNM_NM_Timeout_Timer_Expired == TRUE )
                                              {
                                                  setTimer( t_NM_Timeout_Time, c_NM_Timeout_Time );
                                                  boCanNM_NM_Timeout_Timer_Expired = FALSE;
                                              }
                                              if( boCanNM_Rx_Indication == TRUE )
                                              {
                                                  cancelTimer( t_NM_Timeout_Time );
                                                  setTimer( t_NM_Timeout_Time, c_NM_Timeout_Time );
                                                  boCanNM_Rx_Indication = FALSE;
                                              }
                                              if( boCanNM_Tx_Confirmation == TRUE )
                                              {
                                                  cancelTimer( t_NM_Timeout_Time );
                                                  setTimer( t_NM_Timeout_Time, c_NM_Timeout_Time );
                                                  boCanNM_Tx_Confirmation = FALSE;
                                              }
                                              if( boCanNM_RepeatMessage_Timer_Expired == TRUE )
                                              {
                                                  boCanNM_RepeatMessage_Timer_Expired = FALSE;
                                                  if( NM_Request_State )
                                                  {
                                                      NM_Mode = cNM_Mode_Normal_Operation_State;
                                                      NM_Transmit_Cycle = NmAsrCanMsgReducedTime;
                                                  }
                                                  else
                                                  {
                                                      cancelTimer( t_NM_Transmit );    // stop NM-Franme immediately
                                                      NM_Mode = cNM_Mode_Ready_Sleep;
                                                  }
                                              }
                                              break;
    }
    if( bOld_NM_Mode != NM_Mode )
    {
        _Nm_StateChangeNotification( bOld_NM_Mode, NM_Mode );    // does the Trace
        putValue( HMI__NM_EIS_ActualState, NM_Mode );
    }
}
/*@@end*/

/*@@caplFunc:_NM_Init():*/
_NM_Init()
{
    NM_Transmit_Cycle = NmAsrCanMsgStandardCycle;
}
/*@@end*/

/*@@caplFunc:_NM_NetworkMode():*/
_NM_NetworkMode()
{
    setTimer( t_DBKomTimer_5ms, 1 ); //  ms     start CAN-communication immediately
    setTimer( t_DBKomTimer_20ms, 2 ); //  ms     start CAN-communication immediately
    putValue( HMI__NM_EIS_CommActive, 1 );
}
/*@@end*/

/*@@caplFunc:_Nm_BusSleepModeInd():*/
_Nm_BusSleepModeInd()
{
    write( "_Nm_BusSleepModeInd", "Sleep Mode active");
    __EIS_Startup_Delay();
    __EIS_Reset_E2E_SQC();
}
/*@@end*/

/*@@caplFunc:_Nm_PrepareBusSleepModeInd():*/
void _Nm_PrepareBusSleepModeInd()
{
//    _Trace( "Nm_PrepareBusSleepModeInd", "Prepare Sleep Mode active");
    putValue( HMI__NM_EIS_CommActive, 0 );
    cancelTimer( t_DBKomTimer_5ms );
    cancelTimer( t_DBKomTimer_20ms );
}
/*@@end*/

/*@@caplFunc:_Nm_StateChangeNotification(byte,byte):*/
_Nm_StateChangeNotification( byte previousState, byte currentState )
{
/*
    char line[50];

    snprintf( line, elcount(line ), "Transition from %d to %d", previousState, currentState );
    _Trace( "Nm_StateChangeNotification", "", line );
*/
}
/*@@end*/

/*@@caplFunc:_ReleaseCommRequest(word):*/
_ReleaseCommRequest( word RequestID )
{
    word temp; // actual NM request status

    temp = getValue( HMI__NM_EIS_NM_Request );
    temp &= ~RequestID; // reset NM request 
    putValue( HMI__NM_EIS_NM_Request, temp );
    _NM_Switch_NM_Mode();
}
/*@@end*/

/*@@caplFunc:_SetCommRequest(word):*/
_SetCommRequest( word RequestID )
{
    word temp; // actual NM request status

    temp = getValue( HMI__NM_EIS_NM_Request );
    temp |= RequestID; // set NM request 
    putValue( HMI__NM_EIS_NM_Request, temp );
    _NM_Switch_NM_Mode();
}
/*@@end*/

/*@@caplFunc:_TraceCall(char[],long):*/
void _TraceCall( char functionName[], long callResult )
{
    char line[100];

    if( callResult == 1 )
        snprintf( line, elcount(line ), "calling %s", functionName );
    else
        snprintf( line, elcount(line ), "call to %s failed - wrong state?", functionName );
    _Trace( "", "", line );
}
/*@@end*/

/*@@caplFunc:_Trace(char[],char[]):*/
void _Trace( char functionName[], char info[])
{
    _Trace( functionName, info, "");
}
/*@@end*/

/*@@caplFunc:_Trace(char[],char[],char[],long):*/
void _Trace( char functionName[], char info[], char verbose[], long argument )
{
    char line[100];

    snprintf( line, elcount(line ), verbose, argument );
    _Trace( functionName, info, line );
}
/*@@end*/

/*@@caplFunc:_Trace(char[],char[],char[]):*/
void _Trace( char functionName[], char info[], char verbose[])
{
  char sep[2] = "/";
  sep[0] = functionName[0] ? '/' : 0;
  if( verbose[0])
  {
    write( "[%.3f]%s%s%s: %s", timeNow()/100000.0, gECU
           , sep
           , functionName
           , verbose
           );
  } else
  {
    write( "[%.3f]%s%s%s: %s", timeNow()/100000.0, gECU
           , sep
           , functionName
           , info
           );
  }
}
/*@@end*/

/*@@caplFunc:___Template_Header():*/
___Template_Header()
{
// #FUNCTIONS#
// #FUNCTIONS_END#
// #TIMERS#
// #TIMERS_END#
// #ENVVARS#
// #ENVVARS_END#
}
/*@@end*/

/*@@caplFunc:AB_R_Stat_AR_check_output():*/
AB_R_Stat_AR_check_output()
{
    if( !getValue( HMI__STMSG_AB_R_Stat_AR ) )
    {
        // Botschaft AB_R_Stat_AR ID: 819 --- Sendeart 5 cyclicAndSpontanWithDelay --- 
        if( _AB_R_Stat_AR_DelayCnt > 0) _AB_R_Stat_AR_DelayCnt--; // Mindestsendeabstand
        _AB_R_Stat_AR_Cnt--;
        if( _AB_R_Stat_AR_Cnt < 1 )
        {
            if( _AB_R_Stat_AR_DelayCnt < 1 )
            {
                // Nachricht wg. abgelaufenem Zyklus ausgeben (Mindestsendeabstand eingehalten)
                AB_R_Stat_AR_output();
                 _AB_R_Stat_AR_SpontanFlag = 0; // Spontan-Flag zurücksetzen
                _AB_R_Stat_AR_DelayCnt = _AB_R_Stat_AR_MinDelay;
            }
            else
            {
                // Spontanflag setzen damit nach Ablauf Mindestsendeabstand gesendet wird
                 _AB_R_Stat_AR_SpontanFlag = 1;
            }
            _AB_R_Stat_AR_Cnt = ( getValue( HMI__MSGCyc_AB_R_Stat_AR ) / _AB_R_Stat_AR_Timebase ); //_AB_R_Stat_AR_CycleCount; // Zyklus-Zähler zurücksetzen
        }
        else if( _AB_R_Stat_AR_SpontanFlag)
        {
            if( _AB_R_Stat_AR_DelayCnt < 1 )
            {
                // Nachricht wg. spontaner Änderung ausgeben (Mindestsendeabstand eingehalten)
                AB_R_Stat_AR_output();
                _AB_R_Stat_AR_SpontanFlag = 0; // Spontan-Flag zurücksetzen
                _AB_R_Stat_AR_DelayCnt = _AB_R_Stat_AR_MinDelay;
            }
        }
    }
}
/*@@end*/

/*@@caplFunc:AB_R_Stat_AR_init():*/
AB_R_Stat_AR_init()
{   /* Botschaft AB_R_Stat_AR ID: 819 --- Sendeart 5 cyclicAndSpontanWithDelay --- 
BA_ "ApplMessage" BO_ 819 0;
BA_ "NmAsrMessage" BO_ 819 0;
BA_ "GenMsgMinAcceptLength" BO_ 819 2;
BA_ "GenMsgILSupport" BO_ 819 1;
BA_ "DiagState" BO_ 819 0;
BA_ "DiagRequest" BO_ 819 0;
BA_ "DiagResponse" BO_ 819 0;
BA_ "GenMsgStartValue" BO_ 819 "0";
BA_ "GenMsgStartDelayTime" BO_ 819 0;
BA_ "GenMsgDelayTime" BO_ 819 5;
BA_ "GenMsgNrOfRepetitions" BO_ 819 0;
BA_ "GenMsgCycleTime" BO_ 819 500;
BA_ "GenMsgSendType" BO_ 819 5;
    */
    _AB_R_Stat_AR_Timebase =             c_tDBKomTimer_20ms;
    _AB_R_Stat_AR_CycleCount =          500 / _AB_R_Stat_AR_Timebase;
    _AB_R_Stat_AR_StartDelay =            0 / _AB_R_Stat_AR_Timebase;
    _AB_R_Stat_AR_MinDelay =              5 / _AB_R_Stat_AR_Timebase;
    _AB_R_Stat_AR_Cnt = _AB_R_Stat_AR_StartDelay;
    _AB_R_Stat_AR_SpontanFlag = 0;
    _AB_R_Stat_AR_DelayCnt = 0;

    putValue( HMI__STMSGSD_AB_R_Stat_AR, _AB_R_Stat_AR_StartDelay * _AB_R_Stat_AR_Timebase );
    
    _mAB_R_Stat_AR.AB_R_Alive.phys = getValue( HMI_AB_R_Alive );
    _mAB_R_Stat_AR.AB_R_Presf_Disp_Rq.phys = getValue( HMI_AB_R_Presf_Disp_Rq );
    _mAB_R_Stat_AR.AB_RL_Movm.phys = getValue( HMI_AB_RL_Movm);
    _mAB_R_Stat_AR.AB_RL_Posn.phys = getValue( HMI_AB_RL_Posn);
    _mAB_R_Stat_AR.AB_RL_SRS_Disp_Rq_1.phys = getValue( HMI_AB_RL_SRS_Disp_Rq_1 );
    _mAB_R_Stat_AR.AB_RL_SRS_Disp_Rq_2.phys = getValue( HMI_AB_RL_SRS_Disp_Rq_2);
    _mAB_R_Stat_AR.AB_RR_Movm.phys = getValue( HMI_AB_RR_Movm);
    _mAB_R_Stat_AR.AB_RR_Posn.phys = getValue( HMI_AB_RR_Posn);
    _mAB_R_Stat_AR.AB_RR_SRS_Disp_Rq_1.phys = getValue( HMI_AB_RR_SRS_Disp_Rq_1 );
    _mAB_R_Stat_AR.AB_RR_SRS_Disp_Rq_2.phys = getValue( HMI_AB_RR_SRS_Disp_Rq_2);
}
/*@@end*/

/*@@caplFunc:AB_R_Stat_AR_output():*/
void AB_R_Stat_AR_output(void)
{
   byte crc;

    if( getValue( HMI_AB_R_Presf_Disp_Rq_Toggle_Rq ) )
    {
        if( getValue( HMI_AB_R_Presf_Disp_Rq ) )
            putValue( HMI_AB_R_Presf_Disp_Rq, 0 );
        else
            putValue( HMI_AB_R_Presf_Disp_Rq, 1 );

           _AB_R_Stat_AR_SpontanFlag = 0;
    }
    output( _mAB_R_Stat_AR );
}
/*@@end*/

/*@@caplFunc:AB_R_Stat_AR_saveEnvVars(dword):*/
AB_R_Stat_AR_saveEnvVars( dword hFile )
{
    filePutString("\n// Knoten EIS: AB_R_Stat_AR\n", 28, hFile );
    snprintf( buffer, elcount( buffer ), "0.0000 HMI__STMSG_AB_R_Stat_AR := %X\n", getValue( HMI__STMSG_AB_R_Stat_AR ) );            filePutString ( buffer, elcount( buffer ), hFile );
    snprintf( buffer, elcount( buffer ), "0.0000 HMI__STMSGT_AB_R_Stat_AR := %X\n", getValue( HMI__STMSGT_AB_R_Stat_AR ) );        filePutString ( buffer, elcount( buffer ), hFile );
    snprintf( buffer, elcount( buffer ), "0.0000 HMI_AB_R_Alive := %X\n", getValue( HMI_AB_R_Alive ) );    filePutString ( buffer, elcount( buffer ), hFile );
    snprintf( buffer, elcount( buffer ), "0.0000 HMI_AB_R_Presf_Disp_Rq := %X\n", getValue( HMI_AB_R_Presf_Disp_Rq ) );    filePutString ( buffer, elcount( buffer ), hFile );
    snprintf( buffer, elcount( buffer ), "0.0000 HMI_AB_RL_Movm := %X\n", getValue( HMI_AB_RL_Movm ) );    filePutString ( buffer, elcount( buffer ), hFile );
    snprintf( buffer, elcount( buffer ), "0.0000 HMI_AB_RL_Posn := %X\n", getValue( HMI_AB_RL_Posn ) );    filePutString ( buffer, elcount( buffer ), hFile );
    snprintf( buffer, elcount( buffer ), "0.0000 HMI_AB_RL_SRS_Disp_Rq_1 := %X\n", getValue( HMI_AB_RL_SRS_Disp_Rq_1 ) );    filePutString ( buffer, elcount( buffer ), hFile );
    snprintf( buffer, elcount( buffer ), "0.0000 HMI_AB_RL_SRS_Disp_Rq_2 := %X\n", getValue( HMI_AB_RL_SRS_Disp_Rq_2 ) );    filePutString ( buffer, elcount( buffer ), hFile );
    snprintf( buffer, elcount( buffer ), "0.0000 HMI_AB_RR_Movm := %X\n", getValue( HMI_AB_RR_Movm ) );    filePutString ( buffer, elcount( buffer ), hFile );
    snprintf( buffer, elcount( buffer ), "0.0000 HMI_AB_RR_Posn := %X\n", getValue( HMI_AB_RR_Posn ) );    filePutString ( buffer, elcount( buffer ), hFile );
    snprintf( buffer, elcount( buffer ), "0.0000 HMI_AB_RR_SRS_Disp_Rq_1 := %X\n", getValue( HMI_AB_RR_SRS_Disp_Rq_1 ) );    filePutString ( buffer, elcount( buffer ), hFile );
    snprintf( buffer, elcount( buffer ), "0.0000 HMI_AB_RR_SRS_Disp_Rq_2 := %X\n", getValue( HMI_AB_RR_SRS_Disp_Rq_2 ) );    filePutString ( buffer, elcount( buffer ), hFile );
}
/*@@end*/

/*@@envVar:HMI__MSGCyc_AB_R_Stat_AR:*/
on envVar HMI__MSGCyc_AB_R_Stat_AR
{
       _AB_R_Stat_AR_SpontanFlag = 1;
}
/*@@end*/

/*@@timer:_tAB_R_Stat_AR:*/
on timer _tAB_R_Stat_AR
{
    putValue( HMI__STMSG_AB_R_Stat_AR, 0 );
}
/*@@end*/

/*@@envVar:HMI__STMSG_AB_R_Stat_AR:*/
on EnvVar HMI__STMSG_AB_R_Stat_AR
{
    long tDelay;
    if( getValue( this ) == 2 )
    {
        tDelay = getValue( HMI__STMSGT_AB_R_Stat_AR );
        if( tDelay > 0 )
            setTimer( _tAB_R_Stat_AR, tDelay );
        else
            putValue( HMI__STMSG_AB_R_Stat_AR, 0 );
    }
}
/*@@end*/

/*@@envVar:HMI_AB_R_Alive:*/
on EnvVar HMI_AB_R_Alive
{

   _mAB_R_Stat_AR.AB_R_Alive.phys = getValue(this);
    _AB_R_Stat_AR_SpontanFlag = 1;
}
/*@@end*/

/*@@envVar:HMI_AB_R_Presf_Disp_Rq:*/
on EnvVar HMI_AB_R_Presf_Disp_Rq
{
    _mAB_R_Stat_AR.AB_R_Presf_Disp_Rq.phys = getValue(this);
    if( getValue( HMI_AB_R_Presf_Disp_Rq_Toggle_Rq ) == 0 )
        _AB_R_Stat_AR_SpontanFlag = 1;
}
/*@@end*/

/*@@envVar:HMI_AB_RL_Movm:*/
on EnvVar HMI_AB_RL_Movm
{
    _mAB_R_Stat_AR.AB_RL_Movm.phys = getValue(this);
    _AB_R_Stat_AR_SpontanFlag = 1;
}
/*@@end*/

/*@@envVar:HMI_AB_RL_Posn:*/
on EnvVar HMI_AB_RL_Posn
{
    _mAB_R_Stat_AR.AB_RL_Posn.phys = getValue(this);
    _AB_R_Stat_AR_SpontanFlag = 1;
}
/*@@end*/

/*@@envVar:HMI_AB_RL_SRS_Disp_Rq_1:*/
on EnvVar HMI_AB_RL_SRS_Disp_Rq_1
{
    _mAB_R_Stat_AR.AB_RL_SRS_Disp_Rq_1.phys = getValue(this);
    _AB_R_Stat_AR_SpontanFlag = 1;
}
/*@@end*/

/*@@envVar:HMI_AB_RL_SRS_Disp_Rq_2:*/
on EnvVar HMI_AB_RL_SRS_Disp_Rq_2
{
    _mAB_R_Stat_AR.AB_RL_SRS_Disp_Rq_2.phys = getValue(this);
    _AB_R_Stat_AR_SpontanFlag = 1;
}
/*@@end*/

/*@@envVar:HMI_AB_RR_Movm:*/
on EnvVar HMI_AB_RR_Movm
{
    _mAB_R_Stat_AR.AB_RR_Movm.phys = getValue(this);
    _AB_R_Stat_AR_SpontanFlag = 1;
}
/*@@end*/

/*@@envVar:HMI_AB_RR_Posn:*/
on EnvVar HMI_AB_RR_Posn
{
    _mAB_R_Stat_AR.AB_RR_Posn.phys = getValue(this);
    _AB_R_Stat_AR_SpontanFlag = 1;
}
/*@@end*/

/*@@envVar:HMI_AB_RR_SRS_Disp_Rq_1:*/
on EnvVar HMI_AB_RR_SRS_Disp_Rq_1
{
    _mAB_R_Stat_AR.AB_RR_SRS_Disp_Rq_1.phys = getValue(this);
    _AB_R_Stat_AR_SpontanFlag = 1;
}
/*@@end*/

/*@@envVar:HMI_AB_RR_SRS_Disp_Rq_2:*/
on EnvVar HMI_AB_RR_SRS_Disp_Rq_2
{
    _mAB_R_Stat_AR.AB_RR_SRS_Disp_Rq_2.phys = getValue(this);
    _AB_R_Stat_AR_SpontanFlag = 1;
}
/*@@end*/

/*@@caplFunc:Adapt_Seat_D_Stat_AR_check_output():*/
Adapt_Seat_D_Stat_AR_check_output()
{
    if( !getValue( HMI__STMSG_Adapt_Seat_D_Stat_AR ) )
        {
            // Botschaft Adapt_Seat_D_Stat_AR ID: 1206 --- Sendeart 0 cyclicX --- 
            _Adapt_Seat_D_Stat_AR_Cnt--;
            if( _Adapt_Seat_D_Stat_AR_Cnt < 1 )
            {
                // Nachricht wg. abgelaufenem Zyklus ausgeben
                Adapt_Seat_D_Stat_AR_output();
                // Zyklus-Zähler zurücksetzen
                _Adapt_Seat_D_Stat_AR_Cnt = _Adapt_Seat_D_Stat_AR_CycleCount;
            }
        }
}
/*@@end*/

/*@@caplFunc:Adapt_Seat_D_Stat_AR_init():*/
Adapt_Seat_D_Stat_AR_init()
{   /* Botschaft Adapt_Seat_D_Stat_AR ID: 1206 --- Sendeart 0 cyclicX --- 
BA_ "ApplMessage" BO_ 1206 0;
BA_ "NmAsrMessage" BO_ 1206 0;
BA_ "GenMsgMinAcceptLength" BO_ 1206 4;
BA_ "GenMsgILSupport" BO_ 1206 1;
BA_ "DiagState" BO_ 1206 0;
BA_ "DiagRequest" BO_ 1206 0;
BA_ "DiagResponse" BO_ 1206 0;
BA_ "GenMsgStartValue" BO_ 1206 "0";
BA_ "GenMsgCycleTime" BO_ 1206 1000;
BA_ "GenMsgSendType" BO_ 1206 0;
    */
    _Adapt_Seat_D_Stat_AR_Timebase =      c_tDBKomTimer_20ms;
    _Adapt_Seat_D_Stat_AR_CycleCount =   1000 / _Adapt_Seat_D_Stat_AR_Timebase;
    _Adapt_Seat_D_Stat_AR_StartDelay =      0 / _Adapt_Seat_D_Stat_AR_Timebase;
    _Adapt_Seat_D_Stat_AR_Cnt = _Adapt_Seat_D_Stat_AR_StartDelay;
    _Adapt_Seat_D_Stat_AR_SpontanFlag = 0;

    putValue( HMI__STMSGSD_Adapt_Seat_D_Stat_AR, _Adapt_Seat_D_Stat_AR_StartDelay * _Adapt_Seat_D_Stat_AR_Timebase );

    _mAdapt_Seat_D_Stat_AR.Adapt_Seat_D_ID_MemPos1.phys = getValue( HMI_Adapt_Seat_D_ID_MemPos1 );
    _mAdapt_Seat_D_Stat_AR.Adapt_Seat_D_ID_MemPos2.phys = getValue( HMI_Adapt_Seat_D_ID_MemPos2 );
    _mAdapt_Seat_D_Stat_AR.Adapt_Seat_D_ID_MemPos3.phys = getValue( HMI_Adapt_Seat_D_ID_MemPos3 );
}
/*@@end*/

/*@@caplFunc:Adapt_Seat_D_Stat_AR_output():*/
Adapt_Seat_D_Stat_AR_output(void)
{
    output( _mAdapt_Seat_D_Stat_AR );
}
/*@@end*/

/*@@caplFunc:Adapt_Seat_D_Stat_AR_saveEnvVars(dword):*/
Adapt_Seat_D_Stat_AR_saveEnvVars( dword hFile )
{
    filePutString("\n// Knoten EIS: Adapt_Seat_D_Stat_AR\n", 36, hFile );
    snprintf( buffer, elcount( buffer ), "0.0000 HMI__STMSG_Adapt_Seat_D_Stat_AR := %X\n", getValue( HMI__STMSG_Adapt_Seat_D_Stat_AR ) );        filePutString ( buffer, elcount( buffer ), hFile );
    snprintf( buffer, elcount( buffer ), "0.0000 HMI__STMSGT_Adapt_Seat_D_Stat_AR := %X\n", getValue( HMI__STMSGT_Adapt_Seat_D_Stat_AR ) );        filePutString ( buffer, elcount( buffer ), hFile );
    snprintf( buffer, elcount( buffer ), "0.0000 HMI_Adapt_Seat_D_ID_MemPos1  := %X\n", getValue( HMI_Adapt_Seat_D_ID_MemPos1 ) );        filePutString ( buffer, elcount( buffer ), hFile );
    snprintf( buffer, elcount( buffer ), "0.0000 HMI_Adapt_Seat_D_ID_MemPos2  := %X\n", getValue( HMI_Adapt_Seat_D_ID_MemPos2 ) );        filePutString ( buffer, elcount( buffer ), hFile );
    snprintf( buffer, elcount( buffer ), "0.0000 HMI_Adapt_Seat_D_ID_MemPos3  := %X\n", getValue( HMI_Adapt_Seat_D_ID_MemPos3 ) );        filePutString ( buffer, elcount( buffer ), hFile );
}
/*@@end*/

/*@@timer:_tAdapt_Seat_D_Stat_AR:*/
on timer _tAdapt_Seat_D_Stat_AR
{
    putValue( HMI__STMSG_Adapt_Seat_D_Stat_AR, 0 );
}
/*@@end*/

/*@@envVar:HMI__STMSG_Adapt_Seat_D_Stat_AR:*/
on EnvVar HMI__STMSG_Adapt_Seat_D_Stat_AR
{
    long tDelay;
    if( getValue( this ) == 2 )
    {
        tDelay = getValue( HMI__STMSGT_Adapt_Seat_D_Stat_AR );
        if( tDelay > 0)    
            setTimer( _tAdapt_Seat_D_Stat_AR, tDelay );
        else
            putValue( HMI__STMSG_Adapt_Seat_D_Stat_AR, 0 );
    }
}
/*@@end*/

/*@@envVar:HMI_Adapt_Seat_D_ID_MemPos1:*/
on EnvVar HMI_Adapt_Seat_D_ID_MemPos1
{
    _mAdapt_Seat_D_Stat_AR.Adapt_Seat_D_ID_MemPos1.phys = getValue(this);
}
/*@@end*/

/*@@envVar:HMI_Adapt_Seat_D_ID_MemPos2:*/
on EnvVar HMI_Adapt_Seat_D_ID_MemPos2
{
    _mAdapt_Seat_D_Stat_AR.Adapt_Seat_D_ID_MemPos2.phys = getValue(this);
}
/*@@end*/

/*@@envVar:HMI_Adapt_Seat_D_ID_MemPos3:*/
on EnvVar HMI_Adapt_Seat_D_ID_MemPos3
{
    _mAdapt_Seat_D_Stat_AR.Adapt_Seat_D_ID_MemPos3.phys = getValue(this);
}
/*@@end*/

/*@@caplFunc:Adblue_Disp_Rq_AR_check_output():*/
Adblue_Disp_Rq_AR_check_output()
{
    if( !getValue( HMI__STMSG_Adblue_Disp_Rq_AR ) )
    {
        // Botschaft Adblue_Disp_Rq_AR ID: 734 --- Sendeart 5 cyclicAndSpontanWithDelay --- 
        if( _Adblue_Disp_Rq_AR_DelayCnt > 0) _Adblue_Disp_Rq_AR_DelayCnt--; // Mindestsendeabstand
        _Adblue_Disp_Rq_AR_Cnt--;
        if( _Adblue_Disp_Rq_AR_Cnt < 1 )
        {
            if( _Adblue_Disp_Rq_AR_DelayCnt < 1 )
            {
                // Nachricht wg. abgelaufenem Zyklus ausgeben (Mindestsendeabstand eingehalten)
                Adblue_Disp_Rq_AR_output();
                 _Adblue_Disp_Rq_AR_SpontanFlag = 0; // Spontan-Flag zurücksetzen
                _Adblue_Disp_Rq_AR_DelayCnt = _Adblue_Disp_Rq_AR_MinDelay;
            }
            else
            {
                // Spontanflag setzen damit nach Ablauf Mindestsendeabstand gesendet wird
                 _Adblue_Disp_Rq_AR_SpontanFlag = 1;
            }
            _Adblue_Disp_Rq_AR_Cnt = _Adblue_Disp_Rq_AR_CycleCount; // Zyklus-Zähler zurücksetzen
        }
        else if( _Adblue_Disp_Rq_AR_SpontanFlag )
        {
            if( _Adblue_Disp_Rq_AR_DelayCnt < 1 )
            {
                // Nachricht wg. spontaner Änderung ausgeben (Mindestsendeabstand eingehalten)
                Adblue_Disp_Rq_AR_output();
                _Adblue_Disp_Rq_AR_SpontanFlag = 0; // Spontan-Flag zurücksetzen
                _Adblue_Disp_Rq_AR_DelayCnt = _Adblue_Disp_Rq_AR_MinDelay;
            }
        }
    }
}
/*@@end*/

/*@@caplFunc:Adblue_Disp_Rq_AR_init():*/
Adblue_Disp_Rq_AR_init()
{   /* Botschaft Adblue_Disp_Rq_AR ID: 734 --- Sendeart 5 cyclicAndSpontanWithDelay --- 
BA_ "ApplMessage" BO_ 734 0;
BA_ "NmAsrMessage" BO_ 734 0;
BA_ "GenMsgMinAcceptLength" BO_ 734 8;
BA_ "GenMsgILSupport" BO_ 734 1;
BA_ "DiagState" BO_ 734 0;
BA_ "DiagRequest" BO_ 734 0;
BA_ "DiagResponse" BO_ 734 0;
BA_ "GenMsgStartValue" BO_ 734 "0";
BA_ "GenMsgStartDelayTime" BO_ 734 0;
BA_ "GenMsgDelayTime" BO_ 734 500;
BA_ "GenMsgNrOfRepetitions" BO_ 734 0;
BA_ "GenMsgCycleTime" BO_ 734 5000;
BA_ "GenMsgSendType" BO_ 734 5;
    */
    _Adblue_Disp_Rq_AR_Timebase =          c_tDBKomTimer_20ms;
    _Adblue_Disp_Rq_AR_CycleCount =      5000 / _Adblue_Disp_Rq_AR_Timebase;
    _Adblue_Disp_Rq_AR_StartDelay =       500 / _Adblue_Disp_Rq_AR_Timebase;
    _Adblue_Disp_Rq_AR_MinDelay =           0 / _Adblue_Disp_Rq_AR_Timebase;
    _Adblue_Disp_Rq_AR_Cnt = _Adblue_Disp_Rq_AR_StartDelay;
    _Adblue_Disp_Rq_AR_SpontanFlag = 0;
    _Adblue_Disp_Rq_AR_DelayCnt = 0;

    putValue( HMI__STMSGSD_Adblue_Disp_Rq_AR, _Adblue_Disp_Rq_AR_StartDelay * _Adblue_Disp_Rq_AR_Timebase );

    _mAdblue_Disp_Rq_AR.AdBlue_Md_Disp_Rq.phys           = getValue( HMI_AdBlue_Md_Disp_Rq );
    _mAdblue_Disp_Rq_AR.Adblue_RemDistServ_Disp_Rq.phys  = getValue( HMI_Adblue_RemDistServ_Disp_Rq );
    _mAdblue_Disp_Rq_AR.AdBlue_SCRCM_Flt_Disp_Rq.phys    = getValue( HMI_AdBlue_SCRCM_Flt_Disp_Rq );
    _mAdblue_Disp_Rq_AR.AdBlue_TankLvl_Disp_Rq.phys      = getValue( HMI_AdBlue_TankLvl_Disp_Rq );
    _mAdblue_Disp_Rq_AR.AdBlue_TankRes_Disp_Rq.phys      = getValue( HMI_AdBlue_TankRes_Disp_Rq );
}
/*@@end*/

/*@@caplFunc:Adblue_Disp_Rq_AR_output():*/
Adblue_Disp_Rq_AR_output(void)
{
    output( _mAdblue_Disp_Rq_AR );
}
/*@@end*/

/*@@caplFunc:Adblue_Disp_Rq_AR_saveEnvVars(dword):*/
Adblue_Disp_Rq_AR_saveEnvVars( dword hFile )
{
    filePutString("\n// Knoten EIS: Adblue_Disp_Rq_AR\n", 25, hFile );
    snprintf( buffer, elcount( buffer ), "0.0000 HMI__STMSG_Adblue_Disp_Rq_AR := %X\n", getValue( HMI__STMSG_Adblue_Disp_Rq_AR ) );        filePutString ( buffer, elcount( buffer ), hFile );
    snprintf( buffer, elcount( buffer ), "0.0000 HMI__STMSGT_Adblue_Disp_Rq_AR := %X\n", getValue( HMI__STMSGT_Adblue_Disp_Rq_AR ) );        filePutString ( buffer, elcount( buffer ), hFile );
    snprintf( buffer, elcount( buffer ), "0.0000 HMI_AdBlue_Md_Disp_Rq := %X\n", getValue( HMI_AdBlue_Md_Disp_Rq ) );        filePutString ( buffer, elcount( buffer ), hFile );
    snprintf( buffer, elcount( buffer ), "0.0000 HMI_Adblue_RemDistServ_Disp_Rq := %X\n", getValue( HMI_Adblue_RemDistServ_Disp_Rq ) );        filePutString ( buffer, elcount( buffer ), hFile );
    snprintf( buffer, elcount( buffer ), "0.0000 HMI_AdBlue_SCRCM_Flt_Disp_Rq := %X\n", getValue( HMI_AdBlue_SCRCM_Flt_Disp_Rq ) );        filePutString ( buffer, elcount( buffer ), hFile );
    snprintf( buffer, elcount( buffer ), "0.0000 HMI_AdBlue_TankLvl_Disp_Rq := %X\n", getValue( HMI_AdBlue_TankLvl_Disp_Rq ) );        filePutString ( buffer, elcount( buffer ), hFile );
    snprintf( buffer, elcount( buffer ), "0.0000 HMI_AdBlue_TankRes_Disp_Rq := %X\n", getValue( HMI_AdBlue_TankRes_Disp_Rq ) );        filePutString ( buffer, elcount( buffer ), hFile );
}
/*@@end*/

/*@@timer:_tAdblue_Disp_Rq_AR:*/
on timer _tAdblue_Disp_Rq_AR
{
    putValue( HMI__STMSG_Adblue_Disp_Rq_AR, 0 );
}
/*@@end*/

/*@@envVar:HMI__STMSG_Adblue_Disp_Rq_AR:*/
on EnvVar HMI__STMSG_Adblue_Disp_Rq_AR
{
    long tDelay;
    if( getValue( this ) == 2 )
    {
        tDelay = getValue( HMI__STMSGT_Adblue_Disp_Rq_AR );
        if( tDelay > 0)    
            setTimer( _tAdblue_Disp_Rq_AR, tDelay );
        else
            putValue( HMI__STMSG_Adblue_Disp_Rq_AR, 0 );
    }
}
/*@@end*/

/*@@envVar:HMI_AdBlue_Md_Disp_Rq:*/
on EnvVar HMI_AdBlue_Md_Disp_Rq
{
    _mAdblue_Disp_Rq_AR.AdBlue_Md_Disp_Rq.phys = getValue(this);
    _Adblue_Disp_Rq_AR_SpontanFlag = 1;
}
/*@@end*/

/*@@envVar:HMI_Adblue_RemDistServ_Disp_Rq:*/
on EnvVar HMI_Adblue_RemDistServ_Disp_Rq
{
    _mAdblue_Disp_Rq_AR.Adblue_RemDistServ_Disp_Rq.phys = getValue(this);
    _Adblue_Disp_Rq_AR_SpontanFlag = 1;
}
/*@@end*/

/*@@envVar:HMI_AdBlue_SCRCM_Flt_Disp_Rq:*/
on EnvVar HMI_AdBlue_SCRCM_Flt_Disp_Rq
{
    _mAdblue_Disp_Rq_AR.AdBlue_SCRCM_Flt_Disp_Rq.phys = getValue(this);
    _Adblue_Disp_Rq_AR_SpontanFlag = 1;
}
/*@@end*/

/*@@envVar:HMI_AdBlue_TankLvl_Disp_Rq:*/
on EnvVar HMI_AdBlue_TankLvl_Disp_Rq
{
    _mAdblue_Disp_Rq_AR.AdBlue_TankLvl_Disp_Rq.phys = getValue(this);
    _Adblue_Disp_Rq_AR_SpontanFlag = 1;
}
/*@@end*/

/*@@envVar:HMI_AdBlue_TankRes_Disp_Rq:*/
on EnvVar HMI_AdBlue_TankRes_Disp_Rq
{
    _mAdblue_Disp_Rq_AR.AdBlue_TankRes_Disp_Rq.phys = getValue(this);
    _Adblue_Disp_Rq_AR_SpontanFlag = 1;
}
/*@@end*/

/*@@caplFunc:Adblue_Disp_Warn_Rq_AR_check_output():*/
Adblue_Disp_Warn_Rq_AR_check_output()
{
    if( !getValue( HMI__STMSG_Adblue_Disp_Warn_Rq_AR ) )
        {
            // Botschaft Adblue_Disp_Warn_Rq_AR ID: 1209 --- Sendeart 0 cyclicX --- 
            _Adblue_Disp_Warn_Rq_AR_Cnt--;
            if( _Adblue_Disp_Warn_Rq_AR_Cnt < 1 )
            {
                // Nachricht wg. abgelaufenem Zyklus ausgeben
                Adblue_Disp_Warn_Rq_AR_output();
                // Zyklus-Zähler zurücksetzen
                _Adblue_Disp_Warn_Rq_AR_Cnt = _Adblue_Disp_Warn_Rq_AR_CycleCount;
            }
        }
}
/*@@end*/

/*@@caplFunc:Adblue_Disp_Warn_Rq_AR_init():*/
Adblue_Disp_Warn_Rq_AR_init()
{   /* Botschaft Adblue_Disp_Warn_Rq_AR ID: 1209 --- Sendeart 0 cyclicX --- 
BA_ "ApplMessage" BO_ 1209 0;
BA_ "NmAsrMessage" BO_ 1209 0;
BA_ "GenMsgMinAcceptLength" BO_ 1209 8;
BA_ "GenMsgILSupport" BO_ 1209 1;
BA_ "DiagState" BO_ 1209 0;
BA_ "DiagRequest" BO_ 1209 0;
BA_ "DiagResponse" BO_ 1209 0;
BA_ "GenMsgStartValue" BO_ 1209 "0";
BA_ "GenMsgStartDelayTime" BO_ 1209 0;
BA_ "GenMsgCycleTime" BO_ 1209 1000;
BA_ "GenMsgSendType" BO_ 1209 0;
    */
    _Adblue_Disp_Warn_Rq_AR_Timebase =          c_tDBKomTimer_20ms;
    _Adblue_Disp_Warn_Rq_AR_CycleCount = 1000 / _Adblue_Disp_Warn_Rq_AR_Timebase;
    _Adblue_Disp_Warn_Rq_AR_StartDelay =    0 / _Adblue_Disp_Warn_Rq_AR_Timebase;
    _Adblue_Disp_Warn_Rq_AR_Cnt = _Adblue_Disp_Warn_Rq_AR_StartDelay;

    putValue( HMI__STMSGSD_Adblue_Disp_Warn_Rq_AR, _Adblue_Disp_Warn_Rq_AR_StartDelay * _Adblue_Disp_Warn_Rq_AR_Timebase );

    _mAdblue_Disp_Warn_Rq_AR.Adblue_RemainDist.phys = getValue( HMI_Adblue_RemainDist );
    _mAdblue_Disp_Warn_Rq_AR.Adblue_WarnLvl1.phys = getValue( HMI_Adblue_WarnLvl1 );
    _mAdblue_Disp_Warn_Rq_AR.Adblue_WarnLvl2.phys = getValue( HMI_Adblue_WarnLvl2 );
    _mAdblue_Disp_Warn_Rq_AR.Adblue_WarnLvl3.phys = getValue( HMI_Adblue_WarnLvl3 );
    _mAdblue_Disp_Warn_Rq_AR.AdblueEU6_ChkMsg_Disp_Rq.phys = getValue( HMI_AdblueEU6_ChkMsg_Disp_Rq );
    _mAdblue_Disp_Warn_Rq_AR.AdblueEU6_Msg_Disp_TrgrRq.phys = getValue( HMI_AdblueEU6_Msg_Disp_TrgrRq );
    _mAdblue_Disp_Warn_Rq_AR.AdblueEU6_RefillMsg_Disp_Rq.phys = getValue( HMI_AdblueEU6_RefillMsg_Disp_Rq );
    _mAdblue_Disp_Warn_Rq_AR.AdblueEU6_RemainDist.phys = getValue( HMI_AdblueEU6_RemainDist );
    _mAdblue_Disp_Warn_Rq_AR.EngSt_Remain.phys = getValue( HMI_EngSt_Remain );
}
/*@@end*/

/*@@caplFunc:Adblue_Disp_Warn_Rq_AR_output():*/
Adblue_Disp_Warn_Rq_AR_output(void)
{
    output( _mAdblue_Disp_Warn_Rq_AR );
}
/*@@end*/

/*@@caplFunc:Adblue_Disp_Warn_Rq_AR_saveEnvVars(dword):*/
Adblue_Disp_Warn_Rq_AR_saveEnvVars( dword hFile )
{
    filePutString("\n// Knoten EIS: Adblue_Disp_Warn_Rq_AR\n", 36, hFile );
    snprintf( buffer, elcount( buffer ), "0.0000 HMI__STMSG_EIAdblue_Disp_Warn_Rq_AR := %X\n", getValue( HMI__STMSG_Adblue_Disp_Warn_Rq_AR ) );        filePutString ( buffer, elcount( buffer ), hFile );
    snprintf( buffer, elcount( buffer ), "0.0000 HMI__STMSGT_EAdblue_Disp_Warn_Rq_AR := %X\n", getValue( HMI__STMSGT_Adblue_Disp_Warn_Rq_AR ) );        filePutString ( buffer, elcount( buffer ), hFile );
    snprintf( buffer, elcount( buffer ), "0.0000 HMI_Adblue_RemainDist  := %X\n", getValue( HMI_Adblue_RemainDist ) );        filePutString ( buffer, elcount( buffer ), hFile );
    snprintf( buffer, elcount( buffer ), "0.0000 HMI_Adblue_WarnLvl1  := %X\n", getValue( HMI_Adblue_WarnLvl1 ) );        filePutString ( buffer, elcount( buffer ), hFile );
    snprintf( buffer, elcount( buffer ), "0.0000 HMI_Adblue_WarnLvl2  := %X\n", getValue( HMI_Adblue_WarnLvl2 ) );        filePutString ( buffer, elcount( buffer ), hFile );
    snprintf( buffer, elcount( buffer ), "0.0000 HMI_Adblue_WarnLvl3  := %X\n", getValue( HMI_Adblue_WarnLvl3 ) );        filePutString ( buffer, elcount( buffer ), hFile );
    snprintf( buffer, elcount( buffer ), "0.0000 HMI_AdblueEU6_ChkMsg_Disp_Rq  := %X\n", getValue( HMI_AdblueEU6_ChkMsg_Disp_Rq ) );        filePutString ( buffer, elcount( buffer ), hFile );
    snprintf( buffer, elcount( buffer ), "0.0000 HMI_AdblueEU6_Msg_Disp_TrgrRq  := %X\n", getValue( HMI_AdblueEU6_Msg_Disp_TrgrRq ) );        filePutString ( buffer, elcount( buffer ), hFile );
    snprintf( buffer, elcount( buffer ), "0.0000 HMI_AdblueEU6_RefillMsg_Disp_Rq  := %X\n", getValue( HMI_AdblueEU6_RefillMsg_Disp_Rq ) );        filePutString ( buffer, elcount( buffer ), hFile );
    snprintf( buffer, elcount( buffer ), "0.0000 HMI_AdblueEU6_RemainDist  := %X\n", getValue( HMI_AdblueEU6_RemainDist ) );        filePutString ( buffer, elcount( buffer ), hFile );
    snprintf( buffer, elcount( buffer ), "0.0000 HMI_EngSt_Remain  := %X\n", getValue( HMI_EngSt_Remain ) );        filePutString ( buffer, elcount( buffer ), hFile );
}
/*@@end*/

/*@@timer:_tAdblue_Disp_Warn_Rq_AR:*/
on timer _tAdblue_Disp_Warn_Rq_AR
{
    putValue( HMI__STMSG_Adblue_Disp_Warn_Rq_AR, 0 );
}
/*@@end*/

/*@@envVar:HMI__STMSG_Adblue_Disp_Warn_Rq_AR:*/
on EnvVar HMI__STMSG_Adblue_Disp_Warn_Rq_AR
{
    long tDelay;
    if( getValue( this ) == 2 )
    {
        tDelay = getValue( HMI__STMSGT_Adblue_Disp_Warn_Rq_AR );
        if( tDelay > 0 )
            setTimer( _tAdblue_Disp_Warn_Rq_AR, tDelay );
        else
            putValue( HMI__STMSG_Adblue_Disp_Warn_Rq_AR, 0 );
    }
}
/*@@end*/

/*@@envVar:HMI_Adblue_RemainDist:*/
on EnvVar HMI_Adblue_RemainDist
{
    _mAdblue_Disp_Warn_Rq_AR.Adblue_RemainDist.phys = getValue(this);
    putValue( HMI_Adblue_RemainDist_Hex, getValue(this) + 32767 );
}
/*@@end*/

/*@@envVar:HMI_Adblue_WarnLvl1:*/
on EnvVar HMI_Adblue_WarnLvl1
{
    _mAdblue_Disp_Warn_Rq_AR.Adblue_WarnLvl1.phys = getValue(this);
}
/*@@end*/

/*@@envVar:HMI_Adblue_WarnLvl2:*/
on EnvVar HMI_Adblue_WarnLvl2
{
    _mAdblue_Disp_Warn_Rq_AR.Adblue_WarnLvl2.phys = getValue(this);
}
/*@@end*/

/*@@envVar:HMI_Adblue_WarnLvl3:*/
on EnvVar HMI_Adblue_WarnLvl3
{
    _mAdblue_Disp_Warn_Rq_AR.Adblue_WarnLvl3.phys = getValue(this);
}
/*@@end*/

/*@@envVar:HMI_AdblueEU6_ChkMsg_Disp_Rq:*/
on EnvVar HMI_AdblueEU6_ChkMsg_Disp_Rq
{
    _mAdblue_Disp_Warn_Rq_AR.AdblueEU6_ChkMsg_Disp_Rq.phys = getValue(this);
}
/*@@end*/

/*@@envVar:HMI_AdblueEU6_Msg_Disp_TrgrRq:*/
on EnvVar HMI_AdblueEU6_Msg_Disp_TrgrRq
{
    _mAdblue_Disp_Warn_Rq_AR.AdblueEU6_Msg_Disp_TrgrRq.phys = getValue(this);
}
/*@@end*/

/*@@envVar:HMI_AdblueEU6_RefillMsg_Disp_Rq:*/
on EnvVar HMI_AdblueEU6_RefillMsg_Disp_Rq
{
    _mAdblue_Disp_Warn_Rq_AR.AdblueEU6_RefillMsg_Disp_Rq.phys = getValue(this);
}
/*@@end*/

/*@@envVar:HMI_AdblueEU6_RemainDist:*/
on EnvVar HMI_AdblueEU6_RemainDist
{
    _mAdblue_Disp_Warn_Rq_AR.AdblueEU6_RemainDist.phys = getValue(this);
}
/*@@end*/

/*@@envVar:HMI_EngSt_Remain:*/
on EnvVar HMI_EngSt_Remain
{
    _mAdblue_Disp_Warn_Rq_AR.EngSt_Remain.phys = getValue(this);
}
/*@@end*/

/*@@envVar:HMI_Adblue_RemainDist_Hex:*/
on EnvVar HMI_Adblue_RemainDist_Hex
{
    _mAdblue_Disp_Warn_Rq_AR.Adblue_RemainDist.phys = getValue(this)-32767;
    putValue( HMI_Adblue_RemainDist, getValue(this) - 32767 );
}
/*@@end*/

/*@@caplFunc:APPL_ECU_HIL_TO_IC1_check_output():*/
APPL_ECU_HIL_TO_IC1_check_output()
{
//    if( !getValue( HMI__STMSG_APPL_ECU_HIL_TO_IC1 ) )  must not timeouted, is on event only
    {
        // Botschaft APPL_ECU_HIL_TO_IC1 --- Sendeart 1 spontanX
        if( _APPL_ECU_HIL_TO_IC1_SpontanFlag )
        {
            // Nachricht wg. spontaner Änderung ausgeben
            APPL_ECU_HIL_TO_IC1_output();
            // Spontan-Flag zurücksetzen
            _APPL_ECU_HIL_TO_IC1_SpontanFlag = 0;
        }
    }
}
/*@@end*/

/*@@caplFunc:APPL_ECU_HIL_TO_IC1_getValue():*/
void APPL_ECU_HIL_TO_IC1_getValue(void)
{
    _mAPPL_ECU_HIL_TO_IC1.byte( 0 ) = getValue( HMI_APPL_ECU_HIL_TO_IC1A );
    _mAPPL_ECU_HIL_TO_IC1.byte( 1 ) = getValue( HMI_APPL_ECU_HIL_TO_IC1B );
    _mAPPL_ECU_HIL_TO_IC1.byte( 2 ) = getValue( HMI_APPL_ECU_HIL_TO_IC1C );
    _mAPPL_ECU_HIL_TO_IC1.byte( 3 ) = getValue( HMI_APPL_ECU_HIL_TO_IC1D );
    _mAPPL_ECU_HIL_TO_IC1.byte( 4 ) = getValue( HMI_APPL_ECU_HIL_TO_IC1E );
    _mAPPL_ECU_HIL_TO_IC1.byte( 5 ) = getValue( HMI_APPL_ECU_HIL_TO_IC1F );
    _mAPPL_ECU_HIL_TO_IC1.byte( 6 ) = getValue( HMI_APPL_ECU_HIL_TO_IC1G );
    _mAPPL_ECU_HIL_TO_IC1.byte( 7 ) = getValue( HMI_APPL_ECU_HIL_TO_IC1H );
}
/*@@end*/

/*@@caplFunc:APPL_ECU_HIL_TO_IC1_init():*/
APPL_ECU_HIL_TO_IC1_init()
{
    // Botschaft APPL_ECU_HIL_TO_IC1 --- Sendeart 1 spontanX --- 
    _APPL_ECU_HIL_TO_IC1_Timebase =      c_tDBKomTimer_20ms;
    _APPL_ECU_HIL_TO_IC1_SpontanFlag = 0;

    _mAPPL_ECU_HIL_TO_IC1.APPL_ECU_HIL_TO_IC1A.phys = getValue( HMI_APPL_ECU_HIL_TO_IC1A);
    _mAPPL_ECU_HIL_TO_IC1.APPL_ECU_HIL_TO_IC1B.phys = getValue( HMI_APPL_ECU_HIL_TO_IC1B);
    _mAPPL_ECU_HIL_TO_IC1.APPL_ECU_HIL_TO_IC1C.phys = getValue( HMI_APPL_ECU_HIL_TO_IC1C);
    _mAPPL_ECU_HIL_TO_IC1.APPL_ECU_HIL_TO_IC1D.phys = getValue( HMI_APPL_ECU_HIL_TO_IC1D);
    _mAPPL_ECU_HIL_TO_IC1.APPL_ECU_HIL_TO_IC1E.phys = getValue( HMI_APPL_ECU_HIL_TO_IC1E);
    _mAPPL_ECU_HIL_TO_IC1.APPL_ECU_HIL_TO_IC1F.phys = getValue( HMI_APPL_ECU_HIL_TO_IC1F);
    _mAPPL_ECU_HIL_TO_IC1.APPL_ECU_HIL_TO_IC1G.phys = getValue( HMI_APPL_ECU_HIL_TO_IC1G);
    _mAPPL_ECU_HIL_TO_IC1.APPL_ECU_HIL_TO_IC1H.phys = getValue( HMI_APPL_ECU_HIL_TO_IC1H);
}
/*@@end*/

/*@@caplFunc:APPL_ECU_HIL_TO_IC1_output():*/
APPL_ECU_HIL_TO_IC1_output(void)
{
    output( _mAPPL_ECU_HIL_TO_IC1 );
}
/*@@end*/

/*@@caplFunc:APPL_ECU_HIL_TO_IC1_saveEnvVars(dword):*/
APPL_ECU_HIL_TO_IC1_saveEnvVars( dword hFile )
{
    filePutString("\n// Knoten EIS: APPL_ECU_HIL_TO_IC1\n", 25, hFile );
    snprintf( buffer, elcount( buffer ), "0.0000 HMI__STMSG_APPL_ECU_HIL_TO_IC1 := %X\n", getValue( HMI__STMSG_APPL_ECU_HIL_TO_IC1 ) );        filePutString ( buffer, elcount( buffer ), hFile );
    snprintf( buffer, elcount( buffer ), "0.0000 HMI__STMSGT_APPL_ECU_HIL_TO_IC1 := %X\n", getValue( HMI__STMSGT_APPL_ECU_HIL_TO_IC1 ) );        filePutString ( buffer, elcount( buffer ), hFile );
    snprintf( buffer, elcount( buffer ), "0.0000 HMI_APPL_ECU_HIL_TO_IC1A := %X\n", getValue( HMI_APPL_ECU_HIL_TO_IC1A ) );        filePutString ( buffer, elcount( buffer ), hFile );
    snprintf( buffer, elcount( buffer ), "0.0000 HMI_APPL_ECU_HIL_TO_IC1B := %X\n", getValue( HMI_APPL_ECU_HIL_TO_IC1B ) );        filePutString ( buffer, elcount( buffer ), hFile );
    snprintf( buffer, elcount( buffer ), "0.0000 HMI_APPL_ECU_HIL_TO_IC1C := %X\n", getValue( HMI_APPL_ECU_HIL_TO_IC1C ) );        filePutString ( buffer, elcount( buffer ), hFile );
    snprintf( buffer, elcount( buffer ), "0.0000 HMI_APPL_ECU_HIL_TO_IC1D := %X\n", getValue( HMI_APPL_ECU_HIL_TO_IC1D ) );        filePutString ( buffer, elcount( buffer ), hFile );
    snprintf( buffer, elcount( buffer ), "0.0000 HMI_APPL_ECU_HIL_TO_IC1E := %X\n", getValue( HMI_APPL_ECU_HIL_TO_IC1E ) );        filePutString ( buffer, elcount( buffer ), hFile );
    snprintf( buffer, elcount( buffer ), "0.0000 HMI_APPL_ECU_HIL_TO_IC1F := %X\n", getValue( HMI_APPL_ECU_HIL_TO_IC1F ) );        filePutString ( buffer, elcount( buffer ), hFile );
    snprintf( buffer, elcount( buffer ), "0.0000 HMI_APPL_ECU_HIL_TO_IC1G := %X\n", getValue( HMI_APPL_ECU_HIL_TO_IC1G ) );        filePutString ( buffer, elcount( buffer ), hFile );
    snprintf( buffer, elcount( buffer ), "0.0000 HMI_APPL_ECU_HIL_TO_IC1H := %X\n", getValue( HMI_APPL_ECU_HIL_TO_IC1H ) );        filePutString ( buffer, elcount( buffer ), hFile );
}
/*@@end*/

/*@@envVar:HMI__STMSP_APPL_ECU_HIL_TO_IC1:*/
on EnvVar HMI__STMSP_APPL_ECU_HIL_TO_IC1
{
/* HJH inserted VDO */
    _APPL_ECU_HIL_TO_IC1_SpontanFlag = 1;
    if( getValue( this ) )
        putValue( this, 0 );
}
/*@@end*/

/*@@envVar:Env_Send_APPL_ECU_HIL_TO_IC1:*/
on envVar Env_Send_APPL_ECU_HIL_TO_IC1
{
  if( getValue(this) )
  {
    output( _mAPPL_ECU_HIL_TO_IC1 );
  }
}
/*@@end*/

/*@@envVar:HMI_APPL_ECU_HIL_TO_IC1A:*/
on EnvVar HMI_APPL_ECU_HIL_TO_IC1A
{
    _mAPPL_ECU_HIL_TO_IC1.APPL_ECU_HIL_TO_IC1A = getValue(this);
}
/*@@end*/

/*@@envVar:HMI_APPL_ECU_HIL_TO_IC1B:*/
on EnvVar HMI_APPL_ECU_HIL_TO_IC1B
{
    _mAPPL_ECU_HIL_TO_IC1.APPL_ECU_HIL_TO_IC1B = getValue(this);
}
/*@@end*/

/*@@envVar:HMI_APPL_ECU_HIL_TO_IC1C:*/
on EnvVar HMI_APPL_ECU_HIL_TO_IC1C
{
    _mAPPL_ECU_HIL_TO_IC1.APPL_ECU_HIL_TO_IC1C = getValue(this);
}
/*@@end*/

/*@@envVar:HMI_APPL_ECU_HIL_TO_IC1D:*/
on EnvVar HMI_APPL_ECU_HIL_TO_IC1D
{
    _mAPPL_ECU_HIL_TO_IC1.APPL_ECU_HIL_TO_IC1D = getValue(this);
}
/*@@end*/

/*@@envVar:HMI_APPL_ECU_HIL_TO_IC1E:*/
on EnvVar HMI_APPL_ECU_HIL_TO_IC1E
{
    _mAPPL_ECU_HIL_TO_IC1.APPL_ECU_HIL_TO_IC1E = getValue(this);
}
/*@@end*/

/*@@envVar:HMI_APPL_ECU_HIL_TO_IC1F:*/
on EnvVar HMI_APPL_ECU_HIL_TO_IC1F
{
    _mAPPL_ECU_HIL_TO_IC1.APPL_ECU_HIL_TO_IC1F = getValue(this);
}
/*@@end*/

/*@@envVar:HMI_APPL_ECU_HIL_TO_IC1G:*/
on EnvVar HMI_APPL_ECU_HIL_TO_IC1G
{
    _mAPPL_ECU_HIL_TO_IC1.APPL_ECU_HIL_TO_IC1G = getValue(this);
}
/*@@end*/

/*@@envVar:HMI_APPL_ECU_HIL_TO_IC1H:*/
on EnvVar HMI_APPL_ECU_HIL_TO_IC1H
{
    _mAPPL_ECU_HIL_TO_IC1.APPL_ECU_HIL_TO_IC1H = getValue(this);
}
/*@@end*/

/*@@caplFunc:Assyst_Stat_AR_check_output():*/
Assyst_Stat_AR_check_output()
{
    if( !getValue( HMI__STMSG_Assyst_Stat_AR ) )
    {
        // Botschaft Assyst_Stat_AR ID: 487 --- Sendeart 0 cyclicX --- 
        _Assyst_Stat_AR_Cnt--;
        if( _Assyst_Stat_AR_Cnt < 1 )
        {
            // Nachricht wg. abgelaufenem Zyklus ausgeben
            Assyst_Stat_AR_output();
            // Zyklus-Zähler zurücksetzen
            _Assyst_Stat_AR_Cnt = _Assyst_Stat_AR_CycleCount;
        }
    }
}
/*@@end*/

/*@@caplFunc:Assyst_Stat_AR_init():*/
Assyst_Stat_AR_init()
{   /* Botschaft Assyst_Stat_AR ID: 487 --- Sendeart 0 cyclicX --- 
BA_ "ApplMessage" BO_ 487 0;
BA_ "NmAsrMessage" BO_ 487 0;
BA_ "GenMsgMinAcceptLength" BO_ 487 8;
BA_ "GenMsgILSupport" BO_ 487 1;
BA_ "DiagState" BO_ 487 0;
BA_ "DiagRequest" BO_ 487 0;
BA_ "DiagResponse" BO_ 487 0;
BA_ "GenMsgStartValue" BO_ 487 "0";
BA_ "GenMsgStartDelayTime" BO_ 487 0;
BA_ "GenMsgCycleTime" BO_ 487 1000;
BA_ "GenMsgSendType" BO_ 487 0;
    */
    _Assyst_Stat_AR_Timebase =          c_tDBKomTimer_20ms;
    _Assyst_Stat_AR_CycleCount =      1000 / _Assyst_Stat_AR_Timebase;
    _Assyst_Stat_AR_StartDelay =         0 / _Assyst_Stat_AR_Timebase;
    _Assyst_Stat_AR_Cnt = _Assyst_Stat_AR_StartDelay;

    putValue( HMI__STMSGSD_Assyst_Stat_AR, _Assyst_Stat_AR_StartDelay * _Assyst_Stat_AR_Timebase );

    _mAssyst_Stat_AR.Assyst_OilQuant.phys            = getValue( HMI_Assyst_OilQuant );
    _mAssyst_Stat_AR.Assyst_RelOilQual_Para.phys     = getValue( HMI_Assyst_RelOilQual_Para );
    _mAssyst_Stat_AR.Assyst_RemDist.phys             = getValue( HMI_Assyst_RemDist );
    _mAssyst_Stat_AR.Assyst_RemDist_Rdc.phys         = getValue( HMI_Assyst_RemDist_Rdc );
    _mAssyst_Stat_AR.Assyst_RemTm.phys               = getValue( HMI_Assyst_RemTm );
}
/*@@end*/

/*@@caplFunc:Assyst_Stat_AR_output():*/
Assyst_Stat_AR_output(void)
{
    output( _mAssyst_Stat_AR );
}
/*@@end*/

/*@@caplFunc:Assyst_Stat_AR_saveEnvVars(dword):*/
Assyst_Stat_AR_saveEnvVars( dword hFile )
{
    filePutString("\n// Knoten EIS: Assyst_Stat_AR\n", 28, hFile );
    snprintf( buffer, elcount( buffer ), "0.0000 HMI__STMSG_Assyst_Stat_AR := %X\n", getValue( HMI__STMSG_Assyst_Stat_AR ) );        filePutString ( buffer, elcount( buffer ), hFile );
    snprintf( buffer, elcount( buffer ), "0.0000 HMI__STMSGT_Assyst_Stat_AR := %X\n", getValue( HMI__STMSGT_Assyst_Stat_AR ) );        filePutString ( buffer, elcount( buffer ), hFile );
    snprintf( buffer, elcount( buffer ), "0.0000 HMI_Assyst_OilQuant := %X\n", getValue( HMI_Assyst_OilQuant ) );        filePutString ( buffer, elcount( buffer ), hFile );
    snprintf( buffer, elcount( buffer ), "0.0000 HMI_Assyst_RelOilQual_Para := %X\n", getValue( HMI_Assyst_RelOilQual_Para ) );        filePutString ( buffer, elcount( buffer ), hFile );
    snprintf( buffer, elcount( buffer ), "0.0000 HMI_Assyst_RemDist := %X\n", getValue( HMI_Assyst_RemDist ) );        filePutString ( buffer, elcount( buffer ), hFile );
    snprintf( buffer, elcount( buffer ), "0.0000 HMI_Assyst_RemDist_Rdc := %X\n", getValue( HMI_Assyst_RemDist_Rdc ) );        filePutString ( buffer, elcount( buffer ), hFile );
    snprintf( buffer, elcount( buffer ), "0.0000 HMI_Assyst_RemTm := %X\n", getValue( HMI_Assyst_RemTm ) );        filePutString ( buffer, elcount( buffer ), hFile );
}
/*@@end*/

/*@@timer:_tAssyst_Stat_AR:*/
on timer _tAssyst_Stat_AR
{
    putValue( HMI__STMSG_Assyst_Stat_AR, 0 );
}
/*@@end*/

/*@@envVar:HMI__STMSG_Assyst_Stat_AR:*/
on EnvVar HMI__STMSG_Assyst_Stat_AR
{
    long tDelay;
    if( getValue( this ) == 2 )
    {
        tDelay = getValue( HMI__STMSGT_Assyst_Stat_AR );
        if( tDelay > 0)    
            setTimer( _tAssyst_Stat_AR, tDelay );
        else
            putValue( HMI__STMSG_Assyst_Stat_AR, 0 );
    }
}
/*@@end*/

/*@@envVar:HMI_Assyst_OilQuant:*/
on EnvVar HMI_Assyst_OilQuant
{
    _mAssyst_Stat_AR.Assyst_OilQuant.phys = getValue(this);
}
/*@@end*/

/*@@envVar:HMI_Assyst_RelOilQual_Para:*/
on EnvVar HMI_Assyst_RelOilQual_Para
{
    putValue( HMI_Assyst_RelOilQual_Para_0x01, getValue( this ) & 0x01 );
    putValue( HMI_Assyst_RelOilQual_Para_0x02, ( getValue( this ) & 0x02 ) >> 1 );
    putValue( HMI_Assyst_RelOilQual_Para_0x04, ( getValue( this ) & 0x04 ) >> 2 );
    putValue( HMI_Assyst_RelOilQual_Para_0x08, ( getValue( this ) & 0x08 ) >> 3 );
    putValue( HMI_Assyst_RelOilQual_Para_0x10, ( getValue( this ) & 0x10 ) >> 4 );
    putValue( HMI_Assyst_RelOilQual_Para_0x20, ( getValue( this ) & 0x20 ) >> 5 );
    putValue( HMI_Assyst_RelOilQual_Para_0x40, ( getValue( this ) & 0x40 ) >> 6 );
    putValue( HMI_Assyst_RelOilQual_Para_0x80, ( getValue( this ) & 0x80 ) >> 7 );
   _mAssyst_Stat_AR.Assyst_RelOilQual_Para.phys = getValue(this);
}
/*@@end*/

/*@@envVar:HMI_Assyst_RelOilQual_Para_0x01:*/
on EnvVar HMI_Assyst_RelOilQual_Para_0x01
{
    byte temp;

    temp = getValue( HMI_Assyst_RelOilQual_Para );
    if( ( temp & 0x01 ) == getValue( this ) )
    {
        return;
    }
    else
    {
        temp = ( temp & 0xFE ) + getValue( this );
    }
    putValue( HMI_Assyst_RelOilQual_Para, temp );
    _mAssyst_Stat_AR.Assyst_RelOilQual_Para.phys = temp;
}
/*@@end*/

/*@@envVar:HMI_Assyst_RelOilQual_Para_0x02:*/
on EnvVar HMI_Assyst_RelOilQual_Para_0x02
{
    byte temp;

    temp = getValue( HMI_Assyst_RelOilQual_Para );
    if( ( ( temp & 0x02 ) >> 1 ) == getValue( this ) )
    {
        return;
    }
    else
    {
        temp = (temp & 0xFD) + ( getValue( this ) << 1 );
    }
    putValue( HMI_Assyst_RelOilQual_Para, temp );
    _mAssyst_Stat_AR.Assyst_RelOilQual_Para.phys = temp;
}
/*@@end*/

/*@@envVar:HMI_Assyst_RelOilQual_Para_0x04:*/
on EnvVar HMI_Assyst_RelOilQual_Para_0x04
{
    byte temp;

    temp = getValue( HMI_Assyst_RelOilQual_Para );
    if( ( ( temp & 0x04 ) >> 2 ) == getValue( this ) )
    {
        return;
    }
    else
    {
        temp = (temp & 0xFB) + ( getValue( this ) << 2 );
    }
    putValue( HMI_Assyst_RelOilQual_Para, temp );
    _mAssyst_Stat_AR.Assyst_RelOilQual_Para.phys = temp;
}
/*@@end*/

/*@@envVar:HMI_Assyst_RelOilQual_Para_0x08:*/
on EnvVar HMI_Assyst_RelOilQual_Para_0x08
{
    byte temp;

    temp = getValue( HMI_Assyst_RelOilQual_Para );
    if( ( ( temp & 0x08 ) >> 3 ) == getValue( this ) )
    {
        return;
    }
    else
    {
        temp = (temp & 0xF7) + ( getValue( this ) << 3 );
    }
    putValue( HMI_Assyst_RelOilQual_Para, temp );
    _mAssyst_Stat_AR.Assyst_RelOilQual_Para.phys = temp;
}
/*@@end*/

/*@@envVar:HMI_Assyst_RelOilQual_Para_0x10:*/
on EnvVar HMI_Assyst_RelOilQual_Para_0x10
{
    byte temp;

    temp = getValue( HMI_Assyst_RelOilQual_Para );
    if( ( ( temp & 0x10 ) >> 4 ) == getValue( this ) )
    {
        return;
    }
    else
    {
        temp = (temp & 0xEF) + ( getValue( this ) << 4 );
    }
    putValue( HMI_Assyst_RelOilQual_Para, temp );
    _mAssyst_Stat_AR.Assyst_RelOilQual_Para.phys = temp;
}
/*@@end*/

/*@@envVar:HMI_Assyst_RelOilQual_Para_0x20:*/
on EnvVar HMI_Assyst_RelOilQual_Para_0x20
{
    byte temp;

    temp = getValue( HMI_Assyst_RelOilQual_Para );
    if( ( ( temp & 0x20 ) >> 5 ) == getValue( this ) )
    {
        return;
    }
    else
    {
        temp = (temp & 0xDF) + ( getValue( this ) << 5 );
    }
    putValue( HMI_Assyst_RelOilQual_Para, temp );
    _mAssyst_Stat_AR.Assyst_RelOilQual_Para.phys = temp;
}
/*@@end*/

/*@@envVar:HMI_Assyst_RelOilQual_Para_0x40:*/
on EnvVar HMI_Assyst_RelOilQual_Para_0x40
{
    byte temp;

    temp = getValue( HMI_Assyst_RelOilQual_Para );
    if( ( ( temp & 0x40 ) >> 6 ) == getValue( this ) )
    {
        return;
    }
    else
    {
        temp = (temp & 0xBF) + ( getValue( this ) << 6 );
    }
    putValue( HMI_Assyst_RelOilQual_Para, temp );
    _mAssyst_Stat_AR.Assyst_RelOilQual_Para.phys = temp;
}
/*@@end*/

/*@@envVar:HMI_Assyst_RelOilQual_Para_0x80:*/
on EnvVar HMI_Assyst_RelOilQual_Para_0x80
{
    byte temp;

    temp = getValue( HMI_Assyst_RelOilQual_Para );
    if( ( ( temp & 0x80 ) >> 7 ) == getValue( this ) )
    {
        return;
    }
    else
    {
        temp = (temp & 0x7F) + ( getValue( this ) << 7 );
    }
    putValue( HMI_Assyst_RelOilQual_Para, temp );
    _mAssyst_Stat_AR.Assyst_RelOilQual_Para.phys = temp;
}
/*@@end*/

/*@@envVar:HMI_Assyst_RemDist:*/
on EnvVar HMI_Assyst_RemDist
{
    _mAssyst_Stat_AR.Assyst_RemDist.phys = getValue(this);
}
/*@@end*/

/*@@envVar:HMI_Assyst_RemDist_Rdc:*/
on EnvVar HMI_Assyst_RemDist_Rdc
{
    _mAssyst_Stat_AR.Assyst_RemDist_Rdc.phys = getValue(this);
}
/*@@end*/

/*@@envVar:HMI_Assyst_RemTm:*/
on EnvVar HMI_Assyst_RemTm
{
    _mAssyst_Stat_AR.Assyst_RemTm.phys = getValue(this);
}
/*@@end*/

/*@@caplFunc:Assyst_Stat2_AR_check_output():*/
Assyst_Stat2_AR_check_output()
{
    if( !getValue( HMI__STMSG_Assyst_Stat2_AR ) )
    {
        // Botschaft Assyst_Stat2_AR ID: 485 --- Sendeart 5 cyclicAndSpontanWithDelay --- 
        if( _Assyst_Stat2_AR_DelayCnt > 0) _Assyst_Stat2_AR_DelayCnt--; // Mindestsendeabstand
        _Assyst_Stat2_AR_Cnt--;
        if( _Assyst_Stat2_AR_Cnt < 1 )
        {
            if( _Assyst_Stat2_AR_DelayCnt < 1 )
            {
                // Nachricht wg. abgelaufenem Zyklus ausgeben (Mindestsendeabstand eingehalten)
                Assyst_Stat2_AR_output();
                _Assyst_Stat2_AR_SpontanFlag = 0; // Spontan-Flag zurücksetzen
                _Assyst_Stat2_AR_DelayCnt = _Assyst_Stat2_AR_MinDelay;
            }
            else
            {
                // Spontanflag setzen damit nach Ablauf Mindestsendeabstand gesendet wird
                 _Assyst_Stat2_AR_SpontanFlag = 1;
            }
            _Assyst_Stat2_AR_Cnt = _Assyst_Stat2_AR_CycleCount; // Zyklus-Zähler zurücksetzen
        }
        else if( _Assyst_Stat2_AR_SpontanFlag )
        {
            if( _Assyst_Stat2_AR_DelayCnt < 1 )
            {
                // Nachricht wg. spontaner Änderung ausgeben (Mindestsendeabstand eingehalten)
                Assyst_Stat2_AR_output();
                _Assyst_Stat2_AR_SpontanFlag = 0; // Spontan-Flag zurücksetzen
                _Assyst_Stat2_AR_DelayCnt = _Assyst_Stat2_AR_MinDelay;
            }
        }
    }
}
/*@@end*/

/*@@caplFunc:Assyst_Stat2_AR_init():*/
Assyst_Stat2_AR_init()
{   /* Botschaft Assyst_Stat2_AR ID: 485 --- Sendeart 5 cyclicAndSpontanWithDelay --- 
BA_ "ApplMessage" BO_ 485 0;
BA_ "NmAsrMessage" BO_ 485 0;
BA_ "GenMsgMinAcceptLength" BO_ 485 8;
BA_ "GenMsgILSupport" BO_ 485 1;
BA_ "DiagState" BO_ 485 0;
BA_ "DiagRequest" BO_ 485 0;
BA_ "DiagResponse" BO_ 485 0;
BA_ "GenMsgStartValue" BO_ 485 "0";
BA_ "GenMsgStartDelayTime" BO_ 485 0;
BA_ "GenMsgDelayTime" BO_ 485 100;
BA_ "GenMsgNrOfRepetitions" BO_ 485 0;
BA_ "GenMsgCycleTime" BO_ 485 1000;
BA_ "GenMsgSendType" BO_ 485 5;
    */
    _Assyst_Stat2_AR_Timebase =         c_tDBKomTimer_20ms;
    _Assyst_Stat2_AR_CycleCount =     1000 / _Assyst_Stat2_AR_Timebase;
    _Assyst_Stat2_AR_StartDelay =        0 / _Assyst_Stat2_AR_Timebase;
    _Assyst_Stat2_AR_MinDelay =        100 / _Assyst_Stat2_AR_Timebase;
    _Assyst_Stat2_AR_Cnt = _Assyst_Stat2_AR_StartDelay;
    _Assyst_Stat2_AR_SpontanFlag = 0;
    _Assyst_Stat2_AR_DelayCnt = 0;

    putValue( HMI__STMSGSD_Assyst_Stat2_AR, _Assyst_Stat2_AR_StartDelay * _Assyst_Stat2_AR_Timebase );

    _mAssyst_Stat2_AR.Assyst_HndOvr_Stat.phys = getValue( HMI_Assyst_HndOvr_Stat );
    _mAssyst_Stat2_AR.Assyst_OilQuant_Disp_Rq.phys = getValue( HMI_Assyst_OilQuant_Disp_Rq );
    _mAssyst_Stat2_AR.Assyst_OilQuant_Miss.phys = getValue( HMI_Assyst_OilQuant_Miss );
    _mAssyst_Stat2_AR.Assyst_OilQuant_Rel.phys = getValue( HMI_Assyst_OilQuant_Rel );
    _mAssyst_Stat2_AR.Assyst_OilWarn_Disp_Rq.phys = getValue( HMI_Assyst_OilWarn_Disp_Rq );
    _mAssyst_Stat2_AR.Assyst_RelOilQual_Para2.phys = getValue( HMI_Assyst_RelOilQual_Para2 );
    _mAssyst_Stat2_AR.Assyst_ServConf_Stat.phys = getValue( HMI_Assyst_ServConf_Stat );
    _mAssyst_Stat2_AR.Assyst_ServRst_Stat.phys = getValue( HMI_Assyst_ServRst_Stat );
}
/*@@end*/

/*@@caplFunc:Assyst_Stat2_AR_output():*/
Assyst_Stat2_AR_output()
{
    output( _mAssyst_Stat2_AR );
}
/*@@end*/

/*@@caplFunc:Assyst_Stat2_AR_saveEnvVars(dword):*/
Assyst_Stat2_AR_saveEnvVars( dword hFile )
{
    filePutString("\n// Knoten EIS: Assyst_Stat2_AR\n", 29, hFile );
    snprintf( buffer, elcount( buffer ), "0.0000 HMI__STMSG_Assyst_Stat2_AR := %X\n", getValue( HMI__STMSG_Assyst_Stat2_AR) );        filePutString( buffer, elcount( buffer ), hFile );
    snprintf( buffer, elcount( buffer ), "0.0000 HMI__STMSGT_Assyst_Stat2_AR := %X\n", getValue( HMI__STMSGT_Assyst_Stat2_AR) );        filePutString( buffer, elcount( buffer ), hFile );
    snprintf( buffer, elcount( buffer ), "0.0000 HMI_Assyst_HndOvr_Stat := %X\n", getValue( HMI_Assyst_HndOvr_Stat ) );        filePutString( buffer, elcount( buffer ), hFile );
    snprintf( buffer, elcount( buffer ), "0.0000 HMI_Assyst_OilQuant_Disp_Rq := %X\n", getValue( HMI_Assyst_OilQuant_Disp_Rq ) );        filePutString( buffer, elcount( buffer ), hFile );
    snprintf( buffer, elcount( buffer ), "0.0000 HMI_Assyst_OilQuant_Miss := %X\n", getValue( HMI_Assyst_OilQuant_Miss ) );        filePutString( buffer, elcount( buffer ), hFile );
    snprintf( buffer, elcount( buffer ), "0.0000 HMI_Assyst_OilQuant_Rel := %X\n", getValue( HMI_Assyst_OilQuant_Rel ) );        filePutString( buffer, elcount( buffer ), hFile );
    snprintf( buffer, elcount( buffer ), "0.0000 HMI_Assyst_OilWarn_Disp_Rq := %X\n", getValue( HMI_Assyst_OilWarn_Disp_Rq ) );        filePutString( buffer, elcount( buffer ), hFile );
    snprintf( buffer, elcount( buffer ), "0.0000 HMI_Assyst_RelOilQual_Para2 := %X\n", getValue( HMI_Assyst_RelOilQual_Para2 ) );        filePutString ( buffer, elcount( buffer ), hFile );
    snprintf( buffer, elcount( buffer ), "0.0000 HMI_Assyst_ServConf_Stat := %X\n", getValue( HMI_Assyst_ServConf_Stat ) );        filePutString( buffer, elcount( buffer ), hFile );
    snprintf( buffer, elcount( buffer ), "0.0000 HMI_Assyst_ServRst_Stat := %X\n", getValue( HMI_Assyst_ServRst_Stat ) );        filePutString( buffer, elcount( buffer ), hFile );
}
/*@@end*/

/*@@timer:_tAssyst_Stat2_AR:*/
on timer _tAssyst_Stat2_AR
{
    putValue( HMI__STMSG_Assyst_Stat2_AR, 0 );
}
/*@@end*/

/*@@envVar:HMI__STMSG_Assyst_Stat2_AR:*/
on EnvVar HMI__STMSG_Assyst_Stat2_AR
{
    long tDelay;
    if( getValue( this ) == 2 )
    {
        tDelay = getValue( HMI__STMSGT_Assyst_Stat2_AR );
        if( tDelay > 0)    
            setTimer( _tAssyst_Stat2_AR, tDelay );
        else
            putValue( HMI__STMSG_Assyst_Stat2_AR, 0 );
    }
}
/*@@end*/

/*@@envVar:HMI_Assyst_RelOilQual_Para2:*/
on EnvVar HMI_Assyst_RelOilQual_Para2
{
    putValue( HMI_Assyst_RelOilQual_Para2_0x01, getValue( this ) & 0x01 );
    putValue( HMI_Assyst_RelOilQual_Para2_0x02, ( getValue( this ) & 0x02 ) >> 1 );
    putValue( HMI_Assyst_RelOilQual_Para2_0x04, ( getValue( this ) & 0x04 ) >> 2 );
    putValue( HMI_Assyst_RelOilQual_Para2_0x08, ( getValue( this ) & 0x08 ) >> 3 );
    putValue( HMI_Assyst_RelOilQual_Para2_0x10, ( getValue( this ) & 0x10 ) >> 4 );
    putValue( HMI_Assyst_RelOilQual_Para2_0x20, ( getValue( this ) & 0x20 ) >> 5 );
    putValue( HMI_Assyst_RelOilQual_Para2_0x40, ( getValue( this ) & 0x40 ) >> 6 );
    putValue( HMI_Assyst_RelOilQual_Para2_0x80, ( getValue( this ) & 0x80 ) >> 7 );
   _mAssyst_Stat2_AR.Assyst_RelOilQual_Para2.phys = getValue(this);
}
/*@@end*/

/*@@envVar:HMI_Assyst_RelOilQual_Para2_0x01:*/
on EnvVar HMI_Assyst_RelOilQual_Para2_0x01
{
    byte temp;

    temp = getValue( HMI_Assyst_RelOilQual_Para2 );
    if( ( temp & 0x01 ) == getValue( this ) )
    {
        return;
    }
    else
    {
        temp = ( temp & 0xFE ) + getValue( this );
    }
    putValue( HMI_Assyst_RelOilQual_Para2, temp );
    _mAssyst_Stat2_AR.Assyst_RelOilQual_Para2.phys = temp;
}
/*@@end*/

/*@@envVar:HMI_Assyst_RelOilQual_Para2_0x02:*/
on EnvVar HMI_Assyst_RelOilQual_Para2_0x02
{
    byte temp;

    temp = getValue( HMI_Assyst_RelOilQual_Para2 );
    if( ( ( temp & 0x02 ) >> 1 ) == getValue( this ) )
    {
        return;
    }
    else
    {
        temp = (temp & 0xFD) + ( getValue( this ) << 1 );
    }
    putValue( HMI_Assyst_RelOilQual_Para2, temp );
    _mAssyst_Stat2_AR.Assyst_RelOilQual_Para2.phys = temp;
}
/*@@end*/

/*@@envVar:HMI_Assyst_RelOilQual_Para2_0x04:*/
on EnvVar HMI_Assyst_RelOilQual_Para2_0x04
{
    byte temp;

    temp = getValue( HMI_Assyst_RelOilQual_Para2 );
    if( ( ( temp & 0x04 ) >> 2 ) == getValue( this ) )
    {
        return;
    }
    else
    {
        temp = (temp & 0xFB) + ( getValue( this ) << 2 );
    }
    putValue( HMI_Assyst_RelOilQual_Para2, temp );
    _mAssyst_Stat2_AR.Assyst_RelOilQual_Para2.phys = temp;
}
/*@@end*/

/*@@envVar:HMI_Assyst_RelOilQual_Para2_0x08:*/
on EnvVar HMI_Assyst_RelOilQual_Para2_0x08
{
    byte temp;

    temp = getValue( HMI_Assyst_RelOilQual_Para2 );
    if( ( ( temp & 0x08 ) >> 3 ) == getValue( this ) )
    {
        return;
    }
    else
    {
        temp = (temp & 0xF7) + ( getValue( this ) << 3 );
    }
    putValue( HMI_Assyst_RelOilQual_Para2, temp );
    _mAssyst_Stat2_AR.Assyst_RelOilQual_Para2.phys = temp;
}
/*@@end*/

/*@@envVar:HMI_Assyst_RelOilQual_Para2_0x10:*/
on EnvVar HMI_Assyst_RelOilQual_Para2_0x10
{
    byte temp;

    temp = getValue( HMI_Assyst_RelOilQual_Para2 );
    if( ( ( temp & 0x10 ) >> 4 ) == getValue( this ) )
    {
        return;
    }
    else
    {
        temp = (temp & 0xEF) + ( getValue( this ) << 4 );
    }
    putValue( HMI_Assyst_RelOilQual_Para2, temp );
    _mAssyst_Stat2_AR.Assyst_RelOilQual_Para2.phys = temp;
}
/*@@end*/

/*@@envVar:HMI_Assyst_RelOilQual_Para2_0x20:*/
on EnvVar HMI_Assyst_RelOilQual_Para2_0x20
{
    byte temp;

    temp = getValue( HMI_Assyst_RelOilQual_Para2 );
    if( ( ( temp & 0x20 ) >> 5 ) == getValue( this ) )
    {
        return;
    }
    else
    {
        temp = (temp & 0xDF) + ( getValue( this ) << 5 );
    }
    putValue( HMI_Assyst_RelOilQual_Para2, temp );
    _mAssyst_Stat2_AR.Assyst_RelOilQual_Para2.phys = temp;
}
/*@@end*/

/*@@envVar:HMI_Assyst_RelOilQual_Para2_0x40:*/
on EnvVar HMI_Assyst_RelOilQual_Para2_0x40
{
    byte temp;

    temp = getValue( HMI_Assyst_RelOilQual_Para2 );
    if( ( ( temp & 0x40 ) >> 6 ) == getValue( this ) )
    {
        return;
    }
    else
    {
        temp = (temp & 0xBF) + ( getValue( this ) << 6 );
    }
    putValue( HMI_Assyst_RelOilQual_Para2, temp );
    _mAssyst_Stat2_AR.Assyst_RelOilQual_Para2.phys = temp;
}
/*@@end*/

/*@@envVar:HMI_Assyst_RelOilQual_Para2_0x80:*/
on EnvVar HMI_Assyst_RelOilQual_Para2_0x80
{
    byte temp;

    temp = getValue( HMI_Assyst_RelOilQual_Para2 );
    if( ( ( temp & 0x80 ) >> 7 ) == getValue( this ) )
    {
        return;
    }
    else
    {
        temp = (temp & 0x7F) + ( getValue( this ) << 7 );
    }
    putValue( HMI_Assyst_RelOilQual_Para2, temp );
    _mAssyst_Stat2_AR.Assyst_RelOilQual_Para2.phys = temp;
}
/*@@end*/

/*@@envVar:HMI_Assyst_HndOvr_Stat:*/
on EnvVar HMI_Assyst_HndOvr_Stat
{
    _mAssyst_Stat2_AR.Assyst_HndOvr_Stat.phys = getValue(this);
    _Assyst_Stat2_AR_SpontanFlag = 1;
}
/*@@end*/

/*@@envVar:HMI_Assyst_OilQuant_Disp_Rq:*/
on EnvVar HMI_Assyst_OilQuant_Disp_Rq
{
    _mAssyst_Stat2_AR.Assyst_OilQuant_Disp_Rq.phys = getValue(this);
    _Assyst_Stat2_AR_SpontanFlag = 1;
}
/*@@end*/

/*@@envVar:HMI_Assyst_OilQuant_Miss:*/
on EnvVar HMI_Assyst_OilQuant_Miss
{
    _mAssyst_Stat2_AR.Assyst_OilQuant_Miss.phys = getValue(this);
    _Assyst_Stat2_AR_SpontanFlag = 1;
}
/*@@end*/

/*@@envVar:HMI_Assyst_OilQuant_Rel:*/
on EnvVar HMI_Assyst_OilQuant_Rel
{
    _mAssyst_Stat2_AR.Assyst_OilQuant_Rel.phys = getValue(this);
    _Assyst_Stat2_AR_SpontanFlag = 1;
}
/*@@end*/

/*@@envVar:HMI_Assyst_OilWarn_Disp_Rq:*/
on EnvVar HMI_Assyst_OilWarn_Disp_Rq
{
    _mAssyst_Stat2_AR.Assyst_OilWarn_Disp_Rq.phys = getValue(this);
    _Assyst_Stat2_AR_SpontanFlag = 1;
}
/*@@end*/

/*@@envVar:HMI_Assyst_ServConf_Stat:*/
on EnvVar HMI_Assyst_ServConf_Stat
{
    _mAssyst_Stat2_AR.Assyst_ServConf_Stat.phys = getValue(this);
    _Assyst_Stat2_AR_SpontanFlag = 1;
}
/*@@end*/

/*@@envVar:HMI_Assyst_ServRst_Stat:*/
on EnvVar HMI_Assyst_ServRst_Stat
{
    _mAssyst_Stat2_AR.Assyst_ServRst_Stat.phys = getValue(this);
    _Assyst_Stat2_AR_SpontanFlag = 1;
}
/*@@end*/

/*@@caplFunc:Assyst_Stat3_AR_check_output():*/
Assyst_Stat3_AR_check_output()
{
    if( !getValue( HMI__STMSG_Assyst_Stat3_AR ) )
    {
        // Botschaft Assyst_Stat3_AR ID: 1065 --- Sendeart 5 cyclicAndSpontanWithDelay --- 
        if( _Assyst_Stat3_AR_DelayCnt > 0) _Assyst_Stat3_AR_DelayCnt--; // Mindestsendeabstand
        _Assyst_Stat3_AR_Cnt--;
        if( _Assyst_Stat3_AR_Cnt < 1 )
        {
            if( _Assyst_Stat3_AR_DelayCnt < 1 )
            {
                Assyst_Stat3_AR_output(); // Nachricht wg. abgelaufenem Zyklus ausgeben (Mindestsendeabstand eingehalten)
                _Assyst_Stat3_AR_SpontanFlag = 0; // Spontan-Flag zurücksetzen
                _Assyst_Stat3_AR_DelayCnt = _Assyst_Stat3_AR_MinDelay;
            }
            else
            {
                 _Assyst_Stat3_AR_SpontanFlag = 1; // Spontanflag setzen damit nach Ablauf Mindestsendeabstand gesendet wird
            }
            _Assyst_Stat3_AR_Cnt = _Assyst_Stat3_AR_CycleCount; // Zyklus-Zähler zurücksetzen
        }
        else if( _Assyst_Stat3_AR_SpontanFlag )
        {
            if( _Assyst_Stat3_AR_DelayCnt < 1 )
            {
                Assyst_Stat3_AR_output(); // Nachricht wg. spontaner Änderung ausgeben (Mindestsendeabstand eingehalten)
                _Assyst_Stat3_AR_SpontanFlag = 0; // Spontan-Flag zurücksetzen
                _Assyst_Stat3_AR_DelayCnt = _Assyst_Stat3_AR_MinDelay;
            }
        }
    }
}
/*@@end*/

/*@@caplFunc:Assyst_Stat3_AR_init():*/
Assyst_Stat3_AR_init()
{   /* Botschaft Assyst_Stat3_AR ID: 1065 --- Sendeart 5 cyclicAndSpontanWithDelay --- 
BA_ "ApplMessage" BO_ 1065 0;
BA_ "NmAsrMessage" BO_ 1065 0;
BA_ "GenMsgMinAcceptLength" BO_ 1065 8;
BA_ "GenMsgILSupport" BO_ 1065 1;
BA_ "DiagState" BO_ 1065 0;
BA_ "DiagRequest" BO_ 1065 0;
BA_ "DiagResponse" BO_ 1065 0;
BA_ "GenMsgStartValue" BO_ 1065 "0";
BA_ "GenMsgCycleTime" BO_ 1065 1000;
BA_ "GenMsgSendType" BO_ 1065 0;
    */
    _Assyst_Stat3_AR_Timebase =         c_tDBKomTimer_20ms;
    _Assyst_Stat3_AR_CycleCount =     1000 / _Assyst_Stat3_AR_Timebase;
    _Assyst_Stat3_AR_StartDelay =        0 / _Assyst_Stat3_AR_Timebase;
    _Assyst_Stat3_AR_MinDelay =          0 / _Assyst_Stat3_AR_Timebase;
    _Assyst_Stat3_AR_Cnt = _Assyst_Stat3_AR_StartDelay;
    _Assyst_Stat3_AR_SpontanFlag = 0;
    _Assyst_Stat3_AR_DelayCnt = 0;

    putValue( HMI__STMSGSD_Assyst_Stat2_AR, _Assyst_Stat2_AR_StartDelay * _Assyst_Stat2_AR_Timebase );

    _mAssyst_Stat3_AR.Assyst_OprtnTm.phys = getValue( HMI_Assyst_OprtnTm );
    _mAssyst_Stat3_AR.Assyst_RemainOprtnTm.phys = getValue( HMI_Assyst_RemainOprtnTm );
}
/*@@end*/

/*@@caplFunc:Assyst_Stat3_AR_output():*/
Assyst_Stat3_AR_output()
{
    output( _mAssyst_Stat3_AR );
}
/*@@end*/

/*@@caplFunc:Assyst_Stat3_AR_saveEnvVars(dword):*/
Assyst_Stat3_AR_saveEnvVars( dword hFile )
{
    filePutString("\n// Knoten EIS: Assyst_Stat3_AR\n", 29, hFile );
    snprintf( buffer, elcount( buffer ), "0.0000 HMI__STMSG_Assyst_Stat3_AR := %X\n", getValue( HMI__STMSG_Assyst_Stat3_AR) );        filePutString( buffer, elcount( buffer ), hFile );
    snprintf( buffer, elcount( buffer ), "0.0000 HMI__STMSGT_Assyst_Stat3_AR := %X\n", getValue( HMI__STMSGT_Assyst_Stat3_AR) );        filePutString( buffer, elcount( buffer ), hFile );
    snprintf( buffer, elcount( buffer ), "0.0000 HMI_Assyst_OprtnTm := %X\n", getValue( HMI_Assyst_OprtnTm ) );        filePutString( buffer, elcount( buffer ), hFile );
    snprintf( buffer, elcount( buffer ), "0.0000 HMI_Assyst_RemainOprtnTm := %X\n", getValue( HMI_Assyst_RemainOprtnTm ) );        filePutString( buffer, elcount( buffer ), hFile );
}
/*@@end*/

/*@@timer:_tAssyst_Stat3_AR:*/
on timer _tAssyst_Stat3_AR
{
    putValue( HMI__STMSG_Assyst_Stat3_AR, 0 );
}
/*@@end*/

/*@@envVar:HMI__STMSG_Assyst_Stat3_AR:*/
on EnvVar HMI__STMSG_Assyst_Stat3_AR
{
    long tDelay;
    if( getValue( this ) == 2 )
    {
        tDelay = getValue( HMI__STMSGT_Assyst_Stat3_AR );
        if( tDelay > 0)    
            setTimer( _tAssyst_Stat3_AR, tDelay );
        else
            putValue( HMI__STMSG_Assyst_Stat3_AR, 0 );
    }
}
/*@@end*/

/*@@envVar:HMI_Assyst_OprtnTm:*/
on EnvVar HMI_Assyst_OprtnTm
{
    _mAssyst_Stat3_AR.Assyst_OprtnTm.phys = getValue(this);
    _Assyst_Stat3_AR_SpontanFlag = 1;
}
/*@@end*/

/*@@envVar:HMI_Assyst_RemainOprtnTm:*/
on EnvVar HMI_Assyst_RemainOprtnTm
{
    _mAssyst_Stat3_AR.Assyst_RemainOprtnTm.phys = getValue(this);
    _Assyst_Stat3_AR_SpontanFlag = 1;
}
/*@@end*/

/*@@caplFunc:AWD_TCASE_Disp_Rq_AR_check_output():*/
AWD_TCASE_Disp_Rq_AR_check_output()
{
    if( !getValue( HMI__STMSG_AWD_TCASE_Disp_Rq_AR ) )
    {
        // Botschaft AWD_TCASE_Disp_Rq_AR ID: 1184 --- Sendeart 5 cyclicAndSpontanWithDelay --- 
        if( _AWD_TCASE_Disp_Rq_AR_DelayCnt > 0) _AWD_TCASE_Disp_Rq_AR_DelayCnt--; // Mindestsendeabstand
        _AWD_TCASE_Disp_Rq_AR_Cnt--;
        if( _AWD_TCASE_Disp_Rq_AR_Cnt < 1 )
        {
            if( _AWD_TCASE_Disp_Rq_AR_DelayCnt < 1 )
            {
                AWD_TCASE_Disp_Rq_AR_output(); // Nachricht wg. abgelaufenem Zyklus ausgeben (Mindestsendeabstand eingehalten)
                _AWD_TCASE_Disp_Rq_AR_SpontanFlag = 0; // Spontan-Flag zurücksetzen
                _AWD_TCASE_Disp_Rq_AR_DelayCnt = _AWD_TCASE_Disp_Rq_AR_MinDelay;
            }
            else
            {
                 _AWD_TCASE_Disp_Rq_AR_SpontanFlag = 1; // Spontanflag setzen damit nach Ablauf Mindestsendeabstand gesendet wird
            }
            _AWD_TCASE_Disp_Rq_AR_Cnt = _AWD_TCASE_Disp_Rq_AR_CycleCount; // Zyklus-Zähler zurücksetzen
        }
        else if( _AWD_TCASE_Disp_Rq_AR_SpontanFlag )
        {
            if( _AWD_TCASE_Disp_Rq_AR_DelayCnt < 1 )
            {
                AWD_TCASE_Disp_Rq_AR_output(); // Nachricht wg. spontaner Änderung ausgeben (Mindestsendeabstand eingehalten)
                _AWD_TCASE_Disp_Rq_AR_SpontanFlag = 0; // Spontan-Flag zurücksetzen
                _AWD_TCASE_Disp_Rq_AR_DelayCnt = _AWD_TCASE_Disp_Rq_AR_MinDelay;
            }
        }
    }
}
/*@@end*/

/*@@caplFunc:AWD_TCASE_Disp_Rq_AR_init():*/
AWD_TCASE_Disp_Rq_AR_init()
{   /* Botschaft AWD_TCASE_Disp_Rq_AR ID: 1184 --- Sendeart 5 cyclicAndSpontanWithDelay --- 
BA_ "ApplMessage" BO_ 1184 0;
BA_ "NmAsrMessage" BO_ 1184 0;
BA_ "GenMsgMinAcceptLength" BO_ 1184 6;
BA_ "GenMsgILSupport" BO_ 1184 1;
BA_ "DiagState" BO_ 1184 0;
BA_ "DiagRequest" BO_ 1184 0;
BA_ "DiagResponse" BO_ 1184 0;
BA_ "GenMsgStartValue" BO_ 1184 "0";
BA_ "GenMsgDelayTime" BO_ 1184 100;
BA_ "GenMsgNrOfRepetition" BO_ 1184 0;
BA_ "GenMsgCycleTime" BO_ 1184 1000;
BA_ "GenMsgSendType" BO_ 1184 5;
    */
    _AWD_TCASE_Disp_Rq_AR_Timebase =         c_tDBKomTimer_20ms;
    _AWD_TCASE_Disp_Rq_AR_CycleCount =     1000 / _AWD_TCASE_Disp_Rq_AR_Timebase;
    _AWD_TCASE_Disp_Rq_AR_StartDelay =        0 / _AWD_TCASE_Disp_Rq_AR_Timebase;
    _AWD_TCASE_Disp_Rq_AR_MinDelay =        100 / _AWD_TCASE_Disp_Rq_AR_Timebase;
    _AWD_TCASE_Disp_Rq_AR_Cnt = _AWD_TCASE_Disp_Rq_AR_StartDelay;
    _AWD_TCASE_Disp_Rq_AR_SpontanFlag = 0;
    _AWD_TCASE_Disp_Rq_AR_DelayCnt = 0;

    putValue( HMI__STMSGSD_AWD_TCASE_Disp_Rq_AR, _AWD_TCASE_Disp_Rq_AR_StartDelay * _AWD_TCASE_Disp_Rq_AR_Timebase );

    _mAWD_TCASE_Disp_Rq_AR.AWD_Msg1_Disp_Rq.phys = getValue( HMI_AWD_Msg1_Disp_Rq );
    _mAWD_TCASE_Disp_Rq_AR.AWD_Msg2_Disp_Rq.phys = getValue( HMI_AWD_Msg2_Disp_Rq );
    _mAWD_TCASE_Disp_Rq_AR.DiffLk_Msg1_Disp_Rq.phys = getValue( HMI_DiffLk_Msg1_Disp_Rq );
    _mAWD_TCASE_Disp_Rq_AR.DiffLk_Msg2_Disp_Rq.phys = getValue( HMI_DiffLk_Msg2_Disp_Rq );
    _mAWD_TCASE_Disp_Rq_AR.DiffLk_Msg3_Disp_Rq.phys = getValue( HMI_DiffLk_Msg3_Disp_Rq );
    _mAWD_TCASE_Disp_Rq_AR.DiffLk_Msg4_Disp_Rq.phys = getValue( HMI_DiffLk_Msg4_Disp_Rq );
    _mAWD_TCASE_Disp_Rq_AR.DiffLk_Msg5_Disp_Rq.phys = getValue( HMI_DiffLk_Msg5_Disp_Rq );
    _mAWD_TCASE_Disp_Rq_AR.DiffLk_Msg6_Disp_Rq.phys = getValue( HMI_DiffLk_Msg6_Disp_Rq );
    _mAWD_TCASE_Disp_Rq_AR.DiffLk_Msg7_Disp_Rq.phys = getValue( HMI_DiffLk_Msg7_Disp_Rq );
    _mAWD_TCASE_Disp_Rq_AR.DiffLk_Msg8_Disp_Rq.phys = getValue( HMI_DiffLk_Msg8_Disp_Rq );
    _mAWD_TCASE_Disp_Rq_AR.DiffLk_Msg9_Disp_Rq.phys = getValue( HMI_DiffLk_Msg9_Disp_Rq );
    _mAWD_TCASE_Disp_Rq_AR.DPC_Disp_TrgRq_TCASE.phys = getValue( HMI_DPC_Disp_TrgRq_TCASE );
    _mAWD_TCASE_Disp_Rq_AR.TCASE_GrLo_IndLmp_On_Rq.phys = getValue( HMI_TCASE_GrLo_IndLmp_On_Rq );
    _mAWD_TCASE_Disp_Rq_AR.TCASE_Msg1_Disp_Rq.phys = getValue( HMI_TCASE_Msg1_Disp_Rq );
    _mAWD_TCASE_Disp_Rq_AR.TCASE_Msg2_Disp_Rq.phys = getValue( HMI_TCASE_Msg2_Disp_Rq );
    _mAWD_TCASE_Disp_Rq_AR.TCASE_Msg3_Disp_Rq.phys = getValue( HMI_TCASE_Msg3_Disp_Rq );
    _mAWD_TCASE_Disp_Rq_AR.TCASE_Msg4_Disp_Rq.phys = getValue( HMI_TCASE_Msg4_Disp_Rq );
    _mAWD_TCASE_Disp_Rq_AR.TCASE_Msg5_Disp_Rq.phys = getValue( HMI_TCASE_Msg5_Disp_Rq );
    _mAWD_TCASE_Disp_Rq_AR.TCASE_Msg6_Disp_Rq.phys = getValue( HMI_TCASE_Msg6_Disp_Rq );
    _mAWD_TCASE_Disp_Rq_AR.TCASE_Msg7_Disp_Rq.phys = getValue( HMI_TCASE_Msg7_Disp_Rq );
    _mAWD_TCASE_Disp_Rq_AR.TCASE_Msg8_Disp_Rq.phys = getValue( HMI_TCASE_Msg8_Disp_Rq );
    _mAWD_TCASE_Disp_Rq_AR.TCASE_Msg9_Disp_Rq.phys = getValue( HMI_TCASE_Msg9_Disp_Rq );
    _mAWD_TCASE_Disp_Rq_AR.TCASE_Msg10_Disp_Rq.phys = getValue( HMI_TCASE_Msg10_Disp_Rq );
    _mAWD_TCASE_Disp_Rq_AR.TCASE_Msg11_Disp_Rq.phys = getValue( HMI_TCASE_Msg11_Disp_Rq );
    _mAWD_TCASE_Disp_Rq_AR.TCASE_Msg12_Disp_Rq.phys = getValue( HMI_TCASE_Msg12_Disp_Rq );
    _mAWD_TCASE_Disp_Rq_AR.TCASE_Msg13_Disp_Rq.phys = getValue( HMI_TCASE_Msg13_Disp_Rq );
}
/*@@end*/

/*@@caplFunc:AWD_TCASE_Disp_Rq_AR_output():*/
AWD_TCASE_Disp_Rq_AR_output()
{
    output( _mAWD_TCASE_Disp_Rq_AR );
}
/*@@end*/

/*@@caplFunc:AWD_TCASE_Disp_Rq_AR_saveEnvVars(dword):*/
AWD_TCASE_Disp_Rq_AR_saveEnvVars( dword hFile )
{
    filePutString("\n// Knoten EIS: AWD_TCASE_Disp_Rq_AR\n", 29, hFile );
    snprintf( buffer, elcount( buffer ), "0.0000 HMI__STMSG_AWD_TCASE_Disp_Rq_AR := %X\n", getValue( HMI__STMSG_AWD_TCASE_Disp_Rq_AR ) );        filePutString( buffer, elcount( buffer ), hFile );
    snprintf( buffer, elcount( buffer ), "0.0000 HMI__STMSGT_AWD_TCASE_Disp_Rq_AR := %X\n", getValue( HMI__STMSGT_AWD_TCASE_Disp_Rq_AR ) );        filePutString( buffer, elcount( buffer ), hFile );
    snprintf( buffer, elcount( buffer ), "0.0000 HMI_AWD_Msg1_Disp_Rq := %X\n", getValue( HMI_AWD_Msg1_Disp_Rq ) );        filePutString( buffer, elcount( buffer ), hFile );
    snprintf( buffer, elcount( buffer ), "0.0000 HMI_AWD_Msg2_Disp_Rq := %X\n", getValue( HMI_AWD_Msg2_Disp_Rq ) );        filePutString( buffer, elcount( buffer ), hFile );
    snprintf( buffer, elcount( buffer ), "0.0000 HMI_DiffLk_Msg1_Disp_Rq := %X\n", getValue( HMI_DiffLk_Msg1_Disp_Rq ) );        filePutString( buffer, elcount( buffer ), hFile );
    snprintf( buffer, elcount( buffer ), "0.0000 HMI_DiffLk_Msg2_Disp_Rq := %X\n", getValue( HMI_DiffLk_Msg2_Disp_Rq ) );        filePutString( buffer, elcount( buffer ), hFile );
    snprintf( buffer, elcount( buffer ), "0.0000 HMI_DiffLk_Msg3_Disp_Rq := %X\n", getValue( HMI_DiffLk_Msg3_Disp_Rq ) );        filePutString( buffer, elcount( buffer ), hFile );
    snprintf( buffer, elcount( buffer ), "0.0000 HMI_DiffLk_Msg4_Disp_Rq := %X\n", getValue( HMI_DiffLk_Msg4_Disp_Rq ) );        filePutString( buffer, elcount( buffer ), hFile );
    snprintf( buffer, elcount( buffer ), "0.0000 HMI_DiffLk_Msg5_Disp_Rq := %X\n", getValue( HMI_DiffLk_Msg5_Disp_Rq ) );        filePutString( buffer, elcount( buffer ), hFile );
    snprintf( buffer, elcount( buffer ), "0.0000 HMI_DiffLk_Msg6_Disp_Rq := %X\n", getValue( HMI_DiffLk_Msg6_Disp_Rq ) );        filePutString( buffer, elcount( buffer ), hFile );
    snprintf( buffer, elcount( buffer ), "0.0000 HMI_DiffLk_Msg7_Disp_Rq := %X\n", getValue( HMI_DiffLk_Msg7_Disp_Rq ) );        filePutString( buffer, elcount( buffer ), hFile );
    snprintf( buffer, elcount( buffer ), "0.0000 HMI_DiffLk_Msg8_Disp_Rq := %X\n", getValue( HMI_DiffLk_Msg8_Disp_Rq ) );        filePutString( buffer, elcount( buffer ), hFile );
    snprintf( buffer, elcount( buffer ), "0.0000 HMI_DiffLk_Msg9_Disp_Rq := %X\n", getValue( HMI_DiffLk_Msg9_Disp_Rq ) );        filePutString( buffer, elcount( buffer ), hFile );
    snprintf( buffer, elcount( buffer ), "0.0000 HMI_DPC_Disp_TrgRq_TCASE := %X\n", getValue( HMI_DPC_Disp_TrgRq_TCASE ) );        filePutString( buffer, elcount( buffer ), hFile );
    snprintf( buffer, elcount( buffer ), "0.0000 HMI_TCASE_GrLo_IndLmp_On_Rq := %X\n", getValue( HMI_TCASE_GrLo_IndLmp_On_Rq ) );        filePutString( buffer, elcount( buffer ), hFile );
    snprintf( buffer, elcount( buffer ), "0.0000 HMI_TCASE_Msg1_Disp_Rq := %X\n", getValue( HMI_TCASE_Msg1_Disp_Rq ) );        filePutString( buffer, elcount( buffer ), hFile );
    snprintf( buffer, elcount( buffer ), "0.0000 HMI_TCASE_Msg2_Disp_Rq := %X\n", getValue( HMI_TCASE_Msg2_Disp_Rq ) );        filePutString( buffer, elcount( buffer ), hFile );
    snprintf( buffer, elcount( buffer ), "0.0000 HMI_TCASE_Msg3_Disp_Rq := %X\n", getValue( HMI_TCASE_Msg3_Disp_Rq ) );        filePutString( buffer, elcount( buffer ), hFile );
    snprintf( buffer, elcount( buffer ), "0.0000 HMI_TCASE_Msg4_Disp_Rq := %X\n", getValue( HMI_TCASE_Msg4_Disp_Rq ) );        filePutString( buffer, elcount( buffer ), hFile );
    snprintf( buffer, elcount( buffer ), "0.0000 HMI_TCASE_Msg5_Disp_Rq := %X\n", getValue( HMI_TCASE_Msg5_Disp_Rq ) );        filePutString( buffer, elcount( buffer ), hFile );
    snprintf( buffer, elcount( buffer ), "0.0000 HMI_TCASE_Msg6_Disp_Rq := %X\n", getValue( HMI_TCASE_Msg6_Disp_Rq ) );        filePutString( buffer, elcount( buffer ), hFile );
    snprintf( buffer, elcount( buffer ), "0.0000 HMI_TCASE_Msg7_Disp_Rq := %X\n", getValue( HMI_TCASE_Msg7_Disp_Rq ) );        filePutString( buffer, elcount( buffer ), hFile );
    snprintf( buffer, elcount( buffer ), "0.0000 HMI_TCASE_Msg8_Disp_Rq := %X\n", getValue( HMI_TCASE_Msg8_Disp_Rq ) );        filePutString( buffer, elcount( buffer ), hFile );
    snprintf( buffer, elcount( buffer ), "0.0000 HMI_TCASE_Msg9_Disp_Rq := %X\n", getValue( HMI_TCASE_Msg9_Disp_Rq ) );        filePutString( buffer, elcount( buffer ), hFile );
    snprintf( buffer, elcount( buffer ), "0.0000 HMI_TCASE_Msg10_Disp_Rq := %X\n", getValue( HMI_TCASE_Msg10_Disp_Rq ) );        filePutString( buffer, elcount( buffer ), hFile );
    snprintf( buffer, elcount( buffer ), "0.0000 HMI_TCASE_Msg11_Disp_Rq := %X\n", getValue( HMI_TCASE_Msg11_Disp_Rq ) );        filePutString( buffer, elcount( buffer ), hFile );
    snprintf( buffer, elcount( buffer ), "0.0000 HMI_TCASE_Msg12_Disp_Rq := %X\n", getValue( HMI_TCASE_Msg12_Disp_Rq ) );        filePutString( buffer, elcount( buffer ), hFile );
    snprintf( buffer, elcount( buffer ), "0.0000 HMI_TCASE_Msg13_Disp_Rq := %X\n", getValue( HMI_TCASE_Msg13_Disp_Rq ) );        filePutString( buffer, elcount( buffer ), hFile );
}
/*@@end*/

/*@@timer:_tAWD_TCASE_Disp_Rq_AR:*/
on timer _tAWD_TCASE_Disp_Rq_AR
{
    putValue( HMI__STMSG_AWD_TCASE_Disp_Rq_AR, 0 );
}
/*@@end*/

/*@@envVar:HMI__STMSG_AWD_TCASE_Disp_Rq_AR:*/
on EnvVar HMI__STMSG_AWD_TCASE_Disp_Rq_AR
{
    long tDelay;
    if( getValue( this ) == 2 )
    {
        tDelay = getValue( HMI__STMSGT_AWD_TCASE_Disp_Rq_AR );
        if( tDelay > 0)    
            setTimer( _tAWD_TCASE_Disp_Rq_AR, tDelay );
        else
            putValue( HMI__STMSG_AWD_TCASE_Disp_Rq_AR, 0 );
    }
}
/*@@end*/

/*@@envVar:HMI_AWD_Msg1_Disp_Rq:*/
on EnvVar HMI_AWD_Msg1_Disp_Rq
{
    _mAWD_TCASE_Disp_Rq_AR.AWD_Msg1_Disp_Rq.phys = getValue(this);
    _AWD_TCASE_Disp_Rq_AR_SpontanFlag = 1;
}
/*@@end*/

/*@@envVar:HMI_AWD_Msg2_Disp_Rq:*/
on EnvVar HMI_AWD_Msg2_Disp_Rq
{
    _mAWD_TCASE_Disp_Rq_AR.AWD_Msg2_Disp_Rq.phys = getValue(this);
    _AWD_TCASE_Disp_Rq_AR_SpontanFlag = 1;
}
/*@@end*/

/*@@envVar:HMI_DiffLk_Msg1_Disp_Rq:*/
on EnvVar HMI_DiffLk_Msg1_Disp_Rq
{
    _mAWD_TCASE_Disp_Rq_AR.DiffLk_Msg1_Disp_Rq.phys = getValue(this);
    _AWD_TCASE_Disp_Rq_AR_SpontanFlag = 1;
}
/*@@end*/

/*@@envVar:HMI_DiffLk_Msg2_Disp_Rq:*/
on EnvVar HMI_DiffLk_Msg2_Disp_Rq
{
    _mAWD_TCASE_Disp_Rq_AR.DiffLk_Msg2_Disp_Rq.phys = getValue(this);
    _AWD_TCASE_Disp_Rq_AR_SpontanFlag = 1;
}
/*@@end*/

/*@@envVar:HMI_DiffLk_Msg3_Disp_Rq:*/
on EnvVar HMI_DiffLk_Msg3_Disp_Rq
{
    _mAWD_TCASE_Disp_Rq_AR.DiffLk_Msg3_Disp_Rq.phys = getValue(this);
    _AWD_TCASE_Disp_Rq_AR_SpontanFlag = 1;
}
/*@@end*/

/*@@envVar:HMI_DiffLk_Msg4_Disp_Rq:*/
on EnvVar HMI_DiffLk_Msg4_Disp_Rq
{
    _mAWD_TCASE_Disp_Rq_AR.DiffLk_Msg4_Disp_Rq.phys = getValue(this);
    _AWD_TCASE_Disp_Rq_AR_SpontanFlag = 1;
}
/*@@end*/

/*@@envVar:HMI_DiffLk_Msg5_Disp_Rq:*/
on EnvVar HMI_DiffLk_Msg5_Disp_Rq
{
    _mAWD_TCASE_Disp_Rq_AR.DiffLk_Msg5_Disp_Rq.phys = getValue(this);
    _AWD_TCASE_Disp_Rq_AR_SpontanFlag = 1;
}
/*@@end*/

/*@@envVar:HMI_DiffLk_Msg6_Disp_Rq:*/
on EnvVar HMI_DiffLk_Msg6_Disp_Rq
{
    _mAWD_TCASE_Disp_Rq_AR.DiffLk_Msg6_Disp_Rq.phys = getValue(this);
    _AWD_TCASE_Disp_Rq_AR_SpontanFlag = 1;
}
/*@@end*/

/*@@envVar:HMI_DiffLk_Msg7_Disp_Rq:*/
on EnvVar HMI_DiffLk_Msg7_Disp_Rq
{
    _mAWD_TCASE_Disp_Rq_AR.DiffLk_Msg7_Disp_Rq.phys = getValue(this);
    _AWD_TCASE_Disp_Rq_AR_SpontanFlag = 1;
}
/*@@end*/

/*@@envVar:HMI_DiffLk_Msg8_Disp_Rq:*/
on EnvVar HMI_DiffLk_Msg8_Disp_Rq
{
    _mAWD_TCASE_Disp_Rq_AR.DiffLk_Msg8_Disp_Rq.phys = getValue(this);
    _AWD_TCASE_Disp_Rq_AR_SpontanFlag = 1;
}
/*@@end*/

/*@@envVar:HMI_DiffLk_Msg9_Disp_Rq:*/
on EnvVar HMI_DiffLk_Msg9_Disp_Rq
{
    _mAWD_TCASE_Disp_Rq_AR.DiffLk_Msg9_Disp_Rq.phys = getValue(this);
    _AWD_TCASE_Disp_Rq_AR_SpontanFlag = 1;
}
/*@@end*/

/*@@envVar:HMI_DPC_Disp_TrgRq_TCASE:*/
on EnvVar HMI_DPC_Disp_TrgRq_TCASE
{
    _mAWD_TCASE_Disp_Rq_AR.DPC_Disp_TrgRq_TCASE.phys = getValue(this);
    _AWD_TCASE_Disp_Rq_AR_SpontanFlag = 1;
}
/*@@end*/

/*@@envVar:HMI_TCASE_GrLo_IndLmp_On_Rq:*/
on EnvVar HMI_TCASE_GrLo_IndLmp_On_Rq
{
    _mAWD_TCASE_Disp_Rq_AR.TCASE_GrLo_IndLmp_On_Rq.phys = getValue(this);
    _AWD_TCASE_Disp_Rq_AR_SpontanFlag = 1;
}
/*@@end*/

/*@@envVar:HMI_TCASE_Msg1_Disp_Rq:*/
on EnvVar HMI_TCASE_Msg1_Disp_Rq
{
    _mAWD_TCASE_Disp_Rq_AR.TCASE_Msg1_Disp_Rq.phys = getValue(this);
    _AWD_TCASE_Disp_Rq_AR_SpontanFlag = 1;
}
/*@@end*/

/*@@envVar:HMI_TCASE_Msg2_Disp_Rq:*/
on EnvVar HMI_TCASE_Msg2_Disp_Rq
{
    _mAWD_TCASE_Disp_Rq_AR.TCASE_Msg2_Disp_Rq.phys = getValue(this);
    _AWD_TCASE_Disp_Rq_AR_SpontanFlag = 1;
}
/*@@end*/

/*@@envVar:HMI_TCASE_Msg3_Disp_Rq:*/
on EnvVar HMI_TCASE_Msg3_Disp_Rq
{
    _mAWD_TCASE_Disp_Rq_AR.TCASE_Msg3_Disp_Rq.phys = getValue(this);
    _AWD_TCASE_Disp_Rq_AR_SpontanFlag = 1;
}
/*@@end*/

/*@@envVar:HMI_TCASE_Msg4_Disp_Rq:*/
on EnvVar HMI_TCASE_Msg4_Disp_Rq
{
    _mAWD_TCASE_Disp_Rq_AR.TCASE_Msg4_Disp_Rq.phys = getValue(this);
    _AWD_TCASE_Disp_Rq_AR_SpontanFlag = 1;
}
/*@@end*/

/*@@envVar:HMI_TCASE_Msg5_Disp_Rq:*/
on EnvVar HMI_TCASE_Msg5_Disp_Rq
{
    _mAWD_TCASE_Disp_Rq_AR.TCASE_Msg5_Disp_Rq.phys = getValue(this);
    _AWD_TCASE_Disp_Rq_AR_SpontanFlag = 1;
}
/*@@end*/

/*@@envVar:HMI_TCASE_Msg6_Disp_Rq:*/
on EnvVar HMI_TCASE_Msg6_Disp_Rq
{
    _mAWD_TCASE_Disp_Rq_AR.TCASE_Msg6_Disp_Rq.phys = getValue(this);
    _AWD_TCASE_Disp_Rq_AR_SpontanFlag = 1;
}
/*@@end*/

/*@@envVar:HMI_TCASE_Msg7_Disp_Rq:*/
on EnvVar HMI_TCASE_Msg7_Disp_Rq
{
    _mAWD_TCASE_Disp_Rq_AR.TCASE_Msg7_Disp_Rq.phys = getValue(this);
    _AWD_TCASE_Disp_Rq_AR_SpontanFlag = 1;
}
/*@@end*/

/*@@envVar:HMI_TCASE_Msg8_Disp_Rq:*/
on EnvVar HMI_TCASE_Msg8_Disp_Rq
{
    _mAWD_TCASE_Disp_Rq_AR.TCASE_Msg8_Disp_Rq.phys = getValue(this);
    _AWD_TCASE_Disp_Rq_AR_SpontanFlag = 1;
}
/*@@end*/

/*@@envVar:HMI_TCASE_Msg9_Disp_Rq:*/
on EnvVar HMI_TCASE_Msg9_Disp_Rq
{
    _mAWD_TCASE_Disp_Rq_AR.TCASE_Msg9_Disp_Rq.phys = getValue(this);
    _AWD_TCASE_Disp_Rq_AR_SpontanFlag = 1;
}
/*@@end*/

/*@@envVar:HMI_TCASE_Msg10_Disp_Rq:*/
on EnvVar HMI_TCASE_Msg10_Disp_Rq
{
    _mAWD_TCASE_Disp_Rq_AR.TCASE_Msg10_Disp_Rq.phys = getValue(this);
    _AWD_TCASE_Disp_Rq_AR_SpontanFlag = 1;
}
/*@@end*/

/*@@envVar:HMI_TCASE_Msg11_Disp_Rq:*/
on EnvVar HMI_TCASE_Msg11_Disp_Rq
{
    _mAWD_TCASE_Disp_Rq_AR.TCASE_Msg11_Disp_Rq.phys = getValue(this);
    _AWD_TCASE_Disp_Rq_AR_SpontanFlag = 1;
}
/*@@end*/

/*@@envVar:HMI_TCASE_Msg12_Disp_Rq:*/
on EnvVar HMI_TCASE_Msg12_Disp_Rq
{
    _mAWD_TCASE_Disp_Rq_AR.TCASE_Msg12_Disp_Rq.phys = getValue(this);
    _AWD_TCASE_Disp_Rq_AR_SpontanFlag = 1;
}
/*@@end*/

/*@@envVar:HMI_TCASE_Msg13_Disp_Rq:*/
on EnvVar HMI_TCASE_Msg13_Disp_Rq
{
    _mAWD_TCASE_Disp_Rq_AR.TCASE_Msg13_Disp_Rq.phys = getValue(this);
    _AWD_TCASE_Disp_Rq_AR_SpontanFlag = 1;
}
/*@@end*/

/*@@caplFunc:BC_F_Disp_Rq_AR_check_output():*/
BC_F_Disp_Rq_AR_check_output()
{
    if( !getValue( HMI__STMSG_BC_F_Disp_Rq_AR ) )
    {
        // Botschaft BC_F_Disp_Rq_AR ID: 823 --- Sendeart 5 cyclicAndSpontanWithDelay --- 
        _BC_F_Disp_Rq_AR_Cnt--;
        if( _BC_F_Disp_Rq_AR_Cnt < 1 )
        {
            // Nachricht wg. abgelaufenem Zyklus ausgeben
            BC_F_Disp_Rq_AR_output();
            _BC_F_Disp_Rq_AR_Cnt = _BC_F_Disp_Rq_AR_CycleCount; // Zyklus-Zähler zurücksetzen
            _BC_F_Disp_Rq_AR_SpontanFlag = 0; // Spontan-Flag zurücksetzen
        }
        else if( _BC_F_Disp_Rq_AR_SpontanFlag)
        {
            // Nachricht wg. spontaner Änderung ausgeben
            BC_F_Disp_Rq_AR_output();
            _BC_F_Disp_Rq_AR_SpontanFlag = 0; // Spontan-Flag zurücksetzen
        }
    }
}
/*@@end*/

/*@@caplFunc:BC_F_Disp_Rq_AR_init():*/
BC_F_Disp_Rq_AR_init()
{   /* Botschaft BC_F_Disp_Rq_AR ID: 823 --- Sendeart 5 cyclicAndSpontanWithDelay --- 
BA_ "ApplMessage" BO_ 823 0;
BA_ "NmAsrMessage" BO_ 823 0;
BA_ "GenMsgMinAcceptLength" BO_ 823 4;
BA_ "GenMsgILSupport" BO_ 823 1;
BA_ "DiagState" BO_ 823 0;
BA_ "DiagRequest" BO_ 823 0;
BA_ "DiagResponse" BO_ 823 0;
BA_ "GenMsgStartValue" BO_ 823 "0";
BA_ "GenMsgStartDelayTime" BO_ 823 0;
BA_ "GenMsgDelayTime" BO_ 823 5;
BA_ "GenMsgNrOfRepetitions" BO_ 823 0;
BA_ "GenMsgCycleTime" BO_ 823 1000;
BA_ "GenMsgSendType" BO_ 823 5;
    */
    _BC_F_Disp_Rq_AR_Timebase =         c_tDBKomTimer_20ms;
    _BC_F_Disp_Rq_AR_CycleCount =     1000 / _BC_F_Disp_Rq_AR_Timebase;
    _BC_F_Disp_Rq_AR_StartDelay =        0 / _BC_F_Disp_Rq_AR_Timebase;
    _BC_F_Disp_Rq_AR_Cnt = _BC_F_Disp_Rq_AR_StartDelay;
    _BC_F_Disp_Rq_AR_SpontanFlag = 0;

    putValue( HMI__STMSGSD_BC_F_Disp_Rq_AR, _BC_F_Disp_Rq_AR_StartDelay * _BC_F_Disp_Rq_AR_Timebase );

    _mBC_F_Disp_Rq_AR.BrkFldIndLmp_On_Rq.phys = getValue( HMI_BrkFldIndLmp_On_Rq );
    _mBC_F_Disp_Rq_AR.BrkLnWearIndLmp_On_Rq.phys = getValue( HMI_BrkLnWearIndLmp_On_Rq );
    _mBC_F_Disp_Rq_AR.CoolIndLmp_On_Rq.phys = getValue( HMI_CoolIndLmp_On_Rq );
    _mBC_F_Disp_Rq_AR.EngHd_Flt_Stat_BC_F.phys = getValue( HMI_EngHd_Flt_Stat_BC_F );
    _mBC_F_Disp_Rq_AR.EngHd_Stat_BC_F.phys = getValue( HMI_EngHd_Stat_BC_F );
    _mBC_F_Disp_Rq_AR.SEB_WarnDisp_Rq.phys = getValue( HMI_SEB_WarnDisp_Rq );
    _mBC_F_Disp_Rq_AR.SRS_IndLmp_Rq_SEB.phys = getValue( HMI_SRS_IndLmp_Rq_SEB );
    _mBC_F_Disp_Rq_AR.WashWtrIndLmp_LowTemp_On_Rq.phys = getValue( HMI_WashWtrIndLmp_LowTemp_On_Rq );
    _mBC_F_Disp_Rq_AR.WashWtrIndLmp_On_Rq.phys = getValue( HMI_WashWtrIndLmp_On_Rq );
}
/*@@end*/

/*@@caplFunc:BC_F_Disp_Rq_AR_output():*/
BC_F_Disp_Rq_AR_output(void)
{
    output( _mBC_F_Disp_Rq_AR );
}
/*@@end*/

/*@@caplFunc:BC_F_Disp_Rq_AR_saveEnvVars(dword):*/
BC_F_Disp_Rq_AR_saveEnvVars( dword hFile )
{
    filePutString("\n// Knoten EIS: BC_F_Disp_Rq_AR\n", 29, hFile );
    snprintf( buffer, elcount( buffer ), "0.0000 HMI__STMSG_BC_F_Disp_Rq_AR := %X\n", getValue( HMI__STMSG_BC_F_Disp_Rq_AR ) );        filePutString ( buffer, elcount( buffer ), hFile );
    snprintf( buffer, elcount( buffer ), "0.0000 HMI__STMSGT_BC_F_Disp_Rq_AR := %X\n", getValue( HMI__STMSGT_BC_F_Disp_Rq_AR ) );        filePutString ( buffer, elcount( buffer ), hFile );
    snprintf( buffer, elcount( buffer ), "0.0000 HMI_BrkFldIndLmp_On_Rq := %X\n", getValue( HMI_BrkFldIndLmp_On_Rq ) );        filePutString ( buffer, elcount( buffer ), hFile );
    snprintf( buffer, elcount( buffer ), "0.0000 HMI_BrkLnWearIndLmp_On_Rq := %X\n", getValue( HMI_BrkLnWearIndLmp_On_Rq ) );        filePutString ( buffer, elcount( buffer ), hFile );
    snprintf( buffer, elcount( buffer ), "0.0000 HMI_CoolIndLmp_On_Rq := %X\n", getValue( HMI_CoolIndLmp_On_Rq ) );        filePutString ( buffer, elcount( buffer ), hFile );
    snprintf( buffer, elcount( buffer ), "0.0000 HMI_EngHd_Flt_Stat_BC_F := %X\n", getValue( HMI_EngHd_Flt_Stat_BC_F ) );        filePutString ( buffer, elcount( buffer ), hFile );
    snprintf( buffer, elcount( buffer ), "0.0000 HMI_EngHd_Stat_BC_F := %X\n", getValue( HMI_EngHd_Stat_BC_F ) );        filePutString ( buffer, elcount( buffer ), hFile );
    snprintf( buffer, elcount( buffer ), "0.0000 HMI_SEB_WarnDisp_Rq := %X\n", getValue( HMI_SEB_WarnDisp_Rq ) );        filePutString ( buffer, elcount( buffer ), hFile );
    snprintf( buffer, elcount( buffer ), "0.0000 HMI_SRS_IndLmp_Rq_SEB := %X\n", getValue( HMI_SRS_IndLmp_Rq_SEB ) );        filePutString ( buffer, elcount( buffer ), hFile );
    snprintf( buffer, elcount( buffer ), "0.0000 HMI_WashWtrIndLmp_LowTemp_On_Rq := %X\n", getValue( HMI_WashWtrIndLmp_LowTemp_On_Rq ) );        filePutString ( buffer, elcount( buffer ), hFile );
    snprintf( buffer, elcount( buffer ), "0.0000 HMI_WashWtrIndLmp_On_Rq := %X\n", getValue( HMI_WashWtrIndLmp_On_Rq ) );        filePutString ( buffer, elcount( buffer ), hFile );
}
/*@@end*/

/*@@envVar:HMI__STMSG_BC_F_Disp_Rq_AR:*/
on EnvVar HMI__STMSG_BC_F_Disp_Rq_AR
{
    long tDelay;
    if( getValue( this ) == 2 )
    {
        tDelay = getValue( HMI__STMSGT_BC_F_Disp_Rq_AR );
        if( tDelay > 0)    
            setTimer( _tBC_F_Disp_Rq_AR, tDelay );
        else
            putValue( HMI__STMSG_BC_F_Disp_Rq_AR, 0 );
    }
}
/*@@end*/

/*@@timer:_tBC_F_Disp_Rq_AR:*/
on timer _tBC_F_Disp_Rq_AR
{
    putValue( HMI__STMSG_BC_F_Disp_Rq_AR, 0 );
}
/*@@end*/

/*@@envVar:HMI_BrkFldIndLmp_On_Rq:*/
on EnvVar HMI_BrkFldIndLmp_On_Rq
{
    _mBC_F_Disp_Rq_AR.BrkFldIndLmp_On_Rq.phys = getValue(this);
    _BC_F_Disp_Rq_AR_SpontanFlag = 1;
}
/*@@end*/

/*@@envVar:HMI_BrkLnWearIndLmp_On_Rq:*/
on EnvVar HMI_BrkLnWearIndLmp_On_Rq
{
    _mBC_F_Disp_Rq_AR.BrkLnWearIndLmp_On_Rq.phys = getValue(this);
    _BC_F_Disp_Rq_AR_SpontanFlag = 1;
}
/*@@end*/

/*@@envVar:HMI_CoolIndLmp_On_Rq:*/
on EnvVar HMI_CoolIndLmp_On_Rq
{
    _mBC_F_Disp_Rq_AR.CoolIndLmp_On_Rq.phys = getValue(this);
    _BC_F_Disp_Rq_AR_SpontanFlag = 1;
}
/*@@end*/

/*@@envVar:HMI_EngHd_Flt_Stat_BC_F:*/
on EnvVar HMI_EngHd_Flt_Stat_BC_F
{
    _mBC_F_Disp_Rq_AR.EngHd_Flt_Stat_BC_F.phys = getValue(this);
    _BC_F_Disp_Rq_AR_SpontanFlag = 1;
}
/*@@end*/

/*@@envVar:HMI_EngHd_Stat_BC_F:*/
on EnvVar HMI_EngHd_Stat_BC_F
{
    _mBC_F_Disp_Rq_AR.EngHd_Stat_BC_F.phys = getValue(this);
    _BC_F_Disp_Rq_AR_SpontanFlag = 1;
}
/*@@end*/

/*@@envVar:HMI_SEB_WarnDisp_Rq:*/
on EnvVar HMI_SEB_WarnDisp_Rq
{
    _mBC_F_Disp_Rq_AR.SEB_WarnDisp_Rq.phys = getValue(this);
    _BC_F_Disp_Rq_AR_SpontanFlag = 1;
}
/*@@end*/

/*@@envVar:HMI_SRS_IndLmp_Rq_SEB:*/
on EnvVar HMI_SRS_IndLmp_Rq_SEB
{
    _mBC_F_Disp_Rq_AR.SRS_IndLmp_Rq_SEB.phys = getValue(this);
    _BC_F_Disp_Rq_AR_SpontanFlag = 1;
}
/*@@end*/

/*@@envVar:HMI_WashWtrIndLmp_LowTemp_On_Rq:*/
on EnvVar HMI_WashWtrIndLmp_LowTemp_On_Rq
{
    _mBC_F_Disp_Rq_AR.WashWtrIndLmp_LowTemp_On_Rq.phys = getValue(this);
    _BC_F_Disp_Rq_AR_SpontanFlag = 1;
}
/*@@end*/

/*@@envVar:HMI_WashWtrIndLmp_On_Rq:*/
on EnvVar HMI_WashWtrIndLmp_On_Rq
{
    _mBC_F_Disp_Rq_AR.WashWtrIndLmp_On_Rq.phys = getValue(this);
    _BC_F_Disp_Rq_AR_SpontanFlag = 1;
}
/*@@end*/

/*@@caplFunc:BC_F_Stat1_AR_check_output():*/
BC_F_Stat1_AR_check_output()
{
    if( !getValue( HMI__STMSG_BC_F_Stat1_AR ) )
    {
        // Botschaft BC_F_Stat1_AR ID: 825 --- Sendeart 5 cyclicAndSpontanWithDelay --- 
        if( _BC_F_Stat1_AR_DelayCnt > 0) _BC_F_Stat1_AR_DelayCnt--; // Mindestsendeabstand
        _BC_F_Stat1_AR_Cnt--;
        if( _BC_F_Stat1_AR_Cnt < 1 )
        {
            if( _BC_F_Stat1_AR_DelayCnt < 1 )
            {
                // Nachricht wg. abgelaufenem Zyklus ausgeben (Mindestsendeabstand eingehalten)
                BC_F_Stat1_AR_output();
                _BC_F_Stat1_AR_SpontanFlag = 0; // Spontan-Flag zurücksetzen
                _BC_F_Stat1_AR_DelayCnt = _BC_F_Stat1_AR_MinDelay;
            }
            else
            {
                // Spontanflag setzen damit nach Ablauf Mindestsendeabstand gesendet wird
                 _BC_F_Stat1_AR_SpontanFlag = 1;
            }
            _BC_F_Stat1_AR_Cnt = _BC_F_Stat1_AR_CycleCount; // Zyklus-Zähler zurücksetzen
        }
        else if( _BC_F_Stat1_AR_SpontanFlag)
        {
            if( _BC_F_Stat1_AR_DelayCnt < 1 )
            {
                // Nachricht wg. spontaner Änderung ausgeben (Mindestsendeabstand eingehalten)
                BC_F_Stat1_AR_output();
                _BC_F_Stat1_AR_SpontanFlag = 0; // Spontan-Flag zurücksetzen
                _BC_F_Stat1_AR_DelayCnt = _BC_F_Stat1_AR_MinDelay;
            }
        }
    }
}
/*@@end*/

/*@@caplFunc:BC_F_Stat1_AR_init():*/
BC_F_Stat1_AR_init()
{   /* Botschaft BC_F_Stat1_AR ID: 825 --- Sendeart 5 cyclicAndSpontanWithDelay --- 
BA_ "ApplMessage" BO_ 825 0;
BA_ "NmAsrMessage" BO_ 825 0;
BA_ "GenMsgMinAcceptLength" BO_ 825 8;
BA_ "GenMsgILSupport" BO_ 825 1;
BA_ "DiagState" BO_ 825 0;
BA_ "DiagRequest" BO_ 825 0;
BA_ "DiagResponse" BO_ 825 0;
BA_ "GenMsgStartValue" BO_ 825 "0";
BA_ "GenMsgStartDelayTime" BO_ 825 0;
BA_ "GenMsgDelayTime" BO_ 825 50;
BA_ "GenMsgNrOfRepetitions" BO_ 825 0;
BA_ "GenMsgCycleTime" BO_ 825 100;
BA_ "GenMsgSendType" BO_ 825 5;
    */
    _BC_F_Stat1_AR_Timebase =          c_tDBKomTimer_5ms;
    _BC_F_Stat1_AR_CycleCount =      100 / _BC_F_Stat1_AR_Timebase;
    _BC_F_Stat1_AR_StartDelay =        0 / _BC_F_Stat1_AR_Timebase;
    _BC_F_Stat1_AR_MinDelay =         50 / _BC_F_Stat1_AR_Timebase;
    _BC_F_Stat1_AR_Cnt = _BC_F_Stat1_AR_StartDelay;
    _BC_F_Stat1_AR_SpontanFlag = 0;
    _BC_F_Stat1_AR_DelayCnt = 0;

    putValue( HMI__STMSGSD_BC_F_Stat1_AR, _BC_F_Stat1_AR_StartDelay * _BC_F_Stat1_AR_Timebase );

    putValue( HMI_AirTemp_Outsd, 20 );  // 60° Difference * 0.5° resolution := 20°C
    _mBC_F_Stat1_AR.AirTemp_Outsd.phys = getValue( HMI_AirTemp_Outsd );
    putValue( HMI_AirTemp_Outsd_Sens_Stat, 0 ); 
    _mBC_F_Stat1_AR.AirTemp_Outsd_Sens_Stat.phys = getValue( HMI_AirTemp_Outsd_Sens_Stat );
    _mBC_F_Stat1_AR.CLkS_Akust_Lk_Rq_Stat.phys = getValue( HMI_CLkS_Akust_Lk_Rq_Stat );
    _mBC_F_Stat1_AR.CLkS_Emg_Unlk_Rq.phys = getValue( HMI_CLkS_Emg_Unlk_Rq );
    _mBC_F_Stat1_AR.DL_Lk_V2.phys = getValue( HMI_DL_Lk_V2 );
    _mBC_F_Stat1_AR.DrSw_D_Vld_Stat.phys = getValue( HMI_DrSw_D_Vld_Stat );
    _mBC_F_Stat1_AR.ESL_Lk_Appl_BC_F.phys = getValue( HMI_ESL_Lk_Appl_BC_F );
    _mBC_F_Stat1_AR.Hrn_On.phys = getValue( HMI_Hrn_On );
    _mBC_F_Stat1_AR.IP_Brt.phys = getValue( HMI_IP_Brt );
    _mBC_F_Stat1_AR.PwrSup15_On.phys = getValue( HMI_PwrSup15_On );
    _mBC_F_Stat1_AR.PwrSup15_On_Diag.phys = getValue( HMI_PwrSup15_On_Diag );
    _mBC_F_Stat1_AR.PwrSup15R_On.phys = getValue( HMI_PwrSup15R_On );
    _mBC_F_Stat1_AR.PwrSup15R_On_Diag.phys = getValue( HMI_PwrSup15R_On_Diag );
    putValue( HMI_SwIllLvl_Ctrl_Style, 1 );
    _mBC_F_Stat1_AR.SwIllLvl_Ctrl_Style.phys = getValue( HMI_SwIllLvl_Ctrl_Style );
    _mBC_F_Stat1_AR.SwIllLvl_Raw.phys = getValue( HMI_SwIllLvl_Raw );
    _mBC_F_Stat1_AR.TSSR_Cls_Rq.phys = getValue( HMI_TSSR_Cls_Rq );
    _mBC_F_Stat1_AR.TSSR_RainCls_Event_Info.phys = getValue( HMI_TSSR_RainCls_Event_Info );
    _mBC_F_Stat1_AR.TSSR_RB_Sw_Psd_OHCM.phys = getValue( HMI_TSSR_RB_Sw_Psd_OHCM );
    _mBC_F_Stat1_AR.TSSR_Sw_Stat_OHCM.phys = getValue( HMI_TSSR_Sw_Stat_OHCM );
}
/*@@end*/

/*@@caplFunc:BC_F_Stat1_AR_output():*/
BC_F_Stat1_AR_output(void)
{
    output( _mBC_F_Stat1_AR );
}
/*@@end*/

/*@@caplFunc:BC_F_Stat1_AR_saveEnvVars(dword):*/
BC_F_Stat1_AR_saveEnvVars( dword hFile )
{
    filePutString("\n// Knoten EIS: BC_F_Stat1_AR\n", 27, hFile );
    snprintf( buffer, elcount( buffer ), "0.0000 HMI__STMSG_BC_F_Stat1_AR := %X\n", getValue( HMI__STMSG_BC_F_Stat1_AR ) );        filePutString ( buffer, elcount( buffer ), hFile );
    snprintf( buffer, elcount( buffer ), "0.0000 HMI__STMSGT_BC_F_Stat1_AR := %X\n", getValue( HMI__STMSGT_BC_F_Stat1_AR ) );        filePutString ( buffer, elcount( buffer ), hFile );
    snprintf( buffer, elcount( buffer ), "0.0000 HMI_AirTemp_Outsd := %X\n", getValue( HMI_AirTemp_Outsd ) );        filePutString ( buffer, elcount( buffer ), hFile );
    snprintf( buffer, elcount( buffer ), "0.0000 HMI_AirTemp_Outsd_Sens_Stat := %X\n", getValue( HMI_AirTemp_Outsd_Sens_Stat ) );        filePutString ( buffer, elcount( buffer ), hFile );
    snprintf( buffer, elcount( buffer ), "0.0000 HMI_CLkS_Akust_Lk_Rq_Stat := %X\n", getValue( HMI_CLkS_Akust_Lk_Rq_Stat ) );        filePutString ( buffer, elcount( buffer ), hFile );
    snprintf( buffer, elcount( buffer ), "0.0000 HMI_CLkS_Emg_Unlk_Rq := %X\n", getValue( HMI_CLkS_Emg_Unlk_Rq ) );        filePutString ( buffer, elcount( buffer ), hFile );
    snprintf( buffer, elcount( buffer ), "0.0000 HMI_DL_Lk_V2 := %X\n", getValue( HMI_DL_Lk_V2 ) );        filePutString ( buffer, elcount( buffer ), hFile );
    snprintf( buffer, elcount( buffer ), "0.0000 HMI_DrSw_D_Vld_Stat := %X\n", getValue( HMI_DrSw_D_Vld_Stat ) );        filePutString ( buffer, elcount( buffer ), hFile );
    snprintf( buffer, elcount( buffer ), "0.0000 HMI_ESL_Lk_Appl_BC_F := %X\n", getValue( HMI_ESL_Lk_Appl_BC_F ) );        filePutString ( buffer, elcount( buffer ), hFile );
    snprintf( buffer, elcount( buffer ), "0.0000 HMI_Hrn_On := %X\n", getValue( HMI_Hrn_On ) );        filePutString ( buffer, elcount( buffer ), hFile );
    snprintf( buffer, elcount( buffer ), "0.0000 HMI_IP_Brt := %X\n", getValue( HMI_IP_Brt ) );        filePutString ( buffer, elcount( buffer ), hFile );
    snprintf( buffer, elcount( buffer ), "0.0000 HMI_PwrSup15_On := %X\n", getValue( HMI_PwrSup15_On ) );        filePutString ( buffer, elcount( buffer ), hFile );
    snprintf( buffer, elcount( buffer ), "0.0000 HMI_PwrSup15_On_Diag := %X\n", getValue( HMI_PwrSup15_On_Diag ) );        filePutString ( buffer, elcount( buffer ), hFile );
    snprintf( buffer, elcount( buffer ), "0.0000 HMI_PwrSup15R_On := %X\n", getValue( HMI_PwrSup15R_On ) );        filePutString ( buffer, elcount( buffer ), hFile );
    snprintf( buffer, elcount( buffer ), "0.0000 HMI_PwrSup15R_On_Diag := %X\n", getValue( HMI_PwrSup15R_On_Diag ) );        filePutString ( buffer, elcount( buffer ), hFile );
    snprintf( buffer, elcount( buffer ), "0.0000 HMI_SwIllLvl_Ctrl_Style := %X\n", getValue( HMI_SwIllLvl_Ctrl_Style ) );        filePutString ( buffer, elcount( buffer ), hFile );
    snprintf( buffer, elcount( buffer ), "0.0000 HMI_SwIllLvl_Raw := %X\n", getValue( HMI_SwIllLvl_Raw ) );        filePutString ( buffer, elcount( buffer ), hFile );
    snprintf( buffer, elcount( buffer ), "0.0000 HMI_TSSR_Cls_Rq := %X\n", getValue( HMI_TSSR_Cls_Rq ) );        filePutString ( buffer, elcount( buffer ), hFile );
    snprintf( buffer, elcount( buffer ), "0.0000 HMI_TSSR_RainCls_Event_Info := %X\n", getValue( HMI_TSSR_RainCls_Event_Info ) );        filePutString ( buffer, elcount( buffer ), hFile );
    snprintf( buffer, elcount( buffer ), "0.0000 HMI_TSSR_RB_Sw_Psd_OHCM := %X\n", getValue( HMI_TSSR_RB_Sw_Psd_OHCM ) );        filePutString ( buffer, elcount( buffer ), hFile );
    snprintf( buffer, elcount( buffer ), "0.0000 HMI_TSSR_Sw_Stat_OHCM := %X\n", getValue( HMI_TSSR_Sw_Stat_OHCM ) );        filePutString ( buffer, elcount( buffer ), hFile );
}
/*@@end*/

/*@@timer:_tBC_F_Stat1_AR:*/
on timer _tBC_F_Stat1_AR
{
    putValue( HMI__STMSG_BC_F_Stat1_AR, 0 );
}
/*@@end*/

/*@@envVar:HMI__STMSG_BC_F_Stat1_AR:*/
on EnvVar HMI__STMSG_BC_F_Stat1_AR
{
    long tDelay;
    if( getValue( this ) == 2 )
    {
        tDelay = getValue( HMI__STMSGT_BC_F_Stat1_AR );
        if( tDelay > 0)    
            setTimer( _tBC_F_Stat1_AR, tDelay );
        else
            putValue( HMI__STMSG_BC_F_Stat1_AR, 0 );
    }
}
/*@@end*/

/*@@envVar:HMI_AirTemp_Outsd:*/
on EnvVar HMI_AirTemp_Outsd
{
    _mBC_F_Stat1_AR.AirTemp_Outsd.phys = getValue(this);
    _BC_F_Stat1_AR_SpontanFlag = 1;
}
/*@@end*/

/*@@envVar:HMI_AirTemp_Outsd_Sens_Stat:*/
on EnvVar HMI_AirTemp_Outsd_Sens_Stat
{
    _mBC_F_Stat1_AR.AirTemp_Outsd_Sens_Stat.phys = getValue(this);
    _BC_F_Stat1_AR_SpontanFlag = 1;
}
/*@@end*/

/*@@envVar:HMI_CLkS_Akust_Lk_Rq_Stat:*/
on EnvVar HMI_CLkS_Akust_Lk_Rq_Stat
{
    _mBC_F_Stat1_AR.CLkS_Akust_Lk_Rq_Stat.phys = getValue(this);
    _BC_F_Stat1_AR_SpontanFlag = 1;
}
/*@@end*/

/*@@envVar:HMI_CLkS_Emg_Unlk_Rq:*/
on EnvVar HMI_CLkS_Emg_Unlk_Rq
{
    _mBC_F_Stat1_AR.CLkS_Emg_Unlk_Rq.phys = getValue(this);
    _BC_F_Stat1_AR_SpontanFlag = 1;
}
/*@@end*/

/*@@envVar:HMI_DL_Lk_V2:*/
on EnvVar HMI_DL_Lk_V2
{
    _mBC_F_Stat1_AR.DL_Lk_V2.phys = getValue(this);
    _BC_F_Stat1_AR_SpontanFlag = 1;
}
/*@@end*/

/*@@envVar:HMI_DrSw_D_Vld_Stat:*/
on EnvVar HMI_DrSw_D_Vld_Stat
{
    _mBC_F_Stat1_AR.DrSw_D_Vld_Stat.phys = getValue(this);
    _BC_F_Stat1_AR_SpontanFlag = 1;
}
/*@@end*/

/*@@envVar:HMI_ESL_Lk_Appl_BC_F:*/
on EnvVar HMI_ESL_Lk_Appl_BC_F
{
    _mBC_F_Stat1_AR.ESL_Lk_Appl_BC_F.phys = getValue(this);
    _BC_F_Stat1_AR_SpontanFlag = 1;
}
/*@@end*/

/*@@envVar:HMI_Hrn_On:*/
on EnvVar HMI_Hrn_On
{
    _mBC_F_Stat1_AR.Hrn_On.phys = getValue(this);
    _BC_F_Stat1_AR_SpontanFlag = 1;
}
/*@@end*/

/*@@envVar:HMI_IP_Brt:*/
on EnvVar HMI_IP_Brt
{
    _mBC_F_Stat1_AR.IP_Brt.phys = getValue(this);
    _BC_F_Stat1_AR_SpontanFlag = 1;
}
/*@@end*/

/*@@envVar:HMI_PwrSup15_On:*/
on EnvVar HMI_PwrSup15_On
{
    _mBC_F_Stat1_AR.PwrSup15_On.phys = getValue(this);
    _BC_F_Stat1_AR_SpontanFlag = 1;
}
/*@@end*/

/*@@envVar:HMI_PwrSup15_On_Diag:*/
on EnvVar HMI_PwrSup15_On_Diag
{
    _mBC_F_Stat1_AR.PwrSup15_On_Diag.phys = getValue(this);
    _BC_F_Stat1_AR_SpontanFlag = 1;
}
/*@@end*/

/*@@envVar:HMI_PwrSup15R_On:*/
on EnvVar HMI_PwrSup15R_On
{
    _mBC_F_Stat1_AR.PwrSup15R_On.phys = getValue(this);
    _BC_F_Stat1_AR_SpontanFlag = 1;
}
/*@@end*/

/*@@envVar:HMI_PwrSup15R_On_Diag:*/
on EnvVar HMI_PwrSup15R_On_Diag
{
    _mBC_F_Stat1_AR.PwrSup15R_On_Diag.phys = getValue(this);
    _BC_F_Stat1_AR_SpontanFlag = 1;
}
/*@@end*/

/*@@envVar:HMI_SwIllLvl_Ctrl_Style:*/
on EnvVar HMI_SwIllLvl_Ctrl_Style
{
    _mBC_F_Stat1_AR.SwIllLvl_Ctrl_Style.phys = getValue(this);
    _BC_F_Stat1_AR_SpontanFlag = 1;
}
/*@@end*/

/*@@envVar:HMI_SwIllLvl_Raw:*/
on EnvVar HMI_SwIllLvl_Raw
{
    _mBC_F_Stat1_AR.SwIllLvl_Raw.phys = getValue(this);
//    _BC_F_Stat1_AR_SpontanFlag = 1;    !!!! blocked for getting incremental dimming
}
/*@@end*/

/*@@envVar:HMI_TSSR_Cls_Rq:*/
on EnvVar HMI_TSSR_Cls_Rq
{
    _mBC_F_Stat1_AR.TSSR_Cls_Rq.phys = getValue(this);
    _BC_F_Stat1_AR_SpontanFlag = 1;
}
/*@@end*/

/*@@envVar:HMI_TSSR_RainCls_Event_Info:*/
on EnvVar HMI_TSSR_RainCls_Event_Info
{
    _mBC_F_Stat1_AR.TSSR_RainCls_Event_Info.phys = getValue(this);
    _BC_F_Stat1_AR_SpontanFlag = 1;
}
/*@@end*/

/*@@envVar:HMI_TSSR_RB_Sw_Psd_OHCM:*/
on EnvVar HMI_TSSR_RB_Sw_Psd_OHCM
{
    _mBC_F_Stat1_AR.TSSR_RB_Sw_Psd_OHCM.phys = getValue(this);
    _BC_F_Stat1_AR_SpontanFlag = 1;
}
/*@@end*/

/*@@envVar:HMI_TSSR_Sw_Stat_OHCM:*/
on EnvVar HMI_TSSR_Sw_Stat_OHCM
{
    _mBC_F_Stat1_AR.TSSR_Sw_Stat_OHCM.phys = getValue(this);
    _BC_F_Stat1_AR_SpontanFlag = 1;
}
/*@@end*/

/*@@caplFunc:BC_F_Stat2_AR_check_output():*/
BC_F_Stat2_AR_check_output()
{
    if( !getValue( HMI__STMSG_BC_F_Stat2_AR ) )
    {
        // Botschaft BC_F_Stat2_AR ID: 821 --- Sendeart 5 cyclicAndSpontanWithDelay --- 
        _BC_F_Stat2_AR_Cnt--;
        if( _BC_F_Stat2_AR_Cnt < 1 )
        {
            // Nachricht wg. abgelaufenem Zyklus ausgeben
            BC_F_Stat2_AR_output();
            _BC_F_Stat2_AR_Cnt = _BC_F_Stat2_AR_CycleCount; // Zyklus-Zähler zurücksetzen
            _BC_F_Stat2_AR_SpontanFlag = 0; // Spontan-Flag zurücksetzen
        }
        else if( _BC_F_Stat2_AR_SpontanFlag)
        {
            // Nachricht wg. spontaner Änderung ausgeben
            BC_F_Stat2_AR_output();
            _BC_F_Stat2_AR_SpontanFlag = 0; // Spontan-Flag zurücksetzen
        }
    }
}
/*@@end*/

/*@@caplFunc:BC_F_Stat2_AR_init():*/
BC_F_Stat2_AR_init()
{   /* Botschaft BC_F_Stat2_AR ID: 821 --- Sendeart 5 cyclicAndSpontanWithDelay --- 
BA_ "ApplMessage" BO_ 821 0;
BA_ "NmAsrMessage" BO_ 821 0;
BA_ "GenMsgMinAcceptLength" BO_ 821 8;
BA_ "GenMsgILSupport" BO_ 821 1;
BA_ "DiagState" BO_ 821 0;
BA_ "DiagRequest" BO_ 821 0;
BA_ "DiagResponse" BO_ 821 0;
BA_ "GenMsgStartValue" BO_ 821 "0";
BA_ "GenMsgStartDelayTime" BO_ 821 0;
BA_ "GenMsgDelayTime" BO_ 821 5;
BA_ "GenMsgNrOfRepetitions" BO_ 821 0;
BA_ "GenMsgCycleTime" BO_ 821 500;
BA_ "GenMsgSendType" BO_ 821 5;
    */
    _BC_F_Stat2_AR_Timebase =         c_tDBKomTimer_20ms;
    _BC_F_Stat2_AR_CycleCount =     500 / _BC_F_Stat2_AR_Timebase;
    _BC_F_Stat2_AR_StartDelay =       0 / _BC_F_Stat2_AR_Timebase;
    _BC_F_Stat2_AR_Cnt = _BC_F_Stat2_AR_StartDelay;
    _BC_F_Stat2_AR_SpontanFlag = 0;

    putValue( HMI__STMSGSD_BC_F_Stat2_AR, _BC_F_Stat2_AR_StartDelay * _BC_F_Stat2_AR_Timebase );

    _mBC_F_Stat2_AR.BeltHdOvrSw_Psd_V2.phys = getValue( HMI_BeltHdOvrSw_Psd_V2 );
    _mBC_F_Stat2_AR.BMM_Status.phys = getValue( HMI_BMM_Status );
    _mBC_F_Stat2_AR.DTQ_Sw_Md.phys = getValue( HMI_DTQ_Sw_Md );
    _mBC_F_Stat2_AR.CPF_Ft_Stat.phys = getValue( HMI_CPF_Ft_Stat );
    _mBC_F_Stat2_AR.HdRst_R_Rq.phys = getValue( HMI_HdRst_R_Rq );
    _mBC_F_Stat2_AR.HUD_Sw_Psd.phys = getValue( HMI_HUD_Sw_Psd );
    _mBC_F_Stat2_AR.LDP_Sw_Md.phys = getValue( HMI_LDP_Sw_Md );
    _mBC_F_Stat2_AR.NV_Sw_Psd.phys = getValue( HMI_NV_Sw_Psd );
    _mBC_F_Stat2_AR.ParkSw_Psd.phys = getValue( HMI_ParkSw_Psd );
    _mBC_F_Stat2_AR.RB_R_Sw_Psd_Ft.phys = getValue( HMI_RB_R_Sw_Psd_Ft );
    _mBC_F_Stat2_AR.RLS_AutoPosn.phys = getValue( HMI_RLS_AutoPosn );
    _mBC_F_Stat2_AR.RLS_FogLmp_Ft_Posn.phys = getValue( HMI_RLS_FogLmp_Ft_Posn );
    _mBC_F_Stat2_AR.RLS_FogLmp_R_Posn.phys = getValue( HMI_RLS_FogLmp_R_Posn );
    _mBC_F_Stat2_AR.RLS_LoBm_Posn.phys = getValue( HMI_RLS_LoBm_Posn );
    _mBC_F_Stat2_AR.RLS_PkLmp_Posn_Lt.phys = getValue( HMI_RLS_PkLmp_Posn_Lt );
    _mBC_F_Stat2_AR.RLS_PkLmp_Posn_Rt.phys = getValue( HMI_RLS_PkLmp_Posn_Rt );
    _mBC_F_Stat2_AR.RLS_PosnLmp_Posn.phys = getValue( HMI_RLS_PosnLmp_Posn );
    _mBC_F_Stat2_AR.SuspLvlAdjSw_Psd_AMG.phys = getValue( HMI_SuspLvlAdjSw_Psd_AMG );
    _mBC_F_Stat2_AR.SVS_Sw_Psd.phys = getValue( HMI_SVS_Sw_Psd );
}
/*@@end*/

/*@@caplFunc:BC_F_Stat2_AR_output():*/
BC_F_Stat2_AR_output(void)
{
    output( _mBC_F_Stat2_AR );
}
/*@@end*/

/*@@caplFunc:BC_F_Stat2_AR_saveEnvVars(dword):*/
BC_F_Stat2_AR_saveEnvVars( dword hFile )
{
    filePutString("\n// Knoten EIS: BC_F_Stat2_AR\n", 27, hFile );
    snprintf( buffer, elcount( buffer ), "0.0000 HMI__STMSG_BC_F_Stat2_AR := %X\n", getValue( HMI__STMSG_BC_F_Stat2_AR ) );        filePutString ( buffer, elcount( buffer ), hFile );
    snprintf( buffer, elcount( buffer ), "0.0000 HMI__STMSGT_BC_F_Stat2_AR := %X\n", getValue( HMI__STMSGT_BC_F_Stat2_AR ) );        filePutString ( buffer, elcount( buffer ), hFile );
    snprintf( buffer, elcount( buffer ), "0.0000 HMI_BeltHdOvrSw_Psd_V2 := %X\n", getValue( HMI_BeltHdOvrSw_Psd_V2 ) );        filePutString ( buffer, elcount( buffer ), hFile );
    snprintf( buffer, elcount( buffer ), "0.0000 HMI_BMM_Status := %X\n", getValue( HMI_BMM_Status ) );        filePutString ( buffer, elcount( buffer ), hFile );
    snprintf( buffer, elcount( buffer ), "0.0000 HMI_CPF_Ft_Stat := %X\n", getValue( HMI_CPF_Ft_Stat ) );        filePutString ( buffer, elcount( buffer ), hFile );
    snprintf( buffer, elcount( buffer ), "0.0000 HMI_DTQ_Sw_Md := %X\n", getValue( HMI_DTQ_Sw_Md ) );        filePutString ( buffer, elcount( buffer ), hFile );
    snprintf( buffer, elcount( buffer ), "0.0000 HMI_HdRst_R_Rq := %X\n", getValue( HMI_HdRst_R_Rq ) );        filePutString ( buffer, elcount( buffer ), hFile );
    snprintf( buffer, elcount( buffer ), "0.0000 HMI_HUD_Sw_Psd := %X\n", getValue( HMI_HUD_Sw_Psd ) );        filePutString ( buffer, elcount( buffer ), hFile );
    snprintf( buffer, elcount( buffer ), "0.0000 HMI_LDP_Sw_Md := %X\n", getValue( HMI_LDP_Sw_Md ) );        filePutString ( buffer, elcount( buffer ), hFile );
    snprintf( buffer, elcount( buffer ), "0.0000 HMI_NV_Sw_Psd := %X\n", getValue( HMI_NV_Sw_Psd ) );        filePutString ( buffer, elcount( buffer ), hFile );
    snprintf( buffer, elcount( buffer ), "0.0000 HMI_ParkSw_Psd := %X\n", getValue( HMI_ParkSw_Psd ) );        filePutString ( buffer, elcount( buffer ), hFile );
    snprintf( buffer, elcount( buffer ), "0.0000 HMI_RB_R_Sw_Psd_Ft := %X\n", getValue( HMI_RB_R_Sw_Psd_Ft ) );        filePutString ( buffer, elcount( buffer ), hFile );
    snprintf( buffer, elcount( buffer ), "0.0000 HMI_RLS_AutoPosn := %X\n", getValue( HMI_RLS_AutoPosn ) );        filePutString ( buffer, elcount( buffer ), hFile );
    snprintf( buffer, elcount( buffer ), "0.0000 HMI_RLS_FogLmp_Ft_Posn := %X\n", getValue( HMI_RLS_FogLmp_Ft_Posn ) );        filePutString ( buffer, elcount( buffer ), hFile );
    snprintf( buffer, elcount( buffer ), "0.0000 HMI_RLS_FogLmp_R_Posn := %X\n", getValue( HMI_RLS_FogLmp_R_Posn ) );        filePutString ( buffer, elcount( buffer ), hFile );
    snprintf( buffer, elcount( buffer ), "0.0000 HMI_RLS_LoBm_Posn := %X\n", getValue( HMI_RLS_LoBm_Posn ) );        filePutString ( buffer, elcount( buffer ), hFile );
    snprintf( buffer, elcount( buffer ), "0.0000 HMI_RLS_PkLmp_Posn_Lt := %X\n", getValue( HMI_RLS_PkLmp_Posn_Lt ) );        filePutString ( buffer, elcount( buffer ), hFile );
    snprintf( buffer, elcount( buffer ), "0.0000 HMI_RLS_PkLmp_Posn_Rt := %X\n", getValue( HMI_RLS_PkLmp_Posn_Rt ) );        filePutString ( buffer, elcount( buffer ), hFile );
    snprintf( buffer, elcount( buffer ), "0.0000 HMI_RLS_PosnLmp_Posn := %X\n", getValue( HMI_RLS_PosnLmp_Posn ) );        filePutString ( buffer, elcount( buffer ), hFile );
    snprintf( buffer, elcount( buffer ), "0.0000 HMI_RoadsdCallSw_Stat := %X\n", getValue( HMI_RoadsdCallSw_Stat ) );        filePutString ( buffer, elcount( buffer ), hFile );
    snprintf( buffer, elcount( buffer ), "0.0000 HMI_ServCallSw_Stat := %X\n", getValue( HMI_ServCallSw_Stat ) );        filePutString ( buffer, elcount( buffer ), hFile );
    snprintf( buffer, elcount( buffer ), "0.0000 HMI_SOS_CallSw_Stat := %X\n", getValue( HMI_SOS_CallSw_Stat ) );        filePutString ( buffer, elcount( buffer ), hFile );
    snprintf( buffer, elcount( buffer ), "0.0000 HMI_SuspLvlAdjSw_Psd_AMG := %X\n", getValue( HMI_SuspLvlAdjSw_Psd_AMG ) );        filePutString ( buffer, elcount( buffer ), hFile );
    snprintf( buffer, elcount( buffer ), "0.0000 HMI_SVS_Sw_Psd := %X\n", getValue( HMI_SVS_Sw_Psd ) );        filePutString ( buffer, elcount( buffer ), hFile );
}
/*@@end*/

/*@@timer:_tBC_F_Stat2_AR:*/
on timer _tBC_F_Stat2_AR
{
    putValue( HMI__STMSG_BC_F_Stat2_AR, 0 );
}
/*@@end*/

/*@@envVar:HMI__STMSG_BC_F_Stat2_AR:*/
on EnvVar HMI__STMSG_BC_F_Stat2_AR
{
    long tDelay;
    if( getValue( this ) == 2 )
    {
        tDelay = getValue( HMI__STMSGT_BC_F_Stat2_AR );
        if( tDelay > 0)    
            setTimer( _tBC_F_Stat2_AR, tDelay );
        else
            putValue( HMI__STMSG_BC_F_Stat2_AR, 0 );
    }
}
/*@@end*/

/*@@envVar:HMI_BeltHdOvrSw_Psd_V2:*/
on EnvVar HMI_BeltHdOvrSw_Psd_V2
{
    _mBC_F_Stat2_AR.BeltHdOvrSw_Psd_V2.phys = getValue(this);
    _BC_F_Stat2_AR_SpontanFlag = 1;
}
/*@@end*/

/*@@envVar:HMI_BMM_Status:*/
on EnvVar HMI_BMM_Status
{
    _mBC_F_Stat2_AR.BMM_Status.phys = getValue(this);
    _BC_F_Stat2_AR_SpontanFlag = 1;
}
/*@@end*/

/*@@envVar:HMI_CPF_Ft_Stat:*/
on EnvVar HMI_CPF_Ft_Stat
{
    _mBC_F_Stat2_AR.CPF_Ft_Stat.phys = getValue(this);
    _BC_F_Stat2_AR_SpontanFlag = 1;
}
/*@@end*/

/*@@envVar:HMI_DTQ_Sw_Md:*/
on EnvVar HMI_DTQ_Sw_Md
{
    _mBC_F_Stat2_AR.DTQ_Sw_Md.phys = getValue(this);
    _BC_F_Stat2_AR_SpontanFlag = 1;
}
/*@@end*/

/*@@envVar:HMI_HdRst_R_Rq:*/
on EnvVar HMI_HdRst_R_Rq
{
    _mBC_F_Stat2_AR.HdRst_R_Rq.phys = getValue(this);
    _BC_F_Stat2_AR_SpontanFlag = 1;
}
/*@@end*/

/*@@envVar:HMI_HUD_Sw_Psd:*/
on EnvVar HMI_HUD_Sw_Psd
{
    _mBC_F_Stat2_AR.HUD_Sw_Psd.phys = getValue(this);
    _BC_F_Stat2_AR_SpontanFlag = 1;
}
/*@@end*/

/*@@envVar:HMI_LDP_Sw_Md:*/
on EnvVar HMI_LDP_Sw_Md
{
    _mBC_F_Stat2_AR.LDP_Sw_Md.phys = getValue(this);
    _BC_F_Stat2_AR_SpontanFlag = 1;
}
/*@@end*/

/*@@envVar:HMI_NV_Sw_Psd:*/
on EnvVar HMI_NV_Sw_Psd
{
    _mBC_F_Stat2_AR.NV_Sw_Psd.phys = getValue(this);
    _BC_F_Stat2_AR_SpontanFlag = 1;
}
/*@@end*/

/*@@envVar:HMI_ParkSw_Psd:*/
on EnvVar HMI_ParkSw_Psd
{
    _mBC_F_Stat2_AR.ParkSw_Psd.phys = getValue(this);
    _BC_F_Stat2_AR_SpontanFlag = 1;
}
/*@@end*/

/*@@envVar:HMI_RB_R_Sw_Psd_Ft:*/
on EnvVar HMI_RB_R_Sw_Psd_Ft
{
    _mBC_F_Stat2_AR.RB_R_Sw_Psd_Ft.phys = getValue(this);
    _BC_F_Stat2_AR_SpontanFlag = 1;
}
/*@@end*/

/*@@envVar:HMI_RLS_AutoPosn:*/
on EnvVar HMI_RLS_AutoPosn
{
    _mBC_F_Stat2_AR.RLS_AutoPosn.phys = getValue(this);
    _BC_F_Stat2_AR_SpontanFlag = 1;
}
/*@@end*/

/*@@envVar:HMI_RLS_FogLmp_Ft_Posn:*/
on EnvVar HMI_RLS_FogLmp_Ft_Posn
{
    _mBC_F_Stat2_AR.RLS_FogLmp_Ft_Posn.phys = getValue(this);
    _BC_F_Stat2_AR_SpontanFlag = 1;
}
/*@@end*/

/*@@envVar:HMI_RLS_FogLmp_R_Posn:*/
on EnvVar HMI_RLS_FogLmp_R_Posn
{
    _mBC_F_Stat2_AR.RLS_FogLmp_R_Posn.phys = getValue(this);
    _BC_F_Stat2_AR_SpontanFlag = 1;
}
/*@@end*/

/*@@envVar:HMI_RLS_LoBm_Posn:*/
on EnvVar HMI_RLS_LoBm_Posn
{
    _mBC_F_Stat2_AR.RLS_LoBm_Posn.phys = getValue(this);
    _BC_F_Stat2_AR_SpontanFlag = 1;
}
/*@@end*/

/*@@envVar:HMI_RLS_PkLmp_Posn_Lt:*/
on EnvVar HMI_RLS_PkLmp_Posn_Lt
{
    _mBC_F_Stat2_AR.RLS_PkLmp_Posn_Lt.phys = getValue(this);
    _BC_F_Stat2_AR_SpontanFlag = 1;
}
/*@@end*/

/*@@envVar:HMI_RLS_PkLmp_Posn_Rt:*/
on EnvVar HMI_RLS_PkLmp_Posn_Rt
{
    _mBC_F_Stat2_AR.RLS_PkLmp_Posn_Rt.phys = getValue(this);
    _BC_F_Stat2_AR_SpontanFlag = 1;
}
/*@@end*/

/*@@envVar:HMI_RLS_PosnLmp_Posn:*/
on EnvVar HMI_RLS_PosnLmp_Posn
{
    _mBC_F_Stat2_AR.RLS_PosnLmp_Posn.phys = getValue(this);
    _BC_F_Stat2_AR_SpontanFlag = 1;
}
/*@@end*/

/*@@envVar:HMI_SuspLvlAdjSw_Psd_AMG:*/
on EnvVar HMI_SuspLvlAdjSw_Psd_AMG
{
    _mBC_F_Stat2_AR.SuspLvlAdjSw_Psd_AMG.phys = getValue(this);
    _BC_F_Stat2_AR_SpontanFlag = 1;
}
/*@@end*/

/*@@envVar:HMI_SVS_Sw_Psd:*/
on EnvVar HMI_SVS_Sw_Psd
{
    _mBC_F_Stat2_AR.SVS_Sw_Psd.phys = getValue(this);
    _BC_F_Stat2_AR_SpontanFlag = 1;
}
/*@@end*/

/*@@caplFunc:BC_F_Stat4_AR_check_output():*/
BC_F_Stat4_AR_check_output()
{
    if( !getValue( HMI__STMSG_BC_F_Stat4_AR ) )
    {
        // Botschaft BC_F_Stat4_AR ID: 661 --- Sendeart 5 cyclicAndSpontanWithDelay --- 
        _BC_F_Stat4_AR_Cnt--;
        if( _BC_F_Stat4_AR_Cnt < 1 )
        {
            // Nachricht wg. abgelaufenem Zyklus ausgeben
            BC_F_Stat4_AR_output();
            _BC_F_Stat4_AR_Cnt = _BC_F_Stat4_AR_CycleCount; // Zyklus-Zähler zurücksetzen
            _BC_F_Stat4_AR_SpontanFlag = 0; // Spontan-Flag zurücksetzen
        }
        else if( _BC_F_Stat4_AR_SpontanFlag)
        {
            // Nachricht wg. spontaner Änderung ausgeben
            BC_F_Stat4_AR_output();
            _BC_F_Stat4_AR_SpontanFlag = 0; // Spontan-Flag zurücksetzen
        }
    }
}
/*@@end*/

/*@@caplFunc:BC_F_Stat4_AR_init():*/
BC_F_Stat4_AR_init()
{   /* Botschaft BC_F_Stat4_AR ID: 661 --- Sendeart 5 cyclicAndSpontanWithDelay --- 
BA_ "ApplMessage" BO_ 661 0;
BA_ "NmAsrMessage" BO_ 661 0;
BA_ "GenMsgMinAcceptLength" BO_ 661 4;
BA_ "GenMsgILSupport" BO_ 661 1;
BA_ "DiagState" BO_ 661 0;
BA_ "DiagRequest" BO_ 661 0;
BA_ "DiagResponse" BO_ 661 0;
BA_ "GenMsgStartValue" BO_ 661 "0";
BA_ "GenMsgDelayTime" BO_ 661 10;
BA_ "GenMsgNrOfRepetition" BO_ 661 0;
BA_ "GenMsgCycleTime" BO_ 661 100;
BA_ "GenMsgSendType" BO_ 661 5;
    */
    _BC_F_Stat4_AR_Timebase =         c_tDBKomTimer_20ms;
    _BC_F_Stat4_AR_CycleCount =     500 / _BC_F_Stat4_AR_Timebase;
    _BC_F_Stat4_AR_StartDelay =       0 / _BC_F_Stat4_AR_Timebase;
    _BC_F_Stat4_AR_Cnt = _BC_F_Stat4_AR_StartDelay;
    _BC_F_Stat4_AR_SpontanFlag = 0;

    putValue( HMI__STMSGSD_BC_F_Stat4_AR, _BC_F_Stat4_AR_StartDelay * _BC_F_Stat4_AR_Timebase );

    _mBC_F_Stat4_AR.Airbag_P_LED_On_Stat_ASBM.phys = getValue( HMI_Airbag_P_LED_On_Stat_ASBM );
    _mBC_F_Stat4_AR.Airbag_LED_Stat_ASBM_UB.phys = getValue( HMI_Airbag_LED_Stat_ASBM_UB );
    _mBC_F_Stat4_AR.COD_Ind_LED_Stat_ASBM.phys = getValue( HMI_COD_Ind_LED_Stat_ASBM );
    _mBC_F_Stat4_AR.Rsrv1_Airbag_LED_Stat_ASBM.phys = getValue( HMI_Rsrv1_Airbag_LED_Stat_ASBM );
    _mBC_F_Stat4_AR.Text_LED_Stat_ASBM.phys = getValue( HMI_Text_LED_Stat_ASBM );
}
/*@@end*/

/*@@caplFunc:BC_F_Stat4_AR_output():*/
BC_F_Stat4_AR_output()
{
    byte crc;
    byte SQC_help;

    if( !getValue( HMI_SQC_Airbag_LED_Stat_ASBM_Auto ) )
    {
        // berechne message counter
        SQC_help = getValue( HMI_SQC_Airbag_LED_Stat_ASBM );
        if( SQC_help >= 15 ) SQC_help = 0;
        else SQC_help++;
        putValue( HMI_SQC_Airbag_LED_Stat_ASBM, SQC_help );
        _mBC_F_Stat4_AR.SQC_Airbag_LED_Stat_ASBM = SQC_help;
    }
    else
          _mBC_F_Stat4_AR.SQC_Airbag_LED_Stat_ASBM = getValue( HMI_SQC_Airbag_LED_Stat_ASBM );

    if( getValue( HMI_CRC_Airbag_LED_Stat_ASBM_Profile_02 ) )
    {
        if( !getValue( HMI_CRC_Airbag_LED_Stat_ASBM_Auto ) )
        {   // CRC according Profile_02 ( W213 )
            // berechne crc
            crc = 0xFF;
//          crc = crctable_profile02[ crc ^ _mBC_F_Stat4_AR.byte( 0 ) ];  CRC
            crc = crctable_profile02[ crc ^ _mBC_F_Stat4_AR.byte( 1 ) ];
            crc = crctable_profile02[ crc ^ _mBC_F_Stat4_AR.byte( 2 ) ];
//            crc = crctable_profile02[ crc ^ _mBC_F_Stat4_AR.byte( 3 ) ];
//            crc = crctable_profile02[ crc ^ _mBC_F_Stat4_AR.byte( 4 ) ];
//            crc = crctable_profile02[ crc ^ _mBC_F_Stat4_AR.byte( 5 ) ];
//            crc = crctable_profile02[ crc ^ _mBC_F_Stat4_AR.byte( 6 ) ];
//            crc = crctable_profile02[ crc ^ _mBC_F_Stat4_AR.byte( 7 ) ];
            crc = crctable_profile02[ crc ^ _BC_F_Stat4_AR_CRC_Offset[ _mBC_F_Stat4_AR.SQC_Airbag_LED_Stat_ASBM ] ]; // load offset
            crc = (crc ^ 0xFF);
            if( getValue(  HMI_CRC_Airbag_LED_Stat_ASBM_Invalid ) )
                crc++;
            _mBC_F_Stat4_AR.CRC_Airbag_LED_Stat_ASBM = crc;
            putValue( HMI_CRC_Airbag_LED_Stat_ASBM, crc );
        }
        else
            _mBC_F_Stat4_AR.CRC_Airbag_LED_Stat_ASBM = getValue( HMI_CRC_Airbag_LED_Stat_ASBM );
    }

    output( _mBC_F_Stat4_AR );
}
/*@@end*/

/*@@caplFunc:BC_F_Stat4_AR_saveEnvVars(dword):*/
BC_F_Stat4_AR_saveEnvVars( dword hFile )
{
    filePutString("\n// Knoten EIS: BC_F_Stat4_AR\n", 27, hFile );
    snprintf( buffer, elcount( buffer ), "0.0000 HMI__STMSG_BC_F_Stat4_AR := %X\n", getValue( HMI__STMSG_BC_F_Stat4_AR ) );        filePutString ( buffer, elcount( buffer ), hFile );
    snprintf( buffer, elcount( buffer ), "0.0000 HMI__STMSGT_BC_F_Stat4_AR := %X\n", getValue( HMI__STMSGT_BC_F_Stat4_AR ) );        filePutString ( buffer, elcount( buffer ), hFile );
    snprintf( buffer, elcount( buffer ), "0.0000 HMI_Airbag_P_LED_On_Stat_ASBM := %X\n", getValue( HMI_Airbag_P_LED_On_Stat_ASBM ) );        filePutString ( buffer, elcount( buffer ), hFile );
    snprintf( buffer, elcount( buffer ), "0.0000 HMI_Airbag_LED_Stat_ASBM_UB := %X\n", getValue( HMI_Airbag_LED_Stat_ASBM_UB ) );        filePutString ( buffer, elcount( buffer ), hFile );
    snprintf( buffer, elcount( buffer ), "0.0000 HMI_COD_Ind_LED_Stat_ASBM := %X\n", getValue( HMI_COD_Ind_LED_Stat_ASBM ) );        filePutString ( buffer, elcount( buffer ), hFile );
    snprintf( buffer, elcount( buffer ), "0.0000 HMI_CRC_Airbag_LED_Stat_ASBM := %X\n", getValue( HMI_CRC_Airbag_LED_Stat_ASBM ) );        filePutString ( buffer, elcount( buffer ), hFile );
    snprintf( buffer, elcount( buffer ), "0.0000 HMI_CRC_Airbag_LED_Stat_ASBM_Auto := %X\n", getValue( HMI_CRC_Airbag_LED_Stat_ASBM_Auto ) );        filePutString ( buffer, elcount( buffer ), hFile );
    snprintf( buffer, elcount( buffer ), "0.0000 HMI_CRC_Airbag_LED_Stat_ASBM_Invalid := %X\n", getValue( HMI_CRC_Airbag_LED_Stat_ASBM_Invalid ) );        filePutString ( buffer, elcount( buffer ), hFile );
    snprintf( buffer, elcount( buffer ), "0.0000 HMI_Rsrv1_Airbag_LED_Stat_ASBM := %X\n", getValue( HMI_Rsrv1_Airbag_LED_Stat_ASBM ) );        filePutString ( buffer, elcount( buffer ), hFile );
    snprintf( buffer, elcount( buffer ), "0.0000 HMI_SQC_Airbag_LED_Stat_ASBM := %X\n", getValue( HMI_SQC_Airbag_LED_Stat_ASBM ) );        filePutString ( buffer, elcount( buffer ), hFile );
    snprintf( buffer, elcount( buffer ), "0.0000 HMI_SQC_Airbag_LED_Stat_ASBM_Auto := %X\n", getValue( HMI_SQC_Airbag_LED_Stat_ASBM_Auto ) );        filePutString ( buffer, elcount( buffer ), hFile );
    snprintf( buffer, elcount( buffer ), "0.0000 HMI_Text_LED_Stat_ASBM := %X\n", getValue( HMI_Text_LED_Stat_ASBM ) );        filePutString ( buffer, elcount( buffer ), hFile );
}
/*@@end*/

/*@@timer:_tBC_F_Stat4_AR:*/
on timer _tBC_F_Stat4_AR
{
    putValue( HMI__STMSG_BC_F_Stat4_AR, 0 );
}
/*@@end*/

/*@@envVar:HMI__STMSG_BC_F_Stat4_AR:*/
on EnvVar HMI__STMSG_BC_F_Stat4_AR
{
    long tDelay;
    if( getValue( this ) == 2 )
    {
        tDelay = getValue( HMI__STMSGT_BC_F_Stat4_AR );
        if( tDelay > 0)    
            setTimer( _tBC_F_Stat4_AR, tDelay );
        else
            putValue( HMI__STMSG_BC_F_Stat4_AR, 0 );
    }
}
/*@@end*/

/*@@envVar:HMI_Airbag_P_LED_On_Stat_ASBM:*/
on EnvVar HMI_Airbag_P_LED_On_Stat_ASBM
{
    _mBC_F_Stat4_AR.Airbag_P_LED_On_Stat_ASBM.phys = getValue(this);
    _BC_F_Stat4_AR_SpontanFlag = 1;
}
/*@@end*/

/*@@envVar:HMI_Airbag_LED_Stat_ASBM_UB:*/
on EnvVar HMI_Airbag_LED_Stat_ASBM_UB
{
    _mBC_F_Stat4_AR.Airbag_LED_Stat_ASBM_UB.phys = getValue(this);
    _BC_F_Stat4_AR_SpontanFlag = 1;
}
/*@@end*/

/*@@envVar:HMI_COD_Ind_LED_Stat_ASBM:*/
on EnvVar HMI_COD_Ind_LED_Stat_ASBM
{
    _mBC_F_Stat4_AR.COD_Ind_LED_Stat_ASBM.phys = getValue(this);
    _BC_F_Stat4_AR_SpontanFlag = 1;
}
/*@@end*/

/*@@envVar:HMI_Rsrv1_Airbag_LED_Stat_ASBM:*/
on EnvVar HMI_Rsrv1_Airbag_LED_Stat_ASBM
{
    _mBC_F_Stat4_AR.Rsrv1_Airbag_LED_Stat_ASBM.phys = getValue(this);
    _BC_F_Stat4_AR_SpontanFlag = 1;
}
/*@@end*/

/*@@envVar:HMI_Text_LED_Stat_ASBM:*/
on EnvVar HMI_Text_LED_Stat_ASBM
{
    _mBC_F_Stat4_AR.Text_LED_Stat_ASBM.phys = getValue(this);
    _BC_F_Stat4_AR_SpontanFlag = 1;
}
/*@@end*/

/*@@caplFunc:BC_R_Stat1_AR_check_output():*/
BC_R_Stat1_AR_check_output()
{
    if( !getValue( HMI__STMSG_BC_R_Stat1_AR ) )
    {
        // Botschaft BC_R_Stat1_AR ID: 849 --- Sendeart 5 cyclicAndSpontanWithDelay --- 
        _BC_R_Stat1_AR_Cnt--;
        if( _BC_R_Stat1_AR_Cnt < 1 )
        {
            // Nachricht wg. abgelaufenem Zyklus ausgeben
            BC_R_Stat1_AR_output();
            _BC_R_Stat1_AR_Cnt = _BC_R_Stat1_AR_CycleCount; // Zyklus-Zähler zurücksetzen
            _BC_R_Stat1_AR_SpontanFlag = 0; // Spontan-Flag zurücksetzen
        }
        else if( _BC_R_Stat1_AR_SpontanFlag)
        {
            // Nachricht wg. spontaner Änderung ausgeben
            BC_R_Stat1_AR_output();
            _BC_R_Stat1_AR_SpontanFlag = 0; // Spontan-Flag zurücksetzen
        }
    }
}
/*@@end*/

/*@@caplFunc:BC_R_Stat1_AR_init():*/
BC_R_Stat1_AR_init()
{   /* Botschaft BC_R_Stat1_AR ID: 849 --- Sendeart 5 cyclicAndSpontanWithDelay --- 
BA_ "ApplMessage" BO_ 849 0;
BA_ "NmAsrMessage" BO_ 849 0;
BA_ "GenMsgMinAcceptLength" BO_ 849 8;
BA_ "GenMsgILSupport" BO_ 849 1;
BA_ "DiagState" BO_ 849 0;
BA_ "DiagRequest" BO_ 849 0;
BA_ "DiagResponse" BO_ 849 0;
BA_ "GenMsgStartValue" BO_ 849 "0";
BA_ "GenMsgStartDelayTime" BO_ 849 0;
BA_ "GenMsgDelayTime" BO_ 849 5;
BA_ "GenMsgNrOfRepetitions" BO_ 849 0;
BA_ "GenMsgCycleTime" BO_ 849 200;
BA_ "GenMsgSendType" BO_ 849 5;
    */
    _BC_R_Stat1_AR_Timebase =        c_tDBKomTimer_20ms;
    _BC_R_Stat1_AR_CycleCount =    200 / _BC_R_Stat1_AR_Timebase;
    _BC_R_Stat1_AR_StartDelay =      0 / _BC_R_Stat1_AR_Timebase;
    _BC_R_Stat1_AR_Cnt = _BC_R_Stat1_AR_StartDelay;
    _BC_R_Stat1_AR_SpontanFlag = 0;

    putValue( HMI__STMSGSD_BC_R_Stat1_AR, _BC_R_Stat1_AR_StartDelay * _BC_R_Stat1_AR_Timebase );

    _mBC_R_Stat1_AR.Bckl_Sw_3L_SAM_R_Tgl.phys = getValue( HMI_Bckl_Sw_3L_SAM_R_Tgl );
    _mBC_R_Stat1_AR.Bckl_Sw_3L_Stat_SAM_R.phys = getValue( HMI_Bckl_Sw_3L_Stat_SAM_R );
    _mBC_R_Stat1_AR.Bckl_Sw_3R_SAM_R_Tgl.phys = getValue( HMI_Bckl_Sw_3R_SAM_R_Tgl );
    _mBC_R_Stat1_AR.Bckl_Sw_3R_Stat_SAM_R.phys = getValue( HMI_Bckl_Sw_3R_Stat_SAM_R );
    _mBC_R_Stat1_AR.Bckl_Sw_RL_SAM_R_Tgl.phys = getValue( HMI_Bckl_Sw_RL_SAM_R_Tgl );
    _mBC_R_Stat1_AR.Bckl_Sw_RL_Stat_SAM_R.phys = getValue( HMI_Bckl_Sw_RL_Stat_SAM_R );
    _mBC_R_Stat1_AR.Bckl_Sw_RM_SAM_R_Tgl.phys = getValue( HMI_Bckl_Sw_RM_SAM_R_Tgl );
    _mBC_R_Stat1_AR.Bckl_Sw_RM_Stat_SAM_R.phys = getValue( HMI_Bckl_Sw_RM_Stat_SAM_R );
    _mBC_R_Stat1_AR.Bckl_Sw_RR_SAM_R_Tgl.phys = getValue( HMI_Bckl_Sw_RR_SAM_R_Tgl );
    _mBC_R_Stat1_AR.Bckl_Sw_RR_Stat_SAM_R.phys = getValue( HMI_Bckl_Sw_RR_Stat_SAM_R );
    _mBC_R_Stat1_AR.BgC_Sw_Psd.phys = getValue( HMI_BgC_Sw_Psd );
    _mBC_R_Stat1_AR.BrkLnWear_R.phys = getValue( HMI_BrkLnWear_R );
    _mBC_R_Stat1_AR.CPF_R_Stat.phys = getValue( HMI_CPF_R_Stat );
    _mBC_R_Stat1_AR.DL_Lch_Psd.phys = getValue( HMI_DL_Lch_Psd );
    _mBC_R_Stat1_AR.DL_LchTrgr_Actv.phys = getValue( HMI_DL_LchTrgr_Actv );
    _mBC_R_Stat1_AR.DL_RemActn_3rdRow_Stat.phys = getValue( HMI_DL_RemActn_3rdRow_Stat );
    _mBC_R_Stat1_AR.DL_Lk_Ovruse_Prot_Actv.phys = getValue( HMI_DL_Lk_Ovruse_Prot_Actv );
    _mBC_R_Stat1_AR.DL_RLtch_Stat.phys = getValue( HMI_DL_RLtch_Stat );
    _mBC_R_Stat1_AR.DL_Sw_Psd.phys = getValue( HMI_DL_Sw_Psd );
    _mBC_R_Stat1_AR.DL_SwCls_Psd.phys = getValue( HMI_DL_SwCls_Psd );
    _mBC_R_Stat1_AR.DL_SwLkCls_Psd.phys = getValue( HMI_DL_SwLkCls_Psd );
    _mBC_R_Stat1_AR.DL1_Sw_Psd.phys = getValue( HMI_DL1_Sw_Psd );
    _mBC_R_Stat1_AR.DL2_Sw_Psd.phys = getValue( HMI_DL2_Sw_Psd );    
    _mBC_R_Stat1_AR.EBL_Stat.phys = getValue( HMI_EBL_Stat );
    _mBC_R_Stat1_AR.EmgLgt_Term15_In_Stat.phys = getValue( HMI_EmgLgt_Term15_In_Stat );
    _mBC_R_Stat1_AR.Parity_Bckl_Sw_3L_SAM_R.phys = getValue( HMI_Parity_Bckl_Sw_3L_SAM_R );
    _mBC_R_Stat1_AR.Parity_Bckl_Sw_3R_SAM_R.phys = getValue( HMI_Parity_Bckl_Sw_3R_SAM_R );
    _mBC_R_Stat1_AR.Parity_Bckl_Sw_RL_SAM_R.phys = getValue( HMI_Parity_Bckl_Sw_RL_SAM_R );
    _mBC_R_Stat1_AR.Parity_Bckl_Sw_RM_SAM_R.phys = getValue( HMI_Parity_Bckl_Sw_RM_SAM_R );
    _mBC_R_Stat1_AR.Parity_Bckl_Sw_RR_SAM_R.phys = getValue( HMI_Parity_Bckl_Sw_RR_SAM_R );
    _mBC_R_Stat1_AR.RB_R_Stat_V2.phys = getValue( HMI_RB_R_Stat_V2 );
    _mBC_R_Stat1_AR.RemTank_Unlk_Stat.phys = getValue( HMI_RemTank_Unlk_Stat );
    _mBC_R_Stat1_AR.SeatBkRst_FL_Stat.phys = getValue( HMI_SeatBkRst_FL_Stat );
    _mBC_R_Stat1_AR.SeatBkRst_FR_Stat.phys = getValue( HMI_SeatBkRst_FR_Stat );
    _mBC_R_Stat1_AR.SeatBkRst_RL_Stat.phys = getValue( HMI_SeatBkRst_RL_Stat );
    _mBC_R_Stat1_AR.SeatBkRst_RM_Stat.phys = getValue( HMI_SeatBkRst_RM_Stat );
    _mBC_R_Stat1_AR.SeatBkRst_RR_Stat.phys = getValue( HMI_SeatBkRst_RR_Stat );
    _mBC_R_Stat1_AR.Term54_Actv.phys = getValue( HMI_Term54_Actv );
    _mBC_R_Stat1_AR.Wpr_R_OutsdPkPosn.phys = getValue( HMI_Wpr_R_OutsdPkPosn );
}
/*@@end*/

/*@@caplFunc:BC_R_Stat1_AR_output():*/
BC_R_Stat1_AR_output(void)
{
    output( _mBC_R_Stat1_AR );
}
/*@@end*/

/*@@caplFunc:BC_R_Stat1_AR_saveEnvVars(dword):*/
BC_R_Stat1_AR_saveEnvVars( dword hFile )
{
    filePutString("\n// Knoten EIS: BC_R_Stat1_AR\n", 26, hFile );
    snprintf( buffer, elcount( buffer ), "0.0000 HMI__STMSG_BC_R_Stat1_AR := %X\n", getValue( HMI__STMSG_BC_R_Stat1_AR ) );    filePutString ( buffer, elcount( buffer ), hFile );
    snprintf( buffer, elcount( buffer ), "0.0000 HMI__STMSGT_BC_R_Stat1_AR := %X\n", getValue( HMI__STMSGT_BC_R_Stat1_AR ) );    filePutString ( buffer, elcount( buffer ), hFile );
    snprintf( buffer, elcount( buffer ), "0.0000 HMI_Bckl_Sw_3L_SAM_R_Tgl := %X\n", getValue( HMI_Bckl_Sw_3L_SAM_R_Tgl ) );    filePutString ( buffer, elcount( buffer ), hFile );
    snprintf( buffer, elcount( buffer ), "0.0000 HMI_Bckl_Sw_3L_Stat_SAM_R := %X\n", getValue( HMI_Bckl_Sw_3L_Stat_SAM_R ) );    filePutString ( buffer, elcount( buffer ), hFile );
    snprintf( buffer, elcount( buffer ), "0.0000 HMI_Bckl_Sw_3R_SAM_R_Tgl := %X\n", getValue( HMI_Bckl_Sw_3R_SAM_R_Tgl ) );    filePutString ( buffer, elcount( buffer ), hFile );
    snprintf( buffer, elcount( buffer ), "0.0000 HMI_Bckl_Sw_3R_Stat_SAM_R := %X\n", getValue( HMI_Bckl_Sw_3R_Stat_SAM_R ) );    filePutString ( buffer, elcount( buffer ), hFile );
    snprintf( buffer, elcount( buffer ), "0.0000 HMI_Bckl_Sw_RL_SAM_R_Tgl := %X\n", getValue( HMI_Bckl_Sw_RL_SAM_R_Tgl ) );    filePutString ( buffer, elcount( buffer ), hFile );
    snprintf( buffer, elcount( buffer ), "0.0000 HMI_Bckl_Sw_RL_Stat_SAM_R := %X\n", getValue( HMI_Bckl_Sw_RL_Stat_SAM_R ) );    filePutString ( buffer, elcount( buffer ), hFile );
    snprintf( buffer, elcount( buffer ), "0.0000 HMI_Bckl_Sw_RM_SAM_R_Tgl := %X\n", getValue( HMI_Bckl_Sw_RM_SAM_R_Tgl ) );    filePutString ( buffer, elcount( buffer ), hFile );
    snprintf( buffer, elcount( buffer ), "0.0000 HMI_Bckl_Sw_RM_Stat_SAM_R := %X\n", getValue( HMI_Bckl_Sw_RM_Stat_SAM_R ) );    filePutString ( buffer, elcount( buffer ), hFile );
    snprintf( buffer, elcount( buffer ), "0.0000 HMI_Bckl_Sw_RR_SAM_R_Tgl := %X\n", getValue( HMI_Bckl_Sw_RR_SAM_R_Tgl ) );    filePutString ( buffer, elcount( buffer ), hFile );
    snprintf( buffer, elcount( buffer ), "0.0000 HMI_Bckl_Sw_RR_Stat_SAM_R := %X\n", getValue( HMI_Bckl_Sw_RR_Stat_SAM_R ) );    filePutString ( buffer, elcount( buffer ), hFile );
    snprintf( buffer, elcount( buffer ), "0.0000 HMI_BgC_Sw_Psd := %X\n", getValue( HMI_BgC_Sw_Psd ) );    filePutString ( buffer, elcount( buffer ), hFile );
    snprintf( buffer, elcount( buffer ), "0.0000 HMI_BrkLnWear_R := %X\n", getValue( HMI_BrkLnWear_R ) );    filePutString ( buffer, elcount( buffer ), hFile );
    snprintf( buffer, elcount( buffer ), "0.0000 HMI_CPF_R_Stat := %X\n", getValue( HMI_CPF_R_Stat ) );    filePutString ( buffer, elcount( buffer ), hFile );
    snprintf( buffer, elcount( buffer ), "0.0000 HMI_DL_Lch_Psd := %X\n", getValue( HMI_DL_Lch_Psd ) );    filePutString ( buffer, elcount( buffer ), hFile );
    snprintf( buffer, elcount( buffer ), "0.0000 HMI_DL_LchTrgr_Actv := %X\n", getValue( HMI_DL_LchTrgr_Actv ) );    filePutString ( buffer, elcount( buffer ), hFile );
    snprintf( buffer, elcount( buffer ), "0.0000 HMI_DL_RemActn_3rdRow_Stat := %X\n", getValue( HMI_DL_RemActn_3rdRow_Stat ) );    filePutString ( buffer, elcount( buffer ), hFile );
    snprintf( buffer, elcount( buffer ), "0.0000 HMI_DL_Lk_Ovruse_Prot_Actv  := %X\n", getValue( HMI_DL_Lk_Ovruse_Prot_Actv  ) );    filePutString ( buffer, elcount( buffer ), hFile );
    snprintf( buffer, elcount( buffer ), "0.0000 HMI_DL_RLtch_Stat := %X\n", getValue( HMI_DL_RLtch_Stat ) );    filePutString ( buffer, elcount( buffer ), hFile );
    snprintf( buffer, elcount( buffer ), "0.0000 HMI_DL_Sw_Psd := %X\n", getValue( HMI_DL_Sw_Psd ) );    filePutString ( buffer, elcount( buffer ), hFile );
    snprintf( buffer, elcount( buffer ), "0.0000 HMI_DL_SwCls_Psd := %X\n", getValue( HMI_DL_SwCls_Psd ) );    filePutString ( buffer, elcount( buffer ), hFile );
    snprintf( buffer, elcount( buffer ), "0.0000 HMI_DL_SwLkCls_Psd := %X\n", getValue( HMI_DL_SwLkCls_Psd ) );    filePutString ( buffer, elcount( buffer ), hFile );
    snprintf( buffer, elcount( buffer ), "0.0000 HMI_DL1_Sw_Psd := %X\n", getValue( HMI_DL1_Sw_Psd ) );    filePutString ( buffer, elcount( buffer ), hFile );
    snprintf( buffer, elcount( buffer ), "0.0000 HMI_DL2_Sw_Psd := %X\n", getValue( HMI_DL2_Sw_Psd ) );    filePutString ( buffer, elcount( buffer ), hFile );
    snprintf( buffer, elcount( buffer ), "0.0000 HMI_EBL_Stat := %X\n", getValue( HMI_EBL_Stat ) );    filePutString ( buffer, elcount( buffer ), hFile );
    snprintf( buffer, elcount( buffer ), "0.0000 HMI_EmgLgt_Term15_In_Stat := %X\n", getValue( HMI_EmgLgt_Term15_In_Stat ) );    filePutString ( buffer, elcount( buffer ), hFile );
    snprintf( buffer, elcount( buffer ), "0.0000 HMI_Parity_Bckl_Sw_3L_SAM_R := %X\n", getValue( HMI_Parity_Bckl_Sw_3L_SAM_R ) );    filePutString ( buffer, elcount( buffer ), hFile );
    snprintf( buffer, elcount( buffer ), "0.0000 HMI_Parity_Bckl_Sw_3R_SAM_R := %X\n", getValue( HMI_Parity_Bckl_Sw_3R_SAM_R ) );    filePutString ( buffer, elcount( buffer ), hFile );
    snprintf( buffer, elcount( buffer ), "0.0000 HMI_Parity_Bckl_Sw_RL_SAM_R := %X\n", getValue( HMI_Parity_Bckl_Sw_RL_SAM_R ) );    filePutString ( buffer, elcount( buffer ), hFile );
    snprintf( buffer, elcount( buffer ), "0.0000 HMI_Parity_Bckl_Sw_RM_SAM_R := %X\n", getValue( HMI_Parity_Bckl_Sw_RM_SAM_R ) );    filePutString ( buffer, elcount( buffer ), hFile );
    snprintf( buffer, elcount( buffer ), "0.0000 HMI_Parity_Bckl_Sw_RR_SAM_R := %X\n", getValue( HMI_Parity_Bckl_Sw_RR_SAM_R ) );    filePutString ( buffer, elcount( buffer ), hFile );
    snprintf( buffer, elcount( buffer ), "0.0000 HMI_RB_R_Stat_V2 := %X\n", getValue( HMI_RB_R_Stat_V2 ) );    filePutString ( buffer, elcount( buffer ), hFile );
    snprintf( buffer, elcount( buffer ), "0.0000 HMI_RemTank_Unlk_Stat := %X\n", getValue( HMI_RemTank_Unlk_Stat ) );    filePutString ( buffer, elcount( buffer ), hFile );
    snprintf( buffer, elcount( buffer ), "0.0000 HMI_SeatBkRst_FL_Stat := %X\n", getValue( HMI_SeatBkRst_FL_Stat ) );    filePutString ( buffer, elcount( buffer ), hFile );
    snprintf( buffer, elcount( buffer ), "0.0000 HMI_SeatBkRst_FR_Stat := %X\n", getValue( HMI_SeatBkRst_FR_Stat ) );    filePutString ( buffer, elcount( buffer ), hFile );
    snprintf( buffer, elcount( buffer ), "0.0000 HMI_SeatBkRst_RL_Stat := %X\n", getValue( HMI_SeatBkRst_RL_Stat ) );    filePutString ( buffer, elcount( buffer ), hFile );
    snprintf( buffer, elcount( buffer ), "0.0000 HMI_SeatBkRst_RM_Stat := %X\n", getValue( HMI_SeatBkRst_RM_Stat ) );    filePutString ( buffer, elcount( buffer ), hFile );
    snprintf( buffer, elcount( buffer ), "0.0000 HMI_SeatBkRst_RR_Stat := %X\n", getValue( HMI_SeatBkRst_RR_Stat ) );    filePutString ( buffer, elcount( buffer ), hFile );
    snprintf( buffer, elcount( buffer ), "0.0000 HMI_Term54_Actv := %X\n", getValue( HMI_Term54_Actv ) );    filePutString ( buffer, elcount( buffer ), hFile );
    snprintf( buffer, elcount( buffer ), "0.0000 HMI_Wpr_R_OutsdPkPosn := %X\n", getValue( HMI_Wpr_R_OutsdPkPosn ) );    filePutString ( buffer, elcount( buffer ), hFile );
}
/*@@end*/

/*@@timer:_tBC_R_Stat1_AR:*/
on timer _tBC_R_Stat1_AR
{
    putValue( HMI__STMSG_BC_R_Stat1_AR, 0 );
}
/*@@end*/

/*@@envVar:HMI__STMSG_BC_R_Stat1_AR:*/
on EnvVar HMI__STMSG_BC_R_Stat1_AR
{
    long tDelay;
    if( getValue( this ) == 2 )
    {
        tDelay = getValue( HMI__STMSGT_BC_R_Stat1_AR );
        if( tDelay > 0)    
            setTimer( _tBC_R_Stat1_AR, tDelay );
        else
            putValue( HMI__STMSG_BC_R_Stat1_AR, 0 );
    }
}
/*@@end*/

/*@@envVar:HMI_Bckl_Sw_3L_SAM_R_Tgl:*/
on EnvVar HMI_Bckl_Sw_3L_SAM_R_Tgl
{
    _mBC_R_Stat1_AR.Bckl_Sw_3L_SAM_R_Tgl.phys = getValue(this);
    _BC_R_Stat1_AR_SpontanFlag = 1;
}
/*@@end*/

/*@@envVar:HMI_Bckl_Sw_3L_Stat_SAM_R:*/
on EnvVar HMI_Bckl_Sw_3L_Stat_SAM_R
{
    _mBC_R_Stat1_AR.Bckl_Sw_3L_Stat_SAM_R.phys = getValue(this);
    _BC_R_Stat1_AR_SpontanFlag = 1;
}
/*@@end*/

/*@@envVar:HMI_Bckl_Sw_3R_SAM_R_Tgl:*/
on EnvVar HMI_Bckl_Sw_3R_SAM_R_Tgl
{
    _mBC_R_Stat1_AR.Bckl_Sw_3R_SAM_R_Tgl.phys = getValue(this);
    _BC_R_Stat1_AR_SpontanFlag = 1;
}
/*@@end*/

/*@@envVar:HMI_Bckl_Sw_3R_Stat_SAM_R:*/
on EnvVar HMI_Bckl_Sw_3R_Stat_SAM_R
{
    _mBC_R_Stat1_AR.Bckl_Sw_3R_Stat_SAM_R.phys = getValue(this);
    _BC_R_Stat1_AR_SpontanFlag = 1;
}
/*@@end*/

/*@@envVar:HMI_Bckl_Sw_RL_SAM_R_Tgl:*/
on EnvVar HMI_Bckl_Sw_RL_SAM_R_Tgl
{
    _mBC_R_Stat1_AR.Bckl_Sw_RL_SAM_R_Tgl.phys = getValue(this);
    _BC_R_Stat1_AR_SpontanFlag = 1;
}
/*@@end*/

/*@@envVar:HMI_Bckl_Sw_RL_Stat_SAM_R:*/
on EnvVar HMI_Bckl_Sw_RL_Stat_SAM_R
{
    _mBC_R_Stat1_AR.Bckl_Sw_RL_Stat_SAM_R.phys = getValue(this);
    _BC_R_Stat1_AR_SpontanFlag = 1;
}
/*@@end*/

/*@@envVar:HMI_Bckl_Sw_RM_SAM_R_Tgl:*/
on EnvVar HMI_Bckl_Sw_RM_SAM_R_Tgl
{
    _mBC_R_Stat1_AR.Bckl_Sw_RM_SAM_R_Tgl.phys = getValue(this);
    _BC_R_Stat1_AR_SpontanFlag = 1;
}
/*@@end*/

/*@@envVar:HMI_Bckl_Sw_RM_Stat_SAM_R:*/
on EnvVar HMI_Bckl_Sw_RM_Stat_SAM_R
{
    _mBC_R_Stat1_AR.Bckl_Sw_RM_Stat_SAM_R.phys = getValue(this);
    _BC_R_Stat1_AR_SpontanFlag = 1;
}
/*@@end*/

/*@@envVar:HMI_Bckl_Sw_RR_SAM_R_Tgl:*/
on EnvVar HMI_Bckl_Sw_RR_SAM_R_Tgl
{
    _mBC_R_Stat1_AR.Bckl_Sw_RR_SAM_R_Tgl.phys = getValue(this);
    _BC_R_Stat1_AR_SpontanFlag = 1;
}
/*@@end*/

/*@@envVar:HMI_Bckl_Sw_RR_Stat_SAM_R:*/
on EnvVar HMI_Bckl_Sw_RR_Stat_SAM_R
{
    _mBC_R_Stat1_AR.Bckl_Sw_RR_Stat_SAM_R.phys = getValue(this);
    _BC_R_Stat1_AR_SpontanFlag = 1;
}
/*@@end*/

/*@@envVar:HMI_BgC_Sw_Psd:*/
on EnvVar HMI_BgC_Sw_Psd
{
    _mBC_R_Stat1_AR.BgC_Sw_Psd.phys = getValue(this);
    _BC_R_Stat1_AR_SpontanFlag = 1;
}
/*@@end*/

/*@@envVar:HMI_BrkLnWear_R:*/
on EnvVar HMI_BrkLnWear_R
{
    _mBC_R_Stat1_AR.BrkLnWear_R.phys = getValue(this);
    _BC_R_Stat1_AR_SpontanFlag = 1;
}
/*@@end*/

/*@@envVar:HMI_CPF_R_Stat:*/
on EnvVar HMI_CPF_R_Stat
{
    _mBC_R_Stat1_AR.CPF_R_Stat.phys = getValue(this);
    _BC_R_Stat1_AR_SpontanFlag = 1;
}
/*@@end*/

/*@@envVar:HMI_DL_Lch_Psd:*/
on EnvVar HMI_DL_Lch_Psd
{
    _mBC_R_Stat1_AR.DL_Lch_Psd.phys = getValue(this);
    _BC_R_Stat1_AR_SpontanFlag = 1;
}
/*@@end*/

/*@@envVar:HMI_DL_LchTrgr_Actv:*/
on EnvVar HMI_DL_LchTrgr_Actv
{
    _mBC_R_Stat1_AR.DL_LchTrgr_Actv.phys = getValue(this);
    _BC_R_Stat1_AR_SpontanFlag = 1;
}
/*@@end*/

/*@@envVar:HMI_DL_Lk_Ovruse_Prot_Actv:*/
on EnvVar HMI_DL_Lk_Ovruse_Prot_Actv
{
    _mBC_R_Stat1_AR.DL_Lk_Ovruse_Prot_Actv.phys = getValue(this);
    _BC_R_Stat1_AR_SpontanFlag = 1;
}
/*@@end*/

/*@@envVar:HMI_DL_RemActn_3rdRow_Stat:*/
on EnvVar HMI_DL_RemActn_3rdRow_Stat
{
    _mBC_R_Stat1_AR.DL_RemActn_3rdRow_Stat.phys = getValue(this);
    _BC_R_Stat1_AR_SpontanFlag = 1;
}
/*@@end*/

/*@@envVar:HMI_DL_RLtch_Stat:*/
on EnvVar HMI_DL_RLtch_Stat
{
    _mBC_R_Stat1_AR.DL_RLtch_Stat.phys = getValue(this);
    _BC_R_Stat1_AR_SpontanFlag = 1;
}
/*@@end*/

/*@@envVar:HMI_DL_Sw_Psd:*/
on EnvVar HMI_DL_Sw_Psd
{
    _mBC_R_Stat1_AR.DL_Sw_Psd.phys = getValue(this);
    _BC_R_Stat1_AR_SpontanFlag = 1;
}
/*@@end*/

/*@@envVar:HMI_DL_SwCls_Psd:*/
on EnvVar HMI_DL_SwCls_Psd
{
    _mBC_R_Stat1_AR.DL_SwCls_Psd.phys = getValue(this);
    _BC_R_Stat1_AR_SpontanFlag = 1;
}
/*@@end*/

/*@@envVar:HMI_DL_SwLkCls_Psd:*/
on EnvVar HMI_DL_SwLkCls_Psd
{
    _mBC_R_Stat1_AR.DL_SwLkCls_Psd.phys = getValue(this);
    _BC_R_Stat1_AR_SpontanFlag = 1;
}
/*@@end*/

/*@@envVar:HMI_DL1_Sw_Psd:*/
on EnvVar HMI_DL1_Sw_Psd
{
    _mBC_R_Stat1_AR.DL1_Sw_Psd.phys = getValue(this);
    _BC_R_Stat1_AR_SpontanFlag = 1;
}
/*@@end*/

/*@@envVar:HMI_DL2_Sw_Psd:*/
on EnvVar HMI_DL2_Sw_Psd
{
    _mBC_R_Stat1_AR.DL2_Sw_Psd.phys = getValue(this);
    _BC_R_Stat1_AR_SpontanFlag = 1;
}
/*@@end*/

/*@@envVar:HMI_EBL_Stat:*/
on EnvVar HMI_EBL_Stat
{
    _mBC_R_Stat1_AR.EBL_Stat.phys = getValue(this);
    _BC_R_Stat1_AR_SpontanFlag = 1;
}
/*@@end*/

/*@@envVar:HMI_EmgLgt_Term15_In_Stat:*/
on envVar HMI_EmgLgt_Term15_In_Stat
{
    _mBC_R_Stat1_AR.EmgLgt_Term15_In_Stat.phys = getValue(this);
    _BC_R_Stat1_AR_SpontanFlag = 1;
}
/*@@end*/

/*@@envVar:HMI_Parity_Bckl_Sw_3L_SAM_R:*/
on EnvVar HMI_Parity_Bckl_Sw_3L_SAM_R
{
    _mBC_R_Stat1_AR.Parity_Bckl_Sw_3L_SAM_R.phys = getValue(this);
    _BC_R_Stat1_AR_SpontanFlag = 1;
}
/*@@end*/

/*@@envVar:HMI_Parity_Bckl_Sw_3R_SAM_R:*/
on EnvVar HMI_Parity_Bckl_Sw_3R_SAM_R
{
    _mBC_R_Stat1_AR.Parity_Bckl_Sw_3R_SAM_R.phys = getValue(this);
    _BC_R_Stat1_AR_SpontanFlag = 1;
}
/*@@end*/

/*@@envVar:HMI_Parity_Bckl_Sw_RL_SAM_R:*/
on EnvVar HMI_Parity_Bckl_Sw_RL_SAM_R
{
    _mBC_R_Stat1_AR.Parity_Bckl_Sw_RL_SAM_R.phys = getValue(this);
    _BC_R_Stat1_AR_SpontanFlag = 1;
}
/*@@end*/

/*@@envVar:HMI_Parity_Bckl_Sw_RM_SAM_R:*/
on EnvVar HMI_Parity_Bckl_Sw_RM_SAM_R
{
    _mBC_R_Stat1_AR.Parity_Bckl_Sw_RM_SAM_R.phys = getValue(this);
    _BC_R_Stat1_AR_SpontanFlag = 1;
}
/*@@end*/

/*@@envVar:HMI_Parity_Bckl_Sw_RR_SAM_R:*/
on EnvVar HMI_Parity_Bckl_Sw_RR_SAM_R
{
    _mBC_R_Stat1_AR.Parity_Bckl_Sw_RR_SAM_R.phys = getValue(this);
    _BC_R_Stat1_AR_SpontanFlag = 1;
}
/*@@end*/

/*@@envVar:HMI_RB_R_Stat_V2:*/
on EnvVar HMI_RB_R_Stat_V2
{
    _mBC_R_Stat1_AR.RB_R_Stat_V2.phys = getValue(this);
    _BC_R_Stat1_AR_SpontanFlag = 1;
}
/*@@end*/

/*@@envVar:HMI_RemTank_Unlk_Stat:*/
on envVar HMI_RemTank_Unlk_Stat
{
    _mBC_R_Stat1_AR.RemTank_Unlk_Stat.phys = getValue(this);
    _BC_R_Stat1_AR_SpontanFlag = 1;
}
/*@@end*/

/*@@envVar:HMI_SeatBkRst_FL_Stat:*/
on EnvVar HMI_SeatBkRst_FL_Stat
{
    _mBC_R_Stat1_AR.SeatBkRst_FL_Stat.phys = getValue(this);
    _BC_R_Stat1_AR_SpontanFlag = 1;
}
/*@@end*/

/*@@envVar:HMI_SeatBkRst_FR_Stat:*/
on EnvVar HMI_SeatBkRst_FR_Stat
{
    _mBC_R_Stat1_AR.SeatBkRst_FR_Stat.phys = getValue(this);
    _BC_R_Stat1_AR_SpontanFlag = 1;
}
/*@@end*/

/*@@envVar:HMI_SeatBkRst_RL_Stat:*/
on EnvVar HMI_SeatBkRst_RL_Stat
{
    _mBC_R_Stat1_AR.SeatBkRst_RL_Stat.phys = getValue(this);
    _BC_R_Stat1_AR_SpontanFlag = 1;
}
/*@@end*/

/*@@envVar:HMI_SeatBkRst_RM_Stat:*/
on EnvVar HMI_SeatBkRst_RM_Stat
{
    _mBC_R_Stat1_AR.SeatBkRst_RM_Stat.phys = getValue(this);
    _BC_R_Stat1_AR_SpontanFlag = 1;
}
/*@@end*/

/*@@envVar:HMI_SeatBkRst_RR_Stat:*/
on EnvVar HMI_SeatBkRst_RR_Stat
{
    _mBC_R_Stat1_AR.SeatBkRst_RR_Stat.phys = getValue(this);
    _BC_R_Stat1_AR_SpontanFlag = 1;
}
/*@@end*/

/*@@envVar:HMI_Term54_Actv:*/
on EnvVar HMI_Term54_Actv
{
    _mBC_R_Stat1_AR.Term54_Actv.phys = getValue(this);
    _BC_R_Stat1_AR_SpontanFlag = 1;
}
/*@@end*/

/*@@envVar:HMI_Wpr_R_OutsdPkPosn:*/
on EnvVar HMI_Wpr_R_OutsdPkPosn
{
    _mBC_R_Stat1_AR.Wpr_R_OutsdPkPosn.phys = getValue(this);
    _BC_R_Stat1_AR_SpontanFlag = 1;
}
/*@@end*/

/*@@caplFunc:BC_R_Stat2_AR_check_output():*/
BC_R_Stat2_AR_check_output()
{
    if( !getValue( HMI__STMSG_BC_R_Stat2_AR ) )
    {
        // Botschaft BC_R_Stat2_AR ID: 869 --- Sendeart 5 cyclicAndSpontanWithDelay --- 
        _BC_R_Stat2_AR_Cnt--;
        if( _BC_R_Stat2_AR_Cnt < 1 )
        {
            BC_R_Stat2_AR_output(); // Nachricht wg. abgelaufenem Zyklus ausgeben
            _BC_R_Stat2_AR_Cnt = _BC_R_Stat2_AR_CycleCount; // Zyklus-Zähler zurücksetzen
            _BC_R_Stat2_AR_SpontanFlag = 0; // Spontan-Flag zurücksetzen
        }
        else if( _BC_R_Stat1_AR_SpontanFlag)
        {
            BC_R_Stat2_AR_output(); // Nachricht wg. spontaner Änderung ausgeben
            _BC_R_Stat2_AR_SpontanFlag = 0; // Spontan-Flag zurücksetzen
        }
    }
}
/*@@end*/

/*@@caplFunc:BC_R_Stat2_AR_init():*/
BC_R_Stat2_AR_init()
{   /* Botschaft BC_R_Stat2_AR ID: 869 --- Sendeart 5 cyclicAndSpontanWithDelay --- 
BA_ "ApplMessage" BO_ 869 0;
BA_ "NmAsrMessage" BO_ 869 0;
BA_ "GenMsgMinAcceptLength" BO_ 869 8;
BA_ "GenMsgILSupport" BO_ 869 1;
BA_ "DiagState" BO_ 869 0;
BA_ "DiagRequest" BO_ 869 0;
BA_ "DiagResponse" BO_ 869 0;
BA_ "GenMsgStartValue" BO_ 869 "0";
BA_ "GenMsgDelayTime" BO_ 869 5;
BA_ "GenMsgNrOfRepetitions" BO_ 869 0;
BA_ "GenMsgCycleTime" BO_ 869 200;
BA_ "GenMsgSendType" BO_ 869 5;
    */
    _BC_R_Stat2_AR_Timebase =              c_tDBKomTimer_20ms;
    _BC_R_Stat2_AR_CycleCount =          200 / _BC_R_Stat2_AR_Timebase;
    _BC_R_Stat2_AR_StartDelay =            0 / _BC_R_Stat2_AR_Timebase;
    _BC_R_Stat2_AR_Cnt = _BC_R_Stat2_AR_StartDelay;
    _BC_R_Stat2_AR_SpontanFlag = 0;

    putValue( HMI__STMSGSD_BC_R_Stat2_AR, _BC_R_Stat2_AR_StartDelay * _BC_R_Stat2_AR_Timebase );

    _mBC_R_Stat2_AR.SeatBkRst_3L_Stat.phys = getValue( HMI_SeatBkRst_3L_Stat );
    _mBC_R_Stat2_AR.SeatBkRst_3R_Stat.phys = getValue( HMI_SeatBkRst_3R_Stat );
    _mBC_R_Stat2_AR.SeatBkRstSleepPosn_RL.phys = getValue( HMI_SeatBkRstSleepPosn_RL );
    _mBC_R_Stat2_AR.SeatBkRstSleepPosn_RR.phys = getValue( HMI_SeatBkRstSleepPosn_RR );
    _mBC_R_Stat2_AR.SeatCsn_RL_Stat.phys = getValue( HMI_SeatCsn_RL_Stat );
    _mBC_R_Stat2_AR.SeatCsn_RR_Stat.phys = getValue( HMI_SeatCsn_RR_Stat );
}
/*@@end*/

/*@@caplFunc:BC_R_Stat2_AR_output():*/
BC_R_Stat2_AR_output(void)
{
    output( _mBC_R_Stat2_AR );
}
/*@@end*/

/*@@caplFunc:BC_R_Stat2_AR_saveEnvVars(dword):*/
BC_R_Stat2_AR_saveEnvVars( dword hFile )
{
    filePutString("\n// Knoten EIS: BC_R_Stat2_AR\n", 26, hFile );
    snprintf( buffer, elcount( buffer ), "0.0000 HMI__STMSG_BC_R_Stat2_AR := %X\n", getValue( HMI__STMSG_BC_R_Stat2_AR ) );    filePutString ( buffer, elcount( buffer ), hFile );
    snprintf( buffer, elcount( buffer ), "0.0000 HMI__STMSGT_BC_R_Stat2_AR := %X\n", getValue( HMI__STMSGT_BC_R_Stat2_AR ) );    filePutString ( buffer, elcount( buffer ), hFile );
    snprintf( buffer, elcount( buffer ), "0.0000 HMI_SeatBkRst_3L_Stat := %X\n", getValue( HMI_SeatBkRst_3L_Stat ) );    filePutString ( buffer, elcount( buffer ), hFile );
    snprintf( buffer, elcount( buffer ), "0.0000 HMI_SeatBkRst_3R_Stat := %X\n", getValue( HMI_SeatBkRst_3R_Stat ) );    filePutString ( buffer, elcount( buffer ), hFile );
    snprintf( buffer, elcount( buffer ), "0.0000 HMI_SeatBkRstSleepPosn_RL := %X\n", getValue( HMI_SeatBkRstSleepPosn_RL ) );    filePutString ( buffer, elcount( buffer ), hFile );
    snprintf( buffer, elcount( buffer ), "0.0000 HMI_SeatBkRstSleepPosn_RR := %X\n", getValue( HMI_SeatBkRstSleepPosn_RR ) );    filePutString ( buffer, elcount( buffer ), hFile );
    snprintf( buffer, elcount( buffer ), "0.0000 HMI_SeatCsn_RL_Stat := %X\n", getValue( HMI_SeatCsn_RL_Stat ) );    filePutString ( buffer, elcount( buffer ), hFile );
    snprintf( buffer, elcount( buffer ), "0.0000 HMI_SeatCsn_RR_Stat := %X\n", getValue( HMI_SeatCsn_RR_Stat ) );    filePutString ( buffer, elcount( buffer ), hFile );
}
/*@@end*/

/*@@timer:_tBC_R_Stat2_AR:*/
on timer _tBC_R_Stat2_AR
{
    putValue( HMI__STMSG_BC_R_Stat2_AR, 0 );
}
/*@@end*/

/*@@envVar:HMI__STMSG_BC_R_Stat2_AR:*/
on EnvVar HMI__STMSG_BC_R_Stat2_AR
{
    long tDelay;
    if( getValue( this ) == 2 )
    {
        tDelay = getValue( HMI__STMSGT_BC_R_Stat2_AR );
        if( tDelay > 0)    
            setTimer( _tBC_R_Stat2_AR, tDelay );
        else
            putValue( HMI__STMSG_BC_R_Stat2_AR, 0 );
    }
}
/*@@end*/

/*@@envVar:HMI_SeatBkRst_3L_Stat:*/
on EnvVar HMI_SeatBkRst_3L_Stat
{
    _mBC_R_Stat2_AR.SeatBkRst_3L_Stat.phys = getValue(this);
    _BC_R_Stat2_AR_SpontanFlag = 1;
}
/*@@end*/

/*@@envVar:HMI_SeatBkRst_3R_Stat:*/
on EnvVar HMI_SeatBkRst_3R_Stat
{
    _mBC_R_Stat2_AR.SeatBkRst_3R_Stat.phys = getValue(this);
    _BC_R_Stat2_AR_SpontanFlag = 1;
}
/*@@end*/

/*@@envVar:HMI_SeatBkRstSleepPosn_RR:*/
on EnvVar HMI_SeatBkRstSleepPosn_RR
{
    _mBC_R_Stat2_AR.SeatBkRstSleepPosn_RR.phys = getValue(this);
    _BC_R_Stat2_AR_SpontanFlag = 1;
}
/*@@end*/

/*@@envVar:HMI_SeatBkRstSleepPosn_RL:*/
on EnvVar HMI_SeatBkRstSleepPosn_RL
{
    _mBC_R_Stat2_AR.SeatBkRstSleepPosn_RL.phys = getValue(this);
    _BC_R_Stat2_AR_SpontanFlag = 1;
}
/*@@end*/

/*@@envVar:HMI_SeatCsn_RL_Stat:*/
on EnvVar HMI_SeatCsn_RL_Stat
{
    _mBC_R_Stat2_AR.SeatCsn_RL_Stat.phys = getValue(this);
    _BC_R_Stat2_AR_SpontanFlag = 1;
}
/*@@end*/

/*@@envVar:HMI_SeatCsn_RR_Stat:*/
on EnvVar HMI_SeatCsn_RR_Stat
{
    _mBC_R_Stat2_AR.SeatCsn_RR_Stat.phys = getValue(this);
    _BC_R_Stat2_AR_SpontanFlag = 1;
}
/*@@end*/

/*@@caplFunc:BODY_HMI_R0_AR_check_output():*/
BODY_HMI_R0_AR_check_output()
{
    if( !getValue( HMI__STMSG_BODY_HMI_R0_AR ) )
    {
        // Botschaft BODY_HMI_R0_AR ID: 1111 --- Sendeart 5 cyclicAndSpontanWithDelay --- 
        _BODY_HMI_R0_AR_Cnt--;
        if( _BODY_HMI_R0_AR_Cnt < 1 )
        {
            BODY_HMI_R0_AR_output(); // Nachricht wg. abgelaufenem Zyklus ausgeben
            _BODY_HMI_R0_AR_Cnt = _BODY_HMI_R0_AR_CycleCount; // Zyklus-Zähler zurücksetzen
             _BODY_HMI_R0_AR_SpontanFlag = 0; // Spontan-Flag zurücksetzen
        }
        else if( _BODY_HMI_R0_AR_SpontanFlag)
        {
            BODY_HMI_R0_AR_output(); // Nachricht wg. spontaner Änderung ausgeben
             _BODY_HMI_R0_AR_SpontanFlag = 0; // Spontan-Flag zurücksetzen
        }
    }
}
/*@@end*/

/*@@caplFunc:BODY_HMI_R0_AR_init():*/
BODY_HMI_R0_AR_init()
{   /* Botschaft BODY_HMI_R0_AR ID: 1111 --- Sendeart 5 cyclicAndSpontanWithDelay --- 
BA_ "ApplMessage" BO_ 1111 0;
BA_ "NmAsrMessage" BO_ 1111 0;
BA_ "GenMsgMinAcceptLength" BO_ 1111 8;
BA_ "GenMsgILSupport" BO_ 1111 1;
BA_ "DiagState" BO_ 1111 0;
BA_ "DiagRequest" BO_ 1111 0;
BA_ "DiagResponse" BO_ 1111 0;
BA_ "GenMsgStartValue" BO_ 1111 "0";
BA_ "GenMsgStartDelayTime" BO_ 1111 40;
BA_ "GenMsgDelayTime" BO_ 1111 5;
BA_ "GenMsgNrOfRepetitions" BO_ 1111 0;
BA_ "GenMsgCycleTime" BO_ 1111 1000;
BA_ "GenMsgSendType" BO_ 1111 5;
    */
    _BODY_HMI_R0_AR_Timebase =     c_tDBKomTimer_20ms;
    _BODY_HMI_R0_AR_CycleCount = 1000 / _BODY_HMI_R0_AR_Timebase;
    _BODY_HMI_R0_AR_StartDelay =   40 / _BODY_HMI_R0_AR_Timebase;
    _BODY_HMI_R0_AR_Cnt = _BODY_HMI_R0_AR_StartDelay;
    _BODY_HMI_R0_AR_SpontanFlag = 0;

    putValue( HMI__STMSGSD_BODY_HMI_R0_AR, _BODY_HMI_R0_AR_StartDelay * _BODY_HMI_R0_AR_Timebase );

    _mBODY_HMI_R0_AR.CoronaLgt_Stat.phys = getValue( HMI_CoronaLgt_Stat );
    _mBODY_HMI_R0_AR.CoronaLgt_Stat_UB.phys = getValue( HMI_CoronaLgt_Stat_UB );
    _mBODY_HMI_R0_AR.IL_AgDur_Stat.phys = getValue( HMI_IL_AgDur_Stat );
    _mBODY_HMI_R0_AR.IL_AgDur_Stat_UB.phys = getValue( HMI_IL_AgDur_Stat_UB );
    _mBODY_HMI_R0_AR.TranspChg_Roof_Stat.phys = getValue( HMI_TranspChg_Roof_Stat );
    _mBODY_HMI_R0_AR.TranspChg_Roof_Stat_UB.phys = getValue( HMI_TranspChg_Roof_Stat_UB );
}
/*@@end*/

/*@@caplFunc:BODY_HMI_R0_AR_output():*/
BODY_HMI_R0_AR_output(void)
{
    output( _mBODY_HMI_R0_AR );
}
/*@@end*/

/*@@caplFunc:BODY_HMI_R0_AR_saveEnvVars(dword):*/
BODY_HMI_R0_AR_saveEnvVars( dword hFile )
{
    filePutString("\n// Knoten EIS: BODY_HMI_R0_AR\n", 26, hFile );
    snprintf( buffer, elcount( buffer ), "0.0000 HMI__STMSG_BODY_HMI_R0_AR := %X\n", getValue( HMI__STMSG_BODY_HMI_R0_AR ) );    filePutString( buffer, elcount( buffer ), hFile );
    snprintf( buffer, elcount( buffer ), "0.0000 HMI__STMSGT_BODY_HMI_R0_AR := %X\n", getValue( HMI__STMSGT_BODY_HMI_R0_AR ) );    filePutString( buffer, elcount( buffer ), hFile );
    snprintf( buffer, elcount( buffer ), "0.0000 HMI_CoronaLgt_Stat := %X\n", getValue( HMI_CoronaLgt_Stat ) );    filePutString( buffer, elcount( buffer ), hFile );
    snprintf( buffer, elcount( buffer ), "0.0000 HMI_CoronaLgt_Stat_UB := %X\n", getValue( HMI_CoronaLgt_Stat_UB ) );    filePutString( buffer, elcount( buffer ), hFile );
    snprintf( buffer, elcount( buffer ), "0.0000 HMI_IL_AgDur_Stat := %X\n", getValue( HMI_IL_AgDur_Stat ) );    filePutString( buffer, elcount( buffer ), hFile );
    snprintf( buffer, elcount( buffer ), "0.0000 HMI_IL_AgDur_Stat_UB := %X\n", getValue( HMI_IL_AgDur_Stat_UB ) );    filePutString( buffer, elcount( buffer ), hFile );
    snprintf( buffer, elcount( buffer ), "0.0000 HMI_TranspChg_Roof_Stat := %X\n", getValue( HMI_TranspChg_Roof_Stat ) );    filePutString( buffer, elcount( buffer ), hFile );
    snprintf( buffer, elcount( buffer ), "0.0000 HMI_TranspChg_Roof_Stat_UB := %X\n", getValue( HMI_TranspChg_Roof_Stat_UB ) );    filePutString( buffer, elcount( buffer ), hFile );
}
/*@@end*/

/*@@timer:_tBODY_HMI_R0_AR:*/
on timer _tBODY_HMI_R0_AR
{
    putValue( HMI__STMSG_BODY_HMI_R0_AR, 0 );
}
/*@@end*/

/*@@envVar:HMI__STMSG_BODY_HMI_R0_AR:*/
on EnvVar HMI__STMSG_BODY_HMI_R0_AR
{
    long tDelay;
    if( getValue( this ) == 2 )
    {
        tDelay = getValue( HMI__STMSGT_BODY_HMI_R0_AR );
        if( tDelay > 0)    
            setTimer( _tBODY_HMI_R0_AR, tDelay );
        else
            putValue( HMI__STMSG_BODY_HMI_R0_AR, 0 );
    }
}
/*@@end*/

/*@@envVar:HMI_CoronaLgt_Stat:*/
on EnvVar HMI_CoronaLgt_Stat
{
    _mBODY_HMI_R0_AR.CoronaLgt_Stat.phys = getValue(this);
    _BODY_HMI_R0_AR_SpontanFlag = 1;
}
/*@@end*/

/*@@envVar:HMI_CoronaLgt_Stat_UB:*/
on EnvVar HMI_CoronaLgt_Stat_UB
{
    _mBODY_HMI_R0_AR.CoronaLgt_Stat_UB.phys = getValue(this);
    _BODY_HMI_R0_AR_SpontanFlag = 1;
}
/*@@end*/

/*@@envVar:HMI_IL_AgDur_Stat:*/
on EnvVar HMI_IL_AgDur_Stat
{
    _mBODY_HMI_R0_AR.IL_AgDur_Stat.phys = getValue(this);
    _BODY_HMI_R0_AR_SpontanFlag = 1;
}
/*@@end*/

/*@@envVar:HMI_IL_AgDur_Stat_UB:*/
on EnvVar HMI_IL_AgDur_Stat_UB
{
    _mBODY_HMI_R0_AR.IL_AgDur_Stat_UB.phys = getValue(this);
    _BODY_HMI_R0_AR_SpontanFlag = 1;
}
/*@@end*/

/*@@envVar:HMI_TranspChg_Roof_Stat:*/
on EnvVar HMI_TranspChg_Roof_Stat
{
    _mBODY_HMI_R0_AR.TranspChg_Roof_Stat.phys = getValue(this);
    _BODY_HMI_R0_AR_SpontanFlag = 1;
}
/*@@end*/

/*@@envVar:HMI_TranspChg_Roof_Stat_UB:*/
on EnvVar HMI_TranspChg_Roof_Stat_UB
{
    _mBODY_HMI_R0_AR.TranspChg_Roof_Stat_UB.phys = getValue(this);
    _BODY_HMI_R0_AR_SpontanFlag = 1;
}
/*@@end*/

/*@@caplFunc:BODY_HMI_R1_AR_check_output():*/
BODY_HMI_R1_AR_check_output()
{
    if( !getValue( HMI__STMSG_BODY_HMI_R1_AR ) )
    {
        // Botschaft BODY_HMI_R1_AR ID: 543 --- Sendeart 5 cyclicAndSpontanWithDelay --- 
        _BODY_HMI_R1_AR_Cnt--;
        if( _BODY_HMI_R1_AR_Cnt < 1 )
        {
            // Nachricht wg. abgelaufenem Zyklus ausgeben
            BODY_HMI_R1_AR_output();
            _BODY_HMI_R1_AR_Cnt = _BODY_HMI_R1_AR_CycleCount; // Zyklus-Zähler zurücksetzen
            _BODY_HMI_R1_AR_SpontanFlag = 0; // Spontan-Flag zurücksetzen
        }
        else if( _BODY_HMI_R1_AR_SpontanFlag)
        {
            // Nachricht wg. spontaner Änderung ausgeben
            BODY_HMI_R1_AR_output();
            _BODY_HMI_R1_AR_SpontanFlag = 0; // Spontan-Flag zurücksetzen
        }
    }
}
/*@@end*/

/*@@caplFunc:BODY_HMI_R1_AR_init():*/
BODY_HMI_R1_AR_init()
{   /* Botschaft BODY_HMI_R1_AR ID: 543 --- Sendeart 5 cyclicAndSpontanWithDelay --- 
BA_ "ApplMessage" BO_ 543 0;
BA_ "NmAsrMessage" BO_ 543 0;
BA_ "GenMsgMinAcceptLength" BO_ 543 8;
BA_ "GenMsgILSupport" BO_ 543 1;
BA_ "DiagState" BO_ 543 0;
BA_ "DiagRequest" BO_ 543 0;
BA_ "DiagResponse" BO_ 543 0;
BA_ "GenMsgStartValue" BO_ 543 "0";
BA_ "GenMsgStartDelayTime" BO_ 543 30;
BA_ "GenMsgDelayTime" BO_ 543 20;
BA_ "GenMsgNrOfRepetitions" BO_ 543 0;
BA_ "GenMsgCycleTime" BO_ 543 100;
BA_ "GenMsgSendType" BO_ 543 5;
    */
    _BODY_HMI_R1_AR_Timebase =        c_tDBKomTimer_20ms;
    _BODY_HMI_R1_AR_CycleCount =    100 / _BODY_HMI_R1_AR_Timebase;
    _BODY_HMI_R1_AR_StartDelay =     30 / _BODY_HMI_R1_AR_Timebase;
    _BODY_HMI_R1_AR_Cnt = _BODY_HMI_R1_AR_StartDelay;
    _BODY_HMI_R1_AR_SpontanFlag = 0;

    putValue( HMI__STMSGSD_BODY_HMI_R1_AR, _BODY_HMI_R1_AR_StartDelay * _BODY_HMI_R1_AR_Timebase );

    _mBODY_HMI_R1_AR.BeltHdOvr_Lt_Stat.phys = getValue( HMI_BeltHdOvr_Lt_Stat );
    _mBODY_HMI_R1_AR.BeltHdOvr_Lt_Stat_UB.phys = getValue( HMI_BeltHdOvr_Lt_Stat_UB );
    _mBODY_HMI_R1_AR.BeltHdOvr_Rt_Stat.phys = getValue( HMI_BeltHdOvr_Rt_Stat );
    _mBODY_HMI_R1_AR.BeltHdOvr_Rt_Stat_UB.phys = getValue( HMI_BeltHdOvr_Rt_Stat_UB );
    _mBODY_HMI_R1_AR.CT_Stat.phys = getValue( HMI_CT_Stat );
    _mBODY_HMI_R1_AR.CT_Stat_UB.phys = getValue( HMI_CT_Stat_UB );
    _mBODY_HMI_R1_AR.DL_Lim_Stat.phys = getValue( HMI_DL_Lim_Stat );
    _mBODY_HMI_R1_AR.DL_Lim_Stat_UB.phys = getValue( HMI_DL_Lim_Stat_UB );
    _mBODY_HMI_R1_AR.PN14_Bat_Type.phys = getValue( HMI_PN14_Bat_Type );
    _mBODY_HMI_R1_AR.PN14_Bat_Type_UB.phys = getValue( HMI_PN14_Bat_Type_UB );
    _mBODY_HMI_R1_AR.PN14_ProdMd_Stat.phys = getValue( HMI_PN14_ProdMd_Stat );
    _mBODY_HMI_R1_AR.PN14_ProdMd_Stat_UB.phys = getValue( HMI_PN14_ProdMd_Stat_UB );
    _mBODY_HMI_R1_AR.PN14_TDP_Stat_UB.phys = getValue( HMI_PN14_TDP_Stat_UB );
    _mBODY_HMI_R1_AR.PN14_TDP_Sw_Stat.phys = getValue( HMI_PN14_TDP_Sw_Stat );
    _mBODY_HMI_R1_AR.SPCR_Sp_Stat_BC_F.phys = getValue( HMI_SPCR_Sp_Stat_BC_F );
    _mBODY_HMI_R1_AR.SPCR_Stat_BC_F_UB.phys = getValue( HMI_SPCR_Stat_BC_F_UB );
    _mBODY_HMI_R1_AR.TSSR_Ft_RB_Stat.phys = getValue( HMI_TSSR_Ft_RB_Stat );
    _mBODY_HMI_R1_AR.TSSR_Ft_Stat.phys = getValue( HMI_TSSR_Ft_Stat );
    _mBODY_HMI_R1_AR.TSSR_Stat_UB.phys = getValue( HMI_TSSR_Stat_UB );
    _mBODY_HMI_R1_AR.VTA_ITS_Dsabl_Ack_V2.phys = getValue( HMI_VTA_ITS_Dsabl_Ack_V2 );
    _mBODY_HMI_R1_AR.VTA_ITS_Dsabl_Ack_V2_UB.phys = getValue( HMI_VTA_ITS_Dsabl_Ack_V2_UB );
    _mBODY_HMI_R1_AR.VTA_LED_On_Rq.phys = getValue( HMI_VTA_LED_On_Rq );
    _mBODY_HMI_R1_AR.VTA_LED_On_Rq_UB.phys = getValue( HMI_VTA_LED_On_Rq_UB );
    _mBODY_HMI_R1_AR.VTA_TPS_Dsabl_Ack_V2.phys = getValue( HMI_VTA_TPS_Dsabl_Ack_V2 );
    _mBODY_HMI_R1_AR.VTA_TPS_Dsabl_Ack_V2_UB.phys = getValue( HMI_VTA_TPS_Dsabl_Ack_V2_UB );
}
/*@@end*/

/*@@caplFunc:BODY_HMI_R1_AR_output():*/
BODY_HMI_R1_AR_output()
{
    output( _mBODY_HMI_R1_AR );
}
/*@@end*/

/*@@caplFunc:BODY_HMI_R1_AR_saveEnvVars(dword):*/
BODY_HMI_R1_AR_saveEnvVars( dword hFile )
{
    filePutString("\n// Knoten EIS: BODY_HMI_R1_AR\n", 26, hFile );
    snprintf( buffer, elcount( buffer ), "0.0000 HMI__STMSG_BODY_HMI_R1_AR := %X\n", getValue( HMI__STMSG_BODY_HMI_R1_AR ) );    filePutString ( buffer, elcount( buffer ), hFile );
    snprintf( buffer, elcount( buffer ), "0.0000 HMI__STMSGT_BODY_HMI_R1_AR := %X\n", getValue( HMI__STMSGT_BODY_HMI_R1_AR ) );    filePutString ( buffer, elcount( buffer ), hFile );
    snprintf( buffer, elcount( buffer ), "0.0000 HMI_BeltHdOvr_Lt_Stat := %X\n", getValue( HMI_BeltHdOvr_Lt_Stat ) );    filePutString ( buffer, elcount( buffer ), hFile );
    snprintf( buffer, elcount( buffer ), "0.0000 HMI_BeltHdOvr_Lt_Stat_UB := %X\n", getValue( HMI_BeltHdOvr_Lt_Stat_UB ) );    filePutString ( buffer, elcount( buffer ), hFile );
    snprintf( buffer, elcount( buffer ), "0.0000 HMI_BeltHdOvr_Rt_Stat := %X\n", getValue( HMI_BeltHdOvr_Rt_Stat ) );    filePutString ( buffer, elcount( buffer ), hFile );
    snprintf( buffer, elcount( buffer ), "0.0000 HMI_BeltHdOvr_Rt_Stat_UB := %X\n", getValue( HMI_BeltHdOvr_Rt_Stat_UB ) );    filePutString ( buffer, elcount( buffer ), hFile );
    snprintf( buffer, elcount( buffer ), "0.0000 HMI_CT_Stat := %X\n", getValue( HMI_CT_Stat ) );    filePutString ( buffer, elcount( buffer ), hFile );
    snprintf( buffer, elcount( buffer ), "0.0000 HMI_CT_Stat_UB := %X\n", getValue( HMI_CT_Stat_UB ) );    filePutString ( buffer, elcount( buffer ), hFile );
    snprintf( buffer, elcount( buffer ), "0.0000 HMI_DL_Lim_Stat := %X\n", getValue( HMI_DL_Lim_Stat ) );    filePutString ( buffer, elcount( buffer ), hFile );
    snprintf( buffer, elcount( buffer ), "0.0000 HMI_DL_Lim_Stat_UB := %X\n", getValue( HMI_DL_Lim_Stat_UB ) );    filePutString ( buffer, elcount( buffer ), hFile );
    snprintf( buffer, elcount( buffer ), "0.0000 HMI_PN14_Bat_Type := %X\n", getValue( HMI_PN14_Bat_Type ) );    filePutString ( buffer, elcount( buffer ), hFile );
    snprintf( buffer, elcount( buffer ), "0.0000 HMI_PN14_Bat_Type_UB := %X\n", getValue( HMI_PN14_Bat_Type_UB ) );    filePutString ( buffer, elcount( buffer ), hFile );
    snprintf( buffer, elcount( buffer ), "0.0000 HMI_PN14_ProdMd_Stat := %X\n", getValue( HMI_PN14_ProdMd_Stat ) );    filePutString ( buffer, elcount( buffer ), hFile );
    snprintf( buffer, elcount( buffer ), "0.0000 HMI_PN14_ProdMd_Stat_UB := %X\n", getValue( HMI_PN14_ProdMd_Stat_UB ) );    filePutString ( buffer, elcount( buffer ), hFile );
    snprintf( buffer, elcount( buffer ), "0.0000 HMI_PN14_TDP_Stat_UB := %X\n", getValue( HMI_PN14_TDP_Stat_UB ) );    filePutString ( buffer, elcount( buffer ), hFile );
    snprintf( buffer, elcount( buffer ), "0.0000 HMI_PN14_TDP_Sw_Stat := %X\n", getValue( HMI_PN14_TDP_Sw_Stat ) );    filePutString ( buffer, elcount( buffer ), hFile );
    snprintf( buffer, elcount( buffer ), "0.0000 HMI_SPCR_Sp_Stat_BC_F := %X\n", getValue( HMI_SPCR_Sp_Stat_BC_F ) );    filePutString ( buffer, elcount( buffer ), hFile );
    snprintf( buffer, elcount( buffer ), "0.0000 HMI_SPCR_Stat_BC_F_UB := %X\n", getValue( HMI_SPCR_Stat_BC_F_UB ) );    filePutString ( buffer, elcount( buffer ), hFile );
    snprintf( buffer, elcount( buffer ), "0.0000 HMI_TSSR_Ft_RB_Stat := %X\n", getValue( HMI_TSSR_Ft_RB_Stat ) );    filePutString ( buffer, elcount( buffer ), hFile );
    snprintf( buffer, elcount( buffer ), "0.0000 HMI_TSSR_Ft_Stat := %X\n", getValue( HMI_TSSR_Ft_Stat ) );    filePutString ( buffer, elcount( buffer ), hFile );
    snprintf( buffer, elcount( buffer ), "0.0000 HMI_TSSR_Stat_UB := %X\n", getValue( HMI_TSSR_Stat_UB ) );    filePutString ( buffer, elcount( buffer ), hFile );
    snprintf( buffer, elcount( buffer ), "0.0000 HMI_VTA_ITS_Dsabl_Ack_V2 := %X\n", getValue( HMI_VTA_ITS_Dsabl_Ack_V2 ) );    filePutString ( buffer, elcount( buffer ), hFile );
    snprintf( buffer, elcount( buffer ), "0.0000 HMI_VTA_ITS_Dsabl_Ack_V2_UB := %X\n", getValue( HMI_VTA_ITS_Dsabl_Ack_V2_UB ) );    filePutString ( buffer, elcount( buffer ), hFile );
    snprintf( buffer, elcount( buffer ), "0.0000 HMI_VTA_LED_On_Rq := %X\n", getValue( HMI_VTA_LED_On_Rq ) );    filePutString ( buffer, elcount( buffer ), hFile );
    snprintf( buffer, elcount( buffer ), "0.0000 HMI_VTA_LED_On_Rq_UB := %X\n", getValue( HMI_VTA_LED_On_Rq_UB ) );    filePutString ( buffer, elcount( buffer ), hFile );
    snprintf( buffer, elcount( buffer ), "0.0000 HMI_VTA_TPS_Dsabl_Ack_V2 := %X\n", getValue( HMI_VTA_TPS_Dsabl_Ack_V2 ) );    filePutString ( buffer, elcount( buffer ), hFile );
    snprintf( buffer, elcount( buffer ), "0.0000 HMI_VTA_TPS_Dsabl_Ack_V2_UB := %X\n", getValue( HMI_VTA_TPS_Dsabl_Ack_V2_UB ) );    filePutString ( buffer, elcount( buffer ), hFile );
}
/*@@end*/

/*@@timer:_tBODY_HMI_R1_AR:*/
on timer _tBODY_HMI_R1_AR
{
    putValue( HMI__STMSG_BODY_HMI_R1_AR, 0 );
}
/*@@end*/

/*@@envVar:HMI__STMSG_BODY_HMI_R1_AR:*/
on EnvVar HMI__STMSG_BODY_HMI_R1_AR
{
    long tDelay;

    if( getValue( this ) == 2 )
    {
        tDelay = getValue( HMI__STMSGT_BODY_HMI_R1_AR );
        if( tDelay > 0)    
            setTimer( _tBODY_HMI_R1_AR, tDelay );
        else
            putValue( HMI__STMSG_BODY_HMI_R1_AR, 0 );
    }
}
/*@@end*/

/*@@envVar:HMI_BeltHdOvr_Lt_Stat:*/
on envVar HMI_BeltHdOvr_Lt_Stat
{
    _mBODY_HMI_R1_AR.BeltHdOvr_Lt_Stat.phys = getValue(this);
    _BODY_HMI_R1_AR_SpontanFlag = 1;
}
/*@@end*/

/*@@envVar:HMI_BeltHdOvr_Lt_Stat_UB:*/
on envVar HMI_BeltHdOvr_Lt_Stat_UB
{
    _mBODY_HMI_R1_AR.BeltHdOvr_Lt_Stat_UB.phys = getValue(this);
    _BODY_HMI_R1_AR_SpontanFlag = 1;
}
/*@@end*/

/*@@envVar:HMI_BeltHdOvr_Rt_Stat:*/
on envVar HMI_BeltHdOvr_Rt_Stat
{
    _mBODY_HMI_R1_AR.BeltHdOvr_Rt_Stat.phys = getValue(this);
    _BODY_HMI_R1_AR_SpontanFlag = 1;
}
/*@@end*/

/*@@envVar:HMI_BeltHdOvr_Rt_Stat_UB:*/
on envVar HMI_BeltHdOvr_Rt_Stat_UB
{
    _mBODY_HMI_R1_AR.BeltHdOvr_Rt_Stat_UB.phys = getValue(this);
    _BODY_HMI_R1_AR_SpontanFlag = 1;
}
/*@@end*/

/*@@envVar:HMI_CT_Stat:*/
on EnvVar HMI_CT_Stat
{
    _mBODY_HMI_R1_AR.CT_Stat.phys = getValue(this);
    _BODY_HMI_R1_AR_SpontanFlag = 1;
}
/*@@end*/

/*@@envVar:HMI_CT_Stat_UB:*/
on EnvVar HMI_CT_Stat_UB
{
    _mBODY_HMI_R1_AR.CT_Stat_UB.phys = getValue(this);
    _BODY_HMI_R1_AR_SpontanFlag = 1;
}
/*@@end*/

/*@@envVar:HMI_DL_Lim_Stat:*/
on EnvVar HMI_DL_Lim_Stat
{
    _mBODY_HMI_R1_AR.DL_Lim_Stat.phys = getValue(this);
    _BODY_HMI_R1_AR_SpontanFlag = 1;
}
/*@@end*/

/*@@envVar:HMI_DL_Lim_Stat_UB:*/
on EnvVar HMI_DL_Lim_Stat_UB
{
    _mBODY_HMI_R1_AR.DL_Lim_Stat_UB.phys = getValue(this);
    _BODY_HMI_R1_AR_SpontanFlag = 1;
}
/*@@end*/

/*@@envVar:HMI_PN14_Bat_Type:*/
on EnvVar HMI_PN14_Bat_Type
{
    _mBODY_HMI_R1_AR.PN14_Bat_Type.phys = getValue(this);
    _BODY_HMI_R1_AR_SpontanFlag = 1;
}
/*@@end*/

/*@@envVar:HMI_PN14_Bat_Type_UB:*/
on EnvVar HMI_PN14_Bat_Type_UB
{
    _mBODY_HMI_R1_AR.PN14_Bat_Type_UB.phys = getValue(this);
    _BODY_HMI_R1_AR_SpontanFlag = 1;
}
/*@@end*/

/*@@envVar:HMI_PN14_ProdMd_Stat:*/
on EnvVar HMI_PN14_ProdMd_Stat
{
    _mBODY_HMI_R1_AR.PN14_ProdMd_Stat.phys = getValue(this);
    _BODY_HMI_R1_AR_SpontanFlag = 1;
}
/*@@end*/

/*@@envVar:HMI_PN14_ProdMd_Stat_UB:*/
on EnvVar HMI_PN14_ProdMd_Stat_UB
{
    _mBODY_HMI_R1_AR.PN14_ProdMd_Stat_UB.phys = getValue(this);
    _BODY_HMI_R1_AR_SpontanFlag = 1;
}
/*@@end*/

/*@@envVar:HMI_PN14_TDP_Stat_UB:*/
on EnvVar HMI_PN14_TDP_Stat_UB
{
    _mBODY_HMI_R1_AR.PN14_TDP_Stat_UB.phys = getValue(this);
    _BODY_HMI_R1_AR_SpontanFlag = 1;
}
/*@@end*/

/*@@envVar:HMI_PN14_TDP_Sw_Stat:*/
on EnvVar HMI_PN14_TDP_Sw_Stat
{
    _mBODY_HMI_R1_AR.PN14_TDP_Sw_Stat.phys = getValue(this);
    _BODY_HMI_R1_AR_SpontanFlag = 1;
}
/*@@end*/

/*@@envVar:HMI_SPCR_Sp_Stat_BC_F:*/
on envVar HMI_SPCR_Sp_Stat_BC_F
{
    _mBODY_HMI_R1_AR.SPCR_Sp_Stat_BC_F.phys = getValue(this);
    _BODY_HMI_R1_AR_SpontanFlag = 1;
}
/*@@end*/

/*@@envVar:HMI_SPCR_Stat_BC_F_UB:*/
on envVar HMI_SPCR_Stat_BC_F_UB
{
    _mBODY_HMI_R1_AR.SPCR_Stat_BC_F_UB.phys = getValue(this);
    _BODY_HMI_R1_AR_SpontanFlag = 1;
}
/*@@end*/

/*@@envVar:HMI_TSSR_Ft_RB_Stat:*/
on envVar HMI_TSSR_Ft_RB_Stat
{
    _mBODY_HMI_R1_AR.TSSR_Ft_RB_Stat.phys = getValue(this);
    _BODY_HMI_R1_AR_SpontanFlag = 1;
}
/*@@end*/

/*@@envVar:HMI_TSSR_Ft_Stat:*/
on envVar HMI_TSSR_Ft_Stat
{
    _mBODY_HMI_R1_AR.TSSR_Ft_Stat.phys = getValue(this);
    _BODY_HMI_R1_AR_SpontanFlag = 1;
}
/*@@end*/

/*@@envVar:HMI_TSSR_Stat_UB:*/
on envVar HMI_TSSR_Stat_UB
{
    _mBODY_HMI_R1_AR.TSSR_Stat_UB.phys = getValue(this);
    _BODY_HMI_R1_AR_SpontanFlag = 1;
}
/*@@end*/

/*@@envVar:HMI_VTA_InfoMsg_Disp_Rq_V2:*/
on envVar HMI_VTA_InfoMsg_Disp_Rq_V2
{
    _mBODY_HMI_R1_AR.VTA_InfoMsg_Disp_Rq_V2.phys = getValue(this);
    _BODY_HMI_R1_AR_SpontanFlag = 1;
}
/*@@end*/

/*@@envVar:HMI_VTA_InfoMsg_Disp_Rq_V2_UB:*/
on envVar HMI_VTA_InfoMsg_Disp_Rq_V2_UB
{
    _mBODY_HMI_R1_AR.VTA_InfoMsg_Disp_Rq_V2_UB.phys = getValue(this);
    _BODY_HMI_R1_AR_SpontanFlag = 1;
}
/*@@end*/

/*@@envVar:HMI_VTA_ITS_Dsabl_Ack_V2:*/
on envVar HMI_VTA_ITS_Dsabl_Ack_V2
{
    _mBODY_HMI_R1_AR.VTA_ITS_Dsabl_Ack_V2.phys = getValue(this);
    _BODY_HMI_R1_AR_SpontanFlag = 1;
}
/*@@end*/

/*@@envVar:HMI_VTA_ITS_Dsabl_Ack_V2_UB:*/
on envVar HMI_VTA_ITS_Dsabl_Ack_V2_UB
{
    _mBODY_HMI_R1_AR.VTA_ITS_Dsabl_Ack_V2_UB.phys = getValue(this);
    _BODY_HMI_R1_AR_SpontanFlag = 1;
}
/*@@end*/

/*@@envVar:HMI_VTA_LED_On_Rq:*/
on envVar HMI_VTA_LED_On_Rq
{
    _mBODY_HMI_R1_AR.VTA_LED_On_Rq.phys = getValue(this);
    _BODY_HMI_R1_AR_SpontanFlag = 1;
}
/*@@end*/

/*@@envVar:HMI_VTA_LED_On_Rq_UB:*/
on envVar HMI_VTA_LED_On_Rq_UB
{
    _mBODY_HMI_R1_AR.VTA_LED_On_Rq_UB.phys = getValue(this);
    _BODY_HMI_R1_AR_SpontanFlag = 1;
}
/*@@end*/

/*@@envVar:HMI_VTA_TPS_Dsabl_Ack_V2:*/
on EnvVar HMI_VTA_TPS_Dsabl_Ack_V2
{
    _mBODY_HMI_R1_AR.VTA_TPS_Dsabl_Ack_V2.phys = getValue(this);
    _BODY_HMI_R1_AR_SpontanFlag = 1;
}
/*@@end*/

/*@@envVar:HMI_VTA_TPS_Dsabl_Ack_V2_UB:*/
on EnvVar HMI_VTA_TPS_Dsabl_Ack_V2_UB
{
    _mBODY_HMI_R1_AR.VTA_TPS_Dsabl_Ack_V2_UB.phys = getValue(this);
    _BODY_HMI_R1_AR_SpontanFlag = 1;
}
/*@@end*/

/*@@caplFunc:BODY_HMI_R2_AR_check_output():*/
BODY_HMI_R2_AR_check_output()
{
    if( !getValue( HMI__STMSG_BODY_HMI_R2_AR ) )
    {
        // Botschaft BODY_HMI_R2_AR ID: 544 --- Sendeart 5 cyclicAndSpontanWithDelay
        _BODY_HMI_R2_AR_Cnt--;
        if( _BODY_HMI_R2_AR_Cnt < 1 )
        {
            BODY_HMI_R2_AR_output(); // Nachricht wg. abgelaufenem Zyklus ausgeben
            _BODY_HMI_R2_AR_Cnt = _BODY_HMI_R2_AR_CycleCount; // Zyklus-Zähler zurücksetzen
            _BODY_HMI_R2_AR_SpontanFlag = 0; // Spontan-Flag zurücksetzen
        }
        else if( _BODY_HMI_R2_AR_SpontanFlag)
        {
            BODY_HMI_R2_AR_output(); // Nachricht wg. spontaner Änderung ausgeben
            _BODY_HMI_R2_AR_SpontanFlag = 0; // Spontan-Flag zurücksetzen
        }
    }
}
/*@@end*/

/*@@caplFunc:BODY_HMI_R2_AR_init():*/
BODY_HMI_R2_AR_init()
{   /* Botschaft BODY_HMI_R2_AR ID: 544 --- Sendeart 5 cyclicAndSpontanWithDelay --- 
BA_ "ApplMessage" BO_ 544 0;
BA_ "NmAsrMessage" BO_ 544 0;
BA_ "GenMsgMinAcceptLength" BO_ 544 8;
BA_ "GenMsgILSupport" BO_ 544 1;
BA_ "DiagState" BO_ 544 0;
BA_ "DiagRequest" BO_ 544 0;
BA_ "DiagResponse" BO_ 544 0;
BA_ "GenMsgStartValue" BO_ 544 "0";
BA_ "GenMsgStartDelayTime" BO_ 544 25;
BA_ "GenMsgDelayTime" BO_ 544 20;
BA_ "GenMsgNrOfRepetitions" BO_ 544 0;
BA_ "GenMsgCycleTime" BO_ 544 100;
BA_ "GenMsgSendType" BO_ 544 5;
    */
    _BODY_HMI_R2_AR_Timebase =      c_tDBKomTimer_20ms;
    _BODY_HMI_R2_AR_CycleCount =    100 / _BODY_HMI_R2_AR_Timebase;
    _BODY_HMI_R2_AR_StartDelay =     25 / _BODY_HMI_R2_AR_Timebase;
    _BODY_HMI_R2_AR_Cnt = _BODY_HMI_R2_AR_StartDelay;
    _BODY_HMI_R2_AR_SpontanFlag = 0;

    putValue( HMI__STMSGSD_BODY_HMI_R2_AR, _BODY_HMI_R2_AR_StartDelay * _BODY_HMI_R2_AR_Timebase );

    _mBODY_HMI_R2_AR.CSL_LHD_Inact.phys              = getValue( HMI_CSL_LHD_Inact );
    _mBODY_HMI_R2_AR.CSL_LHD_Inact_UB.phys              = getValue( HMI_CSL_LHD_Inact_UB );
    _mBODY_HMI_R2_AR.CSL_RHD_Inact.phys              = getValue( HMI_CSL_RHD_Inact );
    _mBODY_HMI_R2_AR.CSL_RHD_Inact_UB.phys              = getValue( HMI_CSL_RHD_Inact_UB );
    _mBODY_HMI_R2_AR.Mirr_Privacy_Stat.phys              = getValue( HMI_Mirr_Privacy_Stat );
    _mBODY_HMI_R2_AR.Mirr_Privacy_Stat_UB.phys              = getValue( HMI_Mirr_Privacy_Stat_UB );
    _mBODY_HMI_R2_AR.PW_FL_Posn_Stat.phys              = getValue( HMI_PW_FL_Posn_Stat );
    _mBODY_HMI_R2_AR.PW_FL_Stat_V2_UB.phys              = getValue( HMI_PW_FL_Stat_V2_UB );
    _mBODY_HMI_R2_AR.PW_FR_Posn_Stat     .phys              = getValue( HMI_PW_FR_Posn_Stat      );
    _mBODY_HMI_R2_AR.PW_FR_Stat_V2_UB.phys              = getValue( HMI_PW_FR_Stat_V2_UB );
    _mBODY_HMI_R2_AR.PW_RL_Posn_Stat.phys              = getValue( HMI_PW_RL_Posn_Stat );
    _mBODY_HMI_R2_AR.PW_RL_Stat_V2_UB.phys              = getValue( HMI_PW_RL_Stat_V2_UB );
    _mBODY_HMI_R2_AR.PW_RR_Posn_Stat.phys              = getValue( HMI_PW_RR_Posn_Stat );
    _mBODY_HMI_R2_AR.PW_RR_Stat_V2_UB.phys              = getValue( HMI_PW_RR_Stat_V2_UB );
    _mBODY_HMI_R2_AR.PW_Warn_Rq_FL.phys              = getValue( HMI_PW_Warn_Rq_FL );
    _mBODY_HMI_R2_AR.PW_Warn_Rq_FL_UB.phys              = getValue( HMI_PW_Warn_Rq_FL_UB );
    _mBODY_HMI_R2_AR.PW_Warn_Rq_FR.phys              = getValue( HMI_PW_Warn_Rq_FR );
    _mBODY_HMI_R2_AR.PW_Warn_Rq_FR_UB.phys              = getValue( HMI_PW_Warn_Rq_FR_UB );
    _mBODY_HMI_R2_AR.PW_Warn_Rq_RL.phys              = getValue( HMI_PW_Warn_Rq_RL );
    _mBODY_HMI_R2_AR.PW_Warn_Rq_RL_UB.phys              = getValue( HMI_PW_Warn_Rq_RL_UB );
    _mBODY_HMI_R2_AR.PW_Warn_Rq_RR.phys              = getValue( HMI_PW_Warn_Rq_RR );
    _mBODY_HMI_R2_AR.PW_Warn_Rq_RR_UB.phys              = getValue( HMI_PW_Warn_Rq_RR_UB );
    _mBODY_HMI_R2_AR.RoadsdCallSw_Stat.phys              = getValue( HMI_RoadsdCallSw_Stat );
    _mBODY_HMI_R2_AR.RoadsdCallSw_Stat_UB.phys              = getValue( HMI_RoadsdCallSw_Stat_UB );
    _mBODY_HMI_R2_AR.RPC_SRB_Lt_Stat.phys              = getValue( HMI_RPC_SRB_Lt_Stat );
    _mBODY_HMI_R2_AR.RPC_SRB_Lt_Stat_UB.phys              = getValue( HMI_RPC_SRB_Lt_Stat_UB );
    _mBODY_HMI_R2_AR.RPC_SRB_Rt_Stat.phys              = getValue( HMI_RPC_SRB_Rt_Stat );
    _mBODY_HMI_R2_AR.RPC_SRB_Rt_Stat_UB.phys              = getValue( HMI_RPC_SRB_Rt_Stat_UB );
    _mBODY_HMI_R2_AR.ServCallSw_Stat.phys              = getValue( HMI_ServCallSw_Stat );
    _mBODY_HMI_R2_AR.ServCallSw_Stat_UB.phys              = getValue( HMI_ServCallSw_Stat_UB );
    _mBODY_HMI_R2_AR.SOS_CallSw_Stat.phys              = getValue( HMI_SOS_CallSw_Stat );
    _mBODY_HMI_R2_AR.SOS_CallSw_Stat_UB.phys              = getValue( HMI_SOS_CallSw_Stat_UB );
}
/*@@end*/

/*@@caplFunc:BODY_HMI_R2_AR_output():*/
BODY_HMI_R2_AR_output(void)
{
    output( _mBODY_HMI_R2_AR );
}
/*@@end*/

/*@@caplFunc:BODY_HMI_R2_AR_saveEnvVars(dword):*/
BODY_HMI_R2_AR_saveEnvVars( dword hFile )
{
    filePutString("\n// Knoten EIS: BODY_HMI_R2_AR\n", 31, hFile );
    snprintf( buffer, elcount( buffer ), "0.0000 HMI__STMSG_BODY_HMI_R2_AR := %X\n", getValue( HMI__STMSG_BODY_HMI_R2_AR ) );        filePutString ( buffer, elcount( buffer ), hFile );
    snprintf( buffer, elcount( buffer ), "0.0000 HMI__STMSGT_BODY_HMI_R2_AR := %X\n", getValue( HMI__STMSGT_BODY_HMI_R2_AR ) );        filePutString ( buffer, elcount( buffer ), hFile );
    snprintf( buffer, elcount( buffer ), "0.0000 HMI_CSL_LHD_Inact := %X\n", getValue( HMI_CSL_LHD_Inact ) );        filePutString ( buffer, elcount( buffer ), hFile );
    snprintf( buffer, elcount( buffer ), "0.0000 HMI_CSL_LHD_Inact_UB := %X\n", getValue( HMI_CSL_LHD_Inact_UB ) );        filePutString ( buffer, elcount( buffer ), hFile );
    snprintf( buffer, elcount( buffer ), "0.0000 HMI_CSL_RHD_Inact := %X\n", getValue( HMI_CSL_RHD_Inact ) );        filePutString ( buffer, elcount( buffer ), hFile );
    snprintf( buffer, elcount( buffer ), "0.0000 HMI_CSL_RHD_Inact_UB := %X\n", getValue( HMI_CSL_RHD_Inact_UB ) );        filePutString ( buffer, elcount( buffer ), hFile );
    snprintf( buffer, elcount( buffer ), "0.0000 HMI_Mirr_Privacy_Stat := %X\n", getValue( HMI_Mirr_Privacy_Stat ) );        filePutString ( buffer, elcount( buffer ), hFile );
    snprintf( buffer, elcount( buffer ), "0.0000 HMI_Mirr_Privacy_Stat_UB := %X\n", getValue( HMI_Mirr_Privacy_Stat_UB ) );        filePutString ( buffer, elcount( buffer ), hFile );
    snprintf( buffer, elcount( buffer ), "0.0000 HMI_PW_FL_Posn_Stat := %X\n", getValue( HMI_PW_FL_Posn_Stat ) );        filePutString ( buffer, elcount( buffer ), hFile );
    snprintf( buffer, elcount( buffer ), "0.0000 HMI_PW_FL_Stat_V2_UB := %X\n", getValue( HMI_PW_FL_Stat_V2_UB ) );        filePutString ( buffer, elcount( buffer ), hFile );
    snprintf( buffer, elcount( buffer ), "0.0000 HMI_PW_FR_Posn_Stat      := %X\n", getValue( HMI_PW_FR_Posn_Stat      ) );        filePutString ( buffer, elcount( buffer ), hFile );
    snprintf( buffer, elcount( buffer ), "0.0000 HMI_PW_FR_Stat_V2_UB := %X\n", getValue( HMI_PW_FR_Stat_V2_UB ) );        filePutString ( buffer, elcount( buffer ), hFile );
    snprintf( buffer, elcount( buffer ), "0.0000 HMI_PW_RL_Posn_Stat := %X\n", getValue( HMI_PW_RL_Posn_Stat ) );        filePutString ( buffer, elcount( buffer ), hFile );
    snprintf( buffer, elcount( buffer ), "0.0000 HMI_PW_RL_Stat_V2_UB := %X\n", getValue( HMI_PW_RL_Stat_V2_UB ) );        filePutString ( buffer, elcount( buffer ), hFile );
    snprintf( buffer, elcount( buffer ), "0.0000 HMI_PW_RR_Posn_Stat := %X\n", getValue( HMI_PW_RR_Posn_Stat ) );        filePutString ( buffer, elcount( buffer ), hFile );
    snprintf( buffer, elcount( buffer ), "0.0000 HMI_PW_RR_Stat_V2_UB := %X\n", getValue( HMI_PW_RR_Stat_V2_UB ) );        filePutString ( buffer, elcount( buffer ), hFile );
    snprintf( buffer, elcount( buffer ), "0.0000 HMI_PW_Warn_Rq_FL := %X\n", getValue( HMI_PW_Warn_Rq_FL ) );        filePutString ( buffer, elcount( buffer ), hFile );
    snprintf( buffer, elcount( buffer ), "0.0000 HMI_PW_Warn_Rq_FL_UB := %X\n", getValue( HMI_PW_Warn_Rq_FL_UB ) );        filePutString ( buffer, elcount( buffer ), hFile );
    snprintf( buffer, elcount( buffer ), "0.0000 HMI_PW_Warn_Rq_FR := %X\n", getValue( HMI_PW_Warn_Rq_FR ) );        filePutString ( buffer, elcount( buffer ), hFile );
    snprintf( buffer, elcount( buffer ), "0.0000 HMI_PW_Warn_Rq_FR_UB := %X\n", getValue( HMI_PW_Warn_Rq_FR_UB ) );        filePutString ( buffer, elcount( buffer ), hFile );
    snprintf( buffer, elcount( buffer ), "0.0000 HMI_PW_Warn_Rq_RL := %X\n", getValue( HMI_PW_Warn_Rq_RL ) );        filePutString ( buffer, elcount( buffer ), hFile );
    snprintf( buffer, elcount( buffer ), "0.0000 HMI_PW_Warn_Rq_RL_UB := %X\n", getValue( HMI_PW_Warn_Rq_RL_UB ) );        filePutString ( buffer, elcount( buffer ), hFile );
    snprintf( buffer, elcount( buffer ), "0.0000 HMI_PW_Warn_Rq_RR := %X\n", getValue( HMI_PW_Warn_Rq_RR ) );        filePutString ( buffer, elcount( buffer ), hFile );
    snprintf( buffer, elcount( buffer ), "0.0000 HMI_PW_Warn_Rq_RR_UB := %X\n", getValue( HMI_PW_Warn_Rq_RR_UB ) );        filePutString ( buffer, elcount( buffer ), hFile );
    snprintf( buffer, elcount( buffer ), "0.0000 HMI_RoadsdCallSw_Stat := %X\n", getValue( HMI_RoadsdCallSw_Stat ) );        filePutString ( buffer, elcount( buffer ), hFile );
    snprintf( buffer, elcount( buffer ), "0.0000 HMI_RoadsdCallSw_Stat_UB := %X\n", getValue( HMI_RoadsdCallSw_Stat_UB ) );        filePutString ( buffer, elcount( buffer ), hFile );
    snprintf( buffer, elcount( buffer ), "0.0000 HMI_RPC_SRB_Lt_Stat := %X\n", getValue( HMI_RPC_SRB_Lt_Stat ) );        filePutString ( buffer, elcount( buffer ), hFile );
    snprintf( buffer, elcount( buffer ), "0.0000 HMI_RPC_SRB_Lt_Stat_UB := %X\n", getValue( HMI_RPC_SRB_Lt_Stat_UB ) );        filePutString ( buffer, elcount( buffer ), hFile );
    snprintf( buffer, elcount( buffer ), "0.0000 HMI_RPC_SRB_Rt_Stat := %X\n", getValue( HMI_RPC_SRB_Rt_Stat ) );        filePutString ( buffer, elcount( buffer ), hFile );
    snprintf( buffer, elcount( buffer ), "0.0000 HMI_RPC_SRB_Rt_Stat_UB := %X\n", getValue( HMI_RPC_SRB_Rt_Stat_UB ) );        filePutString ( buffer, elcount( buffer ), hFile );
    snprintf( buffer, elcount( buffer ), "0.0000 HMI_ServCallSw_Stat := %X\n", getValue( HMI_ServCallSw_Stat ) );        filePutString ( buffer, elcount( buffer ), hFile );
    snprintf( buffer, elcount( buffer ), "0.0000 HMI_ServCallSw_Stat_UB := %X\n", getValue( HMI_ServCallSw_Stat_UB ) );        filePutString ( buffer, elcount( buffer ), hFile );
    snprintf( buffer, elcount( buffer ), "0.0000 HMI_SOS_CallSw_Stat := %X\n", getValue( HMI_SOS_CallSw_Stat ) );        filePutString ( buffer, elcount( buffer ), hFile );
    snprintf( buffer, elcount( buffer ), "0.0000 HMI_SOS_CallSw_Stat_UB := %X\n", getValue( HMI_SOS_CallSw_Stat_UB ) );        filePutString ( buffer, elcount( buffer ), hFile );
}
/*@@end*/

/*@@timer:_tBODY_HMI_R2_AR:*/
on timer _tBODY_HMI_R2_AR
{
    putValue( HMI__STMSG_BODY_HMI_R2_AR, 0 );
}
/*@@end*/

/*@@envVar:HMI__STMSG_BODY_HMI_R2_AR:*/
on EnvVar HMI__STMSG_BODY_HMI_R2_AR
{
    long tDelay;
    if( getValue( this ) == 2 )
    {
        tDelay = getValue( HMI__STMSGT_BODY_HMI_R2_AR );
        if( tDelay > 0)    
            setTimer( _tBODY_HMI_R2_AR, tDelay );
        else
            putValue( HMI__STMSG_BODY_HMI_R2_AR, 0 );
    }
}
/*@@end*/

/*@@envVar:HMI_CSL_LHD_Inact:*/
on EnvVar HMI_CSL_LHD_Inact
{
    _mBODY_HMI_R2_AR.CSL_LHD_Inact.phys = getValue(this);
    _BODY_HMI_R2_AR_SpontanFlag = 1;
}
/*@@end*/

/*@@envVar:HMI_CSL_LHD_Inact_UB:*/
on EnvVar HMI_CSL_LHD_Inact_UB
{
    _mBODY_HMI_R2_AR.CSL_LHD_Inact_UB.phys = getValue(this);
    _BODY_HMI_R2_AR_SpontanFlag = 1;
}
/*@@end*/

/*@@envVar:HMI_CSL_RHD_Inact:*/
on EnvVar HMI_CSL_RHD_Inact
{
    _mBODY_HMI_R2_AR.CSL_RHD_Inact.phys = getValue(this);
    _BODY_HMI_R2_AR_SpontanFlag = 1;
}
/*@@end*/

/*@@envVar:HMI_CSL_RHD_Inact_UB:*/
on EnvVar HMI_CSL_RHD_Inact_UB
{
    _mBODY_HMI_R2_AR.CSL_RHD_Inact_UB.phys = getValue(this);
    _BODY_HMI_R2_AR_SpontanFlag = 1;
}
/*@@end*/

/*@@envVar:HMI_Mirr_Privacy_Stat:*/
on EnvVar HMI_Mirr_Privacy_Stat
{
    _mBODY_HMI_R2_AR.Mirr_Privacy_Stat.phys = getValue(this);
    _BODY_HMI_R2_AR_SpontanFlag = 1;
}
/*@@end*/

/*@@envVar:HMI_Mirr_Privacy_Stat_UB:*/
on EnvVar HMI_Mirr_Privacy_Stat_UB
{
    _mBODY_HMI_R2_AR.Mirr_Privacy_Stat_UB.phys = getValue(this);
    _BODY_HMI_R2_AR_SpontanFlag = 1;
}
/*@@end*/

/*@@envVar:HMI_PW_FL_Posn_Stat:*/
on EnvVar HMI_PW_FL_Posn_Stat
{
    _mBODY_HMI_R2_AR.PW_FL_Posn_Stat.phys = getValue(this);
    _BODY_HMI_R2_AR_SpontanFlag = 1;
}
/*@@end*/

/*@@envVar:HMI_PW_FL_Stat_V2_UB:*/
on EnvVar HMI_PW_FL_Stat_V2_UB
{
    _mBODY_HMI_R2_AR.PW_FL_Stat_V2_UB.phys = getValue(this);
    _BODY_HMI_R2_AR_SpontanFlag = 1;
}
/*@@end*/

/*@@envVar:HMI_PW_FR_Posn_Stat:*/
on EnvVar HMI_PW_FR_Posn_Stat
{
    _mBODY_HMI_R2_AR.PW_FR_Posn_Stat.phys = getValue(this);
    _BODY_HMI_R2_AR_SpontanFlag = 1;
}
/*@@end*/

/*@@envVar:HMI_PW_FR_Stat_V2_UB:*/
on EnvVar HMI_PW_FR_Stat_V2_UB
{
    _mBODY_HMI_R2_AR.PW_FR_Stat_V2_UB.phys = getValue(this);
    _BODY_HMI_R2_AR_SpontanFlag = 1;
}
/*@@end*/

/*@@envVar:HMI_PW_RL_Posn_Stat:*/
on EnvVar HMI_PW_RL_Posn_Stat
{
    _mBODY_HMI_R2_AR.PW_RL_Posn_Stat.phys = getValue(this);
    _BODY_HMI_R2_AR_SpontanFlag = 1;
}
/*@@end*/

/*@@envVar:HMI_PW_RL_Stat_V2_UB:*/
on EnvVar HMI_PW_RL_Stat_V2_UB
{
    _mBODY_HMI_R2_AR.PW_RL_Stat_V2_UB.phys = getValue(this);
    _BODY_HMI_R2_AR_SpontanFlag = 1;
}
/*@@end*/

/*@@envVar:HMI_PW_RR_Posn_Stat:*/
on EnvVar HMI_PW_RR_Posn_Stat
{
    _mBODY_HMI_R2_AR.PW_RR_Posn_Stat.phys = getValue(this);
    _BODY_HMI_R2_AR_SpontanFlag = 1;
}
/*@@end*/

/*@@envVar:HMI_PW_RR_Stat_V2_UB:*/
on EnvVar HMI_PW_RR_Stat_V2_UB
{
    _mBODY_HMI_R2_AR.PW_RR_Stat_V2_UB.phys = getValue(this);
    _BODY_HMI_R2_AR_SpontanFlag = 1;
}
/*@@end*/

/*@@envVar:HMI_PW_Warn_Rq_FL:*/
on EnvVar HMI_PW_Warn_Rq_FL
{
    _mBODY_HMI_R2_AR.PW_Warn_Rq_FL.phys = getValue(this);
    _BODY_HMI_R2_AR_SpontanFlag = 1;
}
/*@@end*/

/*@@envVar:HMI_PW_Warn_Rq_FL_UB:*/
on EnvVar HMI_PW_Warn_Rq_FL_UB
{
    _mBODY_HMI_R2_AR.PW_Warn_Rq_FL_UB.phys = getValue(this);
    _BODY_HMI_R2_AR_SpontanFlag = 1;
}
/*@@end*/

/*@@envVar:HMI_PW_Warn_Rq_FR:*/
on EnvVar HMI_PW_Warn_Rq_FR
{
    _mBODY_HMI_R2_AR.PW_Warn_Rq_FR.phys = getValue(this);
    _BODY_HMI_R2_AR_SpontanFlag = 1;
}
/*@@end*/

/*@@envVar:HMI_PW_Warn_Rq_FR_UB:*/
on EnvVar HMI_PW_Warn_Rq_FR_UB
{
    _mBODY_HMI_R2_AR.PW_Warn_Rq_FR_UB.phys = getValue(this);
    _BODY_HMI_R2_AR_SpontanFlag = 1;
}
/*@@end*/

/*@@envVar:HMI_PW_Warn_Rq_RL:*/
on EnvVar HMI_PW_Warn_Rq_RL
{
    _mBODY_HMI_R2_AR.PW_Warn_Rq_RL.phys = getValue(this);
    _BODY_HMI_R2_AR_SpontanFlag = 1;
}
/*@@end*/

/*@@envVar:HMI_PW_Warn_Rq_RL_UB:*/
on EnvVar HMI_PW_Warn_Rq_RL_UB
{
    _mBODY_HMI_R2_AR.PW_Warn_Rq_RL_UB.phys = getValue(this);
    _BODY_HMI_R2_AR_SpontanFlag = 1;
}
/*@@end*/

/*@@envVar:HMI_PW_Warn_Rq_RR:*/
on EnvVar HMI_PW_Warn_Rq_RR
{
    _mBODY_HMI_R2_AR.PW_Warn_Rq_RR.phys = getValue(this);
    _BODY_HMI_R2_AR_SpontanFlag = 1;
}
/*@@end*/

/*@@envVar:HMI_PW_Warn_Rq_RR_UB:*/
on EnvVar HMI_PW_Warn_Rq_RR_UB
{
    _mBODY_HMI_R2_AR.PW_Warn_Rq_RR_UB.phys = getValue(this);
    _BODY_HMI_R2_AR_SpontanFlag = 1;
}
/*@@end*/

/*@@envVar:HMI_RoadsdCallSw_Stat:*/
on EnvVar HMI_RoadsdCallSw_Stat
{
    _mBODY_HMI_R2_AR.RoadsdCallSw_Stat.phys = getValue(this);
    _BODY_HMI_R2_AR_SpontanFlag = 1;
}
/*@@end*/

/*@@envVar:HMI_RoadsdCallSw_Stat_UB:*/
on EnvVar HMI_RoadsdCallSw_Stat_UB
{
    _mBODY_HMI_R2_AR.RoadsdCallSw_Stat_UB.phys = getValue(this);
    _BODY_HMI_R2_AR_SpontanFlag = 1;
}
/*@@end*/

/*@@envVar:HMI_RPC_SRB_Lt_Stat:*/
on EnvVar HMI_RPC_SRB_Lt_Stat
{
    _mBODY_HMI_R2_AR.RPC_SRB_Lt_Stat.phys = getValue(this);
    _BODY_HMI_R2_AR_SpontanFlag = 1;
}
/*@@end*/

/*@@envVar:HMI_RPC_SRB_Lt_Stat_UB:*/
on EnvVar HMI_RPC_SRB_Lt_Stat_UB
{
    _mBODY_HMI_R2_AR.RPC_SRB_Lt_Stat_UB.phys = getValue(this);
    _BODY_HMI_R2_AR_SpontanFlag = 1;
}
/*@@end*/

/*@@envVar:HMI_RPC_SRB_Rt_Stat:*/
on EnvVar HMI_RPC_SRB_Rt_Stat
{
    _mBODY_HMI_R2_AR.RPC_SRB_Rt_Stat.phys = getValue(this);
    _BODY_HMI_R2_AR_SpontanFlag = 1;
}
/*@@end*/

/*@@envVar:HMI_RPC_SRB_Rt_Stat_UB:*/
on EnvVar HMI_RPC_SRB_Rt_Stat_UB
{
    _mBODY_HMI_R2_AR.RPC_SRB_Rt_Stat_UB.phys = getValue(this);
    _BODY_HMI_R2_AR_SpontanFlag = 1;
}
/*@@end*/

/*@@envVar:HMI_ServCallSw_Stat:*/
on EnvVar HMI_ServCallSw_Stat
{
    _mBODY_HMI_R2_AR.ServCallSw_Stat.phys = getValue(this);
    _BODY_HMI_R2_AR_SpontanFlag = 1;
}
/*@@end*/

/*@@envVar:HMI_ServCallSw_Stat_UB:*/
on EnvVar HMI_ServCallSw_Stat_UB
{
    _mBODY_HMI_R2_AR.ServCallSw_Stat_UB.phys = getValue(this);
    _BODY_HMI_R2_AR_SpontanFlag = 1;
}
/*@@end*/

/*@@envVar:HMI_SOS_CallSw_Stat:*/
on EnvVar HMI_SOS_CallSw_Stat
{
    _mBODY_HMI_R2_AR.SOS_CallSw_Stat.phys = getValue(this);
    _BODY_HMI_R2_AR_SpontanFlag = 1;
}
/*@@end*/

/*@@envVar:HMI_SOS_CallSw_Stat_UB:*/
on EnvVar HMI_SOS_CallSw_Stat_UB
{
    _mBODY_HMI_R2_AR.SOS_CallSw_Stat_UB.phys = getValue(this);
    _BODY_HMI_R2_AR_SpontanFlag = 1;
}
/*@@end*/

/*@@caplFunc:BSM_Disp_Warn_Rq_AR_check_output():*/
BSM_Disp_Warn_Rq_AR_check_output()
{
    if( !getValue( HMI__STMSG_BSM_Disp_Warn_Rq_AR ) )
    {
        // Botschaft BSM_Disp_Warn_Rq_AR ID: 1049 --- Sendeart 5 cyclicAndSpontanWithDelay --- 
        if( _BSM_Disp_Warn_Rq_AR_DelayCnt > 0) _BSM_Disp_Warn_Rq_AR_DelayCnt--; // Mindestsendeabstand
        _BSM_Disp_Warn_Rq_AR_Cnt--;
        if( _BSM_Disp_Warn_Rq_AR_Cnt < 1 )
        {
            if( _BSM_Disp_Warn_Rq_AR_DelayCnt < 1 )
            {
                BSM_Disp_Warn_Rq_AR_output(); // Nachricht wg. abgelaufenem Zyklus ausgeben (Mindestsendeabstand eingehalten)
                _BSM_Disp_Warn_Rq_AR_SpontanFlag = 0; // Spontan-Flag zurücksetzen
                _BSM_Disp_Warn_Rq_AR_DelayCnt = _BSM_Disp_Warn_Rq_AR_MinDelay;
            }
            else
            {
                // Spontanflag setzen damit nach Ablauf Mindestsendeabstand gesendet wird
                 _BSM_Disp_Warn_Rq_AR_SpontanFlag = 1;
            }
            _BSM_Disp_Warn_Rq_AR_Cnt = _BSM_Disp_Warn_Rq_AR_CycleCount; // Zyklus-Zähler zurücksetzen
        }
        else if( _BSM_Disp_Warn_Rq_AR_SpontanFlag)
        {
            if( _BSM_Disp_Warn_Rq_AR_DelayCnt < 1 )
            {
                BSM_Disp_Warn_Rq_AR_output(); // Nachricht wg. spontaner Änderung ausgeben (Mindestsendeabstand eingehalten)
                _BSM_Disp_Warn_Rq_AR_SpontanFlag = 0; // Spontan-Flag zurücksetzen
                _BSM_Disp_Warn_Rq_AR_DelayCnt = _BSM_Disp_Warn_Rq_AR_MinDelay;
            }
        }
    }
}
/*@@end*/

/*@@caplFunc:BSM_Disp_Warn_Rq_AR_init():*/
BSM_Disp_Warn_Rq_AR_init()
{   /* Botschaft BSM_Disp_Warn_Rq_AR ID: 1049 --- Sendeart 5 cyclicAndSpontanWithDelay --- 
BA_ "ApplMessage" BO_ 1049 0;
BA_ "NmAsrMessage" BO_ 1049 0;
BA_ "GenMsgMinAcceptLength" BO_ 1049 8;
BA_ "GenMsgILSupport" BO_ 1049 1;
BA_ "DiagState" BO_ 1049 0;
BA_ "DiagRequest" BO_ 1049 0;
BA_ "DiagResponse" BO_ 1049 0;
BA_ "GenMsgStartValue" BO_ 1049 "0";
BA_ "GenMsgDelayTime" BO_ 1049 20;
BA_ "GenMsgNrOfRepetitions" BO_ 1049 0;
BA_ "GenMsgCycleTime" BO_ 1049 200;
BA_ "GenMsgSendType" BO_ 1049 5;
    */
    _BSM_Disp_Warn_Rq_AR_Timebase =             c_tDBKomTimer_20ms;
    _BSM_Disp_Warn_Rq_AR_CycleCount =          200 / _BSM_Disp_Warn_Rq_AR_Timebase;
    _BSM_Disp_Warn_Rq_AR_StartDelay =            0 / _BSM_Disp_Warn_Rq_AR_Timebase;
    _BSM_Disp_Warn_Rq_AR_MinDelay =             20 / _BSM_Disp_Warn_Rq_AR_Timebase;
    _BSM_Disp_Warn_Rq_AR_Cnt = _BSM_Disp_Warn_Rq_AR_StartDelay;
    _BSM_Disp_Warn_Rq_AR_SpontanFlag = 0;
    _BSM_Disp_Warn_Rq_AR_DelayCnt = 0;

    putValue( HMI__STMSGSD_BSM_Disp_Warn_Rq_AR, _BSM_Disp_Warn_Rq_AR_StartDelay * _BSM_Disp_Warn_Rq_AR_Timebase );
    
    _BSM_Disp_Warn_Rq_AR_Cnt = 1;
    _BSM_Disp_Warn_Rq_AR_SpontanFlag = 0;
    _mBSM_Disp_Warn_Rq_AR.BSM_AcustWarn_Lt_Rq.phys = getValue( HMI_BSM_AcustWarn_Lt_Rq );
    _mBSM_Disp_Warn_Rq_AR.BSM_AcustWarn_Rq.phys = getValue( HMI_BSM_AcustWarn_Rq );
    _mBSM_Disp_Warn_Rq_AR.BSM_AcustWarn_Rt_Rq.phys = getValue( HMI_BSM_AcustWarn_Rt_Rq );
    _mBSM_Disp_Warn_Rq_AR.BSM_MsgDisp_Rq.phys = getValue( HMI_BSM_MsgDisp_Rq );
    _mBSM_Disp_Warn_Rq_AR.BSM_ObjCls_Lt_Dist_Y.phys = getValue( HMI_BSM_ObjCls_Lt_Dist_Y );
    _mBSM_Disp_Warn_Rq_AR.BSM_ObjCls_Lt_Type.phys = getValue( HMI_BSM_ObjCls_Lt_Type );
    _mBSM_Disp_Warn_Rq_AR.BSM_ObjCls_Rt_Dist_Y.phys = getValue( HMI_BSM_ObjCls_Rt_Dist_Y );
    _mBSM_Disp_Warn_Rq_AR.BSM_ObjCls_Rt_Type.phys = getValue( HMI_BSM_ObjCls_Rt_Type );
    _mBSM_Disp_Warn_Rq_AR.BSM_ObjCls_Stat_UB.phys = getValue( HMI_BSM_ObjCls_Stat_UB );
    _mBSM_Disp_Warn_Rq_AR.BSM_Stat.phys = getValue( HMI_BSM_Stat );
    _mBSM_Disp_Warn_Rq_AR.BSM_Warn_Lt_Rq.phys = getValue( HMI_BSM_Warn_Lt_Rq );
    _mBSM_Disp_Warn_Rq_AR.BSM_Warn_Rt_Rq.phys = getValue( HMI_BSM_Warn_Rt_Rq );
    _mBSM_Disp_Warn_Rq_AR.CTA_Brk_Rq.phys = getValue( HMI_CTA_Brk_Rq );
    _mBSM_Disp_Warn_Rq_AR.CTA_Stat.phys = getValue( HMI_CTA_Stat );
    _mBSM_Disp_Warn_Rq_AR.CTA_Warn_Lt_Rq.phys = getValue( HMI_CTA_Warn_Lt_Rq );
    _mBSM_Disp_Warn_Rq_AR.CTA_Warn_Rt_Rq.phys = getValue( HMI_CTA_Warn_Rt_Rq );
    _mBSM_Disp_Warn_Rq_AR.CTA_Rq_UB.phys = getValue( HMI_CTA_Rq_UB );
    _mBSM_Disp_Warn_Rq_AR.LCMS_Beep_Rq.phys = getValue( HMI_LCMS_Beep_Rq );
    _mBSM_Disp_Warn_Rq_AR.LCMS_BrkMsgDisp_Rq.phys = getValue( HMI_LCMS_BrkMsgDisp_Rq );
    _mBSM_Disp_Warn_Rq_AR.LCMS_MsgDisp_Rq.phys = getValue( HMI_LCMS_MsgDisp_Rq );
}
/*@@end*/

/*@@caplFunc:BSM_Disp_Warn_Rq_AR_output():*/
BSM_Disp_Warn_Rq_AR_output(void)
{
    output( _mBSM_Disp_Warn_Rq_AR );
}
/*@@end*/

/*@@caplFunc:BSM_Disp_Warn_Rq_AR_saveEnvVars(dword):*/
BSM_Disp_Warn_Rq_AR_saveEnvVars( dword hFile )
{
    filePutString("\n// Knoten EIS: BSM_Disp_Warn_Rq_AR\n", 31, hFile );
    snprintf( buffer, elcount( buffer ), "0.0000 HMI__STMSG_BSM_Disp_Warn_Rq_AR := %X\n", getValue( HMI__STMSG_BSM_Disp_Warn_Rq_AR ) );    filePutString ( buffer, elcount( buffer ), hFile );
    snprintf( buffer, elcount( buffer ), "0.0000 HMI__STMSGT_BSM_Disp_Warn_Rq_AR := %X\n", getValue( HMI__STMSGT_BSM_Disp_Warn_Rq_AR ) );    filePutString ( buffer, elcount( buffer ), hFile );
    snprintf( buffer, elcount( buffer ), "0.0000 HMI_BSM_AcustWarn_Lt_Rq := %X\n", getValue( HMI_BSM_AcustWarn_Lt_Rq ) );    filePutString ( buffer, elcount( buffer ), hFile );
    snprintf( buffer, elcount( buffer ), "0.0000 HMI_BSM_AcustWarn_Rq := %X\n", getValue( HMI_BSM_AcustWarn_Rq ) );    filePutString ( buffer, elcount( buffer ), hFile );
    snprintf( buffer, elcount( buffer ), "0.0000 HMI_BSM_AcustWarn_Rt_Rq := %X\n", getValue( HMI_BSM_AcustWarn_Rt_Rq ) );    filePutString ( buffer, elcount( buffer ), hFile );
    snprintf( buffer, elcount( buffer ), "0.0000 HMI_BSM_MsgDisp_Rq := %X\n", getValue( HMI_BSM_MsgDisp_Rq ) );    filePutString ( buffer, elcount( buffer ), hFile );
    snprintf( buffer, elcount( buffer ), "0.0000 HMI_BSM_ObjCls_Lt_Dist_Y := %X\n", getValue( HMI_BSM_ObjCls_Lt_Dist_Y ) );    filePutString ( buffer, elcount( buffer ), hFile );
    snprintf( buffer, elcount( buffer ), "0.0000 HMI_BSM_ObjCls_Lt_Type := %X\n", getValue( HMI_BSM_ObjCls_Lt_Type ) );    filePutString ( buffer, elcount( buffer ), hFile );
    snprintf( buffer, elcount( buffer ), "0.0000 HMI_BSM_ObjCls_Rt_Dist_Y := %X\n", getValue( HMI_BSM_ObjCls_Rt_Dist_Y ) );    filePutString ( buffer, elcount( buffer ), hFile );
    snprintf( buffer, elcount( buffer ), "0.0000 HMI_BSM_ObjCls_Rt_Type := %X\n", getValue( HMI_BSM_ObjCls_Rt_Type ) );    filePutString ( buffer, elcount( buffer ), hFile );
    snprintf( buffer, elcount( buffer ), "0.0000 HMI_BSM_ObjCls_Stat_UB := %X\n", getValue( HMI_BSM_ObjCls_Stat_UB ) );    filePutString ( buffer, elcount( buffer ), hFile );
    snprintf( buffer, elcount( buffer ), "0.0000 HMI_BSM_Stat := %X\n", getValue( HMI_BSM_Stat ) );    filePutString ( buffer, elcount( buffer ), hFile );
    snprintf( buffer, elcount( buffer ), "0.0000 HMI_BSM_Warn_Lt_Rq := %X\n", getValue( HMI_BSM_Warn_Lt_Rq ) );    filePutString ( buffer, elcount( buffer ), hFile );
    snprintf( buffer, elcount( buffer ), "0.0000 HMI_BSM_Warn_Rt_Rq := %X\n", getValue( HMI_BSM_Warn_Rt_Rq ) );    filePutString ( buffer, elcount( buffer ), hFile );
    snprintf( buffer, elcount( buffer ), "0.0000 HMI_CTA_Brk_Rq := %X\n", getValue( HMI_CTA_Brk_Rq ) );    filePutString ( buffer, elcount( buffer ), hFile );
    snprintf( buffer, elcount( buffer ), "0.0000 HMI_CTA_Stat := %X\n", getValue( HMI_CTA_Stat ) );    filePutString ( buffer, elcount( buffer ), hFile );
    snprintf( buffer, elcount( buffer ), "0.0000 HMI_CTA_Warn_Lt_Rq := %X\n", getValue( HMI_CTA_Warn_Lt_Rq ) );    filePutString ( buffer, elcount( buffer ), hFile );
    snprintf( buffer, elcount( buffer ), "0.0000 HMI_CTA_Warn_Rt_Rq := %X\n", getValue( HMI_CTA_Warn_Rt_Rq ) );    filePutString ( buffer, elcount( buffer ), hFile );
    snprintf( buffer, elcount( buffer ), "0.0000 HMI_CTA_Rq_UB := %X\n", getValue( HMI_CTA_Rq_UB ) );    filePutString ( buffer, elcount( buffer ), hFile );
    snprintf( buffer, elcount( buffer ), "0.0000 HMI_LCMS_Beep_Rq := %X\n", getValue( HMI_LCMS_Beep_Rq ) );    filePutString ( buffer, elcount( buffer ), hFile );
    snprintf( buffer, elcount( buffer ), "0.0000 HMI_LCMS_BrkMsgDisp_Rq := %X\n", getValue( HMI_LCMS_BrkMsgDisp_Rq ) );    filePutString ( buffer, elcount( buffer ), hFile );
    snprintf( buffer, elcount( buffer ), "0.0000 HMI_LCMS_MsgDisp_Rq := %X\n", getValue( HMI_LCMS_MsgDisp_Rq ) );    filePutString ( buffer, elcount( buffer ), hFile );
}
/*@@end*/

/*@@timer:_tBSM_Disp_Warn_Rq_AR:*/
on timer _tBSM_Disp_Warn_Rq_AR
{
    putValue( HMI__STMSG_BSM_Disp_Warn_Rq_AR, 0 );
}
/*@@end*/

/*@@envVar:HMI__STMSG_BSM_Disp_Warn_Rq_AR:*/
on EnvVar HMI__STMSG_BSM_Disp_Warn_Rq_AR
{
    long tDelay;
    if( getValue( this ) == 2 )
    {
        tDelay = getValue( HMI__STMSGT_BSM_Disp_Warn_Rq_AR );
        if( tDelay > 0)    
            setTimer( _tBSM_Disp_Warn_Rq_AR, tDelay );
        else
            putValue( HMI__STMSG_BSM_Disp_Warn_Rq_AR, 0 );
    }
}
/*@@end*/

/*@@envVar:HMI_BSM_AcustWarn_Lt_Rq:*/
on EnvVar HMI_BSM_AcustWarn_Lt_Rq
{
    _mBSM_Disp_Warn_Rq_AR.BSM_AcustWarn_Lt_Rq.phys = getValue(this);
    _BSM_Disp_Warn_Rq_AR_SpontanFlag = 1;
}
/*@@end*/

/*@@envVar:HMI_BSM_AcustWarn_Rq:*/
on EnvVar HMI_BSM_AcustWarn_Rq
{
    _mBSM_Disp_Warn_Rq_AR.BSM_AcustWarn_Rq.phys = getValue(this);
    _BSM_Disp_Warn_Rq_AR_SpontanFlag = 1;
}
/*@@end*/

/*@@envVar:HMI_BSM_AcustWarn_Rt_Rq:*/
on EnvVar HMI_BSM_AcustWarn_Rt_Rq
{
    _mBSM_Disp_Warn_Rq_AR.BSM_AcustWarn_Rt_Rq.phys = getValue(this);
    _BSM_Disp_Warn_Rq_AR_SpontanFlag = 1;
}
/*@@end*/

/*@@envVar:HMI_BSM_MsgDisp_Rq:*/
on EnvVar HMI_BSM_MsgDisp_Rq
{
    _mBSM_Disp_Warn_Rq_AR.BSM_MsgDisp_Rq.phys = getValue(this);
    _BSM_Disp_Warn_Rq_AR_SpontanFlag = 1;
}
/*@@end*/

/*@@envVar:HMI_BSM_ObjCls_Lt_Dist_Y:*/
on EnvVar HMI_BSM_ObjCls_Lt_Dist_Y
{
    _mBSM_Disp_Warn_Rq_AR.BSM_ObjCls_Lt_Dist_Y.phys = getValue(this);
    _BSM_Disp_Warn_Rq_AR_SpontanFlag = 1;
}
/*@@end*/

/*@@envVar:HMI_BSM_ObjCls_Lt_Type:*/
on EnvVar HMI_BSM_ObjCls_Lt_Type
{
    _mBSM_Disp_Warn_Rq_AR.BSM_ObjCls_Lt_Type.phys = getValue(this);
    _BSM_Disp_Warn_Rq_AR_SpontanFlag = 1;
}
/*@@end*/

/*@@envVar:HMI_BSM_ObjCls_Rt_Dist_Y:*/
on EnvVar HMI_BSM_ObjCls_Rt_Dist_Y
{
    _mBSM_Disp_Warn_Rq_AR.BSM_ObjCls_Rt_Dist_Y.phys = getValue(this);
    _BSM_Disp_Warn_Rq_AR_SpontanFlag = 1;
}
/*@@end*/

/*@@envVar:HMI_BSM_ObjCls_Rt_Type:*/
on EnvVar HMI_BSM_ObjCls_Rt_Type
{
    _mBSM_Disp_Warn_Rq_AR.BSM_ObjCls_Rt_Type.phys = getValue(this);
    _BSM_Disp_Warn_Rq_AR_SpontanFlag = 1;
}
/*@@end*/

/*@@envVar:HMI_BSM_ObjCls_Stat_UB:*/
on EnvVar HMI_BSM_ObjCls_Stat_UB
{
    _mBSM_Disp_Warn_Rq_AR.BSM_ObjCls_Stat_UB.phys = getValue(this);
    _BSM_Disp_Warn_Rq_AR_SpontanFlag = 1;
}
/*@@end*/

/*@@envVar:HMI_BSM_Stat:*/
on EnvVar HMI_BSM_Stat
{
    _mBSM_Disp_Warn_Rq_AR.BSM_Stat.phys = getValue(this);
    _BSM_Disp_Warn_Rq_AR_SpontanFlag = 1;
}
/*@@end*/

/*@@envVar:HMI_BSM_Warn_Lt_Rq:*/
on EnvVar HMI_BSM_Warn_Lt_Rq
{
    _mBSM_Disp_Warn_Rq_AR.BSM_Warn_Lt_Rq.phys = getValue(this);
    _BSM_Disp_Warn_Rq_AR_SpontanFlag = 1;
}
/*@@end*/

/*@@envVar:HMI_BSM_Warn_Rt_Rq:*/
on EnvVar HMI_BSM_Warn_Rt_Rq
{
    _mBSM_Disp_Warn_Rq_AR.BSM_Warn_Rt_Rq.phys = getValue(this);
    _BSM_Disp_Warn_Rq_AR_SpontanFlag = 1;
}
/*@@end*/

/*@@envVar:HMI_CTA_Brk_Rq:*/
on EnvVar HMI_CTA_Brk_Rq
{
    _mBSM_Disp_Warn_Rq_AR.CTA_Brk_Rq.phys = getValue(this);
    _BSM_Disp_Warn_Rq_AR_SpontanFlag = 1;
}
/*@@end*/

/*@@envVar:HMI_CTA_Stat:*/
on EnvVar HMI_CTA_Stat
{
    _mBSM_Disp_Warn_Rq_AR.CTA_Stat.phys = getValue(this);
    _BSM_Disp_Warn_Rq_AR_SpontanFlag = 1;
}
/*@@end*/

/*@@envVar:HMI_CTA_Warn_Lt_Rq:*/
on EnvVar HMI_CTA_Warn_Lt_Rq
{
    _mBSM_Disp_Warn_Rq_AR.CTA_Warn_Lt_Rq.phys = getValue(this);
    _BSM_Disp_Warn_Rq_AR_SpontanFlag = 1;
}
/*@@end*/

/*@@envVar:HMI_CTA_Warn_Rt_Rq:*/
on EnvVar HMI_CTA_Warn_Rt_Rq
{
    _mBSM_Disp_Warn_Rq_AR.CTA_Warn_Rt_Rq.phys = getValue(this);
    _BSM_Disp_Warn_Rq_AR_SpontanFlag = 1;
}
/*@@end*/

/*@@envVar:HMI_CTA_Rq_UB:*/
on EnvVar HMI_CTA_Rq_UB
{
    _mBSM_Disp_Warn_Rq_AR.CTA_Rq_UB.phys = getValue(this);
    _BSM_Disp_Warn_Rq_AR_SpontanFlag = 1;
}
/*@@end*/

/*@@envVar:HMI_LCMS_Beep_Rq:*/
on EnvVar HMI_LCMS_Beep_Rq
{
    _mBSM_Disp_Warn_Rq_AR.LCMS_Beep_Rq.phys = getValue(this);
    _BSM_Disp_Warn_Rq_AR_SpontanFlag = 1;
}
/*@@end*/

/*@@envVar:HMI_LCMS_BrkMsgDisp_Rq:*/
on EnvVar HMI_LCMS_BrkMsgDisp_Rq
{
    _mBSM_Disp_Warn_Rq_AR.LCMS_BrkMsgDisp_Rq.phys = getValue(this);
    _BSM_Disp_Warn_Rq_AR_SpontanFlag = 1;
}
/*@@end*/

/*@@envVar:HMI_LCMS_MsgDisp_Rq:*/
on EnvVar HMI_LCMS_MsgDisp_Rq
{
    _mBSM_Disp_Warn_Rq_AR.LCMS_MsgDisp_Rq.phys = getValue(this);
    _BSM_Disp_Warn_Rq_AR_SpontanFlag = 1;
}
/*@@end*/

/*@@caplFunc:CamLane_Disp_Warn_Rq_AR_check_output():*/
CamLane_Disp_Warn_Rq_AR_check_output()
{
    if( !getValue( HMI__STMSG_CamLane_Disp_Warn_Rq_AR ) )
    {
        // Botschaft CamLane_Disp_Warn_Rq_AR ID: 1035 --- Sendeart 5 cyclicAndSpontanWithDelay --- 
        if( _CamLane_Disp_Warn_Rq_AR_DelayCnt > 0) _CamLane_Disp_Warn_Rq_AR_DelayCnt--; // Mindestsendeabstand
        _CamLane_Disp_Warn_Rq_AR_Cnt--;
        if( _CamLane_Disp_Warn_Rq_AR_Cnt < 1 )
        {
            if( _CamLane_Disp_Warn_Rq_AR_DelayCnt < 1 )
            {
                // Nachricht wg. abgelaufenem Zyklus ausgeben (Mindestsendeabstand eingehalten)
                CamLane_Disp_Warn_Rq_AR_output();
                 _CamLane_Disp_Warn_Rq_AR_SpontanFlag = 0; // Spontan-Flag zurücksetzen
                _CamLane_Disp_Warn_Rq_AR_DelayCnt = _CamLane_Disp_Warn_Rq_AR_MinDelay;
            }
            else
            {
                // Spontanflag setzen damit nach Ablauf Mindestsendeabstand gesendet wird
                 _CamLane_Disp_Warn_Rq_AR_SpontanFlag = 1;
            }
            _CamLane_Disp_Warn_Rq_AR_Cnt = _CamLane_Disp_Warn_Rq_AR_CycleCount; // Zyklus-Zähler zurücksetzen
        }
        else if( _CamLane_Disp_Warn_Rq_AR_SpontanFlag)
        {
            if( _CamLane_Disp_Warn_Rq_AR_DelayCnt < 1 )
            {
                // Nachricht wg. spontaner Änderung ausgeben (Mindestsendeabstand eingehalten)
                CamLane_Disp_Warn_Rq_AR_output();
                _CamLane_Disp_Warn_Rq_AR_SpontanFlag = 0; // Spontan-Flag zurücksetzen
                _CamLane_Disp_Warn_Rq_AR_DelayCnt = _CamLane_Disp_Warn_Rq_AR_MinDelay;
            }
        }
    }
}
/*@@end*/

/*@@caplFunc:CamLane_Disp_Warn_Rq_AR_init():*/
CamLane_Disp_Warn_Rq_AR_init()
{   /* Botschaft CamLane_Disp_Warn_Rq_AR  ID: 1035 --- Sendeart 5 cyclicAndSpontanWithDelay --- 
BA_ "ApplMessage" BO_ 1035 0;
BA_ "NmAsrMessage" BO_ 1035 0;
BA_ "GenMsgMinAcceptLength" BO_ 1035 8;
BA_ "GenMsgILSupport" BO_ 1035 1;
BA_ "DiagState" BO_ 1035 0;
BA_ "DiagRequest" BO_ 1035 0;
BA_ "DiagResponse" BO_ 1035 0;
BA_ "GenMsgStartValue" BO_ 1035 "0";
BA_ "GenMsgDelayTime" BO_ 1035 40;
BA_ "GenMsgNrOfRepetitions" BO_ 1035 0;
BA_ "GenMsgCycleTime" BO_ 1035 160;
BA_ "GenMsgSendType" BO_ 1035 5;
    */
    _CamLane_Disp_Warn_Rq_AR_Timebase =             c_tDBKomTimer_20ms;
    _CamLane_Disp_Warn_Rq_AR_CycleCount =          160 / _CamLane_Disp_Warn_Rq_AR_Timebase;
    _CamLane_Disp_Warn_Rq_AR_StartDelay =            0 / _CamLane_Disp_Warn_Rq_AR_Timebase;
    _CamLane_Disp_Warn_Rq_AR_MinDelay =             40 / _CamLane_Disp_Warn_Rq_AR_Timebase;
    _CamLane_Disp_Warn_Rq_AR_Cnt = _CamLane_Disp_Warn_Rq_AR_StartDelay;
    _CamLane_Disp_Warn_Rq_AR_SpontanFlag = 0;
    _CamLane_Disp_Warn_Rq_AR_DelayCnt = 0;

    putValue( HMI__STMSGSD_CamLane_Disp_Warn_Rq_AR, _CamLane_Disp_Warn_Rq_AR_StartDelay * _CamLane_Disp_Warn_Rq_AR_Timebase);
    
    _mCamLane_Disp_Warn_Rq_AR.CrossWalk_Dist.phys = getValue( HMI_CrossWalk_Dist );
    _mCamLane_Disp_Warn_Rq_AR.CrossWalk_Stat.phys = getValue( HMI_CrossWalk_Stat );
    _mCamLane_Disp_Warn_Rq_AR.LDP_IndLmp_SwLED_HU_Rq_MPC.phys = getValue( HMI_LDP_IndLmp_SwLED_HU_Rq_MPC );
    _mCamLane_Disp_Warn_Rq_AR.LDP_MPC_Md_Stat.phys = getValue( HMI_LDP_MPC_Md_Stat );
    _mCamLane_Disp_Warn_Rq_AR.LDP_MPC_MsgDisp_Rq.phys = getValue( HMI_LDP_MPC_MsgDisp_Rq );
    _mCamLane_Disp_Warn_Rq_AR.PavemntSign_LtrlDist_EgoLane.phys = getValue( HMI_PavemntSign_LtrlDist_EgoLane );
    _mCamLane_Disp_Warn_Rq_AR.PavemntSign_LtrlDist_NghbrLane.phys = getValue( HMI_PavemntSign_LtrlDist_NghbrLane );
    _mCamLane_Disp_Warn_Rq_AR.PavemntSign_Type_EgoLane.phys = getValue( HMI_PavemntSign_Type_EgoLane );
    _mCamLane_Disp_Warn_Rq_AR.PavemntSign_Type_NghbrLane.phys = getValue( HMI_PavemntSign_Type_NghbrLane );
    _mCamLane_Disp_Warn_Rq_AR.Rsrv2_CamLane_Disp_Warn_Rq.phys = getValue( HMI_Rsrv2_CamLane_Disp_Warn_Rq );
    _mCamLane_Disp_Warn_Rq_AR.Rsrv3_CamLane_Disp_Warn_Rq.phys = getValue( HMI_Rsrv3_CamLane_Disp_Warn_Rq );
    _mCamLane_Disp_Warn_Rq_AR.Rsrv4_CamLane_Disp_Warn_Rq.phys = getValue( HMI_Rsrv4_CamLane_Disp_Warn_Rq );
}
/*@@end*/

/*@@caplFunc:CamLane_Disp_Warn_Rq_AR_output():*/
void CamLane_Disp_Warn_Rq_AR_output(void)
{
    byte crc;
    byte SQC_help;

    if( !getValue( HMI_SQC_CamLane_Disp_Warn_Rq_Auto ) )
    {
        // berechne message counter
        SQC_help = getValue( HMI_SQC_CamLane_Disp_Warn_Rq );
        if( SQC_help >= 15 ) SQC_help = 0;
        else SQC_help++;
        putValue( HMI_SQC_CamLane_Disp_Warn_Rq, SQC_help );
        _mCamLane_Disp_Warn_Rq_AR.SQC_CamLane_Disp_Warn_Rq = SQC_help;
    }
    else
          _mCamLane_Disp_Warn_Rq_AR.SQC_CamLane_Disp_Warn_Rq = getValue( HMI_SQC_CamLane_Disp_Warn_Rq );

    if( getValue( HMI_CRC_CamLane_Disp_Warn_Rq_Profile_02 ) )
    {
        if( !getValue( HMI_CRC_CamLane_Disp_Warn_Rq_Auto ) )
        {   // CRC according Profile_02 ( W213 )
            // berechne crc
            crc = 0xFF;
//            crc = crctable_profile02[crc ^ _mCamLane_Disp_Warn_Rq_AR.byte( 0 )];  CRC
            crc = crctable_profile02[crc ^ _mCamLane_Disp_Warn_Rq_AR.byte( 1 )];
            crc = crctable_profile02[crc ^ _mCamLane_Disp_Warn_Rq_AR.byte( 2 )];
            crc = crctable_profile02[crc ^ _mCamLane_Disp_Warn_Rq_AR.byte( 3 )];
            crc = crctable_profile02[crc ^ _mCamLane_Disp_Warn_Rq_AR.byte( 4 )];
            crc = crctable_profile02[crc ^ _mCamLane_Disp_Warn_Rq_AR.byte( 5 )];
            crc = crctable_profile02[crc ^ _mCamLane_Disp_Warn_Rq_AR.byte( 6 )];
            crc = crctable_profile02[crc ^ _mCamLane_Disp_Warn_Rq_AR.byte( 7 )];
            crc = crctable_profile02[crc ^ _CamLane_Disp_Warn_Rq_AR_CRC_Offset[ _mCamLane_Disp_Warn_Rq_AR.SQC_CamLane_Disp_Warn_Rq ] ]; // load offset
            crc = (crc ^ 0xFF);
            if( getValue(  HMI_CRC_CamLane_Disp_Warn_Rq_Invalid ) )
                crc++;
            _mCamLane_Disp_Warn_Rq_AR.CRC_CamLane_Disp_Warn_Rq = crc;
            putValue( HMI_CRC_CamLane_Disp_Warn_Rq, crc );
        }
        else
            _mCamLane_Disp_Warn_Rq_AR.CRC_CamLane_Disp_Warn_Rq = getValue( HMI_CRC_CamLane_Disp_Warn_Rq );
    }
    else
    {
        if( !getValue( HMI_CRC_CamLane_Disp_Warn_Rq_Auto ) )
        {   // CRC according to SAE1850 ( W222 )
            // berechne crc
            crc = 0xFF;
//            crc = crctable[crc ^ _mCamLane_Disp_Warn_Rq_AR.byte( 0 )];  CRC
            crc = crctable[crc ^ _mCamLane_Disp_Warn_Rq_AR.byte( 1 )];
            crc = crctable[crc ^ _mCamLane_Disp_Warn_Rq_AR.byte( 2 )];
            crc = crctable[crc ^ _mCamLane_Disp_Warn_Rq_AR.byte( 3 )];
            crc = crctable[crc ^ _mCamLane_Disp_Warn_Rq_AR.byte( 4 )];
            crc = crctable[crc ^ _mCamLane_Disp_Warn_Rq_AR.byte( 5 )];
            crc = crctable[crc ^ _mCamLane_Disp_Warn_Rq_AR.byte( 6 )];
            crc = crctable[crc ^ _mCamLane_Disp_Warn_Rq_AR.byte( 7 )];
            crc = (crc ^ 0xFF);
            if( getValue(  HMI_CRC_CamLane_Disp_Warn_Rq_Invalid ) )
                crc++;
            _mCamLane_Disp_Warn_Rq_AR.CRC_CamLane_Disp_Warn_Rq = crc;
            putValue( HMI_CRC_CamLane_Disp_Warn_Rq, crc );
        }
        else
            _mCamLane_Disp_Warn_Rq_AR.CRC_CamLane_Disp_Warn_Rq = getValue( HMI_CRC_CamLane_Disp_Warn_Rq );
    }
    output( _mCamLane_Disp_Warn_Rq_AR );
}
/*@@end*/

/*@@caplFunc:CamLane_Disp_Warn_Rq_AR_saveEnvVars(dword):*/
CamLane_Disp_Warn_Rq_AR_saveEnvVars( dword hFile )
{
    filePutString("\n// Knoten EIS: CamLane_Disp_Warn_Rq_AR\n", 31, hFile );
    snprintf( buffer, elcount( buffer ), "0.0000 HMI__STMSG_CamLane_Disp_Warn_Rq_AR := %X\n", getValue( HMI__STMSG_CamLane_Disp_Warn_Rq_AR ) );    filePutString ( buffer, elcount( buffer ), hFile );
    snprintf( buffer, elcount( buffer ), "0.0000 HMI__STMSGT_CamLane_Disp_Warn_Rq_AR := %X\n", getValue( HMI__STMSGT_CamLane_Disp_Warn_Rq_AR ) );    filePutString ( buffer, elcount( buffer ), hFile );
    snprintf( buffer, elcount( buffer ), "0.0000 HMI_CRC_CamLane_Disp_Warn_Rq := %X\n", getValue( HMI_CRC_CamLane_Disp_Warn_Rq ) );    filePutString ( buffer, elcount( buffer ), hFile );
    snprintf( buffer, elcount( buffer ), "0.0000 HMI_CRC_CamLane_Disp_Warn_Rq_Auto := %X\n", getValue( HMI_CRC_CamLane_Disp_Warn_Rq_Auto ) );    filePutString ( buffer, elcount( buffer ), hFile );
    snprintf( buffer, elcount( buffer ), "0.0000 HMI_CRC_CamLane_Disp_Warn_Rq_Profile_02 := %X\n", getValue( HMI_CRC_CamLane_Disp_Warn_Rq_Profile_02 ) );    filePutString ( buffer, elcount( buffer ), hFile );
    snprintf( buffer, elcount( buffer ), "0.0000 HMI_CrossWalk_Dist := %X\n", getValue( HMI_CrossWalk_Dist ) );    filePutString ( buffer, elcount( buffer ), hFile );
    snprintf( buffer, elcount( buffer ), "0.0000 HMI_CrossWalk_Stat := %X\n", getValue( HMI_CrossWalk_Stat ) );    filePutString ( buffer, elcount( buffer ), hFile );
    snprintf( buffer, elcount( buffer ), "0.0000 HMI_LDP_IndLmp_SwLED_HU_Rq_MPC := %X\n", getValue( HMI_LDP_IndLmp_SwLED_HU_Rq_MPC ) );    filePutString ( buffer, elcount( buffer ), hFile );
    snprintf( buffer, elcount( buffer ), "0.0000 HMI_LDP_MPC_Md_Stat := %X\n", getValue( HMI_LDP_MPC_Md_Stat ) );    filePutString ( buffer, elcount( buffer ), hFile );
    snprintf( buffer, elcount( buffer ), "0.0000 HMI_LDP_MPC_MsgDisp_Rq := %X\n", getValue( HMI_LDP_MPC_MsgDisp_Rq ) );    filePutString ( buffer, elcount( buffer ), hFile );
    snprintf( buffer, elcount( buffer ), "0.0000 HMI_PavemntSign_LtrlDist_EgoLane := %X\n", getValue( HMI_PavemntSign_LtrlDist_EgoLane ) );    filePutString ( buffer, elcount( buffer ), hFile );
    snprintf( buffer, elcount( buffer ), "0.0000 HMI_PavemntSign_LtrlDist_NghbrLane := %X\n", getValue( HMI_PavemntSign_LtrlDist_NghbrLane ) );    filePutString ( buffer, elcount( buffer ), hFile );
    snprintf( buffer, elcount( buffer ), "0.0000 HMI_PavemntSign_Type_EgoLane := %X\n", getValue( HMI_PavemntSign_Type_EgoLane ) );    filePutString ( buffer, elcount( buffer ), hFile );
    snprintf( buffer, elcount( buffer ), "0.0000 HMI_PavemntSign_Type_NghbrLane := %X\n", getValue( HMI_PavemntSign_Type_NghbrLane ) );    filePutString ( buffer, elcount( buffer ), hFile );
    snprintf( buffer, elcount( buffer ), "0.0000 HMI_Rsrv2_CamLane_Disp_Warn_Rq := %X\n", getValue( HMI_Rsrv2_CamLane_Disp_Warn_Rq ) );    filePutString ( buffer, elcount( buffer ), hFile );
    snprintf( buffer, elcount( buffer ), "0.0000 HMI_Rsrv3_CamLane_Disp_Warn_Rq := %X\n", getValue( HMI_Rsrv3_CamLane_Disp_Warn_Rq ) );    filePutString ( buffer, elcount( buffer ), hFile );
    snprintf( buffer, elcount( buffer ), "0.0000 HMI_Rsrv4_CamLane_Disp_Warn_Rq := %X\n", getValue( HMI_Rsrv4_CamLane_Disp_Warn_Rq ) );    filePutString ( buffer, elcount( buffer ), hFile );
    snprintf( buffer, elcount( buffer ), "0.0000 HMI_SQC_CamLane_Disp_Warn_Rq := %X\n", getValue( HMI_SQC_CamLane_Disp_Warn_Rq ) );    filePutString ( buffer, elcount( buffer ), hFile );
    snprintf( buffer, elcount( buffer ), "0.0000 HMI_SQC_CamLane_Disp_Warn_Rq_Auto := %X\n", getValue( HMI_SQC_CamLane_Disp_Warn_Rq_Auto ) );    filePutString ( buffer, elcount( buffer ), hFile );
}
/*@@end*/

/*@@timer:_tCamLane_Disp_Warn_Rq_AR:*/
on timer _tCamLane_Disp_Warn_Rq_AR
{
    putValue( HMI__STMSG_CamLane_Disp_Warn_Rq_AR, 0 );
}
/*@@end*/

/*@@envVar:HMI__STMSG_CamLane_Disp_Warn_Rq_AR:*/
on EnvVar HMI__STMSG_CamLane_Disp_Warn_Rq_AR
{
    long tDelay;
    if( getValue( this ) == 2 )
    {
        tDelay = getValue( HMI__STMSGT_CamLane_Disp_Warn_Rq_AR );
        if( tDelay > 0)    
            setTimer( _tCamLane_Disp_Warn_Rq_AR, tDelay );
        else
            putValue( HMI__STMSG_CamLane_Disp_Warn_Rq_AR, 0 );
    }
}
/*@@end*/

/*@@envVar:HMI_CrossWalk_Dist:*/
on EnvVar HMI_CrossWalk_Dist
{
    _mCamLane_Disp_Warn_Rq_AR.CrossWalk_Dist.phys = getValue(this);
    _CamLane_Disp_Warn_Rq_AR_SpontanFlag = 1;
}
/*@@end*/

/*@@envVar:HMI_CrossWalk_Stat:*/
on EnvVar HMI_CrossWalk_Stat
{
    _mCamLane_Disp_Warn_Rq_AR.CrossWalk_Stat.phys = getValue(this);
    _CamLane_Disp_Warn_Rq_AR_SpontanFlag = 1;
}
/*@@end*/

/*@@envVar:HMI_LDP_IndLmp_SwLED_HU_Rq_MPC:*/
on EnvVar HMI_LDP_IndLmp_SwLED_HU_Rq_MPC
{
    _mCamLane_Disp_Warn_Rq_AR.LDP_IndLmp_SwLED_HU_Rq_MPC.phys = getValue(this);
    _CamLane_Disp_Warn_Rq_AR_SpontanFlag = 1;
}
/*@@end*/

/*@@envVar:HMI_LDP_MPC_Md_Stat:*/
on EnvVar HMI_LDP_MPC_Md_Stat
{
    _mCamLane_Disp_Warn_Rq_AR.LDP_MPC_Md_Stat.phys = getValue(this);
    _CamLane_Disp_Warn_Rq_AR_SpontanFlag = 1;
}
/*@@end*/

/*@@envVar:HMI_LDP_MPC_MsgDisp_Rq:*/
on EnvVar HMI_LDP_MPC_MsgDisp_Rq
{
    _mCamLane_Disp_Warn_Rq_AR.LDP_MPC_MsgDisp_Rq.phys = getValue(this);
    _CamLane_Disp_Warn_Rq_AR_SpontanFlag = 1;
}
/*@@end*/

/*@@envVar:HMI_PavemntSign_LtrlDist_EgoLane:*/
on EnvVar HMI_PavemntSign_LtrlDist_EgoLane
{
    _mCamLane_Disp_Warn_Rq_AR.PavemntSign_LtrlDist_EgoLane.phys = getValue(this);
    _CamLane_Disp_Warn_Rq_AR_SpontanFlag = 1;
}
/*@@end*/

/*@@envVar:HMI_PavemntSign_LtrlDist_NghbrLane:*/
on EnvVar HMI_PavemntSign_LtrlDist_NghbrLane
{
    _mCamLane_Disp_Warn_Rq_AR.PavemntSign_LtrlDist_NghbrLane.phys = getValue(this);
    _CamLane_Disp_Warn_Rq_AR_SpontanFlag = 1;
}
/*@@end*/

/*@@envVar:HMI_PavemntSign_Type_EgoLane:*/
on EnvVar HMI_PavemntSign_Type_EgoLane
{
    _mCamLane_Disp_Warn_Rq_AR.PavemntSign_Type_EgoLane.phys = getValue(this);
    _CamLane_Disp_Warn_Rq_AR_SpontanFlag = 1;
}
/*@@end*/

/*@@envVar:HMI_PavemntSign_Type_NghbrLane:*/
on EnvVar HMI_PavemntSign_Type_NghbrLane
{
    _mCamLane_Disp_Warn_Rq_AR.PavemntSign_Type_NghbrLane.phys = getValue(this);
    _CamLane_Disp_Warn_Rq_AR_SpontanFlag = 1;
}
/*@@end*/

/*@@envVar:HMI_Rsrv2_CamLane_Disp_Warn_Rq:*/
on EnvVar HMI_Rsrv2_CamLane_Disp_Warn_Rq
{
    _mCamLane_Disp_Warn_Rq_AR.Rsrv2_CamLane_Disp_Warn_Rq.phys = getValue(this);
    _CamLane_Disp_Warn_Rq_AR_SpontanFlag = 1;
}
/*@@end*/

/*@@envVar:HMI_Rsrv3_CamLane_Disp_Warn_Rq:*/
on EnvVar HMI_Rsrv3_CamLane_Disp_Warn_Rq
{
    _mCamLane_Disp_Warn_Rq_AR.Rsrv3_CamLane_Disp_Warn_Rq.phys = getValue(this);
    _CamLane_Disp_Warn_Rq_AR_SpontanFlag = 1;
}
/*@@end*/

/*@@envVar:HMI_Rsrv4_CamLane_Disp_Warn_Rq:*/
on EnvVar HMI_Rsrv4_CamLane_Disp_Warn_Rq
{
    _mCamLane_Disp_Warn_Rq_AR.Rsrv4_CamLane_Disp_Warn_Rq.phys = getValue(this);
    _CamLane_Disp_Warn_Rq_AR_SpontanFlag = 1;
}
/*@@end*/

/*@@caplFunc:CHASSIS_HMI_R0_AR_check_output():*/
CHASSIS_HMI_R0_AR_check_output()
{
    if( !getValue( HMI__STMSG_CHASSIS_HMI_R0_AR ) )
    {
        // Botschaft CHASSIS_HMI_R0_AR ID: 1071 --- Sendeart 5 cyclicAndSpontanWithDelay ---
        _CHASSIS_HMI_R0_AR_Cnt--;
        if( _CHASSIS_HMI_R0_AR_Cnt < 1 )
        {
            CHASSIS_HMI_R0_AR_output(); // Nachricht wg. abgelaufenem Zyklus ausgeben
            _CHASSIS_HMI_R0_AR_Cnt = _CHASSIS_HMI_R0_AR_CycleCount; // Zyklus-Zähler zurücksetzen
            _CHASSIS_HMI_R0_AR_SpontanFlag = 0; // Spontan-Flag zurücksetzen
        }
        else if( _CHASSIS_HMI_R0_AR_SpontanFlag)
        {
            CHASSIS_HMI_R0_AR_output(); // Nachricht wg. spontaner Änderung ausgeben
            _CHASSIS_HMI_R0_AR_SpontanFlag = 0; // Spontan-Flag zurücksetzen
        }
    }
}
/*@@end*/

/*@@caplFunc:CHASSIS_HMI_R0_AR_init():*/
CHASSIS_HMI_R0_AR_init()
{   /* Botschaft CHASSIS_HMI_R0_AR ID: 1071 --- Sendeart 5 cyclicAndSpontanWithDelay --- 
BA_ "ApplMessage" BO_ 1071 0;
BA_ "NmAsrMessage" BO_ 1071 0;
BA_ "GenMsgMinAcceptLength" BO_ 1071 8;
BA_ "GenMsgILSupport" BO_ 1071 1;
BA_ "DiagState" BO_ 1071 0;
BA_ "DiagRequest" BO_ 1071 0;
BA_ "DiagResponse" BO_ 1071 0;
BA_ "GenMsgStartValue" BO_ 1071 "0";
BA_ "GenMsgStartDelayTime" BO_ 1071 250;
BA_ "GenMsgDelayTime" BO_ 1071 20;
BA_ "GenMsgNrOfRepetition" BO_ 1071 0;
BA_ "GenMsgCycleTime" BO_ 1071 1000;
BA_ "GenMsgSendType" BO_ 1071 5;
    */
    _CHASSIS_HMI_R0_AR_Timebase =      c_tDBKomTimer_20ms;
    _CHASSIS_HMI_R0_AR_CycleCount =   1000 / _CHASSIS_HMI_R0_AR_Timebase;
    _CHASSIS_HMI_R0_AR_StartDelay =    250 / _CHASSIS_HMI_R0_AR_Timebase;
    _CHASSIS_HMI_R0_AR_Cnt = _CHASSIS_HMI_R0_AR_StartDelay;
    _CHASSIS_HMI_R0_AR_SpontanFlag = 0;

    putValue( HMI__STMSGSD_CHASSIS_HMI_R0_AR, _CHASSIS_HMI_R0_AR_StartDelay * _CHASSIS_HMI_R0_AR_Timebase );

    _mCHASSIS_HMI_R0_AR.PNHV_PreCond2_Dsabl.phys                   = getValue( HMI_PNHV_PreCond2_Dsabl );
    _mCHASSIS_HMI_R0_AR.PNHV_PreCond2_Dsabl_UB.phys                   = getValue( HMI_PNHV_PreCond2_Dsabl_UB );
    _mCHASSIS_HMI_R0_AR.PNHV_RemainTm_Wakeup.phys                   = getValue( HMI_PNHV_RemainTm_Wakeup );
    _mCHASSIS_HMI_R0_AR.PNHV_RemainTm_Wakeup_UB.phys                   = getValue( HMI_PNHV_RemainTm_Wakeup_UB );
}
/*@@end*/

/*@@caplFunc:CHASSIS_HMI_R0_AR_output():*/
CHASSIS_HMI_R0_AR_output(void)
{
    output( _mCHASSIS_HMI_R0_AR );
}
/*@@end*/

/*@@caplFunc:CHASSIS_HMI_R0_AR_saveEnvVars(dword):*/
CHASSIS_HMI_R0_AR_saveEnvVars( dword hFile )
{
    filePutString("\n// Knoten EIS: CHASSIS_HMI_R0_AR\n", 31, hFile );
    snprintf( buffer, elcount( buffer ), "0.0000 HMI__STMSG_CHASSIS_HMI_R0_AR := %X\n", getValue( HMI__STMSG_CHASSIS_HMI_R0_AR ) );    filePutString ( buffer, elcount( buffer ), hFile );
    snprintf( buffer, elcount( buffer ), "0.0000 HMI__STMSGT_CHASSIS_HMI_R0_AR := %X\n", getValue( HMI__STMSGT_CHASSIS_HMI_R0_AR ) );    filePutString ( buffer, elcount( buffer ), hFile );
    snprintf( buffer, elcount( buffer ), "0.0000 HMI_PNHV_PreCond2_Dsabl := %X\n", getValue( HMI_PNHV_PreCond2_Dsabl ) );    filePutString ( buffer, elcount( buffer ), hFile );
    snprintf( buffer, elcount( buffer ), "0.0000 HMI_PNHV_PreCond2_Dsabl_UB := %X\n", getValue( HMI_PNHV_PreCond2_Dsabl_UB ) );    filePutString ( buffer, elcount( buffer ), hFile );
    snprintf( buffer, elcount( buffer ), "0.0000 HMI_PNHV_RemainTm_Wakeup := %X\n", getValue( HMI_PNHV_RemainTm_Wakeup ) );    filePutString ( buffer, elcount( buffer ), hFile );
    snprintf( buffer, elcount( buffer ), "0.0000 HMI_PNHV_RemainTm_Wakeup_UB := %X\n", getValue( HMI_PNHV_RemainTm_Wakeup_UB ) );    filePutString ( buffer, elcount( buffer ), hFile );
}
/*@@end*/

/*@@timer:_tCHASSIS_HMI_R0_AR:*/
on timer _tCHASSIS_HMI_R0_AR
{
    putValue( HMI__STMSG_CHASSIS_HMI_R0_AR, 0 );
}
/*@@end*/

/*@@envVar:HMI__STMSG_CHASSIS_HMI_R0_AR:*/
on EnvVar HMI__STMSG_CHASSIS_HMI_R0_AR
{
    long tDelay;
    if( getValue( this ) == 2 )
    {
        tDelay = getValue( HMI__STMSGT_CHASSIS_HMI_R0_AR );
        if( tDelay > 0)    
            setTimer( _tCHASSIS_HMI_R0_AR, tDelay );
        else
            putValue( HMI__STMSG_CHASSIS_HMI_R0_AR, 0 );
    }
}
/*@@end*/

/*@@envVar:HMI_PNHV_PreCond2_Dsabl:*/
on EnvVar HMI_PNHV_PreCond2_Dsabl
{
    _mCHASSIS_HMI_R0_AR.PNHV_PreCond2_Dsabl.phys = getValue(this);
    _CHASSIS_HMI_R0_AR_SpontanFlag = 1;
}
/*@@end*/

/*@@envVar:HMI_PNHV_PreCond2_Dsabl_UB:*/
on EnvVar HMI_PNHV_PreCond2_Dsabl_UB
{
    _mCHASSIS_HMI_R0_AR.PNHV_PreCond2_Dsabl_UB.phys = getValue(this);
    _CHASSIS_HMI_R0_AR_SpontanFlag = 1;
}
/*@@end*/

/*@@envVar:HMI_PNHV_RemainTm_Wakeup:*/
on EnvVar HMI_PNHV_RemainTm_Wakeup
{
    _mCHASSIS_HMI_R0_AR.PNHV_RemainTm_Wakeup.phys = getValue(this);
    _CHASSIS_HMI_R0_AR_SpontanFlag = 1;
}
/*@@end*/

/*@@envVar:HMI_PNHV_RemainTm_Wakeup_UB:*/
on EnvVar HMI_PNHV_RemainTm_Wakeup_UB
{
    _mCHASSIS_HMI_R0_AR.PNHV_RemainTm_Wakeup_UB.phys = getValue(this);
    _CHASSIS_HMI_R0_AR_SpontanFlag = 1;
}
/*@@end*/

/*@@caplFunc:CHASSIS_HMI_R1_AR_check_output():*/
CHASSIS_HMI_R1_AR_check_output()
{
    if( !getValue( HMI__STMSG_CHASSIS_HMI_R1_AR ) )
    {
        // Botschaft CHASSIS_HMI_R1_AR ID: 1107 --- Sendeart 5 cyclicAndSpontanWithDelay --- 
        _CHASSIS_HMI_R1_AR_Cnt--;
        if( _CHASSIS_HMI_R1_AR_Cnt < 1 )
        {
            CHASSIS_HMI_R1_AR_output(); // Nachricht wg. abgelaufenem Zyklus ausgeben
            _CHASSIS_HMI_R1_AR_Cnt = _CHASSIS_HMI_R1_AR_CycleCount; // Zyklus-Zähler zurücksetzen
            _CHASSIS_HMI_R1_AR_SpontanFlag = 0; // Spontan-Flag zurücksetzen
        }
        else if( _CHASSIS_HMI_R1_AR_SpontanFlag)
        {
            CHASSIS_HMI_R1_AR_output(); // Nachricht wg. spontaner Änderung ausgeben
            _CHASSIS_HMI_R1_AR_SpontanFlag = 0; // Spontan-Flag zurücksetzen
        }
    }
}
/*@@end*/

/*@@caplFunc:CHASSIS_HMI_R1_AR_init():*/
CHASSIS_HMI_R1_AR_init()
{   /* Botschaft CHASSIS_HMI_R1_AR ID: 1107 --- Sendeart 5 cyclicAndSpontanWithDelay --- 
BA_ "ApplMessage" BO_ 1107 0;
BA_ "NmAsrMessage" BO_ 1107 0;
BA_ "GenMsgMinAcceptLength" BO_ 1107 8;
BA_ "GenMsgILSupport" BO_ 1107 1;
BA_ "DiagState" BO_ 1107 0;
BA_ "DiagRequest" BO_ 1107 0;
BA_ "DiagResponse" BO_ 1107 0;
BA_ "GenMsgStartValue" BO_ 1107 "0";
BA_ "GenMsgStartDelayTime" BO_ 1107 50;
BA_ "GenMsgDelayTime" BO_ 1107 20;
BA_ "GenMsgNrOfRepetitions" BO_ 1107 0;
BA_ "GenMsgCycleTime" BO_ 1107 200;
BA_ "GenMsgSendType" BO_ 1107 5;
    */
    _CHASSIS_HMI_R1_AR_Timebase =         c_tDBKomTimer_20ms;
    _CHASSIS_HMI_R1_AR_CycleCount =      200 / _CHASSIS_HMI_R1_AR_Timebase;
    _CHASSIS_HMI_R1_AR_StartDelay =       50 / _CHASSIS_HMI_R1_AR_Timebase;
//  _CHASSIS_HMI_R1_AR_MinDelay =         20 / _CHASSIS_HMI_R1_AR_Timebase;
    _CHASSIS_HMI_R1_AR_Cnt = _CHASSIS_HMI_R1_AR_StartDelay;
    _CHASSIS_HMI_R1_AR_SpontanFlag = 0;

    putValue( HMI__STMSGSD_CHASSIS_HMI_R1_AR, _CHASSIS_HMI_R1_AR_StartDelay * _CHASSIS_HMI_R1_AR_Timebase );

    _mCHASSIS_HMI_R1_AR.AccelPdlPosn.phys                   = getValue( HMI_AccelPdlPosn );
    _mCHASSIS_HMI_R1_AR.AccelPdlPosn_Raw.phys               = getValue( HMI_AccelPdlPosn_Raw );
    _mCHASSIS_HMI_R1_AR.CoastMd_Disp_Rq.phys                = getValue( HMI_CoastMd_Disp_Rq );
    _mCHASSIS_HMI_R1_AR.CoastMd_Disp_Rq_UB.phys             = getValue( HMI_CoastMd_Disp_Rq_UB );
    _mCHASSIS_HMI_R1_AR.DTQ_Disp_Rq_V2_UB.phys              = getValue( HMI_DTQ_Disp_Rq_V2_UB );
    _mCHASSIS_HMI_R1_AR.DTQ_FltMsgDisp_Rq.phys              = getValue( HMI_DTQ_FltMsgDisp_Rq );
    _mCHASSIS_HMI_R1_AR.DTQ_Md_Stat.phys                    = getValue( HMI_DTQ_Md_Stat );
    _mCHASSIS_HMI_R1_AR.DTQ_Md_Stat_UB.phys                 = getValue( HMI_DTQ_Md_Stat_UB );
    _mCHASSIS_HMI_R1_AR.DTQ_MsgDisp_Rq_V2.phys              = getValue( HMI_DTQ_MsgDisp_Rq_V2 );
    _mCHASSIS_HMI_R1_AR.DTQ_Stat_Disp_Rq.phys               = getValue( HMI_DTQ_Stat_Disp_Rq );
    _mCHASSIS_HMI_R1_AR.Eng_Rs3_UB.phys                     = getValue( HMI_Eng_Rs3_UB );
    _mCHASSIS_HMI_R1_AR.ExhstFlap_Stg_AMG.phys              = getValue( HMI_ExhstFlap_Stg_AMG );
    _mCHASSIS_HMI_R1_AR.ExhstFlap_Stg_AMG_UB.phys           = getValue( HMI_ExhstFlap_Stg_AMG_UB );
    _mCHASSIS_HMI_R1_AR.VehDrvProg_TCM_V3.phys              = getValue( HMI_VehDrvProg_TCM_V3 );
    _mCHASSIS_HMI_R1_AR.VehDrvProg_TCM_V3_UB.phys           = getValue( HMI_VehDrvProg_TCM_V3_UB );
}
/*@@end*/

/*@@caplFunc:CHASSIS_HMI_R1_AR_output():*/
CHASSIS_HMI_R1_AR_output(void)
{
    output( _mCHASSIS_HMI_R1_AR );
}
/*@@end*/

/*@@caplFunc:CHASSIS_HMI_R1_AR_saveEnvVars(dword):*/
CHASSIS_HMI_R1_AR_saveEnvVars( dword hFile )
{
    filePutString("\n// Knoten EIS: CHASSIS_HMI_R1_AR\n", 31, hFile );
    snprintf( buffer, elcount( buffer ), "0.0000 HMI__STMSG_CHASSIS_HMI_R1_AR := %X\n", getValue( HMI__STMSG_CHASSIS_HMI_R1_AR ) );        filePutString ( buffer, elcount( buffer ), hFile );
    snprintf( buffer, elcount( buffer ), "0.0000 HMI__STMSGT_CHASSIS_HMI_R1_AR := %X\n", getValue( HMI__STMSGT_CHASSIS_HMI_R1_AR ) );        filePutString ( buffer, elcount( buffer ), hFile );
    snprintf( buffer, elcount( buffer ), "0.0000 HMI_AccelPdlPosn := %X\n", getValue( HMI_AccelPdlPosn ) );        filePutString ( buffer, elcount( buffer ), hFile );
    snprintf( buffer, elcount( buffer ), "0.0000 HMI_AccelPdlPosn_Raw := %X\n", getValue( HMI_AccelPdlPosn_Raw ) );        filePutString ( buffer, elcount( buffer ), hFile );
    snprintf( buffer, elcount( buffer ), "0.0000 HMI_CoastMd_Disp_Rq := %X\n", getValue( HMI_CoastMd_Disp_Rq ) );        filePutString ( buffer, elcount( buffer ), hFile );
    snprintf( buffer, elcount( buffer ), "0.0000 HMI_CoastMd_Disp_Rq_UB := %X\n", getValue( HMI_CoastMd_Disp_Rq_UB ) );        filePutString ( buffer, elcount( buffer ), hFile );
    snprintf( buffer, elcount( buffer ), "0.0000 HMI_DTQ_Disp_Rq_V2_UB := %X\n", getValue( HMI_DTQ_Disp_Rq_V2_UB ) );        filePutString ( buffer, elcount( buffer ), hFile );
    snprintf( buffer, elcount( buffer ), "0.0000 HMI_DTQ_FltMsgDisp_Rq := %X\n", getValue( HMI_DTQ_FltMsgDisp_Rq ) );        filePutString ( buffer, elcount( buffer ), hFile );
    snprintf( buffer, elcount( buffer ), "0.0000 HMI_DTQ_Md_Stat := %X\n", getValue( HMI_DTQ_Md_Stat ) );        filePutString ( buffer, elcount( buffer ), hFile );
    snprintf( buffer, elcount( buffer ), "0.0000 HMI_DTQ_Md_Stat_UB := %X\n", getValue( HMI_DTQ_Md_Stat_UB ) );        filePutString ( buffer, elcount( buffer ), hFile );
    snprintf( buffer, elcount( buffer ), "0.0000 HMI_DTQ_MsgDisp_Rq_V2 := %X\n", getValue( HMI_DTQ_MsgDisp_Rq_V2 ) );        filePutString ( buffer, elcount( buffer ), hFile );
    snprintf( buffer, elcount( buffer ), "0.0000 HMI_DTQ_Stat_Disp_Rq := %X\n", getValue( HMI_DTQ_Stat_Disp_Rq ) );        filePutString ( buffer, elcount( buffer ), hFile );
    snprintf( buffer, elcount( buffer ), "0.0000 HMI_Eng_Rs3_UB := %X\n", getValue( HMI_Eng_Rs3_UB ) );        filePutString ( buffer, elcount( buffer ), hFile );
    snprintf( buffer, elcount( buffer ), "0.0000 HMI_ExhstFlap_Stg_AMG := %X\n", getValue( HMI_ExhstFlap_Stg_AMG ) );        filePutString ( buffer, elcount( buffer ), hFile );
    snprintf( buffer, elcount( buffer ), "0.0000 HMI_ExhstFlap_Stg_AMG_UB := %X\n", getValue( HMI_ExhstFlap_Stg_AMG_UB ) );        filePutString ( buffer, elcount( buffer ), hFile );
    snprintf( buffer, elcount( buffer ), "0.0000 HMI_VehDrvProg_TCM_V3 := %X\n", getValue( HMI_VehDrvProg_TCM_V3 ) );        filePutString ( buffer, elcount( buffer ), hFile );
    snprintf( buffer, elcount( buffer ), "0.0000 HMI_VehDrvProg_TCM_V3_UB := %X\n", getValue( HMI_VehDrvProg_TCM_V3_UB ) );        filePutString ( buffer, elcount( buffer ), hFile );
}
/*@@end*/

/*@@timer:_tCHASSIS_HMI_R1_AR:*/
on timer _tCHASSIS_HMI_R1_AR
{
    putValue( HMI__STMSG_CHASSIS_HMI_R1_AR, 0 );
}
/*@@end*/

/*@@envVar:HMI__STMSG_CHASSIS_HMI_R1_AR:*/
on EnvVar HMI__STMSG_CHASSIS_HMI_R1_AR
{
    long tDelay;
    if( getValue( this ) == 2 )
    {
        tDelay = getValue( HMI__STMSGT_CHASSIS_HMI_R1_AR );
        if( tDelay > 0)    
            setTimer( _tCHASSIS_HMI_R1_AR, tDelay );
        else
            putValue( HMI__STMSG_CHASSIS_HMI_R1_AR, 0 );
    }
}
/*@@end*/

/*@@envVar:HMI_AccelPdlPosn:*/
on EnvVar HMI_AccelPdlPosn
{
    _mCHASSIS_HMI_R1_AR.AccelPdlPosn.phys = getValue(this);
    _CHASSIS_HMI_R1_AR_SpontanFlag = 1;
}
/*@@end*/

/*@@envVar:HMI_AccelPdlPosn_Raw:*/
on EnvVar HMI_AccelPdlPosn_Raw
{
    _mCHASSIS_HMI_R1_AR.AccelPdlPosn_Raw.phys = getValue(this);
    _CHASSIS_HMI_R1_AR_SpontanFlag = 1;
}
/*@@end*/

/*@@envVar:HMI_CoastMd_Disp_Rq:*/
on EnvVar HMI_CoastMd_Disp_Rq
{
    _mCHASSIS_HMI_R1_AR.CoastMd_Disp_Rq.phys = getValue(this);
    _CHASSIS_HMI_R1_AR_SpontanFlag = 1;
}
/*@@end*/

/*@@envVar:HMI_CoastMd_Disp_Rq_UB:*/
on EnvVar HMI_CoastMd_Disp_Rq_UB
{
    _mCHASSIS_HMI_R1_AR.CoastMd_Disp_Rq_UB.phys = getValue(this);
    _CHASSIS_HMI_R1_AR_SpontanFlag = 1;
}
/*@@end*/

/*@@envVar:HMI_DTQ_Disp_Rq_V2_UB:*/
on EnvVar HMI_DTQ_Disp_Rq_V2_UB
{
    _mCHASSIS_HMI_R1_AR.DTQ_Disp_Rq_V2_UB.phys = getValue(this);
    _CHASSIS_HMI_R1_AR_SpontanFlag = 1;
}
/*@@end*/

/*@@envVar:HMI_DTQ_FltMsgDisp_Rq:*/
on EnvVar HMI_DTQ_FltMsgDisp_Rq
{
    _mCHASSIS_HMI_R1_AR.DTQ_FltMsgDisp_Rq.phys = getValue(this);
    _CHASSIS_HMI_R1_AR_SpontanFlag = 1;
}
/*@@end*/

/*@@envVar:HMI_DTQ_Md_Stat:*/
on EnvVar HMI_DTQ_Md_Stat
{
    _mCHASSIS_HMI_R1_AR.DTQ_Md_Stat.phys = getValue(this);
    _CHASSIS_HMI_R1_AR_SpontanFlag = 1;
}
/*@@end*/

/*@@envVar:HMI_DTQ_Md_Stat_UB:*/
on EnvVar HMI_DTQ_Md_Stat_UB
{
    _mCHASSIS_HMI_R1_AR.DTQ_Md_Stat_UB.phys = getValue(this);
    _CHASSIS_HMI_R1_AR_SpontanFlag = 1;
}
/*@@end*/

/*@@envVar:HMI_DTQ_MsgDisp_Rq_V2:*/
on EnvVar HMI_DTQ_MsgDisp_Rq_V2
{
    _mCHASSIS_HMI_R1_AR.DTQ_MsgDisp_Rq_V2.phys = getValue(this);
    _CHASSIS_HMI_R1_AR_SpontanFlag = 1;
}
/*@@end*/

/*@@envVar:HMI_DTQ_Stat_Disp_Rq:*/
on EnvVar HMI_DTQ_Stat_Disp_Rq
{
    _mCHASSIS_HMI_R1_AR.DTQ_Stat_Disp_Rq.phys = getValue(this);
    _CHASSIS_HMI_R1_AR_SpontanFlag = 1;
}
/*@@end*/

/*@@envVar:HMI_Eng_Rs3_UB:*/
on EnvVar HMI_Eng_Rs3_UB
{
    _mCHASSIS_HMI_R1_AR.Eng_Rs3_UB.phys = getValue(this);
    _CHASSIS_HMI_R1_AR_SpontanFlag = 1;
}
/*@@end*/

/*@@envVar:HMI_ExhstFlap_Stg_AMG:*/
on EnvVar HMI_ExhstFlap_Stg_AMG
{
    _mCHASSIS_HMI_R1_AR.ExhstFlap_Stg_AMG.phys = getValue(this);
    _CHASSIS_HMI_R1_AR_SpontanFlag = 1;
}
/*@@end*/

/*@@envVar:HMI_ExhstFlap_Stg_AMG_UB:*/
on EnvVar HMI_ExhstFlap_Stg_AMG_UB
{
    _mCHASSIS_HMI_R1_AR.ExhstFlap_Stg_AMG_UB.phys = getValue(this);
    _CHASSIS_HMI_R1_AR_SpontanFlag = 1;
}
/*@@end*/

/*@@envVar:HMI_VehDrvProg_TCM_V3:*/
on EnvVar HMI_VehDrvProg_TCM_V3
{
    _mCHASSIS_HMI_R1_AR.VehDrvProg_TCM_V3.phys = getValue(this);
    _CHASSIS_HMI_R1_AR_SpontanFlag = 1;
}
/*@@end*/

/*@@envVar:HMI_VehDrvProg_TCM_V3_UB:*/
on EnvVar HMI_VehDrvProg_TCM_V3_UB
{
    _mCHASSIS_HMI_R1_AR.VehDrvProg_TCM_V3_UB.phys = getValue(this);
    _CHASSIS_HMI_R1_AR_SpontanFlag = 1;
}
/*@@end*/

/*@@caplFunc:CHASSIS_HMI_R2_AR_check_output():*/
CHASSIS_HMI_R2_AR_check_output()
{
    if( !getValue( HMI__STMSG_CHASSIS_HMI_R2_AR ) )
    {
        // Botschaft CHASSIS_HMI_R2_AR ID: 615 --- Sendeart 5 cyclicAndSpontanWithDelay --- 
        _CHASSIS_HMI_R2_AR_Cnt--;
        if( _CHASSIS_HMI_R2_AR_Cnt < 1 )
        {
            CHASSIS_HMI_R2_AR_output(); // Nachricht wg. abgelaufenem Zyklus ausgeben
            _CHASSIS_HMI_R2_AR_Cnt = _CHASSIS_HMI_R2_AR_CycleCount; // Zyklus-Zähler zurücksetzen
            _CHASSIS_HMI_R2_AR_SpontanFlag = 0; // Spontan-Flag zurücksetzen
        }
        else if( _CHASSIS_HMI_R2_AR_SpontanFlag )
        {
            CHASSIS_HMI_R2_AR_output(); // Nachricht wg. spontaner Änderung ausgeben
            _CHASSIS_HMI_R2_AR_SpontanFlag = 0; // Spontan-Flag zurücksetzen
        }
    }
}
/*@@end*/

/*@@caplFunc:CHASSIS_HMI_R2_AR_init():*/
CHASSIS_HMI_R2_AR_init()
{   /* Botschaft CHASSIS_HMI_R2_AR ID: 615 --- Sendeart 5 cyclicAndSpontanWithDelay --- 
BA_ "ApplMessage" BO_ 615 0;
BA_ "NmAsrMessage" BO_ 615 0;
BA_ "GenMsgMinAcceptLength" BO_ 615 8;
BA_ "GenMsgILSupport" BO_ 615 1;
BA_ "DiagState" BO_ 615 0;
BA_ "DiagRequest" BO_ 615 0;
BA_ "DiagResponse" BO_ 615 0;
BA_ "GenMsgStartValue" BO_ 615 "0";
BA_ "GenMsgStartDelayTime" BO_ 615 140;
BA_ "GenMsgDelayTime" BO_ 615 20;
BA_ "GenMsgNrOfRepetitions" BO_ 615 0;
BA_ "GenMsgCycleTime" BO_ 615 200;
BA_ "GenMsgSendType" BO_ 615 5;
    */
    _CHASSIS_HMI_R2_AR_Timebase =        c_tDBKomTimer_20ms;
    _CHASSIS_HMI_R2_AR_CycleCount =    200 / _CHASSIS_HMI_R2_AR_Timebase;
    _CHASSIS_HMI_R2_AR_StartDelay =    140 / _CHASSIS_HMI_R2_AR_Timebase;
    _CHASSIS_HMI_R2_AR_Cnt = _CHASSIS_HMI_R2_AR_StartDelay;
    _CHASSIS_HMI_R2_AR_SpontanFlag = 0;

    putValue( HMI__STMSGSD_CHASSIS_HMI_R2_AR, _CHASSIS_HMI_R2_AR_StartDelay * _CHASSIS_HMI_R2_AR_Timebase );

    _mCHASSIS_HMI_R2_AR.Brk_Stat.phys              = getValue( HMI_Brk_Stat );
    _mCHASSIS_HMI_R2_AR.BrkPdl_Stat.phys           = getValue( HMI_BrkPdl_Stat );
    _mCHASSIS_HMI_R2_AR.BrkSys_Stat_UB.phys        = getValue( HMI_BrkSys_Stat_UB );
    _mCHASSIS_HMI_R2_AR.BrkTrq_D_V2.phys           = getValue( HMI_BrkTrq_D_V2 );
    _mCHASSIS_HMI_R2_AR.EmgBrk_Actv.phys           = getValue( HMI_EmgBrk_Actv );
    _mCHASSIS_HMI_R2_AR.EPKB_Stat_UB.phys          = getValue( HMI_EPKB_Stat_UB );
    _mCHASSIS_HMI_R2_AR.ESP_Enbl_Rq_EPKB.phys      = getValue( HMI_ESP_Enbl_Rq_EPKB );
    _mCHASSIS_HMI_R2_AR.ESP_Oprtn_Stat_AS_V2.phys  = getValue( HMI_ESP_Oprtn_Stat_AS_V2 );
    _mCHASSIS_HMI_R2_AR.Gr.phys                    = getValue( HMI_Gr );
    _mCHASSIS_HMI_R2_AR.PARK_Sp_Stat.phys          = getValue( HMI_PARK_Sp_Stat );
    _mCHASSIS_HMI_R2_AR.PARK_Stat_PARK.phys        = getValue( HMI_PARK_Stat_PARK );
    _mCHASSIS_HMI_R2_AR.ParkCfg_Stat_UB.phys       = getValue( HMI_ParkCfg_Stat_UB );
    _mCHASSIS_HMI_R2_AR.ParkGuid_Stat.phys         = getValue( HMI_ParkGuid_Stat );
    _mCHASSIS_HMI_R2_AR.ParkStyle_V2.phys          = getValue( HMI_ParkStyle_V2 );
    _mCHASSIS_HMI_R2_AR.PkBrk_Stat.phys            = getValue( HMI_PkBrk_Stat );
    _mCHASSIS_HMI_R2_AR.St_Rq_PARK_UB.phys         = getValue( HMI_St_Rq_PARK_UB );
    _mCHASSIS_HMI_R2_AR.StWhl_Cond_Disp_Rq.phys    = getValue( HMI_StWhl_Cond_Disp_Rq );
    _mCHASSIS_HMI_R2_AR.StWhl_Cond_Disp_Rq_UB.phys = getValue( HMI_StWhl_Cond_Disp_Rq_UB );
    _mCHASSIS_HMI_R2_AR.TCM_Data2_UB.phys          = getValue( HMI_TCM_Data2_UB );
    _mCHASSIS_HMI_R2_AR.TSL_Posn_TCM.phys          = getValue( HMI_TSL_Posn_TCM );
}
/*@@end*/

/*@@caplFunc:CHASSIS_HMI_R2_AR_output():*/
CHASSIS_HMI_R2_AR_output(void)
{
    output( _mCHASSIS_HMI_R2_AR );
}
/*@@end*/

/*@@caplFunc:CHASSIS_HMI_R2_AR_saveEnvVars(dword):*/
CHASSIS_HMI_R2_AR_saveEnvVars( dword hFile )
{
    filePutString("\n// Knoten EIS: CHASSIS_HMI_R2_AR\n", 31, hFile );
    snprintf( buffer, elcount( buffer ), "0.0000 HMI__STMSG_CHASSIS_HMI_R2_AR := %X\n", getValue( HMI__STMSG_CHASSIS_HMI_R2_AR ) );        filePutString ( buffer, elcount( buffer ), hFile );
    snprintf( buffer, elcount( buffer ), "0.0000 HMI__STMSGT_CHASSIS_HMI_R2_AR := %X\n", getValue( HMI__STMSGT_CHASSIS_HMI_R2_AR ) );        filePutString ( buffer, elcount( buffer ), hFile );
    snprintf( buffer, elcount( buffer ), "0.0000 HMI_Brk_Stat := %X\n", getValue( HMI_Brk_Stat ) );        filePutString ( buffer, elcount( buffer ), hFile );
    snprintf( buffer, elcount( buffer ), "0.0000 HMI_BrkPdl_Stat := %X\n", getValue( HMI_BrkPdl_Stat ) );        filePutString ( buffer, elcount( buffer ), hFile );
    snprintf( buffer, elcount( buffer ), "0.0000 HMI_BrkSys_Stat_UB := %X\n", getValue( HMI_BrkSys_Stat_UB ) );        filePutString ( buffer, elcount( buffer ), hFile );
    snprintf( buffer, elcount( buffer ), "0.0000 HMI_BrkTrq_D_V2 := %X\n", getValue( HMI_BrkTrq_D_V2 ) );        filePutString ( buffer, elcount( buffer ), hFile );
    snprintf( buffer, elcount( buffer ), "0.0000 HMI_EmgBrk_Actv := %X\n", getValue( HMI_EmgBrk_Actv ) );        filePutString ( buffer, elcount( buffer ), hFile );
    snprintf( buffer, elcount( buffer ), "0.0000 HMI_EPKB_Stat_UB := %X\n", getValue( HMI_EPKB_Stat_UB ) );        filePutString ( buffer, elcount( buffer ), hFile );
    snprintf( buffer, elcount( buffer ), "0.0000 HMI_ESP_Enbl_Rq_EPKB := %X\n", getValue( HMI_ESP_Enbl_Rq_EPKB ) );        filePutString ( buffer, elcount( buffer ), hFile );
    snprintf( buffer, elcount( buffer ), "0.0000 HMI_ESP_Oprtn_Stat_AS_V2 := %X\n", getValue( HMI_ESP_Oprtn_Stat_AS_V2 ) );        filePutString ( buffer, elcount( buffer ), hFile );
    snprintf( buffer, elcount( buffer ), "0.0000 HMI_Gr := %X\n", getValue( HMI_Gr ) );        filePutString ( buffer, elcount( buffer ), hFile );
    snprintf( buffer, elcount( buffer ), "0.0000 HMI_PARK_Sp_Stat := %X\n", getValue( HMI_PARK_Sp_Stat ) );        filePutString ( buffer, elcount( buffer ), hFile );
    snprintf( buffer, elcount( buffer ), "0.0000 HMI_PARK_Stat_PARK := %X\n", getValue( HMI_PARK_Stat_PARK ) );        filePutString ( buffer, elcount( buffer ), hFile );
    snprintf( buffer, elcount( buffer ), "0.0000 HMI_ParkCfg_Stat_UB := %X\n", getValue( HMI_ParkCfg_Stat_UB ) );        filePutString ( buffer, elcount( buffer ), hFile );
    snprintf( buffer, elcount( buffer ), "0.0000 HMI_ParkGuid_Stat := %X\n", getValue( HMI_ParkGuid_Stat ) );        filePutString ( buffer, elcount( buffer ), hFile );
    snprintf( buffer, elcount( buffer ), "0.0000 HMI_ParkStyle_V2 := %X\n", getValue( HMI_ParkStyle_V2 ) );        filePutString ( buffer, elcount( buffer ), hFile );
    snprintf( buffer, elcount( buffer ), "0.0000 HMI_PkBrk_Stat := %X\n", getValue( HMI_PkBrk_Stat ) );        filePutString ( buffer, elcount( buffer ), hFile );
    snprintf( buffer, elcount( buffer ), "0.0000 HMI_St_Rq_PARK_UB := %X\n", getValue( HMI_St_Rq_PARK_UB ) );        filePutString ( buffer, elcount( buffer ), hFile );
    snprintf( buffer, elcount( buffer ), "0.0000 HMI_StWhl_Cond_Disp_Rq := %X\n", getValue( HMI_StWhl_Cond_Disp_Rq ) );        filePutString ( buffer, elcount( buffer ), hFile );
    snprintf( buffer, elcount( buffer ), "0.0000 HMI_StWhl_Cond_Disp_Rq_UB := %X\n", getValue( HMI_StWhl_Cond_Disp_Rq_UB ) );        filePutString ( buffer, elcount( buffer ), hFile );
    snprintf( buffer, elcount( buffer ), "0.0000 HMI_TCM_Data2_UB := %X\n", getValue( HMI_TCM_Data2_UB ) );        filePutString ( buffer, elcount( buffer ), hFile );
    snprintf( buffer, elcount( buffer ), "0.0000 HMI_TSL_Posn_TCM := %X\n", getValue( HMI_TSL_Posn_TCM ) );        filePutString ( buffer, elcount( buffer ), hFile );
}
/*@@end*/

/*@@timer:_tCHASSIS_HMI_R2_AR:*/
on timer _tCHASSIS_HMI_R2_AR
{
    putValue( HMI__STMSG_CHASSIS_HMI_R2_AR, 0 );
}
/*@@end*/

/*@@envVar:HMI__STMSG_CHASSIS_HMI_R2_AR:*/
on EnvVar HMI__STMSG_CHASSIS_HMI_R2_AR
{
    long tDelay;
    if( getValue( this ) == 2 )
    {
        tDelay = getValue( HMI__STMSGT_CHASSIS_HMI_R2_AR );
        if( tDelay > 0)    
            setTimer( _tCHASSIS_HMI_R2_AR, tDelay );
        else
            putValue( HMI__STMSG_CHASSIS_HMI_R2_AR, 0 );
    }
}
/*@@end*/

/*@@envVar:HMI_Brk_Stat:*/
on EnvVar HMI_Brk_Stat
{
    _mCHASSIS_HMI_R2_AR.Brk_Stat.phys = getValue(this);
    _CHASSIS_HMI_R2_AR_SpontanFlag = 1;
}
/*@@end*/

/*@@envVar:HMI_BrkPdl_Stat:*/
on EnvVar HMI_BrkPdl_Stat
{
    _mCHASSIS_HMI_R2_AR.BrkPdl_Stat.phys = getValue(this);
    _CHASSIS_HMI_R2_AR_SpontanFlag = 1;
}
/*@@end*/

/*@@envVar:HMI_BrkSys_Stat_UB:*/
on EnvVar HMI_BrkSys_Stat_UB
{
    _mCHASSIS_HMI_R2_AR.BrkSys_Stat_UB.phys = getValue(this);
    _CHASSIS_HMI_R2_AR_SpontanFlag = 1;
}
/*@@end*/

/*@@envVar:HMI_BrkTrq_D_V2:*/
on EnvVar HMI_BrkTrq_D_V2
{
    _mCHASSIS_HMI_R2_AR.BrkTrq_D_V2.phys = getValue(this);
    _CHASSIS_HMI_R2_AR_SpontanFlag = 1;
}
/*@@end*/

/*@@envVar:HMI_EmgBrk_Actv:*/
on EnvVar HMI_EmgBrk_Actv
{
    _mCHASSIS_HMI_R2_AR.EmgBrk_Actv.phys = getValue(this);
    _CHASSIS_HMI_R2_AR_SpontanFlag = 1;
}
/*@@end*/

/*@@envVar:HMI_EPKB_Stat_UB:*/
on EnvVar HMI_EPKB_Stat_UB
{
    _mCHASSIS_HMI_R2_AR.EPKB_Stat_UB.phys = getValue(this);
    _CHASSIS_HMI_R2_AR_SpontanFlag = 1;
}
/*@@end*/

/*@@envVar:HMI_ESP_Enbl_Rq_EPKB:*/
on EnvVar HMI_ESP_Enbl_Rq_EPKB
{
    _mCHASSIS_HMI_R2_AR.ESP_Enbl_Rq_EPKB.phys = getValue(this);
    _CHASSIS_HMI_R2_AR_SpontanFlag = 1;
}
/*@@end*/

/*@@envVar:HMI_ESP_Oprtn_Stat_AS_V2:*/
on EnvVar HMI_ESP_Oprtn_Stat_AS_V2
{
    _mCHASSIS_HMI_R2_AR.ESP_Oprtn_Stat_AS_V2.phys = getValue(this);
    _CHASSIS_HMI_R2_AR_SpontanFlag = 1;
}
/*@@end*/

/*@@envVar:HMI_Gr:*/
on EnvVar HMI_Gr
{
    _mCHASSIS_HMI_R2_AR.Gr.phys = getValue(this);
    _CHASSIS_HMI_R2_AR_SpontanFlag = 1;
}
/*@@end*/

/*@@envVar:HMI_PARK_Sp_Stat:*/
on EnvVar HMI_PARK_Sp_Stat
{
    _mCHASSIS_HMI_R2_AR.PARK_Sp_Stat.phys = getValue(this);
    _CHASSIS_HMI_R2_AR_SpontanFlag = 1;
}
/*@@end*/

/*@@envVar:HMI_PARK_Stat_PARK:*/
on EnvVar HMI_PARK_Stat_PARK
{
    _mCHASSIS_HMI_R2_AR.PARK_Stat_PARK.phys = getValue(this);
    _CHASSIS_HMI_R2_AR_SpontanFlag = 1;
}
/*@@end*/

/*@@envVar:HMI_ParkCfg_Stat_UB:*/
on EnvVar HMI_ParkCfg_Stat_UB
{
    _mCHASSIS_HMI_R2_AR.ParkCfg_Stat_UB.phys = getValue(this);
    _CHASSIS_HMI_R2_AR_SpontanFlag = 1;
}
/*@@end*/

/*@@envVar:HMI_ParkGuid_Stat:*/
on EnvVar HMI_ParkGuid_Stat
{
    _mCHASSIS_HMI_R2_AR.ParkGuid_Stat.phys = getValue(this);
    _CHASSIS_HMI_R2_AR_SpontanFlag = 1;
}
/*@@end*/

/*@@envVar:HMI_ParkStyle_V2:*/
on EnvVar HMI_ParkStyle_V2
{
    _mCHASSIS_HMI_R2_AR.ParkStyle_V2.phys = getValue(this);
    _CHASSIS_HMI_R2_AR_SpontanFlag = 1;
}
/*@@end*/

/*@@envVar:HMI_PkBrk_Stat:*/
on EnvVar HMI_PkBrk_Stat
{
    _mCHASSIS_HMI_R2_AR.PkBrk_Stat.phys = getValue(this);
    _CHASSIS_HMI_R2_AR_SpontanFlag = 1;
}
/*@@end*/

/*@@envVar:HMI_St_Rq_PARK_UB:*/
on EnvVar HMI_St_Rq_PARK_UB
{
    _mCHASSIS_HMI_R2_AR.St_Rq_PARK_UB.phys = getValue(this);
    _CHASSIS_HMI_R2_AR_SpontanFlag = 1;
}
/*@@end*/

/*@@envVar:HMI_StWhl_Cond_Disp_Rq:*/
on EnvVar HMI_StWhl_Cond_Disp_Rq
{
    _mCHASSIS_HMI_R2_AR.StWhl_Cond_Disp_Rq.phys = getValue(this);
    _CHASSIS_HMI_R2_AR_SpontanFlag = 1;
}
/*@@end*/

/*@@envVar:HMI_StWhl_Cond_Disp_Rq_UB:*/
on EnvVar HMI_StWhl_Cond_Disp_Rq_UB
{
    _mCHASSIS_HMI_R2_AR.StWhl_Cond_Disp_Rq_UB.phys = getValue(this);
    _CHASSIS_HMI_R2_AR_SpontanFlag = 1;
}
/*@@end*/

/*@@envVar:HMI_TCM_Data2_UB:*/
on EnvVar HMI_TCM_Data2_UB
{
    _mCHASSIS_HMI_R2_AR.TCM_Data2_UB.phys = getValue(this);
    _CHASSIS_HMI_R2_AR_SpontanFlag = 1;
}
/*@@end*/

/*@@envVar:HMI_TSL_Posn_TCM:*/
on EnvVar HMI_TSL_Posn_TCM
{
    _mCHASSIS_HMI_R2_AR.TSL_Posn_TCM.phys = getValue(this);
    _CHASSIS_HMI_R2_AR_SpontanFlag = 1;
}
/*@@end*/

/*@@caplFunc:CHASSIS_HMI_R3_AR_check_output():*/
CHASSIS_HMI_R3_AR_check_output()
{
    if( !getValue( HMI__STMSG_CHASSIS_HMI_R3_AR ) )
    {
        // Botschaft CHASSIS_HMI_R3_AR ID: 617 --- Sendeart 5 cyclicAndSpontanWithDelay --- 
        _CHASSIS_HMI_R3_AR_Cnt--;
        if( _CHASSIS_HMI_R3_AR_Cnt < 1 )
        {
            CHASSIS_HMI_R3_AR_output(); // Nachricht wg. abgelaufenem Zyklus ausgeben
            _CHASSIS_HMI_R3_AR_Cnt = _CHASSIS_HMI_R3_AR_CycleCount; // Zyklus-Zähler zurücksetzen
            _CHASSIS_HMI_R3_AR_SpontanFlag = 0; // Spontan-Flag zurücksetzen
        }
        else if( _CHASSIS_HMI_R3_AR_SpontanFlag)
        {
            CHASSIS_HMI_R3_AR_output(); // Nachricht wg. spontaner Änderung ausgeben
            _CHASSIS_HMI_R3_AR_SpontanFlag = 0; // Spontan-Flag zurücksetzen
        }
    }
}
/*@@end*/

/*@@caplFunc:CHASSIS_HMI_R3_AR_init():*/
CHASSIS_HMI_R3_AR_init()
{   /* Botschaft CHASSIS_HMI_R3_AR ID: 617 --- Sendeart 5 cyclicAndSpontanWithDelay --- 
BA_ "ApplMessage" BO_ 617 0;
BA_ "NmAsrMessage" BO_ 617 0;
BA_ "GenMsgMinAcceptLength" BO_ 617 8;
BA_ "GenMsgILSupport" BO_ 617 1;
BA_ "DiagState" BO_ 617 0;
BA_ "DiagRequest" BO_ 617 0;
BA_ "DiagResponse" BO_ 617 0;
BA_ "GenMsgStartValue" BO_ 617 "0";
BA_ "GenMsgStartDelayTime" BO_ 617 60;
BA_ "GenMsgDelayTime" BO_ 617 20;
BA_ "GenMsgNrOfRepetition" BO_ 617 0;
BA_ "GenMsgCycleTime" BO_ 617 100;
BA_ "GenMsgSendType" BO_ 617 5;
    */
    _CHASSIS_HMI_R3_AR_Timebase =         c_tDBKomTimer_20ms;
    _CHASSIS_HMI_R3_AR_CycleCount =     100 / _CHASSIS_HMI_R3_AR_Timebase;
    _CHASSIS_HMI_R3_AR_StartDelay =      60 / _CHASSIS_HMI_R3_AR_Timebase;
    _CHASSIS_HMI_R3_AR_Cnt = _CHASSIS_HMI_R3_AR_StartDelay;
    _CHASSIS_HMI_R3_AR_SpontanFlag = 0;

    putValue( HMI__STMSGSD_CHASSIS_HMI_R3_AR, _CHASSIS_HMI_R3_AR_StartDelay * _CHASSIS_HMI_R3_AR_Timebase );

    _mCHASSIS_HMI_R3_AR.EngOilTemp.phys                      = getValue( HMI_EngOilTemp );
    _mCHASSIS_HMI_R3_AR.EngOilTemp_UB.phys                   = getValue( HMI_EngOilTemp_UB );
    _mCHASSIS_HMI_R3_AR.FanMtrIndLmp_On_Rq.phys              = getValue( HMI_FanMtrIndLmp_On_Rq );
    _mCHASSIS_HMI_R3_AR.FanMtrIndLmp_On_Rq_UB.phys           = getValue( HMI_FanMtrIndLmp_On_Rq_UB );
    _mCHASSIS_HMI_R3_AR.LowTempCoolIndLmp_On_Rq.phys         = getValue( HMI_LowTempCoolIndLmp_On_Rq );
    _mCHASSIS_HMI_R3_AR.LowTempCoolIndLmp_On_Rq_UB.phys      = getValue( HMI_LowTempCoolIndLmp_On_Rq_UB );
    _mCHASSIS_HMI_R3_AR.PT_Rdy_V2.phys                       = getValue( HMI_PT_Rdy_V2 );
    _mCHASSIS_HMI_R3_AR.PT_Stat_UB.phys                      = getValue( HMI_PT_Stat_UB );
    _mCHASSIS_HMI_R3_AR.SBW_Stat_UB.phys                     = getValue( HMI_SBW_Stat_UB );
    _mCHASSIS_HMI_R3_AR.SSA_Standby_Stat.phys                = getValue( HMI_SSA_Standby_Stat );
    _mCHASSIS_HMI_R3_AR.TSL_Posn_P_ISM.phys                  = getValue( HMI_TSL_Posn_P_ISM );
    _mCHASSIS_HMI_R3_AR.TSL_Posn_Target.phys                 = getValue( HMI_TSL_Posn_Target );
    _mCHASSIS_HMI_R3_AR.TxOilTemp.phys                       = getValue( HMI_TxOilTemp );
    _mCHASSIS_HMI_R3_AR.TxOilTemp_UB.phys                    = getValue( HMI_TxOilTemp_UB );
    _mCHASSIS_HMI_R3_AR.TxShiftStyle_V2.phys                 = getValue( HMI_TxShiftStyle_V2 );
    _mCHASSIS_HMI_R3_AR.TxShiftStyle_V2_UB.phys              = getValue( HMI_TxShiftStyle_V2_UB );
}
/*@@end*/

/*@@caplFunc:CHASSIS_HMI_R3_AR_output():*/
void CHASSIS_HMI_R3_AR_output(void)
{
    byte crc;
    byte SQC_help;

    if( !getValue( HMI_SQC_PT_Stat_Auto ) )
    {
        // berechne message counter
        SQC_help = getValue( HMI_SQC_PT_Stat );
        if( SQC_help >= 15 ) SQC_help = 0;
        else SQC_help++;
        putValue( HMI_SQC_PT_Stat, SQC_help );
        _mCHASSIS_HMI_R3_AR.SQC_PT_Stat = SQC_help;
    }
    else
          _mCHASSIS_HMI_R3_AR.SQC_PT_Stat = getValue( HMI_SQC_PT_Stat );

    if( getValue( HMI_CRC_PT_Stat_Profile_02 ) )
    {
        if( !getValue( HMI_CRC_PT_Stat_Auto ) )
        {   // CRC according Profile_02 ( W213 )
            // berechne crc
            crc = 0xFF;
//             crc = crctable_profile02[crc ^ _mCHASSIS_HMI_R3_AR.byte( 0 )];  CRC
            crc = crctable_profile02[crc ^ _mCHASSIS_HMI_R3_AR.byte( 1 )];
            // crc = crctable_profile02[crc ^ _mCHASSIS_HMI_R3_AR.byte( 2 )];
            // crc = crctable_profile02[crc ^ _mCHASSIS_HMI_R3_AR.byte( 3 )];
            // crc = crctable_profile02[crc ^ _mCHASSIS_HMI_R3_AR.byte( 4 )];
            // crc = crctable_profile02[crc ^ _mCHASSIS_HMI_R3_AR.byte( 5 )];
            // crc = crctable_profile02[crc ^ _mCHASSIS_HMI_R3_AR.byte( 6 )];
            // crc = crctable_profile02[crc ^ _mCHASSIS_HMI_R3_AR.byte( 7 )];
            crc = crctable_profile02[crc = _CHASSIS_HMI_R3_AR_CRC_Offset[ _mCHASSIS_HMI_R3_AR.SQC_PT_Stat ] ]; // load offset
            crc = (crc ^ 0xFF);
            if( getValue(  HMI_CRC_PT_Stat_Invalid ) )
                crc++;
            _mCHASSIS_HMI_R3_AR.CRC_PT_Stat = crc;
            putValue( HMI_CRC_PT_Stat, crc );
        }
        else
            _mCHASSIS_HMI_R3_AR.CRC_PT_Stat = getValue( HMI_CRC_PT_Stat );
    }
    else
    {
        if( !getValue( HMI_CRC_PT_Stat_Auto ) )
        {   // CRC according to SAE1850 ( W222 )
            // berechne crc
            crc = 0xFF;
//            crc = crctable[crc ^ _mCHASSIS_HMI_R3_AR.byte( 0 )];  CRC
            crc = crctable[crc ^ _mCHASSIS_HMI_R3_AR.byte( 1 )];
            // crc = crctable[crc ^ _mCHASSIS_HMI_R3_AR.byte( 2 )];
            // crc = crctable[crc ^ _mCHASSIS_HMI_R3_AR.byte( 3 )];
            // crc = crctable[crc ^ _mCHASSIS_HMI_R3_AR.byte( 4 )];
            // crc = crctable[crc ^ _mCHASSIS_HMI_R3_AR.byte( 5 )];
            // crc = crctable[crc ^ _mCHASSIS_HMI_R3_AR.byte( 6 )];
            // crc = crctable[crc ^ _mCHASSIS_HMI_R3_AR.byte( 7 )];
            crc = (crc ^ 0xFF);
            if( getValue(  HMI_CRC_PT_Stat_Invalid ) )
                crc++;
            _mCHASSIS_HMI_R3_AR.CRC_PT_Stat = crc;
            putValue( HMI_CRC_PT_Stat, crc );
        }
        else
            _mCHASSIS_HMI_R3_AR.CRC_PT_Stat = getValue( HMI_CRC_PT_Stat );
    }
    output( _mCHASSIS_HMI_R3_AR );
}
/*@@end*/

/*@@caplFunc:CHASSIS_HMI_R3_AR_saveEnvVars(dword):*/
CHASSIS_HMI_R3_AR_saveEnvVars( dword hFile )
{
    filePutString("\n// Knoten EIS: CHASSIS_HMI_R3_AR\n", 31, hFile );
    snprintf( buffer, elcount( buffer ), "0.0000 HMI__STMSG_CHASSIS_HMI_R3_AR := %X\n", getValue( HMI__STMSG_CHASSIS_HMI_R3_AR ) );    filePutString ( buffer, elcount( buffer ), hFile );
    snprintf( buffer, elcount( buffer ), "0.0000 HMI__STMSGT_CHASSIS_HMI_R3_AR := %X\n", getValue( HMI__STMSGT_CHASSIS_HMI_R3_AR ) );    filePutString ( buffer, elcount( buffer ), hFile );
    snprintf( buffer, elcount( buffer ), "0.0000 HMI_CRC_PT_Stat := %X\n", getValue( HMI_CRC_PT_Stat ) );    filePutString ( buffer, elcount( buffer ), hFile );
    snprintf( buffer, elcount( buffer ), "0.0000 HMI_CRC_PT_Stat_Auto := %X\n", getValue( HMI_CRC_PT_Stat_Auto ) );    filePutString ( buffer, elcount( buffer ), hFile );
    snprintf( buffer, elcount( buffer ), "0.0000 HMI_CRC_PT_Stat_Profile_02 := %X\n", getValue( HMI_CRC_PT_Stat_Profile_02 ) );    filePutString ( buffer, elcount( buffer ), hFile );
    snprintf( buffer, elcount( buffer ), "0.0000 HMI_EngOilTemp := %X\n", getValue( HMI_EngOilTemp ) );    filePutString ( buffer, elcount( buffer ), hFile );
    snprintf( buffer, elcount( buffer ), "0.0000 HMI_EngOilTemp_UB := %X\n", getValue( HMI_EngOilTemp_UB ) );    filePutString ( buffer, elcount( buffer ), hFile );
    snprintf( buffer, elcount( buffer ), "0.0000 HMI_FanMtrIndLmp_On_Rq := %X\n", getValue( HMI_FanMtrIndLmp_On_Rq ) );    filePutString ( buffer, elcount( buffer ), hFile );
    snprintf( buffer, elcount( buffer ), "0.0000 HMI_FanMtrIndLmp_On_Rq_UB := %X\n", getValue( HMI_FanMtrIndLmp_On_Rq_UB ) );    filePutString ( buffer, elcount( buffer ), hFile );
    snprintf( buffer, elcount( buffer ), "0.0000 HMI_LowTempCoolIndLmp_On_Rq := %X\n", getValue( HMI_LowTempCoolIndLmp_On_Rq ) );    filePutString ( buffer, elcount( buffer ), hFile );
    snprintf( buffer, elcount( buffer ), "0.0000 HMI_LowTempCoolIndLmp_On_Rq_UB := %X\n", getValue( HMI_LowTempCoolIndLmp_On_Rq_UB ) );    filePutString ( buffer, elcount( buffer ), hFile );
    snprintf( buffer, elcount( buffer ), "0.0000 HMI_PT_Rdy_V2 := %X\n", getValue( HMI_PT_Rdy_V2 ) );    filePutString ( buffer, elcount( buffer ), hFile );
    snprintf( buffer, elcount( buffer ), "0.0000 HMI_PT_Stat_UB := %X\n", getValue( HMI_PT_Stat_UB ) );    filePutString ( buffer, elcount( buffer ), hFile );
    snprintf( buffer, elcount( buffer ), "0.0000 HMI_SBW_Stat_UB := %X\n", getValue( HMI_SBW_Stat_UB ) );    filePutString ( buffer, elcount( buffer ), hFile );
    snprintf( buffer, elcount( buffer ), "0.0000 HMI_SQC_PT_Stat := %X\n", getValue( HMI_SQC_PT_Stat ) );    filePutString ( buffer, elcount( buffer ), hFile );
    snprintf( buffer, elcount( buffer ), "0.0000 HMI_SQC_PT_Stat_Auto := %X\n", getValue( HMI_SQC_PT_Stat_Auto ) );    filePutString ( buffer, elcount( buffer ), hFile );
    snprintf( buffer, elcount( buffer ), "0.0000 HMI_SSA_Standby_Stat := %X\n", getValue( HMI_SSA_Standby_Stat ) );    filePutString ( buffer, elcount( buffer ), hFile );
    snprintf( buffer, elcount( buffer ), "0.0000 HMI_TSL_Posn_P_ISM := %X\n", getValue( HMI_TSL_Posn_P_ISM ) );    filePutString ( buffer, elcount( buffer ), hFile );
    snprintf( buffer, elcount( buffer ), "0.0000 HMI_TSL_Posn_Target := %X\n", getValue( HMI_TSL_Posn_Target ) );    filePutString ( buffer, elcount( buffer ), hFile );
    snprintf( buffer, elcount( buffer ), "0.0000 HMI_TxOilTemp := %X\n", getValue( HMI_TxOilTemp ) );    filePutString ( buffer, elcount( buffer ), hFile );
    snprintf( buffer, elcount( buffer ), "0.0000 HMI_TxOilTemp_UB := %X\n", getValue( HMI_TxOilTemp_UB ) );    filePutString ( buffer, elcount( buffer ), hFile );
    snprintf( buffer, elcount( buffer ), "0.0000 HMI_TxShiftStyle_V2 := %X\n", getValue( HMI_TxShiftStyle_V2 ) );    filePutString ( buffer, elcount( buffer ), hFile );
    snprintf( buffer, elcount( buffer ), "0.0000 HMI_TxShiftStyle_V2_UB := %X\n", getValue( HMI_TxShiftStyle_V2_UB ) );    filePutString ( buffer, elcount( buffer ), hFile );
}
/*@@end*/

/*@@timer:_tCHASSIS_HMI_R3_AR:*/
on timer _tCHASSIS_HMI_R3_AR
{
    putValue( HMI__STMSG_CHASSIS_HMI_R3_AR, 0 );
}
/*@@end*/

/*@@envVar:HMI__STMSG_CHASSIS_HMI_R3_AR:*/
on EnvVar HMI__STMSG_CHASSIS_HMI_R3_AR
{
    long tDelay;
    if( getValue( this ) == 2 )
    {
        tDelay = getValue( HMI__STMSGT_CHASSIS_HMI_R3_AR );
        if( tDelay > 0)    
            setTimer( _tCHASSIS_HMI_R3_AR, tDelay );
        else
            putValue( HMI__STMSG_CHASSIS_HMI_R3_AR, 0 );
    }
}
/*@@end*/

/*@@envVar:HMI_EngOilTemp:*/
on EnvVar HMI_EngOilTemp
{
    _mCHASSIS_HMI_R3_AR.EngOilTemp.phys = getValue(this);
    _CHASSIS_HMI_R3_AR_SpontanFlag = 1;
}
/*@@end*/

/*@@envVar:HMI_EngOilTemp_UB:*/
on EnvVar HMI_EngOilTemp_UB
{
    _mCHASSIS_HMI_R3_AR.EngOilTemp_UB.phys = getValue(this);
    _CHASSIS_HMI_R3_AR_SpontanFlag = 1;
}
/*@@end*/

/*@@envVar:HMI_FanMtrIndLmp_On_Rq:*/
on EnvVar HMI_FanMtrIndLmp_On_Rq
{
    _mCHASSIS_HMI_R3_AR.FanMtrIndLmp_On_Rq.phys = getValue(this);
    _CHASSIS_HMI_R3_AR_SpontanFlag = 1;
}
/*@@end*/

/*@@envVar:HMI_FanMtrIndLmp_On_Rq_UB:*/
on EnvVar HMI_FanMtrIndLmp_On_Rq_UB
{
    _mCHASSIS_HMI_R3_AR.FanMtrIndLmp_On_Rq_UB.phys = getValue(this);
    _CHASSIS_HMI_R3_AR_SpontanFlag = 1;
}
/*@@end*/

/*@@envVar:HMI_LowTempCoolIndLmp_On_Rq:*/
on EnvVar HMI_LowTempCoolIndLmp_On_Rq
{
    _mCHASSIS_HMI_R3_AR.LowTempCoolIndLmp_On_Rq.phys = getValue(this);
    _CHASSIS_HMI_R3_AR_SpontanFlag = 1;
}
/*@@end*/

/*@@envVar:HMI_LowTempCoolIndLmp_On_Rq_UB:*/
on EnvVar HMI_LowTempCoolIndLmp_On_Rq_UB
{
    _mCHASSIS_HMI_R3_AR.LowTempCoolIndLmp_On_Rq_UB.phys = getValue(this);
    _CHASSIS_HMI_R3_AR_SpontanFlag = 1;
}       
/*@@end*/

/*@@envVar:HMI_PT_Stat_UB:*/
on EnvVar HMI_PT_Stat_UB
{
    _mCHASSIS_HMI_R3_AR.PT_Stat_UB.phys = getValue(this);
    _CHASSIS_HMI_R3_AR_SpontanFlag = 1;
}
/*@@end*/

/*@@envVar:HMI_PT_Rdy_V2:*/
on EnvVar HMI_PT_Rdy_V2
{
    _mCHASSIS_HMI_R3_AR.PT_Rdy_V2.phys = getValue(this);
    _CHASSIS_HMI_R3_AR_SpontanFlag = 1;
}
/*@@end*/

/*@@envVar:HMI_SBW_Stat_UB:*/
on EnvVar HMI_SBW_Stat_UB
{
    _mCHASSIS_HMI_R3_AR.SBW_Stat_UB.phys = getValue(this);
    _CHASSIS_HMI_R3_AR_SpontanFlag = 1;
}
/*@@end*/

/*@@envVar:HMI_SSA_Standby_Stat:*/
on EnvVar HMI_SSA_Standby_Stat
{
    _mCHASSIS_HMI_R3_AR.SSA_Standby_Stat.phys = getValue(this);
    _CHASSIS_HMI_R3_AR_SpontanFlag = 1;
}
/*@@end*/

/*@@envVar:HMI_TSL_Posn_P_ISM:*/
on EnvVar HMI_TSL_Posn_P_ISM
{
    if( ( getValue( Env_Stress__StresstestMainActiv ) == 0 )   &&
        ( getValue( HMI__NM_EIS_AutomaticNM_Switching ) == 0 )    )
    {
        _SetCommRequest( cGearIndNMRequest );
        setTimer( t_GearIndNMCancelTimer, c_NMCancelTimer_05sec ); // 5 seconds for auto-shut-off
    }
    _mCHASSIS_HMI_R3_AR.TSL_Posn_P_ISM.phys = getValue(this);
    _CHASSIS_HMI_R3_AR_SpontanFlag = 1;
}
/*@@end*/

/*@@envVar:HMI_TSL_Posn_Target:*/
on EnvVar HMI_TSL_Posn_Target
{
    _mCHASSIS_HMI_R3_AR.TSL_Posn_Target.phys = getValue(this);
    _CHASSIS_HMI_R3_AR_SpontanFlag = 1;
}
/*@@end*/

/*@@envVar:HMI_TxOilTemp:*/
on EnvVar HMI_TxOilTemp
{
    _mCHASSIS_HMI_R3_AR.TxOilTemp.phys = getValue(this);
    _CHASSIS_HMI_R3_AR_SpontanFlag = 1;
}
/*@@end*/

/*@@envVar:HMI_TxOilTemp_UB:*/
on EnvVar HMI_TxOilTemp_UB
{
    _mCHASSIS_HMI_R3_AR.TxOilTemp_UB.phys = getValue(this);
    _CHASSIS_HMI_R3_AR_SpontanFlag = 1;
}
/*@@end*/

/*@@envVar:HMI_TxShiftStyle_V2:*/
on EnvVar HMI_TxShiftStyle_V2
{
    if( ( getValue( Env_Stress__StresstestMainActiv ) == 0 )   &&
        ( getValue( HMI__NM_EIS_AutomaticNM_Switching ) == 0 )    )
    {
        _SetCommRequest( cGearIndNMRequest );
        setTimer( t_GearIndNMCancelTimer, c_NMCancelTimer_05sec ); // 5 seconds for auto-shut-off
    }
    _mCHASSIS_HMI_R3_AR.TxShiftStyle_V2.phys = getValue(this);
    _CHASSIS_HMI_R3_AR_SpontanFlag = 1;
}
/*@@end*/

/*@@envVar:HMI_TxShiftStyle_V2_UB:*/
on EnvVar HMI_TxShiftStyle_V2_UB
{
    _mCHASSIS_HMI_R3_AR.TxShiftStyle_V2_UB.phys = getValue(this);
    _CHASSIS_HMI_R3_AR_SpontanFlag = 1;
}
/*@@end*/

/*@@caplFunc:CHASSIS_HMI_R4_AR_check_output():*/
CHASSIS_HMI_R4_AR_check_output()
{
    if( !getValue( HMI__STMSG_CHASSIS_HMI_R4_AR ) )
    {
        // Botschaft CHASSIS_HMI_R4_AR ID: 619 --- Sendeart 0 cyclic --- 
        _CHASSIS_HMI_R4_AR_Cnt--;
        if( _CHASSIS_HMI_R4_AR_Cnt < 1 )
        {
            CHASSIS_HMI_R4_AR_output(); // Nachricht wg. abgelaufenem Zyklus ausgeben
            _CHASSIS_HMI_R4_AR_Cnt = _CHASSIS_HMI_R4_AR_CycleCount; // Zyklus-Zähler zurücksetzen
        }
    }
}
/*@@end*/

/*@@caplFunc:CHASSIS_HMI_R4_AR_init():*/
CHASSIS_HMI_R4_AR_init()
{    /* Botschaft CHASSIS_HMI_R4_AR ID: 619--- Sendeart 0 cyclicX --- 
BA_ "ApplMessage" BO_ 619 0;
BA_ "NmAsrMessage" BO_ 619 0;
BA_ "GenMsgMinAcceptLength" BO_ 619 8;
BA_ "GenMsgILSupport" BO_ 619 1;
BA_ "DiagState" BO_ 619 0;
BA_ "DiagRequest" BO_ 619 0;
BA_ "DiagResponse" BO_ 619 0;
BA_ "GenMsgStartValue" BO_ 619 "0";
BA_ "GenMsgStartDelayTime" BO_ 619 80;
BA_ "GenMsgCycleTime" BO_ 619 100;
BA_ "GenMsgSendType" BO_ 619 0;
    */
    _CHASSIS_HMI_R4_AR_Timebase =         c_tDBKomTimer_20ms;
    _CHASSIS_HMI_R4_AR_CycleCount =     100 / _CHASSIS_HMI_R4_AR_Timebase;
    _CHASSIS_HMI_R4_AR_StartDelay =      80 / _CHASSIS_HMI_R4_AR_Timebase;
    _CHASSIS_HMI_R4_AR_Cnt = _CHASSIS_HMI_R4_AR_StartDelay;

    putValue( HMI__STMSGSD_CHASSIS_HMI_R4_AR, _CHASSIS_HMI_R4_AR_StartDelay * _CHASSIS_HMI_R4_AR_Timebase );

    _mCHASSIS_HMI_R4_AR.EPS_FtWhlAngl.phys = getValue( HMI_EPS_FtWhlAngl );
    _mCHASSIS_HMI_R4_AR.EPS_FtWhlAngl_Offset.phys = getValue( HMI_EPS_FtWhlAngl_Offset );
    _mCHASSIS_HMI_R4_AR.EPS_FtWhlAngl_Stat.phys = getValue( HMI_EPS_FtWhlAngl_Stat );
    _mCHASSIS_HMI_R4_AR.STA_Rs1_UB.phys = getValue( HMI_STA_Rs1_UB );
}
/*@@end*/

/*@@caplFunc:CHASSIS_HMI_R4_AR_output():*/
CHASSIS_HMI_R4_AR_output(void)
{
    output( _mCHASSIS_HMI_R4_AR );
}
/*@@end*/

/*@@caplFunc:CHASSIS_HMI_R4_AR_saveEnvVars(dword):*/
CHASSIS_HMI_R4_AR_saveEnvVars( dword hFile )
{
    filePutString("\n// Knoten EIS: CHASSIS_HMI_R4_AR\n", 31, hFile );
    snprintf( buffer, elcount( buffer ), "0.0000 HMI__STMSG_CHASSIS_HMI_R4_AR := %X\n", getValue( HMI__STMSG_CHASSIS_HMI_R4_AR ) );    filePutString ( buffer, elcount( buffer ), hFile );
    snprintf( buffer, elcount( buffer ), "0.0000 HMI__STMSGT_CHASSIS_HMI_R4_AR := %X\n", getValue( HMI__STMSGT_CHASSIS_HMI_R4_AR ) );    filePutString ( buffer, elcount( buffer ), hFile );
    snprintf( buffer, elcount( buffer ), "0.0000 HMI_EPS_FtWhlAngl := %X\n", getValue( HMI_EPS_FtWhlAngl ) );    filePutString ( buffer, elcount( buffer ), hFile );
    snprintf( buffer, elcount( buffer ), "0.0000 HMI_EPS_FtWhlAngl_Offset := %X\n", getValue( HMI_EPS_FtWhlAngl_Offset ) );    filePutString ( buffer, elcount( buffer ), hFile );
    snprintf( buffer, elcount( buffer ), "0.0000 HMI_EPS_FtWhlAngl_Stat := %X\n", getValue( HMI_EPS_FtWhlAngl_Stat ) );    filePutString ( buffer, elcount( buffer ), hFile );
    snprintf( buffer, elcount( buffer ), "0.0000 HMI_STA_Rs1_UB := %X\n", getValue( HMI_STA_Rs1_UB ) );    filePutString ( buffer, elcount( buffer ), hFile );
}
/*@@end*/

/*@@timer:_tCHASSIS_HMI_R4_AR:*/
on timer _tCHASSIS_HMI_R4_AR
{
    putValue( HMI__STMSG_CHASSIS_HMI_R4_AR, 0 );
}
/*@@end*/

/*@@envVar:HMI__STMSG_CHASSIS_HMI_R4_AR:*/
on EnvVar HMI__STMSG_CHASSIS_HMI_R4_AR
{
    long tDelay;
    if( getValue( this ) == 2 )
    {
        tDelay = getValue( HMI__STMSGT_CHASSIS_HMI_R4_AR );
        if( tDelay > 0)    
            setTimer( _tCHASSIS_HMI_R4_AR, tDelay );
        else
            putValue( HMI__STMSG_CHASSIS_HMI_R4_AR, 0 );
    }
}
/*@@end*/

/*@@envVar:HMI_EPS_FtWhlAngl:*/
on EnvVar HMI_EPS_FtWhlAngl
{
    _mCHASSIS_HMI_R4_AR.EPS_FtWhlAngl.phys = getValue(this);
}
/*@@end*/

/*@@envVar:HMI_EPS_FtWhlAngl_Offset:*/
on EnvVar HMI_EPS_FtWhlAngl_Offset
{
    _mCHASSIS_HMI_R4_AR.EPS_FtWhlAngl_Offset.phys = getValue(this);
}
/*@@end*/

/*@@envVar:HMI_EPS_FtWhlAngl_Stat:*/
on EnvVar HMI_EPS_FtWhlAngl_Stat
{
    _mCHASSIS_HMI_R4_AR.EPS_FtWhlAngl_Stat.phys = getValue(this);
}
/*@@end*/

/*@@envVar:HMI_STA_Rs1_UB:*/
on EnvVar HMI_STA_Rs1_UB
{
    _mCHASSIS_HMI_R4_AR.STA_Rs1_UB.phys = getValue(this);
}
/*@@end*/

/*@@caplFunc:CHASSISPERIPHERY_HMI_R1_AR_check_output():*/
CHASSISPERIPHERY_HMI_R1_AR_check_output()
{
    if( !getValue( HMI__STMSG_CHASSISPERIPHERY_HMI_R1_AR ) )
    {
        // Botschaft CHASSISPERIPHERY_HMI_R1_AR ID: 319 --- Sendeart 0 cyclicX
        _CHASSISPERIPHERY_HMI_R1_AR_Cnt--;
        if( _CHASSISPERIPHERY_HMI_R1_AR_Cnt < 1 )
        {
            CHASSISPERIPHERY_HMI_R1_AR_output(); // Nachricht wg. abgelaufenem Zyklus ausgeben
            _CHASSISPERIPHERY_HMI_R1_AR_Cnt = _CHASSISPERIPHERY_HMI_R1_AR_CycleCount; // Zyklus-Zähler zurücksetzen
        }
    }
}
/*@@end*/

/*@@caplFunc:CHASSISPERIPHERY_HMI_R1_AR_init():*/
CHASSISPERIPHERY_HMI_R1_AR_init()
{   /* Botschaft CHASSISPERIPHERY_HMI_R1_AR ID: 319 --- Sendeart 0 cyclicX --- 
BA_ "ApplMessage" BO_ 319 0;
BA_ "NmAsrMessage" BO_ 319 0;
BA_ "GenMsgMinAcceptLength" BO_ 319 8;
BA_ "GenMsgILSupport" BO_ 319 1;
BA_ "DiagState" BO_ 319 0;
BA_ "DiagRequest" BO_ 319 0;
BA_ "DiagResponse" BO_ 319 0;
BA_ "GenMsgStartValue" BO_ 319 "0";
BA_ "GenMsgStartDelayTime" BO_ 319 15;
BA_ "GenMsgCycleTime" BO_ 319 40;
BA_ "GenMsgSendType" BO_ 319 0;
    */
    _CHASSISPERIPHERY_HMI_R1_AR_Timebase = 20;
    _CHASSISPERIPHERY_HMI_R1_AR_Cnt = 1;
    _mCHASSISPERIPHERY_HMI_R1_AR.CamLane_LaneAttr1_UB.phys = getValue( HMI_CamLane_LaneAttr1_UB );
    _mCHASSISPERIPHERY_HMI_R1_AR.CamLane_LaneAttr2_UB.phys = getValue( HMI_CamLane_LaneAttr2_UB );
    _mCHASSISPERIPHERY_HMI_R1_AR.CamLane_LaneAttr6_UB.phys = getValue( HMI_CamLane_LaneAttr6_UB );
    _mCHASSISPERIPHERY_HMI_R1_AR.CamLane_LaneAttr7_UB.phys = getValue( HMI_CamLane_LaneAttr7_UB );
    _mCHASSISPERIPHERY_HMI_R1_AR.CamLane_LaneChg_Stat.phys = getValue( HMI_CamLane_LaneChg_Stat );
    _mCHASSISPERIPHERY_HMI_R1_AR.CamLane_LaneMarkType_Lt.phys = getValue( HMI_CamLane_LaneMarkType_Lt );
    _mCHASSISPERIPHERY_HMI_R1_AR.CamLane_LaneMarkType_Rt.phys = getValue( HMI_CamLane_LaneMarkType_Rt );
    _mCHASSISPERIPHERY_HMI_R1_AR.CamLane_RoadExit_Stat.phys = getValue( HMI_CamLane_RoadExit_Stat );
    _mCHASSISPERIPHERY_HMI_R1_AR.IHC_Block_Disp_Rq.phys = getValue( HMI_IHC_Block_Disp_Rq );
    _mCHASSISPERIPHERY_HMI_R1_AR.IHC_Lgt_Stat_MPC_UB.phys = getValue( HMI_IHC_Lgt_Stat_MPC_UB );
    _mCHASSISPERIPHERY_HMI_R1_AR.LDP_BrkMsgDisp_Rq_MPC.phys = getValue( HMI_LDP_BrkMsgDisp_Rq_MPC );
    _mCHASSISPERIPHERY_HMI_R1_AR.NghbrLane_Lt_Stat.phys = getValue( HMI_NghbrLane_Lt_Stat );
    _mCHASSISPERIPHERY_HMI_R1_AR.NghbrLane_Lt_Width.phys = getValue( HMI_NghbrLane_Lt_Width );
    _mCHASSISPERIPHERY_HMI_R1_AR.NghbrLane_Rt_Stat.phys = getValue( HMI_NghbrLane_Rt_Stat );
    _mCHASSISPERIPHERY_HMI_R1_AR.NghbrLane_Rt_Width.phys = getValue( HMI_NghbrLane_Rt_Width );
}
/*@@end*/

/*@@caplFunc:CHASSISPERIPHERY_HMI_R1_AR_output():*/
CHASSISPERIPHERY_HMI_R1_AR_output(void)
{
    output( _mCHASSISPERIPHERY_HMI_R1_AR );
}
/*@@end*/

/*@@caplFunc:CHASSISPERIPHERY_HMI_R1_AR_saveEnvVars(dword):*/
CHASSISPERIPHERY_HMI_R1_AR_saveEnvVars( dword hFile )
{
    filePutString("\n// Knoten EIS: CHASSISPERIPHERY_HMI_R1_AR\n", 31, hFile );
    snprintf( buffer, elcount( buffer ), "0.0000 HMI__STMSG_CHASSISPERIPHERY_HMI_R1_AR := %X\n", getValue( HMI__STMSG_CHASSISPERIPHERY_HMI_R1_AR ) );    filePutString ( buffer, elcount( buffer ), hFile );
    snprintf( buffer, elcount( buffer ), "0.0000 HMI__STMSGT_CHASSISPERIPHERY_HMI_R1_AR := %X\n", getValue( HMI__STMSGT_CHASSISPERIPHERY_HMI_R1_AR ) );    filePutString ( buffer, elcount( buffer ), hFile );
    snprintf( buffer, elcount( buffer ), "0.0000 HMI_CamLane_LaneAttr1_UB := %X\n", getValue( HMI_CamLane_LaneAttr1_UB ) );    filePutString ( buffer, elcount( buffer ), hFile );
    snprintf( buffer, elcount( buffer ), "0.0000 HMI_CamLane_LaneAttr2_UB := %X\n", getValue( HMI_CamLane_LaneAttr2_UB ) );    filePutString ( buffer, elcount( buffer ), hFile );
    snprintf( buffer, elcount( buffer ), "0.0000 HMI_CamLane_LaneAttr6_UB := %X\n", getValue( HMI_CamLane_LaneAttr6_UB ) );    filePutString ( buffer, elcount( buffer ), hFile );
    snprintf( buffer, elcount( buffer ), "0.0000 HMI_CamLane_LaneAttr7_UB := %X\n", getValue( HMI_CamLane_LaneAttr7_UB ) );    filePutString ( buffer, elcount( buffer ), hFile );
    snprintf( buffer, elcount( buffer ), "0.0000 HMI_CamLane_LaneChg_Stat := %X\n", getValue( HMI_CamLane_LaneChg_Stat ) );    filePutString ( buffer, elcount( buffer ), hFile );
    snprintf( buffer, elcount( buffer ), "0.0000 HMI_CamLane_LaneMarkType_Lt := %X\n", getValue( HMI_CamLane_LaneMarkType_Lt ) );    filePutString ( buffer, elcount( buffer ), hFile );
    snprintf( buffer, elcount( buffer ), "0.0000 HMI_CamLane_LaneMarkType_Rt := %X\n", getValue( HMI_CamLane_LaneMarkType_Rt ) );    filePutString ( buffer, elcount( buffer ), hFile );
    snprintf( buffer, elcount( buffer ), "0.0000 HMI_CamLane_RoadExit_Stat := %X\n", getValue( HMI_CamLane_RoadExit_Stat ) );    filePutString ( buffer, elcount( buffer ), hFile );
    snprintf( buffer, elcount( buffer ), "0.0000 HMI_IHC_Block_Disp_Rq := %X\n", getValue( HMI_IHC_Block_Disp_Rq ) );    filePutString ( buffer, elcount( buffer ), hFile );
    snprintf( buffer, elcount( buffer ), "0.0000 HMI_IHC_Lgt_Stat_MPC_UB := %X\n", getValue( HMI_IHC_Lgt_Stat_MPC_UB ) );    filePutString ( buffer, elcount( buffer ), hFile );
    snprintf( buffer, elcount( buffer ), "0.0000 HMI_LDP_BrkMsgDisp_Rq_MPC := %X\n", getValue( HMI_LDP_BrkMsgDisp_Rq_MPC ) );    filePutString ( buffer, elcount( buffer ), hFile );
    snprintf( buffer, elcount( buffer ), "0.0000 HMI_NghbrLane_Lt_Stat := %X\n", getValue( HMI_NghbrLane_Lt_Stat ) );    filePutString ( buffer, elcount( buffer ), hFile );
    snprintf( buffer, elcount( buffer ), "0.0000 HMI_NghbrLane_Lt_Width := %X\n", getValue( HMI_NghbrLane_Lt_Width ) );    filePutString ( buffer, elcount( buffer ), hFile );
    snprintf( buffer, elcount( buffer ), "0.0000 HMI_NghbrLane_Rt_Stat := %X\n", getValue( HMI_NghbrLane_Rt_Stat ) );    filePutString ( buffer, elcount( buffer ), hFile );
    snprintf( buffer, elcount( buffer ), "0.0000 HMI_NghbrLane_Rt_Width := %X\n", getValue( HMI_NghbrLane_Rt_Width ) );    filePutString ( buffer, elcount( buffer ), hFile );
}
/*@@end*/

/*@@timer:_tCHASSISPERIPHERY_HMI_R1_AR:*/
on timer _tCHASSISPERIPHERY_HMI_R1_AR
{
    putValue( HMI__STMSG_CHASSISPERIPHERY_HMI_R1_AR, 0 );
}
/*@@end*/

/*@@envVar:HMI__STMSG_CHASSISPERIPHERY_HMI_R1_AR:*/
on EnvVar HMI__STMSG_CHASSISPERIPHERY_HMI_R1_AR
{
    long tDelay;
    if( getValue( this ) == 2 )
    {
        tDelay = getValue( HMI__STMSGT_CHASSISPERIPHERY_HMI_R1_AR );
        if( tDelay > 0)    
            setTimer( _tCHASSISPERIPHERY_HMI_R1_AR, tDelay );
        else
            putValue( HMI__STMSG_CHASSISPERIPHERY_HMI_R1_AR, 0 );
    }
}
/*@@end*/

/*@@envVar:HMI_CamLane_LaneAttr1_UB:*/
on EnvVar HMI_CamLane_LaneAttr1_UB
{
    _mCHASSISPERIPHERY_HMI_R1_AR.CamLane_LaneAttr1_UB.phys = getValue(this);
}
/*@@end*/

/*@@envVar:HMI_CamLane_LaneAttr2_UB:*/
on EnvVar HMI_CamLane_LaneAttr2_UB
{
    _mCHASSISPERIPHERY_HMI_R1_AR.CamLane_LaneAttr2_UB.phys = getValue(this);
}
/*@@end*/

/*@@envVar:HMI_CamLane_LaneAttr6_UB:*/
on EnvVar HMI_CamLane_LaneAttr6_UB
{
    _mCHASSISPERIPHERY_HMI_R1_AR.CamLane_LaneAttr6_UB.phys = getValue(this);
}
/*@@end*/

/*@@envVar:HMI_CamLane_LaneAttr7_UB:*/
on EnvVar HMI_CamLane_LaneAttr7_UB
{
    _mCHASSISPERIPHERY_HMI_R1_AR.CamLane_LaneAttr7_UB.phys = getValue(this);
}
/*@@end*/

/*@@envVar:HMI_CamLane_LaneChg_Stat:*/
on EnvVar HMI_CamLane_LaneChg_Stat
{
    _mCHASSISPERIPHERY_HMI_R1_AR.CamLane_LaneChg_Stat.phys = getValue(this);
}
/*@@end*/

/*@@envVar:HMI_CamLane_LaneMarkType_Lt:*/
on EnvVar HMI_CamLane_LaneMarkType_Lt
{
    _mCHASSISPERIPHERY_HMI_R1_AR.CamLane_LaneMarkType_Lt.phys = getValue(this);
}
/*@@end*/

/*@@envVar:HMI_CamLane_LaneMarkType_Rt:*/
on EnvVar HMI_CamLane_LaneMarkType_Rt
{
    _mCHASSISPERIPHERY_HMI_R1_AR.CamLane_LaneMarkType_Rt.phys = getValue(this);
}
/*@@end*/

/*@@envVar:HMI_CamLane_RoadExit_Stat:*/
on EnvVar HMI_CamLane_RoadExit_Stat
{
    _mCHASSISPERIPHERY_HMI_R1_AR.CamLane_RoadExit_Stat.phys = getValue(this);
}
/*@@end*/

/*@@envVar:HMI_IHC_Block_Disp_Rq:*/
on EnvVar HMI_IHC_Block_Disp_Rq
{
    _mCHASSISPERIPHERY_HMI_R1_AR.IHC_Block_Disp_Rq.phys = getValue(this);
}
/*@@end*/

/*@@envVar:HMI_IHC_Lgt_Stat_MPC_UB:*/
on EnvVar HMI_IHC_Lgt_Stat_MPC_UB
{
    _mCHASSISPERIPHERY_HMI_R1_AR.IHC_Lgt_Stat_MPC_UB.phys = getValue(this);
}
/*@@end*/

/*@@envVar:HMI_LDP_BrkMsgDisp_Rq_MPC:*/
on EnvVar HMI_LDP_BrkMsgDisp_Rq_MPC
{
    _mCHASSISPERIPHERY_HMI_R1_AR.LDP_BrkMsgDisp_Rq_MPC.phys = getValue(this);
}
/*@@end*/

/*@@envVar:HMI_NghbrLane_Lt_Stat:*/
on EnvVar HMI_NghbrLane_Lt_Stat
{
    _mCHASSISPERIPHERY_HMI_R1_AR.NghbrLane_Lt_Stat.phys = getValue(this);
}
/*@@end*/

/*@@envVar:HMI_NghbrLane_Lt_Width:*/
on EnvVar HMI_NghbrLane_Lt_Width
{
    _mCHASSISPERIPHERY_HMI_R1_AR.NghbrLane_Lt_Width.phys = getValue(this);
}
/*@@end*/

/*@@envVar:HMI_NghbrLane_Rt_Stat:*/
on EnvVar HMI_NghbrLane_Rt_Stat
{
    _mCHASSISPERIPHERY_HMI_R1_AR.NghbrLane_Rt_Stat.phys = getValue(this);
}
/*@@end*/

/*@@envVar:HMI_NghbrLane_Rt_Width:*/
on EnvVar HMI_NghbrLane_Rt_Width
{
    _mCHASSISPERIPHERY_HMI_R1_AR.NghbrLane_Rt_Width.phys = getValue(this);
}
/*@@end*/

/*@@caplFunc:CLkS_Rq_AR_Activity(int):*/
void CLkS_Rq_AR_Activity(int active )
{
    if( active )
    {
        if( _CLkS_Rq_AR_SigActivity == 0)
            _CLkS_Rq_AR_Cnt = 1;
        _CLkS_Rq_AR_SigActivity++;
    }
    else
    {
        _CLkS_Rq_AR_SigActivity--;
    }
}
/*@@end*/

/*@@caplFunc:CLkS_Rq_AR_Change(int,int,int):*/
int CLkS_Rq_AR_Change(int lastValue, int sigValue, int inActValue )
{
    bActiveHelper = (sigValue != inActValue );
      if( !lastValue && bActiveHelper )
        CLkS_Rq_AR_Activity( 1 );
      else if( lastValue && !bActiveHelper )
        CLkS_Rq_AR_Activity(0 );
    return bActiveHelper;
}
/*@@end*/

/*@@caplFunc:CLkS_Rq_AR_check_output():*/
CLkS_Rq_AR_check_output()
{
    if( !getValue( HMI__STMSG_CLkS_Rq_AR ) )
    {
        // Botschaft CLkS_Rq_AR ID: 775 --- Sendeart 8 cyclicIfActiveFast --- 
        _CLkS_Rq_AR_Cnt--;
        if( _CLkS_Rq_AR_Cnt < 1 )
        {
            CLkS_Rq_AR_output(); // Zyklus abgelaufen, Nachricht senden
            if( _CLkS_Rq_AR_SigActivity )
                _CLkS_Rq_AR_Cnt = _CLkS_Rq_AR_CycleCountFast;
            else
                _CLkS_Rq_AR_Cnt = _CLkS_Rq_AR_CycleCountSlow;
        }
    }
}
/*@@end*/

/*@@caplFunc:CLkS_Rq_AR_init():*/
CLkS_Rq_AR_init()
{   /* Botschaft CLkS_Rq_AR ID: 775 --- Sendeart 8 cyclicIfActiveFast --- 
BA_ "ApplMessage" BO_ 775 0;
BA_ "NmAsrMessage" BO_ 775 0;
BA_ "GenMsgMinAcceptLength" BO_ 775 8;
BA_ "GenMsgILSupport" BO_ 775 1;
BA_ "DiagState" BO_ 775 0;
BA_ "DiagRequest" BO_ 775 0;
BA_ "DiagResponse" BO_ 775 0;
BA_ "GenMsgStartValue" BO_ 775 "0";
BA_ "GenMsgStartDelayTime" BO_ 775 10;
BA_ "GenMsgDelayTime" BO_ 775 5;
BA_ "GenMsgCycleTime" BO_ 775 200;
BA_ "GenMsgCycleTimeActive" BO_ 775 50;
BA_ "GenMsgSendType" BO_ 775 8;
    */
    _CLkS_Rq_AR_Timebase =            c_tDBKomTimer_5ms;
    _CLkS_Rq_AR_CycleCountSlow =    200 / _CLkS_Rq_AR_Timebase;
    _CLkS_Rq_AR_CycleCountFast =     50 / _CLkS_Rq_AR_Timebase;
    _CLkS_Rq_AR_StartDelay =         10 / _CLkS_Rq_AR_Timebase;
    _CLkS_Rq_AR_Cnt = _CLkS_Rq_AR_StartDelay;
    _CLkS_Rq_AR_SigActivity = 0;

    putValue( HMI__STMSGSD_CLkS_Rq_AR, _CLkS_Rq_AR_StartDelay * _CLkS_Rq_AR_Timebase );

    _mCLkS_Rq_AR.CLkS_DL_Act_Rq.phys = getValue( HMI_CLkS_DL_Act_Rq );                  _CLkS_Rq_AR_CLkS_DL_Act_Rq_LastState = CLkS_Rq_AR_Change( _CLkS_Rq_AR_CLkS_DL_Act_Rq_LastState, _mCLkS_Rq_AR.CLkS_DL_Act_Rq, 0 );
    _mCLkS_Rq_AR.CLkS_DL_Rq.phys = getValue( HMI_CLkS_DL_Rq );                  _CLkS_Rq_AR_CLkS_DL_Rq_LastState = CLkS_Rq_AR_Change( _CLkS_Rq_AR_CLkS_DL_Rq_LastState, _mCLkS_Rq_AR.CLkS_DL_Rq, 0 );
    _mCLkS_Rq_AR.CLkS_Dr_FL_Rq.phys = getValue( HMI_CLkS_Dr_FL_Rq );                  _CLkS_Rq_AR_CLkS_Dr_FL_Rq_LastState = CLkS_Rq_AR_Change( _CLkS_Rq_AR_CLkS_Dr_FL_Rq_LastState, _mCLkS_Rq_AR.CLkS_Dr_FL_Rq, 0 );
    _mCLkS_Rq_AR.CLkS_Dr_FR_Rq.phys = getValue( HMI_CLkS_Dr_FR_Rq );                  _CLkS_Rq_AR_CLkS_Dr_FR_Rq_LastState = CLkS_Rq_AR_Change( _CLkS_Rq_AR_CLkS_Dr_FR_Rq_LastState, _mCLkS_Rq_AR.CLkS_Dr_FR_Rq, 0 );
    _mCLkS_Rq_AR.CLkS_Dr_RL_Rq.phys = getValue( HMI_CLkS_Dr_RL_Rq );                  _CLkS_Rq_AR_CLkS_Dr_RL_Rq_LastState = CLkS_Rq_AR_Change( _CLkS_Rq_AR_CLkS_Dr_RL_Rq_LastState, _mCLkS_Rq_AR.CLkS_Dr_RL_Rq, 0 );
    _mCLkS_Rq_AR.CLkS_Dr_RR_Rq.phys = getValue( HMI_CLkS_Dr_RR_Rq );                  _CLkS_Rq_AR_CLkS_Dr_RR_Rq_LastState = CLkS_Rq_AR_Change( _CLkS_Rq_AR_CLkS_Dr_RR_Rq_LastState, _mCLkS_Rq_AR.CLkS_Dr_RR_Rq, 0 );
    _mCLkS_Rq_AR.CLkS_Ext_Rq.phys = getValue( HMI_CLkS_Ext_Rq );                  _CLkS_Rq_AR_CLkS_Ext_Rq_LastState = CLkS_Rq_AR_Change( _CLkS_Rq_AR_CLkS_Ext_Rq_LastState, _mCLkS_Rq_AR.CLkS_Ext_Rq, 0 );
    _mCLkS_Rq_AR.CLkS_Gas_Dr_Rq.phys = getValue( HMI_CLkS_Gas_Dr_Rq );                  _CLkS_Rq_AR_CLkS_Gas_Dr_Rq_LastState = CLkS_Rq_AR_Change( _CLkS_Rq_AR_CLkS_Gas_Dr_Rq_LastState, _mCLkS_Rq_AR.CLkS_Gas_Dr_Rq, 0 );
    _mCLkS_Rq_AR.CLkS_Src_V2.phys = getValue( HMI_CLkS_Src_V2 );                  _CLkS_Rq_AR_CLkS_Src_V2_LastState = CLkS_Rq_AR_Change( _CLkS_Rq_AR_CLkS_Src_V2_LastState, _mCLkS_Rq_AR.CLkS_Src_V2, 31 );
    _mCLkS_Rq_AR.CLkS_TurnLmp_Rq.phys = getValue( HMI_CLkS_TurnLmp_Rq );                  _CLkS_Rq_AR_CLkS_TurnLmp_Rq_LastState = CLkS_Rq_AR_Change( _CLkS_Rq_AR_CLkS_TurnLmp_Rq_LastState, _mCLkS_Rq_AR.CLkS_TurnLmp_Rq, 0 );
    _mCLkS_Rq_AR.Key_Sw4_Psd.phys = getValue( HMI_Key_Sw4_Psd );                  _CLkS_Rq_AR_Key_Sw4_Psd_LastState = CLkS_Rq_AR_Change( _CLkS_Rq_AR_Key_Sw4_Psd_LastState, _mCLkS_Rq_AR.Key_Sw4_Psd, 0 );
    _mCLkS_Rq_AR.KeyLine.phys = getValue( HMI_KeyLine );                  _CLkS_Rq_AR_KeyLine_LastState = CLkS_Rq_AR_Change( _CLkS_Rq_AR_KeyLine_LastState, _mCLkS_Rq_AR.KeyLine, 15 );
    _mCLkS_Rq_AR.RemAlm_Rq_MPM.phys = getValue( HMI_RemAlm_Rq_MPM );                  _CLkS_Rq_AR_RemAlm_Rq_MPM_LastState = CLkS_Rq_AR_Change( _CLkS_Rq_AR_RemAlm_Rq_MPM_LastState, _mCLkS_Rq_AR.RemAlm_Rq_MPM, 0 );
    _mCLkS_Rq_AR.TDP_Sw_Cls_Rq_EIS.phys = getValue( HMI_TDP_Sw_Cls_Rq_EIS );                  _CLkS_Rq_AR_TDP_Sw_Cls_Rq_EIS_LastState = CLkS_Rq_AR_Change( _CLkS_Rq_AR_TDP_Sw_Cls_Rq_EIS_LastState, _mCLkS_Rq_AR.TDP_Sw_Cls_Rq_EIS, 0 );
}
/*@@end*/

/*@@caplFunc:CLkS_Rq_AR_output():*/
CLkS_Rq_AR_output(void)
{
    output( _mCLkS_Rq_AR );
}
/*@@end*/

/*@@caplFunc:CLkS_Rq_AR_saveEnvVars(dword):*/
CLkS_Rq_AR_saveEnvVars( dword hFile )
{
    filePutString("\n// Knoten EIS: CLkS_Rq_AR\n", 24, hFile );
    snprintf( buffer, elcount( buffer ), "0.0000 HMI__STMSG_CLkS_Rq_AR := %X\n", getValue( HMI__STMSG_CLkS_Rq_AR ) );    filePutString( buffer, elcount( buffer ), hFile );
    snprintf( buffer, elcount( buffer ), "0.0000 HMI__STMSGT_CLkS_Rq_AR := %X\n", getValue( HMI__STMSGT_CLkS_Rq_AR ) );    filePutString( buffer, elcount( buffer ), hFile );
    snprintf( buffer, elcount( buffer ), "0.0000 HMI_CLkS_DL_Act_Rq := %X\n", getValue( HMI_CLkS_DL_Act_Rq ) );    filePutString( buffer, elcount( buffer ), hFile );
    snprintf( buffer, elcount( buffer ), "0.0000 HMI_CLkS_DL_Rq := %X\n", getValue( HMI_CLkS_DL_Rq ) );    filePutString( buffer, elcount( buffer ), hFile );
    snprintf( buffer, elcount( buffer ), "0.0000 HMI_CLkS_Dr_FL_Rq := %X\n", getValue( HMI_CLkS_Dr_FL_Rq ) );    filePutString( buffer, elcount( buffer ), hFile );
    snprintf( buffer, elcount( buffer ), "0.0000 HMI_CLkS_Dr_FR_Rq := %X\n", getValue( HMI_CLkS_Dr_FR_Rq ) );    filePutString( buffer, elcount( buffer ), hFile );
    snprintf( buffer, elcount( buffer ), "0.0000 HMI_CLkS_Dr_RL_Rq := %X\n", getValue( HMI_CLkS_Dr_RL_Rq ) );    filePutString( buffer, elcount( buffer ), hFile );
    snprintf( buffer, elcount( buffer ), "0.0000 HMI_CLkS_Dr_RR_Rq := %X\n", getValue( HMI_CLkS_Dr_RR_Rq ) );    filePutString( buffer, elcount( buffer ), hFile );
    snprintf( buffer, elcount( buffer ), "0.0000 HMI_CLkS_Ext_Rq := %X\n", getValue( HMI_CLkS_Ext_Rq ) );    filePutString( buffer, elcount( buffer ), hFile );
    snprintf( buffer, elcount( buffer ), "0.0000 HMI_CLkS_Gas_Dr_Rq := %X\n", getValue( HMI_CLkS_Gas_Dr_Rq ) );    filePutString( buffer, elcount( buffer ), hFile );
    snprintf( buffer, elcount( buffer ), "0.0000 HMI_CLkS_Src_V2 := %X\n", getValue( HMI_CLkS_Src_V2 ) );    filePutString( buffer, elcount( buffer ), hFile );
    snprintf( buffer, elcount( buffer ), "0.0000 HMI_CLkS_TurnLmp_Rq := %X\n", getValue( HMI_CLkS_TurnLmp_Rq ) );    filePutString( buffer, elcount( buffer ), hFile );
    snprintf( buffer, elcount( buffer ), "0.0000 HMI_Key_Sw4_Psd := %X\n", getValue( HMI_Key_Sw4_Psd ) );    filePutString( buffer, elcount( buffer ), hFile );
    snprintf( buffer, elcount( buffer ), "0.0000 HMI_KeyLine := %X\n", getValue( HMI_KeyLine ) );    filePutString( buffer, elcount( buffer ), hFile );
    snprintf( buffer, elcount( buffer ), "0.0000 HMI_RemAlm_Rq_MPM := %X\n", getValue( HMI_RemAlm_Rq_MPM ) );    filePutString( buffer, elcount( buffer ), hFile );
    snprintf( buffer, elcount( buffer ), "0.0000 HMI_TDP_Sw_Cls_Rq_EIS := %X\n", getValue( HMI_TDP_Sw_Cls_Rq_EIS ) );    filePutString( buffer, elcount( buffer ), hFile );
}
/*@@end*/

/*@@timer:_tCLkS_Rq_AR:*/
on timer _tCLkS_Rq_AR
{
    putValue( HMI__STMSG_CLkS_Rq_AR, 0 );
}
/*@@end*/

/*@@envVar:HMI__STMSG_CLkS_Rq_AR:*/
on EnvVar HMI__STMSG_CLkS_Rq_AR
{
    long tDelay;
    if( getValue( this ) == 2 )
    {
        tDelay = getValue( HMI__STMSGT_CLkS_Rq_AR );
        if( tDelay > 0)    
            setTimer( _tCLkS_Rq_AR, tDelay );
        else
            putValue( HMI__STMSG_CLkS_Rq_AR, 0 );
    }
}
/*@@end*/

/*@@timer:_tCLkS_Ext_Rq_Auto:*/
on timer _tCLkS_Ext_Rq_Auto
{
    putValue( HMI_CLkS_Ext_Rq, 0 );
}
/*@@end*/

/*@@envVar:HMI__ALLDEF_CLkS_Rq_AR:*/
on EnvVar HMI__ALLDEF_CLkS_Rq_AR
{
    if( getValue(this) )
    {
        // alle signale auf default einstellen
        putValue( HMI_CLkS_DL_Act_Rq, 0 );
        putValue( HMI_CLkS_DL_Rq, 0 );
        putValue( HMI_CLkS_Dr_FL_Rq, 0 );
        putValue( HMI_CLkS_Dr_FR_Rq, 0 );
        putValue( HMI_CLkS_Dr_RL_Rq, 0 );
        putValue( HMI_CLkS_Dr_RR_Rq, 0 );
        putValue( HMI_CLkS_Ext_Rq, 0 );
        putValue( HMI_CLkS_Gas_Dr_Rq, 0 );
        putValue( HMI_CLkS_Src_V2, 0 );
        putValue( HMI_CLkS_TurnLmp_Rq, 0 );
        putValue( HMI_Key_Sw4_Psd, 0 );
        putValue( HMI_KeyLine, 0 );
        putValue( HMI_RemAlm_Rq_MPM, 0 );
        putValue( HMI_TDP_Sw_Cls_Rq_EIS, 0 );
    }
}
/*@@end*/

/*@@envVar:HMI_CLkS_DL_Act_Rq:*/
on EnvVar HMI_CLkS_DL_Act_Rq
{
    _mCLkS_Rq_AR.CLkS_DL_Act_Rq.phys = getValue(this);
    _CLkS_Rq_AR_CLkS_DL_Act_Rq_LastState = CLkS_Rq_AR_Change( _CLkS_Rq_AR_CLkS_DL_Act_Rq_LastState, _mCLkS_Rq_AR.CLkS_DL_Act_Rq, 0 );
}
/*@@end*/

/*@@envVar:HMI_CLkS_DL_Rq:*/
on EnvVar HMI_CLkS_DL_Rq
{
    _mCLkS_Rq_AR.CLkS_DL_Rq.phys = getValue(this);
    _CLkS_Rq_AR_CLkS_DL_Rq_LastState = CLkS_Rq_AR_Change( _CLkS_Rq_AR_CLkS_DL_Rq_LastState, _mCLkS_Rq_AR.CLkS_DL_Rq, 0 );
}
/*@@end*/

/*@@envVar:HMI_CLkS_Dr_FL_Rq:*/
on EnvVar HMI_CLkS_Dr_FL_Rq
{
    _mCLkS_Rq_AR.CLkS_Dr_FL_Rq.phys = getValue(this);
    _CLkS_Rq_AR_CLkS_Dr_FL_Rq_LastState = CLkS_Rq_AR_Change( _CLkS_Rq_AR_CLkS_Dr_FL_Rq_LastState, _mCLkS_Rq_AR.CLkS_Dr_FL_Rq, 0 );
}
/*@@end*/

/*@@envVar:HMI_CLkS_Dr_FR_Rq:*/
on EnvVar HMI_CLkS_Dr_FR_Rq
{
    _mCLkS_Rq_AR.CLkS_Dr_FR_Rq.phys = getValue(this);
    _CLkS_Rq_AR_CLkS_Dr_FR_Rq_LastState = CLkS_Rq_AR_Change( _CLkS_Rq_AR_CLkS_Dr_FR_Rq_LastState, _mCLkS_Rq_AR.CLkS_Dr_FR_Rq, 0 );
}
/*@@end*/

/*@@envVar:HMI_CLkS_Dr_RL_Rq:*/
on EnvVar HMI_CLkS_Dr_RL_Rq
{
    _mCLkS_Rq_AR.CLkS_Dr_RL_Rq.phys = getValue(this);
    _CLkS_Rq_AR_CLkS_Dr_RL_Rq_LastState = CLkS_Rq_AR_Change( _CLkS_Rq_AR_CLkS_Dr_RL_Rq_LastState, _mCLkS_Rq_AR.CLkS_Dr_RL_Rq, 0 );
}
/*@@end*/

/*@@envVar:HMI_CLkS_Dr_RR_Rq:*/
on EnvVar HMI_CLkS_Dr_RR_Rq
{
    _mCLkS_Rq_AR.CLkS_Dr_RR_Rq.phys = getValue(this);
    _CLkS_Rq_AR_CLkS_Dr_RR_Rq_LastState = CLkS_Rq_AR_Change( _CLkS_Rq_AR_CLkS_Dr_RR_Rq_LastState, _mCLkS_Rq_AR.CLkS_Dr_RR_Rq, 0 );
}
/*@@end*/

/*@@envVar:HMI_CLkS_Ext_Rq:*/
on EnvVar HMI_CLkS_Ext_Rq
{
    if( ( getValue( Env_Stress__StresstestMainActiv ) == 0 )   &&
        ( getValue( HMI__NM_EIS_AutomaticNM_Switching ) == 0 )    )
    {
        _SetCommRequest( cCarClosureNMRequest );
        setTimer( t_CarClosureNMCancelTimer, c_NMCancelTimer_05sec ); // 30 seconds for auto-shut-off
        if( getValue( HMI_CLkS_Ext_Rq_Auto ) == 0 )
        {
           setTimer( _tCLkS_Ext_Rq_Auto, ( 8 * _CLkS_Rq_AR_CycleCountFast ) * c_tDBKomTimer_5ms );
        }
    }
    _mCLkS_Rq_AR.CLkS_Ext_Rq.phys = getValue(this);
    _CLkS_Rq_AR_CLkS_Ext_Rq_LastState = CLkS_Rq_AR_Change( _CLkS_Rq_AR_CLkS_Ext_Rq_LastState, _mCLkS_Rq_AR.CLkS_Ext_Rq, 0 );
}
/*@@end*/

/*@@envVar:HMI_CLkS_Gas_Dr_Rq:*/
on EnvVar HMI_CLkS_Gas_Dr_Rq
{
    _mCLkS_Rq_AR.CLkS_Gas_Dr_Rq.phys = getValue(this);
    _CLkS_Rq_AR_CLkS_Gas_Dr_Rq_LastState = CLkS_Rq_AR_Change( _CLkS_Rq_AR_CLkS_Gas_Dr_Rq_LastState, _mCLkS_Rq_AR.CLkS_Gas_Dr_Rq, 0 );
}
/*@@end*/

/*@@envVar:HMI_CLkS_Src_V2:*/
on EnvVar HMI_CLkS_Src_V2
{
    _mCLkS_Rq_AR.CLkS_Src_V2.phys = getValue(this);
    _CLkS_Rq_AR_CLkS_Src_V2_LastState = CLkS_Rq_AR_Change( _CLkS_Rq_AR_CLkS_Src_V2_LastState, _mCLkS_Rq_AR.CLkS_Src_V2, 31 );
}
/*@@end*/

/*@@envVar:HMI_CLkS_TurnLmp_Rq:*/
on EnvVar HMI_CLkS_TurnLmp_Rq
{
    _mCLkS_Rq_AR.CLkS_TurnLmp_Rq.phys = getValue(this);
    _CLkS_Rq_AR_CLkS_TurnLmp_Rq_LastState = CLkS_Rq_AR_Change( _CLkS_Rq_AR_CLkS_TurnLmp_Rq_LastState, _mCLkS_Rq_AR.CLkS_TurnLmp_Rq, 0 );
}
/*@@end*/

/*@@envVar:HMI_Key_Sw4_Psd:*/
on EnvVar HMI_Key_Sw4_Psd
{
    _mCLkS_Rq_AR.Key_Sw4_Psd.phys = getValue(this);
    _CLkS_Rq_AR_Key_Sw4_Psd_LastState = CLkS_Rq_AR_Change( _CLkS_Rq_AR_Key_Sw4_Psd_LastState, _mCLkS_Rq_AR.Key_Sw4_Psd, 0 );
}
/*@@end*/

/*@@envVar:HMI_KeyLine:*/
on EnvVar HMI_KeyLine
{
    _mCLkS_Rq_AR.KeyLine.phys = getValue(this);
    _CLkS_Rq_AR_KeyLine_LastState = CLkS_Rq_AR_Change( _CLkS_Rq_AR_KeyLine_LastState, _mCLkS_Rq_AR.KeyLine, 15 );
}
/*@@end*/

/*@@envVar:HMI_RemAlm_Rq_MPM:*/
on EnvVar HMI_RemAlm_Rq_MPM
{
    _mCLkS_Rq_AR.RemAlm_Rq_MPM.phys = getValue(this);
    _CLkS_Rq_AR_RemAlm_Rq_MPM_LastState = CLkS_Rq_AR_Change( _CLkS_Rq_AR_RemAlm_Rq_MPM_LastState, _mCLkS_Rq_AR.RemAlm_Rq_MPM, 0 );
}
/*@@end*/

/*@@envVar:HMI_TDP_Sw_Cls_Rq_EIS:*/
on EnvVar HMI_TDP_Sw_Cls_Rq_EIS
{
    _mCLkS_Rq_AR.TDP_Sw_Cls_Rq_EIS.phys = getValue(this);
    _CLkS_Rq_AR_TDP_Sw_Cls_Rq_EIS_LastState = CLkS_Rq_AR_Change( _CLkS_Rq_AR_TDP_Sw_Cls_Rq_EIS_LastState, _mCLkS_Rq_AR.TDP_Sw_Cls_Rq_EIS, 0 );
}
/*@@end*/

/*@@caplFunc:CLkS_State_AR_check_output():*/
CLkS_State_AR_check_output()
{
    if( !getValue( HMI__STMSG_CLkS_State_AR ) )
    {
        // Botschaft CLkS_State_AR ID: 763 --- Sendeart 5 cyclicAndSpontanWithDelay --- 
        _CLkS_State_AR_Cnt--;
        if( _CLkS_State_AR_Cnt < 1 )
        {
            CLkS_State_AR_output(); // Nachricht wg. abgelaufenem Zyklus ausgeben
            _CLkS_State_AR_Cnt = _CLkS_State_AR_CycleCount; // Zyklus-Zähler zurücksetzen
            _CLkS_State_AR_SpontanFlag = 0; // Spontan-Flag zurücksetzen
        }
        else if( _CLkS_State_AR_SpontanFlag)
        {
            CLkS_State_AR_output(); // Nachricht wg. spontaner Änderung ausgeben
            _CLkS_State_AR_SpontanFlag = 0; // Spontan-Flag zurücksetzen
        }
    }
}
/*@@end*/

/*@@caplFunc:CLkS_State_AR_init():*/
CLkS_State_AR_init()
{   /* Botschaft CLkS_State_AR ID: 763 --- Sendeart 5 cyclicAndSpontanWithDelay --- 
BA_ "ApplMessage" BO_ 763 0;
BA_ "NmAsrMessage" BO_ 763 0;
BA_ "GenMsgMinAcceptLength" BO_ 763 8;
BA_ "GenMsgILSupport" BO_ 763 1;
BA_ "DiagState" BO_ 763 0;
BA_ "DiagRequest" BO_ 763 0;
BA_ "DiagResponse" BO_ 763 0;
BA_ "GenMsgStartValue" BO_ 763 "0";
BA_ "GenMsgStartDelayTime" BO_ 763 20;
BA_ "GenMsgDelayTime" BO_ 763 5;
BA_ "GenMsgNrOfRepetitions" BO_ 763 0;
BA_ "GenMsgCycleTime" BO_ 763 500;
BA_ "GenMsgSendType" BO_ 763 5;
    */
    _CLkS_State_AR_Timebase =         c_tDBKomTimer_20ms;
    _CLkS_State_AR_CycleCount =     500 / _CLkS_State_AR_Timebase;
    _CLkS_State_AR_StartDelay =      20 / _CLkS_State_AR_Timebase;
    _CLkS_State_AR_Cnt = _CLkS_State_AR_StartDelay;
    _CLkS_State_AR_SpontanFlag = 0;

    putValue( HMI__STMSGSD_CLkS_State_AR, _CLkS_State_AR_StartDelay * _CLkS_State_AR_Timebase );

    _mCLkS_State_AR.AutoDrLk_Rq_Src.phys = getValue( HMI_AutoDrLk_Rq_Src );
    _mCLkS_State_AR.AutoDrLk_Stat.phys = getValue( HMI_AutoDrLk_Stat );
    _mCLkS_State_AR.CLkS_DL_Stat.phys = getValue( HMI_CLkS_DL_Stat );
    _mCLkS_State_AR.CLkS_Dr_FL_Stat.phys = getValue( HMI_CLkS_Dr_FL_Stat );
    _mCLkS_State_AR.CLkS_Dr_FR_Stat.phys = getValue( HMI_CLkS_Dr_FR_Stat );
    _mCLkS_State_AR.CLkS_Dr_RL_Stat.phys = getValue( HMI_CLkS_Dr_RL_Stat );
    _mCLkS_State_AR.CLkS_Dr_RR_Stat.phys = getValue( HMI_CLkS_Dr_RR_Stat );
    _mCLkS_State_AR.CLkS_Dsabl.phys = getValue( HMI_CLkS_Dsabl );
    _mCLkS_State_AR.CLkS_Gas_Dr_Stat.phys = getValue( HMI_CLkS_Gas_Dr_Stat );
    _mCLkS_State_AR.CLkS_Key_Rq_Raw.phys = getValue( HMI_CLkS_Key_Rq_Raw );
    _mCLkS_State_AR.CLkS_Lk_Stat3.phys = getValue( HMI_CLkS_Lk_Stat3 );
    _mCLkS_State_AR.CLkS_Ovruse_Prot_Actv.phys = getValue( HMI_CLkS_Ovruse_Prot_Actv );
    _mCLkS_State_AR.CLkS_TransMd_Actv.phys = getValue( HMI_CLkS_TransMd_Actv );
    _mCLkS_State_AR.KeyId_V2.phys = getValue( HMI_KeyId_V2 );
}
/*@@end*/

/*@@caplFunc:CLkS_State_AR_output():*/
CLkS_State_AR_output(void)
{
    output( _mCLkS_State_AR );
}
/*@@end*/

/*@@caplFunc:CLkS_State_AR_saveEnvVars(dword):*/
CLkS_State_AR_saveEnvVars( dword hFile )
{
    filePutString("\n// Knoten EIS: CLkS_State_AR\n", 27, hFile );
    snprintf( buffer, elcount( buffer ), "0.0000 HMI__STMSG_CLkS_State_AR := %X\n", getValue( HMI__STMSG_CLkS_State_AR ) );        filePutString ( buffer, elcount( buffer ), hFile );
    snprintf( buffer, elcount( buffer ), "0.0000 HMI__STMSGT_CLkS_State_AR := %X\n", getValue( HMI__STMSGT_CLkS_State_AR ) );        filePutString ( buffer, elcount( buffer ), hFile );
    snprintf( buffer, elcount( buffer ), "0.0000 HMI_AutoDrLk_Rq_Src := %X\n", getValue( HMI_AutoDrLk_Rq_Src ) );        filePutString ( buffer, elcount( buffer ), hFile );
    snprintf( buffer, elcount( buffer ), "0.0000 HMI_AutoDrLk_Stat := %X\n", getValue( HMI_AutoDrLk_Stat ) );        filePutString ( buffer, elcount( buffer ), hFile );
    snprintf( buffer, elcount( buffer ), "0.0000 HMI_CLkS_DL_Stat := %X\n", getValue( HMI_CLkS_DL_Stat ) );        filePutString ( buffer, elcount( buffer ), hFile );
    snprintf( buffer, elcount( buffer ), "0.0000 HMI_CLkS_Dr_FL_Stat := %X\n", getValue( HMI_CLkS_Dr_FL_Stat ) );        filePutString ( buffer, elcount( buffer ), hFile );
    snprintf( buffer, elcount( buffer ), "0.0000 HMI_CLkS_Dr_FR_Stat := %X\n", getValue( HMI_CLkS_Dr_FR_Stat ) );        filePutString ( buffer, elcount( buffer ), hFile );
    snprintf( buffer, elcount( buffer ), "0.0000 HMI_CLkS_Dr_RL_Stat := %X\n", getValue( HMI_CLkS_Dr_RL_Stat ) );        filePutString ( buffer, elcount( buffer ), hFile );
    snprintf( buffer, elcount( buffer ), "0.0000 HMI_CLkS_Dr_RR_Stat := %X\n", getValue( HMI_CLkS_Dr_RR_Stat ) );        filePutString ( buffer, elcount( buffer ), hFile );
    snprintf( buffer, elcount( buffer ), "0.0000 HMI_CLkS_Dsabl := %X\n", getValue( HMI_CLkS_Dsabl ) );        filePutString ( buffer, elcount( buffer ), hFile );
    snprintf( buffer, elcount( buffer ), "0.0000 HMI_CLkS_Gas_Dr_Stat := %X\n", getValue( HMI_CLkS_Gas_Dr_Stat ) );        filePutString ( buffer, elcount( buffer ), hFile );
    snprintf( buffer, elcount( buffer ), "0.0000 HMI_CLkS_Key_Rq_Raw := %X\n", getValue( HMI_CLkS_Key_Rq_Raw ) );        filePutString ( buffer, elcount( buffer ), hFile );
    snprintf( buffer, elcount( buffer ), "0.0000 HMI_CLkS_Lk_Stat3 := %X\n", getValue( HMI_CLkS_Lk_Stat3 ) );        filePutString ( buffer, elcount( buffer ), hFile );
    snprintf( buffer, elcount( buffer ), "0.0000 HMI_CLkS_Ovruse_Prot_Actv := %X\n", getValue( HMI_CLkS_Ovruse_Prot_Actv ) );        filePutString ( buffer, elcount( buffer ), hFile );
    snprintf( buffer, elcount( buffer ), "0.0000 HMI_CLkS_TransMd_Actv := %X\n", getValue( HMI_CLkS_TransMd_Actv ) );        filePutString ( buffer, elcount( buffer ), hFile );
    snprintf( buffer, elcount( buffer ), "0.0000 HMI_KeyId_V2 := %X\n", getValue( HMI_KeyId_V2 ) );        filePutString ( buffer, elcount( buffer ), hFile );
}
/*@@end*/

/*@@timer:_tCLkS_State_AR:*/
on timer _tCLkS_State_AR
{
    putValue( HMI__STMSG_CLkS_State_AR, 0 );
}
/*@@end*/

/*@@envVar:HMI__STMSG_CLkS_State_AR:*/
on EnvVar HMI__STMSG_CLkS_State_AR
{
    long tDelay;
    if( getValue( this ) == 2 )
    {
        tDelay = getValue( HMI__STMSGT_CLkS_State_AR );
        if( tDelay > 0)    
            setTimer( _tCLkS_State_AR, tDelay );
        else
            putValue( HMI__STMSG_CLkS_State_AR, 0 );
    }
}
/*@@end*/

/*@@envVar:HMI_AutoDrLk_Rq_Src:*/
on EnvVar HMI_AutoDrLk_Rq_Src
{
    _mCLkS_State_AR.AutoDrLk_Rq_Src.phys = getValue(this);
    _CLkS_State_AR_SpontanFlag = 1;
}
/*@@end*/

/*@@envVar:HMI_AutoDrLk_Stat:*/
on EnvVar HMI_AutoDrLk_Stat
{
    _mCLkS_State_AR.AutoDrLk_Stat.phys = getValue(this);
    _CLkS_State_AR_SpontanFlag = 1;
}
/*@@end*/

/*@@envVar:HMI_CLkS_DL_Stat:*/
on EnvVar HMI_CLkS_DL_Stat
{
    _mCLkS_State_AR.CLkS_DL_Stat.phys = getValue(this);
    _CLkS_State_AR_SpontanFlag = 1;
}
/*@@end*/

/*@@envVar:HMI_CLkS_Dr_FL_Stat:*/
on EnvVar HMI_CLkS_Dr_FL_Stat
{
    _mCLkS_State_AR.CLkS_Dr_FL_Stat.phys = getValue(this);
    _CLkS_State_AR_SpontanFlag = 1;
}
/*@@end*/

/*@@envVar:HMI_CLkS_Dr_FR_Stat:*/
on EnvVar HMI_CLkS_Dr_FR_Stat
{
    _mCLkS_State_AR.CLkS_Dr_FR_Stat.phys = getValue(this);
    _CLkS_State_AR_SpontanFlag = 1;
}
/*@@end*/

/*@@envVar:HMI_CLkS_Dr_RL_Stat:*/
on EnvVar HMI_CLkS_Dr_RL_Stat
{
    _mCLkS_State_AR.CLkS_Dr_RL_Stat.phys = getValue(this);
    _CLkS_State_AR_SpontanFlag = 1;
}
/*@@end*/

/*@@envVar:HMI_CLkS_Dr_RR_Stat:*/
on EnvVar HMI_CLkS_Dr_RR_Stat
{
    _mCLkS_State_AR.CLkS_Dr_RR_Stat.phys = getValue(this);
    _CLkS_State_AR_SpontanFlag = 1;
}
/*@@end*/

/*@@envVar:HMI_CLkS_Dsabl:*/
on EnvVar HMI_CLkS_Dsabl
{
    _mCLkS_State_AR.CLkS_Dsabl.phys = getValue(this);
    _CLkS_State_AR_SpontanFlag = 1;
}
/*@@end*/

/*@@envVar:HMI_CLkS_Gas_Dr_Stat:*/
on EnvVar HMI_CLkS_Gas_Dr_Stat
{
    _mCLkS_State_AR.CLkS_Gas_Dr_Stat.phys = getValue(this);
    _CLkS_State_AR_SpontanFlag = 1;
}
/*@@end*/

/*@@envVar:HMI_CLkS_Key_Rq_Raw:*/
on EnvVar HMI_CLkS_Key_Rq_Raw
{
    _mCLkS_State_AR.CLkS_Key_Rq_Raw.phys = getValue(this);
    _CLkS_State_AR_SpontanFlag = 1;
}
/*@@end*/

/*@@envVar:HMI_CLkS_Lk_Stat3:*/
on EnvVar HMI_CLkS_Lk_Stat3
{
    _mCLkS_State_AR.CLkS_Lk_Stat3.phys = getValue(this);
    _CLkS_State_AR_SpontanFlag = 1;
}
/*@@end*/

/*@@envVar:HMI_CLkS_Ovruse_Prot_Actv:*/
on EnvVar HMI_CLkS_Ovruse_Prot_Actv
{
    _mCLkS_State_AR.CLkS_Ovruse_Prot_Actv.phys = getValue(this);
    _CLkS_State_AR_SpontanFlag = 1;
}
/*@@end*/

/*@@envVar:HMI_CLkS_TransMd_Actv:*/
on EnvVar HMI_CLkS_TransMd_Actv
{
    _mCLkS_State_AR.CLkS_TransMd_Actv.phys = getValue(this);
    _CLkS_State_AR_SpontanFlag = 1;
}
/*@@end*/

/*@@envVar:HMI_KeyId_V2:*/
on EnvVar HMI_KeyId_V2
{
    _mCLkS_State_AR.KeyId_V2.phys = getValue(this);
    _CLkS_State_AR_SpontanFlag = 1;
}
/*@@end*/

/*@@caplFunc:ClockSync_Stat_AR_check_output():*/
ClockSync_Stat_AR_check_output()
{
    if( !getValue( HMI__STMSG_ClockSync_Stat_AR ) )
    {
        // Botschaft ClockSync_Stat_AR --- Sendeart 1 spontanX
        if( _ClockSync_Stat_AR_SpontanFlag)
        {
            // Nachricht wg. spontaner Änderung ausgeben
            ClockSync_Stat_AR_output();
            // Spontan-Flag zurücksetzen
             _ClockSync_Stat_AR_SpontanFlag = 0;
        }
    }
}
/*@@end*/

/*@@caplFunc:ClockSync_Stat_AR_init():*/
ClockSync_Stat_AR_init()
{    /* Botschaft ClockSync_Stat_AR ID: 427 --- Sendeart 1 spontanX --- 
BA_ "ApplMessage" BO_ 427 0;
BA_ "NmAsrMessage" BO_ 427 0;
BA_ "GenMsgMinAcceptLength" BO_ 427 8;
BA_ "GenMsgILSupport" BO_ 427 0;
BA_ "DiagState" BO_ 427 0;
BA_ "DiagRequest" BO_ 427 0;
BA_ "DiagResponse" BO_ 427 0;
BA_ "GenMsgStartValue" BO_ 427 "0";
BA_ "GenMsgDelayTime" BO_ 427 40;
BA_ "GenMsgNrOfRepetitions" BO_ 427 0;
BA_ "GenMsgSendType" BO_ 427 1;
        */
    
    _ClockSync_Stat_AR_Timebase =        c_tDBKomTimer_20ms;
    _ClockSync_Stat_AR_CycleCount =     40 / c_tDBKomTimer_20ms;
    _ClockSync_Stat_AR_Cnt = 0;
    _ClockSync_Stat_AR_SpontanFlag = 0;

    putValue( HMI__STMSGSD_ClockSync_Stat_AR, _ClockSync_Stat_AR_StartDelay * _ClockSync_Stat_AR_Timebase ); 

    _mClockSync_Stat_AR.ClockSync_MsgType.phys = getValue( HMI_ClockSync_MsgType );
    _mClockSync_Stat_AR.ClockSync_ReplaceECU.phys = getValue( HMI_ClockSync_ReplaceECU );
    _mClockSync_Stat_AR.ClockSync_Second.phys = getValue( HMI_ClockSync_Second );
    _mClockSync_Stat_AR.ClockSync_TmDiscont.phys = getValue( HMI_ClockSync_TmDiscont );
    _mClockSync_Stat_AR.ClockSync_TmDomain.phys = getValue( HMI_ClockSync_TmDomain );
    _mClockSync_Stat_AR.ClockSync_TmStartZero.phys = getValue( HMI_ClockSync_TmStartZero );
    _mClockSync_Stat_AR.ClockSync_User.phys = getValue( HMI_ClockSync_User );
    _mClockSync_Stat_AR.Rsrv1_ClockSync_Stat1.phys = getValue( HMI_Rsrv1_ClockSync_Stat1 );
    _mClockSync_Stat_AR.ClockSync_NanoSecond.phys = getValue( HMI_ClockSync_NanoSecond );
    _mClockSync_Stat_AR.ClockSync_OvrFlowTm.phys = getValue( HMI_ClockSync_OvrFlowTm );
    _mClockSync_Stat_AR.ClockSync_SyncTmGw.phys = getValue( HMI_ClockSync_SyncTmGw );
    _mClockSync_Stat_AR.ClockSync_TmDomain_FUP.phys = getValue( HMI_ClockSync_TmDomain_FUP );
    _mClockSync_Stat_AR.Rsrv1_ClockSync_Stat2.phys = getValue( HMI_Rsrv1_ClockSync_Stat2 );
}
/*@@end*/

/*@@caplFunc:ClockSync_Stat_AR_output():*/
ClockSync_Stat_AR_output(void)
{
    byte crc;
    byte SQC_help;

    if( !getValue( HMI_SQC_ClockSync_Stat1_Auto ) )
    {
        // berechne message counter
        SQC_help = getValue( HMI_SQC_ClockSync_Stat1 );
        if( SQC_help >= 15 ) SQC_help = 0;
        else SQC_help++;
        putValue( HMI_SQC_ClockSync_Stat1, SQC_help );
        _mClockSync_Stat_AR.SQC_ClockSync_Stat1 = SQC_help;
    }
    else
          _mClockSync_Stat_AR.SQC_ClockSync_Stat1 = getValue( HMI_SQC_ClockSync_Stat1 );

    if( getValue( HMI_CRC_ClockSync_Stat1_Profile_02 ) )
    {
        if( !getValue( HMI_CRC_ClockSync_Stat1_Auto ) )
        {   // CRC according Profile_02 ( W213 )
            // berechne crc
            crc = 0xFF;
//            crc = crctable_profile02[crc ^ _mClockSync_Stat_AR.byte( 0 )];  MUX
//            crc = crctable_profile02[crc ^ _mClockSync_Stat_AR.byte( 1 )];  CRC
            crc = crctable_profile02[crc ^ _mClockSync_Stat_AR.byte( 2 )];
            crc = crctable_profile02[crc ^ _mClockSync_Stat_AR.byte( 3 )];
            crc = crctable_profile02[crc ^ _mClockSync_Stat_AR.byte( 4 )];
            crc = crctable_profile02[crc ^ _mClockSync_Stat_AR.byte( 5 )];
            crc = crctable_profile02[crc ^ _mClockSync_Stat_AR.byte( 6 )];
            crc = crctable_profile02[crc ^ _mClockSync_Stat_AR.byte( 7 )];
//            crc = crctable_profile02[crc ^ _ClockSync_Stat_AR_CRC_Offset[ _mClockSync_Stat_AR.SQC_ClockSync_Stat1 ] ]; // load offset
            crc = (crc ^ 0xFF);
            if( getValue(  HMI_CRC_ClockSync_Stat1_Invalid ) )
                crc++;
            _mClockSync_Stat_AR.CRC_ClockSync_Stat1 = crc;
            putValue( HMI_CRC_ClockSync_Stat1, crc );
        }
        else
            _mClockSync_Stat_AR.CRC_ClockSync_Stat1 = getValue( HMI_CRC_ClockSync_Stat1 );
    }
    else
    {
        if( !getValue( HMI_CRC_ClockSync_Stat1_Auto ) )
        {   // CRC according to SAE1850 ( W222 )
            // berechne crc
            crc = 0xFF;
//            crc = crctable[crc ^ _mClockSync_Stat_AR.byte( 0 )];  MUX
//            crc = crctable[crc ^ _mClockSync_Stat_AR.byte( 1 )];  CRC
            crc = crctable[crc ^ _mClockSync_Stat_AR.byte( 2 )];
            crc = crctable[crc ^ _mClockSync_Stat_AR.byte( 3 )];
            crc = crctable[crc ^ _mClockSync_Stat_AR.byte( 4 )];
            crc = crctable[crc ^ _mClockSync_Stat_AR.byte( 5 )];
            crc = crctable[crc ^ _mClockSync_Stat_AR.byte( 6 )];
            crc = crctable[crc ^ _mClockSync_Stat_AR.byte( 7 )];
            crc = (crc ^ 0xFF);
            if( getValue(  HMI_CRC_ClockSync_Stat1_Invalid ) )
                crc++;
            _mClockSync_Stat_AR.CRC_ClockSync_Stat1 = crc;
            putValue( HMI_CRC_ClockSync_Stat1, crc );
        }
        else
            _mClockSync_Stat_AR.CRC_ClockSync_Stat1 = getValue( HMI_CRC_ClockSync_Stat1);
    }
    output( _mClockSync_Stat_AR );
}
/*@@end*/

/*@@caplFunc:ClockSync_Stat_AR_saveEnvVars(dword):*/
ClockSync_Stat_AR_saveEnvVars( dword hFile )
{
    filePutString("\n// Knoten EIS: ClockSync_Stat_AR\n", 24, hFile );
    snprintf( buffer, elcount( buffer ), "0.0000 HMI__STMSG_ClockSync_Stat_AR := %X\n", getValue( HMI__STMSG_ClockSync_Stat_AR ) );        filePutString( buffer, elcount( buffer ), hFile );
    snprintf( buffer, elcount( buffer ), "0.0000 HMI__STMSGT_ClockSync_Stat_AR := %X\n", getValue( HMI__STMSGT_ClockSync_Stat_AR ) );        filePutString( buffer, elcount( buffer ), hFile );
    snprintf( buffer, elcount( buffer ), "0.0000 HMI_ClockSync_MsgType := %X\n", getValue( HMI_ClockSync_MsgType ) );        filePutString( buffer, elcount( buffer ), hFile );
    snprintf( buffer, elcount( buffer ), "0.0000 HMI_ClockSync_ReplaceECU := %X\n", getValue( HMI_ClockSync_ReplaceECU ) );        filePutString( buffer, elcount( buffer ), hFile );
    snprintf( buffer, elcount( buffer ), "0.0000 HMI_ClockSync_Second := %X\n", getValue( HMI_ClockSync_Second ) );        filePutString( buffer, elcount( buffer ), hFile );
    snprintf( buffer, elcount( buffer ), "0.0000 HMI_ClockSync_TmDiscont := %X\n", getValue( HMI_ClockSync_TmDiscont ) );        filePutString( buffer, elcount( buffer ), hFile );
    snprintf( buffer, elcount( buffer ), "0.0000 HMI_ClockSync_TmDomain := %X\n", getValue( HMI_ClockSync_TmDomain ) );        filePutString( buffer, elcount( buffer ), hFile );
    snprintf( buffer, elcount( buffer ), "0.0000 HMI_ClockSync_TmStartZero := %X\n", getValue( HMI_ClockSync_TmStartZero ) );        filePutString( buffer, elcount( buffer ), hFile );
    snprintf( buffer, elcount( buffer ), "0.0000 HMI_ClockSync_User := %X\n", getValue( HMI_ClockSync_User ) );        filePutString( buffer, elcount( buffer ), hFile );
    snprintf( buffer, elcount( buffer ), "0.0000 HMI_CRC_ClockSync_Stat1 := %X\n", getValue( HMI_CRC_ClockSync_Stat1 ) );        filePutString( buffer, elcount( buffer ), hFile );
    snprintf( buffer, elcount( buffer ), "0.0000 HMI_CRC_ClockSync_Stat1_Auto := %X\n", getValue( HMI_CRC_ClockSync_Stat1_Auto ) );        filePutString( buffer, elcount( buffer ), hFile );
    snprintf( buffer, elcount( buffer ), "0.0000 HMI_CRC_ClockSync_Stat1_Profile_02 := %X\n", getValue( HMI_CRC_ClockSync_Stat1_Profile_02 ) );        filePutString( buffer, elcount( buffer ), hFile );
    snprintf( buffer, elcount( buffer ), "0.0000 HMI_CRC_ClockSync_Stat1_Invalid := %X\n", getValue( HMI_CRC_ClockSync_Stat1_Invalid ) );        filePutString( buffer, elcount( buffer ), hFile );
    snprintf( buffer, elcount( buffer ), "0.0000 HMI_Rsrv1_ClockSync_Stat1 := %X\n", getValue( HMI_Rsrv1_ClockSync_Stat1 ) );        filePutString( buffer, elcount( buffer ), hFile );
    snprintf( buffer, elcount( buffer ), "0.0000 HMI_SQC_ClockSync_Stat1 := %X\n", getValue( HMI_SQC_ClockSync_Stat1 ) );        filePutString( buffer, elcount( buffer ), hFile );
    snprintf( buffer, elcount( buffer ), "0.0000 HMI_SQC_ClockSync_Stat1_Auto := %X\n", getValue( HMI_SQC_ClockSync_Stat1_Auto ) );        filePutString( buffer, elcount( buffer ), hFile );
    snprintf( buffer, elcount( buffer ), "0.0000 HMI_ClockSync_NanoSecond := %X\n", getValue( HMI_ClockSync_NanoSecond ) );        filePutString( buffer, elcount( buffer ), hFile );
    snprintf( buffer, elcount( buffer ), "0.0000 HMI_ClockSync_OvrFlowTm := %X\n", getValue( HMI_ClockSync_OvrFlowTm ) );        filePutString( buffer, elcount( buffer ), hFile );
    snprintf( buffer, elcount( buffer ), "0.0000 HMI_ClockSync_SyncTmGw := %X\n", getValue( HMI_ClockSync_SyncTmGw ) );        filePutString( buffer, elcount( buffer ), hFile );
    snprintf( buffer, elcount( buffer ), "0.0000 HMI_ClockSync_TmDomain_FUP := %X\n", getValue( HMI_ClockSync_TmDomain_FUP ) );        filePutString( buffer, elcount( buffer ), hFile );
    snprintf( buffer, elcount( buffer ), "0.0000 HMI_CRC_ClockSync_Stat2 := %X\n", getValue( HMI_CRC_ClockSync_Stat2 ) );        filePutString( buffer, elcount( buffer ), hFile );
    snprintf( buffer, elcount( buffer ), "0.0000 HMI_CRC_ClockSync_Stat2_Auto := %X\n", getValue( HMI_CRC_ClockSync_Stat2_Auto ) );        filePutString( buffer, elcount( buffer ), hFile );
    snprintf( buffer, elcount( buffer ), "0.0000 HMI_CRC_ClockSync_Stat2_Profile_02 := %X\n", getValue( HMI_CRC_ClockSync_Stat2_Profile_02 ) );        filePutString( buffer, elcount( buffer ), hFile );
    snprintf( buffer, elcount( buffer ), "0.0000 HMI_CRC_ClockSync_Stat2_Invalid := %X\n", getValue( HMI_CRC_ClockSync_Stat2_Invalid ) );        filePutString( buffer, elcount( buffer ), hFile );
    snprintf( buffer, elcount( buffer ), "0.0000 HMI_Rsrv1_ClockSync_Stat2 := %X\n", getValue( HMI_Rsrv1_ClockSync_Stat2 ) );        filePutString( buffer, elcount( buffer ), hFile );
    snprintf( buffer, elcount( buffer ), "0.0000 HMI_SQC_ClockSync_Stat2 := %X\n", getValue( HMI_SQC_ClockSync_Stat2 ) );        filePutString( buffer, elcount( buffer ), hFile );
    snprintf( buffer, elcount( buffer ), "0.0000 HMI_SQC_ClockSync_Stat2_Auto := %X\n", getValue( HMI_SQC_ClockSync_Stat2_Auto ) );        filePutString( buffer, elcount( buffer ), hFile );
}
/*@@end*/

/*@@timer:_tClockSync_Stat_AR:*/
on timer _tClockSync_Stat_AR
{
    putValue( HMI__STMSG_ClockSync_Stat_AR, 0 );
}
/*@@end*/

/*@@envVar:HMI__STMSG_ClockSync_Stat_AR:*/
on EnvVar HMI__STMSG_ClockSync_Stat_AR
{
    long tDelay;
    if( getValue( this ) == 2 )
    {
        tDelay = getValue( HMI__STMSGT_ClockSync_Stat_AR );
        if( tDelay > 0)    
            setTimer( _tClockSync_Stat_AR, tDelay );
        else
            putValue( HMI__STMSG_ClockSync_Stat_AR, 0 );
    }
}
/*@@end*/

/*@@envVar:HMI_ClockSync_MsgType:*/
on EnvVar HMI_ClockSync_MsgType
{
    _mClockSync_Stat_AR.ClockSync_MsgType.phys = getValue(this);
    _ClockSync_Stat_AR_SpontanFlag = 1;
}
/*@@end*/

/*@@envVar:HMI_ClockSync_ReplaceECU:*/
on EnvVar HMI_ClockSync_ReplaceECU
{
    _mClockSync_Stat_AR.ClockSync_ReplaceECU.phys = getValue(this);
    _ClockSync_Stat_AR_SpontanFlag = 1;
}
/*@@end*/

/*@@envVar:HMI_ClockSync_Second:*/
on EnvVar HMI_ClockSync_Second
{
    _mClockSync_Stat_AR.ClockSync_Second.phys = getValue(this);
    _ClockSync_Stat_AR_SpontanFlag = 1;
}
/*@@end*/

/*@@envVar:HMI_ClockSync_TmDiscont:*/
on EnvVar HMI_ClockSync_TmDiscont
{
    _mClockSync_Stat_AR.ClockSync_TmDiscont.phys = getValue(this);
    _ClockSync_Stat_AR_SpontanFlag = 1;
}
/*@@end*/

/*@@envVar:HMI_ClockSync_TmDomain:*/
on EnvVar HMI_ClockSync_TmDomain
{
    _mClockSync_Stat_AR.ClockSync_TmDomain.phys = getValue(this);
    _ClockSync_Stat_AR_SpontanFlag = 1;
}
/*@@end*/

/*@@envVar:HMI_ClockSync_TmStartZero:*/
on EnvVar HMI_ClockSync_TmStartZero
{
    _mClockSync_Stat_AR.ClockSync_TmStartZero.phys = getValue(this);
    _ClockSync_Stat_AR_SpontanFlag = 1;
}
/*@@end*/

/*@@envVar:HMI_ClockSync_User:*/
on EnvVar HMI_ClockSync_User
{
//    _mClockSync_Stat_AR.ClockSync_User.phys = getValue(this);
    _ClockSync_Stat_AR_SpontanFlag = 1;
}
/*@@end*/

/*@@envVar:HMI_Rsrv1_ClockSync_Stat1:*/
on EnvVar HMI_Rsrv1_ClockSync_Stat1
{
    _mClockSync_Stat_AR.Rsrv1_ClockSync_Stat1.phys = getValue(this);
    _ClockSync_Stat_AR_SpontanFlag = 1;
}
/*@@end*/

/*@@envVar:HMI_ClockSync_NanoSecond:*/
on EnvVar HMI_ClockSync_NanoSecond
{
    _mClockSync_Stat_AR.ClockSync_NanoSecond.phys = getValue(this);
    _ClockSync_Stat_AR_SpontanFlag = 1;
}
/*@@end*/

/*@@envVar:HMI_ClockSync_OvrFlowTm:*/
on EnvVar HMI_ClockSync_OvrFlowTm
{
    _mClockSync_Stat_AR.ClockSync_OvrFlowTm.phys = getValue(this);
    _ClockSync_Stat_AR_SpontanFlag = 1;
}
/*@@end*/

/*@@envVar:HMI_ClockSync_SyncTmGw:*/
on EnvVar HMI_ClockSync_SyncTmGw
{
    _mClockSync_Stat_AR.ClockSync_SyncTmGw.phys = getValue(this);
    _ClockSync_Stat_AR_SpontanFlag = 1;
}
/*@@end*/

/*@@envVar:HMI_ClockSync_TmDomain_FUP:*/
on EnvVar HMI_ClockSync_TmDomain_FUP
{
    _mClockSync_Stat_AR.ClockSync_TmDomain_FUP.phys = getValue(this);
    _ClockSync_Stat_AR_SpontanFlag = 1;
}
/*@@end*/

/*@@envVar:HMI_Rsrv1_ClockSync_Stat2:*/
on EnvVar HMI_Rsrv1_ClockSync_Stat2
{
    _mClockSync_Stat_AR.Rsrv1_ClockSync_Stat2.phys = getValue(this);
    _ClockSync_Stat_AR_SpontanFlag = 1;
}
/*@@end*/

/*@@caplFunc:CMS_PI_Sd_Stat_AR_Activity(int):*/
CMS_PI_Sd_Stat_AR_Activity(int active )
{
      if( active )
      {
          if( _CMS_PI_Sd_Stat_AR_SigActivity == 0)
            _CMS_PI_Sd_Stat_AR_Cnt = 1;
        _CMS_PI_Sd_Stat_AR_SigActivity++;
      }
    else
    {
        _CMS_PI_Sd_Stat_AR_SigActivity--;
      }
}
/*@@end*/

/*@@caplFunc:CMS_PI_Sd_Stat_AR_Change(int,int,int):*/
int CMS_PI_Sd_Stat_AR_Change(int lastValue, int sigValue, int inActValue )
{
    bActiveHelper = (sigValue != inActValue );
      if( !lastValue && bActiveHelper )
        CMS_PI_Sd_Stat_AR_Activity( 1 );
      else if( lastValue && !bActiveHelper )
        CMS_PI_Sd_Stat_AR_Activity(0 );
    return bActiveHelper;
}
/*@@end*/

/*@@caplFunc:CMS_PI_Sd_Stat_AR_check_output():*/
CMS_PI_Sd_Stat_AR_check_output()
{
    if( !getValue( HMI__STMSG_CMS_PI_Sd_Stat_AR ) )
    {
        // Botschaft CMS_PI_Sd_Stat_AR ID: 298 --- Sendeart 8 cyclicIfActiveFast --- 
        _CMS_PI_Sd_Stat_AR_Cnt--;
        if( _CMS_PI_Sd_Stat_AR_Cnt < 1 )
        {
            // Zyklus abgelaufen, Nachricht senden
            CMS_PI_Sd_Stat_AR_output();
            _CMS_PI_Sd_Stat_AR_Cnt = _CMS_PI_Sd_Stat_AR_SigActivity ? _CMS_PI_Sd_Stat_AR_CycleCountFast : _CMS_PI_Sd_Stat_AR_CycleCountSlow;
        }
    }
}
/*@@end*/

/*@@caplFunc:CMS_PI_Sd_Stat_AR_init():*/
CMS_PI_Sd_Stat_AR_init()
{   /* Botschaft CMS_PI_Sd_Stat_AR ID: 298 --- Sendeart 8 cyclicIfActiveFast --- 
BA_ "ApplMessage" BO_ 298 0;
BA_ "NmAsrMessage" BO_ 298 0;
BA_ "GenMsgMinAcceptLength" BO_ 298 8;
BA_ "GenMsgILSupport" BO_ 298 1;
BA_ "DiagState" BO_ 298 0;
BA_ "DiagRequest" BO_ 298 0;
BA_ "DiagResponse" BO_ 298 0;
BA_ "GenMsgStartValue" BO_ 298 "0";
BA_ "GenMsgDelayTime" BO_ 298 5;
BA_ "GenMsgCycleTime" BO_ 298 1000;
BA_ "GenMsgCycleTimeActive" BO_ 298 40;
BA_ "GenMsgSendType" BO_ 298 8;
    */
    _CMS_PI_Sd_Stat_AR_Timebase =            c_tDBKomTimer_20ms;
    _CMS_PI_Sd_Stat_AR_CycleCountSlow =   1000 / _CMS_PI_Sd_Stat_AR_Timebase;
    _CMS_PI_Sd_Stat_AR_CycleCountFast =     40 / _CMS_PI_Sd_Stat_AR_Timebase;
    _CMS_PI_Sd_Stat_AR_StartDelay =          0 / _CMS_PI_Sd_Stat_AR_Timebase;
    _CMS_PI_Sd_Stat_AR_Cnt = _CMS_PI_Sd_Stat_AR_StartDelay;
    _CMS_PI_Sd_Stat_AR_SigActivity = 0;

    putValue( HMI__STMSGSD_CMS_PI_Sd_Stat_AR, _CMS_PI_Sd_Stat_AR_StartDelay * _CMS_PI_Sd_Stat_AR_Timebase );

    _mCMS_PI_Sd_Stat_AR.PI_Sd_Lt_Enbl.phys = getValue( HMI_PI_Sd_Lt_Enbl );
    _mCMS_PI_Sd_Stat_AR.PI_Sd_Obj_Lt_RelSpd.phys = getValue( HMI_PI_Sd_Obj_Lt_RelSpd );
//    _mCMS_PI_Sd_Stat_AR.PI_Sd_Obj_Rt_RelSpd.phys = getValue( HMI_PI_Sd_Obj_Rt_RelSpd );
    _mCMS_PI_Sd_Stat_AR.PI_Sd_RelsRcmmnd_Pyro_Lt.phys = getValue( HMI_PI_Sd_RelsRcmmnd_Pyro_Lt );
//    _mCMS_PI_Sd_Stat_AR.PI_Sd_RelsRcmmnd_Pyro_Rt.phys = getValue( HMI_PI_Sd_RelsRcmmnd_Pyro_Rt );
    _mCMS_PI_Sd_Stat_AR.PI_Sd_RelsRcmmnd_Rev_Lt.phys = getValue( HMI_PI_Sd_RelsRcmmnd_Rev_Lt );
//    _mCMS_PI_Sd_Stat_AR.PI_Sd_RelsRcmmnd_Rev_Rt.phys = getValue( HMI_PI_Sd_RelsRcmmnd_Rev_Rt );
//    _mCMS_PI_Sd_Stat_AR.PI_Sd_Rt_Enbl.phys = getValue( HMI_PI_Sd_Rt_Enbl );
    _mCMS_PI_Sd_Stat_AR.PI_Sd_TTI_Lt.phys = getValue( HMI_PI_Sd_TTI_Lt );
//    _mCMS_PI_Sd_Stat_AR.PI_Sd_TTI_Rt.phys = getValue( HMI_PI_Sd_TTI_Rt );
    _mCMS_PI_Sd_Stat_AR.Rsrv1_CMS_PI_Sd_Lt_Stat.phys = getValue( HMI_Rsrv1_CMS_PI_Sd_Lt_Stat );
//    _mCMS_PI_Sd_Stat_AR.Rsrv1_CMS_PI_Sd_Rt_Stat.phys = getValue( HMI_Rsrv1_CMS_PI_Sd_Rt_Stat );
}
/*@@end*/

/*@@caplFunc:CMS_PI_Sd_Stat_AR_output():*/
void CMS_PI_Sd_Stat_AR_output(void)
{
    byte crc;
    byte SQC_help;

    if( !getValue( HMI_SQC_CMS_PI_Sd_Lt_Stat_Auto ) )
    {
        // berechne message counter
        SQC_help = getValue( HMI_SQC_CMS_PI_Sd_Lt_Stat );
        if( SQC_help >= 15 ) SQC_help = 0;
        else SQC_help++;
        putValue( HMI_SQC_CMS_PI_Sd_Lt_Stat, SQC_help );
        _mCMS_PI_Sd_Stat_AR.SQC_CMS_PI_Sd_Lt_Stat = SQC_help;
    }
    else
        _mCMS_PI_Sd_Stat_AR.SQC_CMS_PI_Sd_Lt_Stat = getValue( HMI_SQC_CMS_PI_Sd_Lt_Stat );

    if( !getValue( HMI_CRC_CMS_PI_Sd_Lt_Stat_Auto ) )
    {   // CRC according Profile_02 ( W213 )
        // berechne crc
        crc = 0xFF;
//      crc = crctable_profile02[ crc ^ _mCMS_PI_Sd_Stat_AR.byte( 0 ) ]; // CRC L
        crc = crctable_profile02[ crc ^ _mCMS_PI_Sd_Stat_AR.byte( 1 ) ];
        crc = crctable_profile02[ crc ^ _mCMS_PI_Sd_Stat_AR.byte( 2 ) ];
        crc = crctable_profile02[ crc ^ _mCMS_PI_Sd_Stat_AR.byte( 3 ) ];
//      crc = crctable_profile02[ crc ^ _mCMS_PI_Sd_Stat_AR.byte( 4 ) ]; // CRC R
//      crc = crctable_profile02[ crc ^ _mCMS_PI_Sd_Stat_AR.byte( 5 ) ];
//      crc = crctable_profile02[ crc ^ _mCMS_PI_Sd_Stat_AR.byte( 6 ) ];
//      crc = crctable_profile02[ crc ^ _mCMS_PI_Sd_Stat_AR.byte( 7 ) ];
        crc = crctable_profile02[ crc ^ _CMS_PI_Sd_Stat_AR_CRC_Offset_L[ _mCMS_PI_Sd_Stat_AR.SQC_CMS_PI_Sd_Lt_Stat ] ]; // load offset
        crc = (crc ^ 0xFF);
        if( getValue(  HMI_CRC_CMS_PI_Sd_Rt_Stat_Invalid ) )
            crc++;
        _mCMS_PI_Sd_Stat_AR.CRC_CMS_PI_Sd_Lt_Stat = crc;
        putValue( HMI_CRC_CMS_PI_Sd_Lt_Stat, crc );
    }
    else
        _mCMS_PI_Sd_Stat_AR.CRC_CMS_PI_Sd_Lt_Stat = getValue( HMI_CRC_CMS_PI_Sd_Lt_Stat );

/*    if( !getValue( HMI_SQC_CMS_PI_Sd_Rt_Stat_Auto ))
    {
        // berechne message counter
        if( _mCMS_PI_Sd_Stat_AR.SQC_CMS_PI_Sd_Rt_Stat >= 15 ) _mCMS_PI_Sd_Stat_AR.SQC_CMS_PI_Sd_Rt_Stat = 0;
        else _mCMS_PI_Sd_Stat_AR.SQC_CMS_PI_Sd_Rt_Stat++;
        putValue(HMI_SQC_CMS_PI_Sd_Rt_Stat, _mCMS_PI_Sd_Stat_AR.SQC_CMS_PI_Sd_Rt_Stat );
    }
    else
        _mCMS_PI_Sd_Stat_AR.SQC_CMS_PI_Sd_Rt_Stat = getValue( HMI_SQC_CMS_PI_Sd_Rt_Stat );

    if( !getValue( HMI_CRC_CMS_PI_Sd_Rt_Stat_Auto ) )
    {   // CRC according Profile_02 ( W213 )
        // berechne crc
        crc = 0xFF;
//      crc = crctable_profile02[ crc ^ _mCMS_PI_Sd_Stat_AR.byte( 0 ) ]; // CRC L
//      crc = crctable_profile02[ crc ^ _mCMS_PI_Sd_Stat_AR.byte( 1 ) ];
//      crc = crctable_profile02[ crc ^ _mCMS_PI_Sd_Stat_AR.byte( 2 ) ];
//      crc = crctable_profile02[ crc ^ _mCMS_PI_Sd_Stat_AR.byte( 3 ) ];
//      crc = crctable_profile02[ crc ^ _mCMS_PI_Sd_Stat_AR.byte( 4 ) ]; // CRC R
        crc = crctable_profile02[ crc ^ _mCMS_PI_Sd_Stat_AR.byte( 5 ) ];
        crc = crctable_profile02[ crc ^ _mCMS_PI_Sd_Stat_AR.byte( 6 ) ];
        crc = crctable_profile02[ crc ^ _mCMS_PI_Sd_Stat_AR.byte( 7 ) ];
        crc = crctable_profile02[ crc ^ _CMS_PI_Sd_Stat_AR_CRC_Offset_R[ _mCMS_PI_Sd_Stat_AR.SQC_CMS_PI_Sd_Rt_Stat ] ]; // load offset
        crc = (crc ^ 0xFF);
        if( getValue(  HMI_CRC_CMS_PI_Sd_Rt_Stat_Invalid ) )
            crc++;
        _mCMS_PI_Sd_Stat_AR.CRC_CMS_PI_Sd_Rt_Stat = crc;
        putValue( HMI_CRC_CMS_PI_Sd_Rt_Stat, crc );
    }
    else
        _mCMS_PI_Sd_Stat_AR.CRC_CMS_PI_Sd_Rt_Stat = getValue( HMI_CRC_CMS_PI_Sd_Rt_Stat );
*/
    output( _mCMS_PI_Sd_Stat_AR );
}
/*@@end*/

/*@@caplFunc:CMS_PI_Sd_Stat_AR_saveEnvVars(dword):*/
CMS_PI_Sd_Stat_AR_saveEnvVars( dword hFile )
{
    filePutString("\n// Knoten EIS: CMS_PI_Sd_Stat_AR\n", 33, hFile );
    snprintf( buffer, elcount( buffer ), "0.0000 HMI__STMSG_CMS_PI_Sd_Stat_AR := %X\n", getValue( HMI__STMSG_CMS_PI_Sd_Stat_AR ) );    filePutString( buffer, elcount( buffer ), hFile );
    snprintf( buffer, elcount( buffer ), "0.0000 HMI__STMSGT_CMS_PI_Sd_Stat_AR := %X\n", getValue( HMI__STMSGT_CMS_PI_Sd_Stat_AR ) );    filePutString( buffer, elcount( buffer ), hFile );
    snprintf( buffer, elcount( buffer ), "0.0000 HMI_CRC_CMS_PI_Sd_Lt_Stat := %X\n", getValue( HMI_CRC_CMS_PI_Sd_Lt_Stat ) );    filePutString( buffer, elcount( buffer ), hFile );
    snprintf( buffer, elcount( buffer ), "0.0000 HMI_CRC_CMS_PI_Sd_Lt_Stat_Auto := %X\n", getValue( HMI_CRC_CMS_PI_Sd_Lt_Stat_Auto ) );    filePutString( buffer, elcount( buffer ), hFile );
    snprintf( buffer, elcount( buffer ), "0.0000 HMI_CRC_CMS_PI_Sd_Lt_Stat_Profile_02 := %X\n", getValue( HMI_CRC_CMS_PI_Sd_Lt_Stat_Profile_02 ) );    filePutString( buffer, elcount( buffer ), hFile );
    snprintf( buffer, elcount( buffer ), "0.0000 HMI_CRC_CMS_PI_Sd_Rt_Stat := %X\n", getValue( HMI_CRC_CMS_PI_Sd_Rt_Stat ) );    filePutString( buffer, elcount( buffer ), hFile );
    snprintf( buffer, elcount( buffer ), "0.0000 HMI_CRC_CMS_PI_Sd_Rt_Stat_Auto := %X\n", getValue( HMI_CRC_CMS_PI_Sd_Rt_Stat_Auto ) );    filePutString( buffer, elcount( buffer ), hFile );
    snprintf( buffer, elcount( buffer ), "0.0000 HMI_CRC_CMS_PI_Sd_Rt_Stat_Profile_02 := %X\n", getValue( HMI_CRC_CMS_PI_Sd_Rt_Stat_Profile_02 ) );    filePutString( buffer, elcount( buffer ), hFile );
    snprintf( buffer, elcount( buffer ), "0.0000 HMI_PI_Sd_Lt_Enbl := %X\n", getValue( HMI_PI_Sd_Lt_Enbl ) );    filePutString( buffer, elcount( buffer ), hFile );
    snprintf( buffer, elcount( buffer ), "0.0000 HMI_PI_Sd_Obj_Lt_RelSpd := %X\n", getValue( HMI_PI_Sd_Obj_Lt_RelSpd ) );    filePutString( buffer, elcount( buffer ), hFile );
    snprintf( buffer, elcount( buffer ), "0.0000 HMI_PI_Sd_Obj_Rt_RelSpd := %X\n", getValue( HMI_PI_Sd_Obj_Rt_RelSpd ) );    filePutString( buffer, elcount( buffer ), hFile );
    snprintf( buffer, elcount( buffer ), "0.0000 HMI_PI_Sd_RelsRcmmnd_Pyro_Lt := %X\n", getValue( HMI_PI_Sd_RelsRcmmnd_Pyro_Lt ) );    filePutString( buffer, elcount( buffer ), hFile );
    snprintf( buffer, elcount( buffer ), "0.0000 HMI_PI_Sd_RelsRcmmnd_Pyro_Rt := %X\n", getValue( HMI_PI_Sd_RelsRcmmnd_Pyro_Rt ) );    filePutString( buffer, elcount( buffer ), hFile );
    snprintf( buffer, elcount( buffer ), "0.0000 HMI_PI_Sd_RelsRcmmnd_Rev_Lt := %X\n", getValue( HMI_PI_Sd_RelsRcmmnd_Rev_Lt ) );    filePutString( buffer, elcount( buffer ), hFile );
    snprintf( buffer, elcount( buffer ), "0.0000 HMI_PI_Sd_RelsRcmmnd_Rev_Rt := %X\n", getValue( HMI_PI_Sd_RelsRcmmnd_Rev_Rt ) );    filePutString( buffer, elcount( buffer ), hFile );
    snprintf( buffer, elcount( buffer ), "0.0000 HMI_PI_Sd_Rt_Enbl := %X\n", getValue( HMI_PI_Sd_Rt_Enbl ) );    filePutString( buffer, elcount( buffer ), hFile );
    snprintf( buffer, elcount( buffer ), "0.0000 HMI_PI_Sd_TTI_Lt := %X\n", getValue( HMI_PI_Sd_TTI_Lt ) );    filePutString( buffer, elcount( buffer ), hFile );
    snprintf( buffer, elcount( buffer ), "0.0000 HMI_PI_Sd_TTI_Rt := %X\n", getValue( HMI_PI_Sd_TTI_Rt ) );    filePutString( buffer, elcount( buffer ), hFile );
    snprintf( buffer, elcount( buffer ), "0.0000 HMI_Rsrv1_CMS_PI_Sd_Lt_Stat := %X\n", getValue( HMI_Rsrv1_CMS_PI_Sd_Lt_Stat ) );    filePutString( buffer, elcount( buffer ), hFile );
    snprintf( buffer, elcount( buffer ), "0.0000 HMI_Rsrv1_CMS_PI_Sd_Rt_Stat := %X\n", getValue( HMI_Rsrv1_CMS_PI_Sd_Rt_Stat ) );    filePutString( buffer, elcount( buffer ), hFile );
    snprintf( buffer, elcount( buffer ), "0.0000 HMI_SQC_CMS_PI_Sd_Lt_Stat := %X\n", getValue( HMI_SQC_CMS_PI_Sd_Lt_Stat ) );    filePutString( buffer, elcount( buffer ), hFile );
    snprintf( buffer, elcount( buffer ), "0.0000 HMI_SQC_CMS_PI_Sd_Lt_Stat_Auto := %X\n", getValue( HMI_SQC_CMS_PI_Sd_Lt_Stat_Auto ) );    filePutString( buffer, elcount( buffer ), hFile );
    snprintf( buffer, elcount( buffer ), "0.0000 HMI_SQC_CMS_PI_Sd_Rt_Stat := %X\n", getValue( HMI_SQC_CMS_PI_Sd_Rt_Stat ) );    filePutString( buffer, elcount( buffer ), hFile );
    snprintf( buffer, elcount( buffer ), "0.0000 HMI_SQC_CMS_PI_Sd_Rt_Stat_Auto := %X\n", getValue( HMI_SQC_CMS_PI_Sd_Rt_Stat_Auto ) );    filePutString( buffer, elcount( buffer ), hFile );
}
/*@@end*/

/*@@timer:_tCMS_PI_Sd_Stat_AR:*/
on timer _tCMS_PI_Sd_Stat_AR
{
    putValue( HMI__STMSG_CMS_PI_Sd_Stat_AR, 0 );
}
/*@@end*/

/*@@envVar:HMI__STMSG_CMS_PI_Sd_Stat_AR:*/
on EnvVar HMI__STMSG_CMS_PI_Sd_Stat_AR
{
    long tDelay;
    if( getValue( this ) == 2 )
    {
        tDelay = getValue( HMI__STMSGT_CMS_PI_Sd_Stat_AR );
        if( tDelay > 0)    
            setTimer( _tCMS_PI_Sd_Stat_AR, tDelay );
        else
            putValue( HMI__STMSG_CMS_PI_Sd_Stat_AR, 0 );
    }
}
/*@@end*/

/*@@envVar:HMI__ALLDEF_CMS_PI_Sd_Stat_AR:*/
on EnvVar HMI__ALLDEF_CMS_PI_Sd_Stat_AR
{
    if( getValue(this) )
    {
        // alle signale auf default einstellen
        putValue( HMI_PI_Sd_Lt_Enbl, 0 );
        putValue( HMI_PI_Sd_Obj_Lt_RelSpd, 0 );
        putValue( HMI_PI_Sd_Obj_Rt_RelSpd, 0 );
        putValue( HMI_PI_Sd_RelsRcmmnd_Pyro_Lt, 0 );
        putValue( HMI_PI_Sd_RelsRcmmnd_Pyro_Rt, 0 );
        putValue( HMI_PI_Sd_RelsRcmmnd_Rev_Lt, 0 );
        putValue( HMI_PI_Sd_RelsRcmmnd_Rev_Rt, 0 );
        putValue( HMI_PI_Sd_Rt_Enbl, 0 );
        putValue( HMI_PI_Sd_TTI_Lt, 0 );
        putValue( HMI_PI_Sd_TTI_Rt, 0 );
        putValue( HMI_Rsrv1_CMS_PI_Sd_Lt_Stat, 0 );
        putValue( HMI_Rsrv1_CMS_PI_Sd_Rt_Stat, 0 );
    }
}
/*@@end*/

/*@@envVar:HMI_PI_Sd_Lt_Enbl:*/
on EnvVar HMI_PI_Sd_Lt_Enbl
{
    _mCMS_PI_Sd_Stat_AR.PI_Sd_Lt_Enbl.phys = getValue(this);
    _CMS_PI_Sd_Stat_AR_PI_Sd_Lt_Enbl_LastState = CMS_PI_Sd_Stat_AR_Change( _CMS_PI_Sd_Stat_AR_PI_Sd_Lt_Enbl_LastState, _mCMS_PI_Sd_Stat_AR.PI_Sd_Lt_Enbl, 0 );
}
/*@@end*/

/*@@envVar:HMI_PI_Sd_Rt_Enbl:*/
on EnvVar HMI_PI_Sd_Rt_Enbl
{
//    _mCMS_PI_Sd_Stat_AR.PI_Sd_Rt_Enbl.phys = getValue(this);
//    _CMS_PI_Sd_Stat_AR_PI_Sd_Rt_Enbl_LastState = CMS_PI_Sd_Stat_AR_Change( _CMS_PI_Sd_Stat_AR_PI_Sd_Rt_Enbl_LastState, _mCMS_PI_Sd_Stat_AR.PI_Sd_Rt_Enbl, 0 );
}
/*@@end*/

/*@@envVar:HMI_PI_Sd_Obj_Lt_RelSpd:*/
on EnvVar HMI_PI_Sd_Obj_Lt_RelSpd
{
    _mCMS_PI_Sd_Stat_AR.PI_Sd_Obj_Lt_RelSpd.phys = getValue(this);
    _CMS_PI_Sd_Stat_AR_PI_Sd_Obj_Lt_RelSpd_LastState = CMS_PI_Sd_Stat_AR_Change( _CMS_PI_Sd_Stat_AR_PI_Sd_Obj_Lt_RelSpd_LastState, _mCMS_PI_Sd_Stat_AR.PI_Sd_Obj_Lt_RelSpd, 0 );
}
/*@@end*/

/*@@envVar:HMI_PI_Sd_Obj_Rt_RelSpd:*/
on EnvVar HMI_PI_Sd_Obj_Rt_RelSpd
{
//    _mCMS_PI_Sd_Stat_AR.PI_Sd_Obj_Rt_RelSpd.phys = getValue(this);
//    _CMS_PI_Sd_Stat_AR_PI_Sd_Obj_Rt_RelSpd_LastState = CMS_PI_Sd_Stat_AR_Change( _CMS_PI_Sd_Stat_AR_PI_Sd_Obj_Rt_RelSpd_LastState, _mCMS_PI_Sd_Stat_AR.PI_Sd_Obj_Rt_RelSpd, 0 );
}
/*@@end*/

/*@@envVar:HMI_PI_Sd_RelsRcmmnd_Pyro_Lt:*/
on EnvVar HMI_PI_Sd_RelsRcmmnd_Pyro_Lt
{
    _mCMS_PI_Sd_Stat_AR.PI_Sd_RelsRcmmnd_Pyro_Lt.phys = getValue(this);
    _CMS_PI_Sd_Stat_AR_PI_Sd_RelsRcmmnd_Pyro_Lt_LastState = CMS_PI_Sd_Stat_AR_Change( _CMS_PI_Sd_Stat_AR_PI_Sd_RelsRcmmnd_Pyro_Lt_LastState, _mCMS_PI_Sd_Stat_AR.PI_Sd_RelsRcmmnd_Pyro_Lt, 0 );
}
/*@@end*/

/*@@envVar:HMI_PI_Sd_RelsRcmmnd_Pyro_Rt:*/
on EnvVar HMI_PI_Sd_RelsRcmmnd_Pyro_Rt
{
//    _mCMS_PI_Sd_Stat_AR.PI_Sd_RelsRcmmnd_Pyro_Rt.phys = getValue(this);
//    _CMS_PI_Sd_Stat_AR_PI_Sd_RelsRcmmnd_Pyro_Rt_LastState = CMS_PI_Sd_Stat_AR_Change( _CMS_PI_Sd_Stat_AR_PI_Sd_RelsRcmmnd_Pyro_Rt_LastState, _mCMS_PI_Sd_Stat_AR.PI_Sd_RelsRcmmnd_Pyro_Rt, 0 );
}
/*@@end*/

/*@@envVar:HMI_PI_Sd_RelsRcmmnd_Rev_Lt:*/
on EnvVar HMI_PI_Sd_RelsRcmmnd_Rev_Lt
{
    _mCMS_PI_Sd_Stat_AR.PI_Sd_RelsRcmmnd_Rev_Lt.phys = getValue(this);
    _CMS_PI_Sd_Stat_AR_PI_Sd_RelsRcmmnd_Rev_Lt_LastState = CMS_PI_Sd_Stat_AR_Change( _CMS_PI_Sd_Stat_AR_PI_Sd_RelsRcmmnd_Rev_Lt_LastState, _mCMS_PI_Sd_Stat_AR.PI_Sd_RelsRcmmnd_Rev_Lt, 0 );
}
/*@@end*/

/*@@envVar:HMI_PI_Sd_RelsRcmmnd_Rev_Rt:*/
on EnvVar HMI_PI_Sd_RelsRcmmnd_Rev_Rt
{
//    _mCMS_PI_Sd_Stat_AR.PI_Sd_RelsRcmmnd_Rev_Rt.phys = getValue(this);
//    _CMS_PI_Sd_Stat_AR_PI_Sd_RelsRcmmnd_Rev_Rt_LastState = CMS_PI_Sd_Stat_AR_Change( _CMS_PI_Sd_Stat_AR_PI_Sd_RelsRcmmnd_Rev_Rt_LastState, _mCMS_PI_Sd_Stat_AR.PI_Sd_RelsRcmmnd_Rev_Rt, 0 );
}
/*@@end*/

/*@@envVar:HMI_PI_Sd_TTI_Lt:*/
on EnvVar HMI_PI_Sd_TTI_Lt
{
    _mCMS_PI_Sd_Stat_AR.PI_Sd_TTI_Lt.phys = getValue(this);
    _CMS_PI_Sd_Stat_AR_PI_Sd_TTI_Lt_LastState = CMS_PI_Sd_Stat_AR_Change( _CMS_PI_Sd_Stat_AR_PI_Sd_TTI_Lt_LastState, _mCMS_PI_Sd_Stat_AR.PI_Sd_TTI_Lt, 0 );
}
/*@@end*/

/*@@envVar:HMI_PI_Sd_TTI_Rt:*/
on EnvVar HMI_PI_Sd_TTI_Rt
{
//    _mCMS_PI_Sd_Stat_AR.PI_Sd_TTI_Rt.phys = getValue(this);
//    _CMS_PI_Sd_Stat_AR_PI_Sd_TTI_Rt_LastState = CMS_PI_Sd_Stat_AR_Change( _CMS_PI_Sd_Stat_AR_PI_Sd_TTI_Rt_LastState, _mCMS_PI_Sd_Stat_AR.PI_Sd_TTI_Rt, 0 );
}
/*@@end*/

/*@@envVar:HMI_Rsrv1_CMS_PI_Sd_Lt_Stat:*/
on EnvVar HMI_Rsrv1_CMS_PI_Sd_Lt_Stat
{
    _mCMS_PI_Sd_Stat_AR.Rsrv1_CMS_PI_Sd_Lt_Stat.phys = getValue(this);
    _CMS_PI_Sd_Stat_AR_Rsrv1_CMS_PI_Sd_Lt_Stat_LastState = CMS_PI_Sd_Stat_AR_Change( _CMS_PI_Sd_Stat_AR_Rsrv1_CMS_PI_Sd_Lt_Stat_LastState, _mCMS_PI_Sd_Stat_AR.Rsrv1_CMS_PI_Sd_Lt_Stat, 0 );
}
/*@@end*/

/*@@envVar:HMI_Rsrv1_CMS_PI_Sd_Rt_Stat:*/
on EnvVar HMI_Rsrv1_CMS_PI_Sd_Rt_Stat
{
//    _mCMS_PI_Sd_Stat_AR.Rsrv1_CMS_PI_Sd_Rt_Stat.phys = getValue(this);
//    _CMS_PI_Sd_Stat_AR_Rsrv1_CMS_PI_Sd_Rt_Stat_LastState = CMS_PI_Sd_Stat_AR_Change( _CMS_PI_Sd_Stat_AR_Rsrv1_CMS_PI_Sd_Rt_Stat_LastState, _mCMS_PI_Sd_Stat_AR.Rsrv1_CMS_PI_Sd_Rt_Stat, 0 );
}
/*@@end*/

/*@@caplFunc:CMS_PI_Stat_AR_check_output():*/
CMS_PI_Stat_AR_check_output()
{
    if( !getValue( HMI__STMSG_CMS_PI_Stat_AR ) )
    {
        // Botschaft CMS_PI_Stat_AR ID: 165 --- Sendeart 0 cyclicX --- 
        _CMS_PI_Stat_AR_Cnt--;
        if( _CMS_PI_Stat_AR_Cnt < 1 )
        {
            // Nachricht wg. abgelaufenem Zyklus ausgeben
            CMS_PI_Stat_AR_output();
            // Zyklus-Zähler zurücksetzen
            _CMS_PI_Stat_AR_Cnt = _CMS_PI_Stat_AR_CycleCount;
        }
    }
}
/*@@end*/

/*@@caplFunc:CMS_PI_Stat_AR_init():*/
CMS_PI_Stat_AR_init()
{   /* Botschaft CMS_PI_Stat_AR ID: 165 --- Sendeart 0 cyclicX --- 
BA_ "ApplMessage" BO_ 165 0;
BA_ "NmAsrMessage" BO_ 165 0;
BA_ "GenMsgMinAcceptLength" BO_ 165 8;
BA_ "GenMsgILSupport" BO_ 165 1;
BA_ "DiagState" BO_ 165 0;
BA_ "DiagRequest" BO_ 165 0;
BA_ "DiagResponse" BO_ 165 0;
BA_ "GenMsgStartValue" BO_ 165 "0";
BA_ "GenMsgCycleTime" BO_ 165 20;
BA_ "GenMsgSendType" BO_ 165 0;
    */
    _CMS_PI_Stat_AR_Timebase =         c_tDBKomTimer_20ms;
    _CMS_PI_Stat_AR_CycleCount =      20 / _CMS_PI_Stat_AR_Timebase;
    _CMS_PI_Stat_AR_StartDelay =       0 / _CMS_PI_Stat_AR_Timebase;
    _CMS_PI_Stat_AR_Cnt = _CMS_PI_Stat_AR_StartDelay;

    putValue( HMI__STMSGSD_CMS_PI_Stat_AR, _CMS_PI_Stat_AR_StartDelay * _CMS_PI_Stat_AR_Timebase );

    _mCMS_PI_Stat_AR.CMS_Brk_Rq_V2.phys = getValue( HMI_CMS_Brk_Rq_V2 );
    _mCMS_PI_Stat_AR.CMS_R_Warn_Rq.phys = getValue( HMI_CMS_R_Warn_Rq );
    _mCMS_PI_Stat_AR.CMS_VehDecel_Rq.phys = getValue( HMI_CMS_VehDecel_Rq );
    _mCMS_PI_Stat_AR.CRC_CMS_PI_Stat.phys = getValue( HMI_CRC_CMS_PI_Stat );
    _mCMS_PI_Stat_AR.PI_Enbl.phys = getValue( HMI_PI_Enbl );
    _mCMS_PI_Stat_AR.PI_Obj_R_RelSpd.phys = getValue( HMI_PI_Obj_R_RelSpd );
    _mCMS_PI_Stat_AR.PI_ObjAhdRelSpd.phys = getValue( HMI_PI_ObjAhdRelSpd );
    _mCMS_PI_Stat_AR.PI_R_Enbl.phys = getValue( HMI_PI_R_Enbl );
    _mCMS_PI_Stat_AR.PI_RelsRcmmnd_Ft.phys = getValue( HMI_PI_RelsRcmmnd_Ft );
    _mCMS_PI_Stat_AR.PI_RelsRcmmnd_R.phys = getValue( HMI_PI_RelsRcmmnd_R );
    _mCMS_PI_Stat_AR.PI_TTI_Ft.phys = getValue( HMI_PI_TTI_Ft );
    _mCMS_PI_Stat_AR.PI_TTI_R.phys = getValue( HMI_PI_TTI_R );
    _mCMS_PI_Stat_AR.Rsrv1_CMS_PI_Stat.phys = getValue( HMI_Rsrv1_CMS_PI_Stat );
    _mCMS_PI_Stat_AR.SQC_CMS_PI_Stat .phys = getValue( HMI_SQC_CMS_PI_Stat  );
}
/*@@end*/

/*@@caplFunc:CMS_PI_Stat_AR_output():*/
void CMS_PI_Stat_AR_output(void)
{
    byte crc;
    byte SQC_help;

    if( !getValue( HMI_SQC_CMS_PI_Stat_Auto ) )
    {
        // berechne message counter
        SQC_help = getValue( HMI_SQC_CMS_PI_Stat );
        if( SQC_help >= 15 ) SQC_help = 0;
        else SQC_help++;
        putValue( HMI_SQC_CMS_PI_Stat, SQC_help );
        _mCMS_PI_Stat_AR.SQC_CMS_PI_Stat = SQC_help;
    }
    else
          _mCMS_PI_Stat_AR.SQC_CMS_PI_Stat = getValue( HMI_SQC_CMS_PI_Stat );

    if( getValue( HMI_CRC_CMS_PI_Stat_Profile_02 ) )
    {
        if( !getValue( HMI_CRC_CMS_PI_Stat_Auto ) )
        {   // CRC according Profile_02 ( W213 )
            // berechne crc
            crc = 0xFF;
//            crc = crctable_profile02[crc ^ _mCMS_PI_Stat_AR.byte( 0 )];  CRC
            crc = crctable_profile02[crc ^ _mCMS_PI_Stat_AR.byte( 1 )];
            crc = crctable_profile02[crc ^ _mCMS_PI_Stat_AR.byte( 2 )];
            crc = crctable_profile02[crc ^ _mCMS_PI_Stat_AR.byte( 3 )];
            crc = crctable_profile02[crc ^ _mCMS_PI_Stat_AR.byte( 4 )];
            crc = crctable_profile02[crc ^ _mCMS_PI_Stat_AR.byte( 5 )];
            crc = crctable_profile02[crc ^ _mCMS_PI_Stat_AR.byte( 6 )];
            crc = crctable_profile02[crc ^ _mCMS_PI_Stat_AR.byte( 7 )];
            crc = crctable_profile02[crc ^ _CMS_PI_Stat_AR_CRC_Offset[ _mCMS_PI_Stat_AR.SQC_CMS_PI_Stat ] ]; // load offset
            crc = (crc ^ 0xFF);
            if( getValue(  HMI_CRC_CMS_PI_Stat_Invalid ) )
                crc++;
            _mCMS_PI_Stat_AR.CRC_CMS_PI_Stat = crc;
            putValue( HMI_CRC_CMS_PI_Stat, crc );
        }
        else
            _mCMS_PI_Stat_AR.CRC_CMS_PI_Stat = getValue( HMI_CRC_CMS_PI_Stat );
    }
    else
    {
        if( !getValue( HMI_CRC_CMS_PI_Stat_Auto ) )
        {   // CRC according to SAE1850 ( W222 )
            // berechne crc
            crc = 0xFF;
//            crc = crctable[crc ^ _mCMS_PI_Stat_AR.byte( 0 )];  CRC
            crc = crctable[crc ^ _mCMS_PI_Stat_AR.byte( 1 )];
            crc = crctable[crc ^ _mCMS_PI_Stat_AR.byte( 2 )];
            crc = crctable[crc ^ _mCMS_PI_Stat_AR.byte( 3 )];
            crc = crctable[crc ^ _mCMS_PI_Stat_AR.byte( 4 )];
            crc = crctable[crc ^ _mCMS_PI_Stat_AR.byte( 5 )];
            crc = crctable[crc ^ _mCMS_PI_Stat_AR.byte( 6 )];
            crc = crctable[crc ^ _mCMS_PI_Stat_AR.byte( 7 )];
            crc = (crc ^ 0xFF);
            if( getValue(  HMI_CRC_CMS_PI_Stat_Invalid ) )
                crc++;
            _mCMS_PI_Stat_AR.CRC_CMS_PI_Stat = crc;
            putValue( HMI_CRC_CMS_PI_Stat, crc );
        }
        else
            _mCMS_PI_Stat_AR.CRC_CMS_PI_Stat = getValue( HMI_CRC_CMS_PI_Stat );
    }
    output( _mCMS_PI_Stat_AR );
}
/*@@end*/

/*@@caplFunc:CMS_PI_Stat_AR_saveEnvVars(dword):*/
CMS_PI_Stat_AR_saveEnvVars( dword hFile )
{
    filePutString("\n// Knoten EIS: CMS_PI_Stat_AR\n", 28, hFile );
    snprintf( buffer, elcount( buffer ), "0.0000 HMI__STMSG_CMS_PI_Stat_AR := %X\n", getValue( HMI__STMSG_CMS_PI_Stat_AR ) );        filePutString ( buffer, elcount( buffer ), hFile );
    snprintf( buffer, elcount( buffer ), "0.0000 HMI__STMSGT_CMS_PI_Stat_AR := %X\n", getValue( HMI__STMSGT_CMS_PI_Stat_AR ) );        filePutString ( buffer, elcount( buffer ), hFile );
    snprintf( buffer, elcount( buffer ), "0.0000 HMI_CMS_Brk_Rq_V2 := %X\n", getValue( HMI_CMS_Brk_Rq_V2 ) );        filePutString ( buffer, elcount( buffer ), hFile );
    snprintf( buffer, elcount( buffer ), "0.0000 HMI_CMS_R_Warn_Rq := %X\n", getValue( HMI_CMS_R_Warn_Rq ) );        filePutString ( buffer, elcount( buffer ), hFile );
    snprintf( buffer, elcount( buffer ), "0.0000 HMI_CMS_VehDecel_Rq := %X\n", getValue( HMI_CMS_VehDecel_Rq ) );        filePutString ( buffer, elcount( buffer ), hFile );
    snprintf( buffer, elcount( buffer ), "0.0000 HMI_CRC_CMS_PI_Stat := %X\n", getValue( HMI_CRC_CMS_PI_Stat ) );        filePutString ( buffer, elcount( buffer ), hFile );
    snprintf( buffer, elcount( buffer ), "0.0000 HMI_CRC_CMS_PI_Stat_Auto := %X\n", getValue( HMI_CRC_CMS_PI_Stat_Auto ) );        filePutString ( buffer, elcount( buffer ), hFile );
    snprintf( buffer, elcount( buffer ), "0.0000 HMI_PI_Enbl := %X\n", getValue( HMI_PI_Enbl ) );        filePutString ( buffer, elcount( buffer ), hFile );
    snprintf( buffer, elcount( buffer ), "0.0000 HMI_PI_Obj_R_RelSpd := %X\n", getValue( HMI_PI_Obj_R_RelSpd ) );        filePutString ( buffer, elcount( buffer ), hFile );
    snprintf( buffer, elcount( buffer ), "0.0000 HMI_PI_ObjAhdRelSpd := %X\n", getValue( HMI_PI_ObjAhdRelSpd ) );        filePutString ( buffer, elcount( buffer ), hFile );
    snprintf( buffer, elcount( buffer ), "0.0000 HMI_PI_R_Enbl := %X\n", getValue( HMI_PI_R_Enbl ) );        filePutString ( buffer, elcount( buffer ), hFile );
    snprintf( buffer, elcount( buffer ), "0.0000 HMI_PI_RelsRcmmnd_Ft := %X\n", getValue( HMI_PI_RelsRcmmnd_Ft ) );        filePutString ( buffer, elcount( buffer ), hFile );
    snprintf( buffer, elcount( buffer ), "0.0000 HMI_PI_RelsRcmmnd_R := %X\n", getValue( HMI_PI_RelsRcmmnd_R ) );        filePutString ( buffer, elcount( buffer ), hFile );
    snprintf( buffer, elcount( buffer ), "0.0000 HMI_PI_TTI_Ft := %X\n", getValue( HMI_PI_TTI_Ft ) );        filePutString ( buffer, elcount( buffer ), hFile );
    snprintf( buffer, elcount( buffer ), "0.0000 HMI_PI_TTI_R := %X\n", getValue( HMI_PI_TTI_R ) );        filePutString ( buffer, elcount( buffer ), hFile );
    snprintf( buffer, elcount( buffer ), "0.0000 HMI_Rsrv1_CMS_PI_Stat := %X\n", getValue( HMI_Rsrv1_CMS_PI_Stat ) );        filePutString ( buffer, elcount( buffer ), hFile );
    snprintf( buffer, elcount( buffer ), "0.0000 HMI_SQC_CMS_PI_Stat  := %X\n", getValue( HMI_SQC_CMS_PI_Stat  ) );        filePutString ( buffer, elcount( buffer ), hFile );
    snprintf( buffer, elcount( buffer ), "0.0000 HMI_SQC_CMS_PI_Stat_Auto := %X\n", getValue( HMI_SQC_CMS_PI_Stat_Auto ) );        filePutString ( buffer, elcount( buffer ), hFile );
}
/*@@end*/

/*@@timer:_tCMS_PI_Stat_AR:*/
on timer _tCMS_PI_Stat_AR
{
    putValue( HMI__STMSG_CMS_PI_Stat_AR, 0 );
}
/*@@end*/

/*@@envVar:HMI__STMSG_CMS_PI_Stat_AR:*/
on EnvVar HMI__STMSG_CMS_PI_Stat_AR
{
    long tDelay;
    if( getValue( this ) == 2 )
    {
        tDelay = getValue( HMI__STMSGT_CMS_PI_Stat_AR );
        if( tDelay > 0)    
            setTimer( _tCMS_PI_Stat_AR, tDelay );
        else
            putValue( HMI__STMSG_CMS_PI_Stat_AR, 0 );
    }
}
/*@@end*/

/*@@envVar:HMI_Rsrv1_CMS_PI_Stat:*/
on EnvVar HMI_Rsrv1_CMS_PI_Stat
{
    _mCMS_PI_Stat_AR.Rsrv1_CMS_PI_Stat.phys = getValue(this);
}
/*@@end*/

/*@@envVar:HMI_CMS_VehDecel_Rq:*/
on EnvVar HMI_CMS_VehDecel_Rq
{
    _mCMS_PI_Stat_AR.CMS_VehDecel_Rq.phys = getValue(this);
}
/*@@end*/

/*@@envVar:HMI_CMS_Brk_Rq_V2:*/
on EnvVar HMI_CMS_Brk_Rq_V2
{
    _mCMS_PI_Stat_AR.CMS_Brk_Rq_V2.phys = getValue(this);
}
/*@@end*/

/*@@envVar:HMI_CMS_R_Warn_Rq:*/
on EnvVar HMI_CMS_R_Warn_Rq
{
    _mCMS_PI_Stat_AR.CMS_R_Warn_Rq.phys = getValue(this);
}
/*@@end*/

/*@@caplFunc:CNG_Disp_Rq_AR_check_output():*/
CNG_Disp_Rq_AR_check_output()
{
    if( !getValue( HMI__STMSG_CNG_Disp_Rq_AR ) )
    {
        // Botschaft CNG_Disp_Rq_AR ID: 733 --- Sendeart 5 cyclicAndSpontanWithDelay
        if( _CNG_Disp_Rq_AR_DelayCnt > 0) _CNG_Disp_Rq_AR_DelayCnt--; // Mindestsendeabstand
        _CNG_Disp_Rq_AR_Cnt--;
        if( _CNG_Disp_Rq_AR_Cnt < 1 )
        {
            if( _CNG_Disp_Rq_AR_DelayCnt < 1 )
            {
                CNG_Disp_Rq_AR_output(); // Nachricht wg. abgelaufenem Zyklus ausgeben (Mindestsendeabstand eingehalten)
                _CNG_Disp_Rq_AR_SpontanFlag = 0; // Spontan-Flag zurücksetzen
                _CNG_Disp_Rq_AR_DelayCnt = _CNG_Disp_Rq_AR_MinDelay;
            }
            else
            {
                // Spontanflag setzen damit nach Ablauf Mindestsendeabstand gesendet wird
                 _CNG_Disp_Rq_AR_SpontanFlag = 1;
            }
            _CNG_Disp_Rq_AR_Cnt = _CNG_Disp_Rq_AR_CycleCount; // Zyklus-Zähler zurücksetzen
        }
        else if( _CNG_Disp_Rq_AR_SpontanFlag)
        {
            if( _CNG_Disp_Rq_AR_DelayCnt < 1 )
            {
                CNG_Disp_Rq_AR_output(); // Nachricht wg. spontaner Änderung ausgeben (Mindestsendeabstand eingehalten)
                _CNG_Disp_Rq_AR_SpontanFlag = 0; // Spontan-Flag zurücksetzen
                _CNG_Disp_Rq_AR_DelayCnt = _CNG_Disp_Rq_AR_MinDelay;
            }
        }
    }
}
/*@@end*/

/*@@caplFunc:CNG_Disp_Rq_AR_init():*/
CNG_Disp_Rq_AR_init()
{   /* Botschaft CNG_Disp_Rq_AR ID: 733 --- Sendeart 5 cyclicAndSpontanWithDelay --- 
BA_ "ApplMessage" BO_ 733 0;
BA_ "NmAsrMessage" BO_ 733 0;
BA_ "GenMsgMinAcceptLength" BO_ 733 8;
BA_ "GenMsgILSupport" BO_ 733 1;
BA_ "DiagState" BO_ 733 0;
BA_ "DiagRequest" BO_ 733 0;
BA_ "DiagResponse" BO_ 733 0;
BA_ "GenMsgStartValue" BO_ 733 "0";
BA_ "GenMsgDelayTime" BO_ 733 100;
BA_ "GenMsgNrOfRepetitions" BO_ 733 0;
BA_ "GenMsgCycleTime" BO_ 733 1000;
BA_ "GenMsgSendType" BO_ 733 5;
    */
    _CNG_Disp_Rq_AR_Timebase =         c_tDBKomTimer_20ms;
    _CNG_Disp_Rq_AR_CycleCount =    1000 / _CNG_Disp_Rq_AR_Timebase;
    _CNG_Disp_Rq_AR_StartDelay =       0 / _CNG_Disp_Rq_AR_Timebase;
    _CNG_Disp_Rq_AR_MinDelay =       100 / _CNG_Disp_Rq_AR_Timebase;
    _CNG_Disp_Rq_AR_Cnt = _CNG_Disp_Rq_AR_StartDelay;
    _CNG_Disp_Rq_AR_SpontanFlag = 0;
    _CNG_Disp_Rq_AR_DelayCnt = 0;

    putValue( HMI__STMSGSD_CNG_Disp_Rq_AR, _CNG_Disp_Rq_AR_StartDelay * _CNG_Disp_Rq_AR_Timebase );

    _mCNG_Disp_Rq_AR.CNG_FuelMd_Disp_Rq.phys = getValue( HMI_CNG_FuelMd_Disp_Rq );
    _mCNG_Disp_Rq_AR.CNG_FuelMd_Stat.phys = getValue( HMI_CNG_FuelMd_Stat );
    _mCNG_Disp_Rq_AR.CNG_FuelMdChg_Actv.phys = getValue( HMI_CNG_FuelMdChg_Actv );
    _mCNG_Disp_Rq_AR.CNG_FuelMdChg_Stat.phys = getValue( HMI_CNG_FuelMdChg_Stat );
    _mCNG_Disp_Rq_AR.CNG_FuelPress.phys = getValue( HMI_CNG_FuelPress );
    _mCNG_Disp_Rq_AR.CNG_Msg1_Disp_Rq.phys = getValue( HMI_CNG_Msg1_Disp_Rq );
    _mCNG_Disp_Rq_AR.CNG_Msg2_Disp_Rq.phys = getValue( HMI_CNG_Msg2_Disp_Rq );
    _mCNG_Disp_Rq_AR.CNG_Msg3_Disp_Rq.phys = getValue( HMI_CNG_Msg3_Disp_Rq );
    _mCNG_Disp_Rq_AR.CNG_Msg4_Disp_Rq.phys = getValue( HMI_CNG_Msg4_Disp_Rq );
    _mCNG_Disp_Rq_AR.CNG_Msg5_Disp_Rq.phys = getValue( HMI_CNG_Msg5_Disp_Rq );
    _mCNG_Disp_Rq_AR.CNG_Msg6_Disp_Rq.phys = getValue( HMI_CNG_Msg6_Disp_Rq );
    _mCNG_Disp_Rq_AR.CNG_Msg7_Disp_Rq.phys = getValue( HMI_CNG_Msg7_Disp_Rq );
    _mCNG_Disp_Rq_AR.CNG_Msg8_Disp_Rq.phys = getValue( HMI_CNG_Msg8_Disp_Rq );
    _mCNG_Disp_Rq_AR.CNG_Qual.phys = getValue( HMI_CNG_Qual );
    _mCNG_Disp_Rq_AR.CNG_TankCapIndLmp_On_Rq.phys = getValue( HMI_CNG_TankCapIndLmp_On_Rq );
    _mCNG_Disp_Rq_AR.CNG_TankLvl.phys = getValue( HMI_CNG_TankLvl );
    _mCNG_Disp_Rq_AR.CNG_TankLvl_Min.phys = getValue( HMI_CNG_TankLvl_Min );
    _mCNG_Disp_Rq_AR.Rsrv1_CNG_Disp_Rq.phys = getValue( HMI_Rsrv1_CNG_Disp_Rq );
    _mCNG_Disp_Rq_AR.Rsrv2_CNG_Disp_Rq.phys = getValue( HMI_Rsrv2_CNG_Disp_Rq );
}
/*@@end*/

/*@@caplFunc:CNG_Disp_Rq_AR_output():*/
CNG_Disp_Rq_AR_output(void)
{
    output( _mCNG_Disp_Rq_AR );
}
/*@@end*/

/*@@caplFunc:CNG_Disp_Rq_AR_saveEnvVars(dword):*/
CNG_Disp_Rq_AR_saveEnvVars( dword hFile )
{
    filePutString("\n// Knoten EIS: CNG_Disp_Rq_AR\n", 29, hFile );
    snprintf( buffer, elcount( buffer ), "0.0000 HMI__STMSG_CNG_Disp_Rq_AR := %X\n", getValue( HMI__STMSG_CNG_Disp_Rq_AR ) );        filePutString ( buffer, elcount( buffer ), hFile );
    snprintf( buffer, elcount( buffer ), "0.0000 HMI__STMSGT_CNG_Disp_Rq_AR := %X\n", getValue( HMI__STMSGT_CNG_Disp_Rq_AR ) );        filePutString ( buffer, elcount( buffer ), hFile );
    snprintf( buffer, elcount( buffer ), "0.0000 HMI_CNG_FuelMd_Disp_Rq := %X\n", getValue( HMI_CNG_FuelMd_Disp_Rq ) );        filePutString ( buffer, elcount( buffer ), hFile );
    snprintf( buffer, elcount( buffer ), "0.0000 HMI_CNG_FuelMd_Stat := %X\n", getValue( HMI_CNG_FuelMd_Stat ) );        filePutString ( buffer, elcount( buffer ), hFile );
    snprintf( buffer, elcount( buffer ), "0.0000 HMI_CNG_FuelMdChg_Actv := %X\n", getValue( HMI_CNG_FuelMdChg_Actv ) );        filePutString ( buffer, elcount( buffer ), hFile );
    snprintf( buffer, elcount( buffer ), "0.0000 HMI_CNG_FuelMdChg_Stat := %X\n", getValue( HMI_CNG_FuelMdChg_Stat ) );        filePutString ( buffer, elcount( buffer ), hFile );
    snprintf( buffer, elcount( buffer ), "0.0000 HMI_CNG_FuelPress := %X\n", getValue( HMI_CNG_FuelPress ) );        filePutString ( buffer, elcount( buffer ), hFile );
    snprintf( buffer, elcount( buffer ), "0.0000 HMI_CNG_Msg1_Disp_Rq := %X\n", getValue( HMI_CNG_Msg1_Disp_Rq ) );        filePutString ( buffer, elcount( buffer ), hFile );
    snprintf( buffer, elcount( buffer ), "0.0000 HMI_CNG_Msg2_Disp_Rq := %X\n", getValue( HMI_CNG_Msg2_Disp_Rq ) );        filePutString ( buffer, elcount( buffer ), hFile );
    snprintf( buffer, elcount( buffer ), "0.0000 HMI_CNG_Msg3_Disp_Rq := %X\n", getValue( HMI_CNG_Msg3_Disp_Rq ) );        filePutString ( buffer, elcount( buffer ), hFile );
    snprintf( buffer, elcount( buffer ), "0.0000 HMI_CNG_Msg4_Disp_Rq := %X\n", getValue( HMI_CNG_Msg4_Disp_Rq ) );        filePutString ( buffer, elcount( buffer ), hFile );
    snprintf( buffer, elcount( buffer ), "0.0000 HMI_CNG_Msg5_Disp_Rq := %X\n", getValue( HMI_CNG_Msg5_Disp_Rq ) );        filePutString ( buffer, elcount( buffer ), hFile );
    snprintf( buffer, elcount( buffer ), "0.0000 HMI_CNG_Msg6_Disp_Rq := %X\n", getValue( HMI_CNG_Msg6_Disp_Rq ) );        filePutString ( buffer, elcount( buffer ), hFile );
    snprintf( buffer, elcount( buffer ), "0.0000 HMI_CNG_Msg7_Disp_Rq := %X\n", getValue( HMI_CNG_Msg7_Disp_Rq ) );        filePutString ( buffer, elcount( buffer ), hFile );
    snprintf( buffer, elcount( buffer ), "0.0000 HMI_CNG_Msg8_Disp_Rq := %X\n", getValue( HMI_CNG_Msg8_Disp_Rq ) );        filePutString ( buffer, elcount( buffer ), hFile );
    snprintf( buffer, elcount( buffer ), "0.0000 HMI_CNG_Qual := %X\n", getValue( HMI_CNG_Qual ) );        filePutString ( buffer, elcount( buffer ), hFile );
    snprintf( buffer, elcount( buffer ), "0.0000 HMI_CNG_TankCapIndLmp_On_Rq := %X\n", getValue( HMI_CNG_TankCapIndLmp_On_Rq ) );        filePutString ( buffer, elcount( buffer ), hFile );
    snprintf( buffer, elcount( buffer ), "0.0000 HMI_CNG_TankLvl := %X\n", getValue( HMI_CNG_TankLvl ) );        filePutString ( buffer, elcount( buffer ), hFile );
    snprintf( buffer, elcount( buffer ), "0.0000 HMI_CNG_TankLvl_Min := %X\n", getValue( HMI_CNG_TankLvl_Min ) );        filePutString ( buffer, elcount( buffer ), hFile );
    snprintf( buffer, elcount( buffer ), "0.0000 HMI_Rsrv1_CNG_Disp_Rq := %X\n", getValue( HMI_Rsrv1_CNG_Disp_Rq ) );        filePutString ( buffer, elcount( buffer ), hFile );
    snprintf( buffer, elcount( buffer ), "0.0000 HMI_Rsrv2_CNG_Disp_Rq := %X\n", getValue( HMI_Rsrv2_CNG_Disp_Rq ) );        filePutString ( buffer, elcount( buffer ), hFile );
}
/*@@end*/

/*@@timer:_tCNG_Disp_Rq_AR:*/
on timer _tCNG_Disp_Rq_AR
{
    putValue( HMI__STMSG_CNG_Disp_Rq_AR, 0 );
}
/*@@end*/

/*@@envVar:HMI__STMSG_CNG_Disp_Rq_AR:*/
on EnvVar HMI__STMSG_CNG_Disp_Rq_AR
{
    long tDelay;
    if( getValue( this ) == 2 )
    {
        tDelay = getValue( HMI__STMSGT_CNG_Disp_Rq_AR );
        if( tDelay > 0)    
            setTimer( _tCNG_Disp_Rq_AR, tDelay );
        else
            putValue( HMI__STMSG_CNG_Disp_Rq_AR, 0 );
    }
}
/*@@end*/

/*@@envVar:HMI_CNG_FuelMd_Disp_Rq:*/
on EnvVar HMI_CNG_FuelMd_Disp_Rq
{
    _mCNG_Disp_Rq_AR.CNG_FuelMd_Disp_Rq.phys = getValue(this);
    _CNG_Disp_Rq_AR_SpontanFlag = 1;
}
/*@@end*/

/*@@envVar:HMI_CNG_FuelMd_Stat:*/
on EnvVar HMI_CNG_FuelMd_Stat
{
    _mCNG_Disp_Rq_AR.CNG_FuelMd_Stat.phys = getValue(this);
    _CNG_Disp_Rq_AR_SpontanFlag = 1;
}
/*@@end*/

/*@@envVar:HMI_CNG_FuelMdChg_Actv:*/
on EnvVar HMI_CNG_FuelMdChg_Actv
{
    _mCNG_Disp_Rq_AR.CNG_FuelMdChg_Actv.phys = getValue(this);
    _CNG_Disp_Rq_AR_SpontanFlag = 1;
}
/*@@end*/

/*@@envVar:HMI_CNG_FuelMdChg_Stat:*/
on EnvVar HMI_CNG_FuelMdChg_Stat
{
    _mCNG_Disp_Rq_AR.CNG_FuelMdChg_Stat.phys = getValue(this);
    _CNG_Disp_Rq_AR_SpontanFlag = 1;
}
/*@@end*/

/*@@envVar:HMI_CNG_FuelPress:*/
on EnvVar HMI_CNG_FuelPress
{
    _mCNG_Disp_Rq_AR.CNG_FuelPress.phys = getValue(this);
    _CNG_Disp_Rq_AR_SpontanFlag = 1;
}
/*@@end*/

/*@@envVar:HMI_CNG_Msg1_Disp_Rq:*/
on EnvVar HMI_CNG_Msg1_Disp_Rq
{
    _mCNG_Disp_Rq_AR.CNG_Msg1_Disp_Rq.phys = getValue(this);
    _CNG_Disp_Rq_AR_SpontanFlag = 1;
}
/*@@end*/

/*@@envVar:HMI_CNG_Msg2_Disp_Rq:*/
on EnvVar HMI_CNG_Msg2_Disp_Rq
{
    _mCNG_Disp_Rq_AR.CNG_Msg2_Disp_Rq.phys = getValue(this);
    _CNG_Disp_Rq_AR_SpontanFlag = 1;
}
/*@@end*/

/*@@envVar:HMI_CNG_Msg3_Disp_Rq:*/
on EnvVar HMI_CNG_Msg3_Disp_Rq
{
    _mCNG_Disp_Rq_AR.CNG_Msg3_Disp_Rq.phys = getValue(this);
    _CNG_Disp_Rq_AR_SpontanFlag = 1;
}
/*@@end*/

/*@@envVar:HMI_CNG_Msg4_Disp_Rq:*/
on EnvVar HMI_CNG_Msg4_Disp_Rq
{
    _mCNG_Disp_Rq_AR.CNG_Msg4_Disp_Rq.phys = getValue(this);
    _CNG_Disp_Rq_AR_SpontanFlag = 1;
}
/*@@end*/

/*@@envVar:HMI_CNG_Msg5_Disp_Rq:*/
on EnvVar HMI_CNG_Msg5_Disp_Rq
{
    _mCNG_Disp_Rq_AR.CNG_Msg5_Disp_Rq.phys = getValue(this);
    _CNG_Disp_Rq_AR_SpontanFlag = 1;
}
/*@@end*/

/*@@envVar:HMI_CNG_Msg6_Disp_Rq:*/
on EnvVar HMI_CNG_Msg6_Disp_Rq
{
    _mCNG_Disp_Rq_AR.CNG_Msg6_Disp_Rq.phys = getValue(this);
    _CNG_Disp_Rq_AR_SpontanFlag = 1;
}
/*@@end*/

/*@@envVar:HMI_CNG_Msg7_Disp_Rq:*/
on EnvVar HMI_CNG_Msg7_Disp_Rq
{
    _mCNG_Disp_Rq_AR.CNG_Msg7_Disp_Rq.phys = getValue(this);
    _CNG_Disp_Rq_AR_SpontanFlag = 1;
}
/*@@end*/

/*@@envVar:HMI_CNG_Msg8_Disp_Rq:*/
on EnvVar HMI_CNG_Msg8_Disp_Rq
{
    _mCNG_Disp_Rq_AR.CNG_Msg8_Disp_Rq.phys = getValue(this);
    _CNG_Disp_Rq_AR_SpontanFlag = 1;
}
/*@@end*/

/*@@envVar:HMI_CNG_Qual:*/
on EnvVar HMI_CNG_Qual
{
    _mCNG_Disp_Rq_AR.CNG_Qual.phys = getValue(this);
    _CNG_Disp_Rq_AR_SpontanFlag = 1;
}
/*@@end*/

/*@@envVar:HMI_CNG_TankCapIndLmp_On_Rq:*/
on EnvVar HMI_CNG_TankCapIndLmp_On_Rq
{
    _mCNG_Disp_Rq_AR.CNG_TankCapIndLmp_On_Rq.phys = getValue(this);
    _CNG_Disp_Rq_AR_SpontanFlag = 1;
}
/*@@end*/

/*@@envVar:HMI_CNG_TankLvl:*/
on EnvVar HMI_CNG_TankLvl
{
    _mCNG_Disp_Rq_AR.CNG_TankLvl.phys = getValue(this);
    _CNG_Disp_Rq_AR_SpontanFlag = 1;
}
/*@@end*/

/*@@envVar:HMI_CNG_TankLvl_Min:*/
on EnvVar HMI_CNG_TankLvl_Min
{
    _mCNG_Disp_Rq_AR.CNG_TankLvl_Min.phys = getValue(this);
    _CNG_Disp_Rq_AR_SpontanFlag = 1;
}
/*@@end*/

/*@@envVar:HMI_Rsrv1_CNG_Disp_Rq:*/
on EnvVar HMI_Rsrv1_CNG_Disp_Rq
{
    _mCNG_Disp_Rq_AR.Rsrv1_CNG_Disp_Rq.phys = getValue(this);
    _CNG_Disp_Rq_AR_SpontanFlag = 1;
}
/*@@end*/

/*@@envVar:HMI_Rsrv2_CNG_Disp_Rq:*/
on EnvVar HMI_Rsrv2_CNG_Disp_Rq
{
    _mCNG_Disp_Rq_AR.Rsrv2_CNG_Disp_Rq.phys = getValue(this);
    _CNG_Disp_Rq_AR_SpontanFlag = 1;
}
/*@@end*/

/*@@caplFunc:COM_Call_Stat_AR_check_output():*/
COM_Call_Stat_AR_check_output()
{
    if( !getValue( HMI__STMSG_COM_Call_Stat_AR ) )
    {
        // Botschaft COM_Call_Stat_AR ID: 708 --- Sendeart 5 cyclicAndSpontanWithDelay --- 
        _COM_Call_Stat_AR_Cnt--;
        if( _COM_Call_Stat_AR_Cnt < 1 )
        {
            COM_Call_Stat_AR_output(); // Nachricht wg. abgelaufenem Zyklus ausgeben
            _COM_Call_Stat_AR_Cnt = _COM_Call_Stat_AR_CycleCount; // Zyklus-Zähler zurücksetzen
            _COM_Call_Stat_AR_SpontanFlag = 0; // Spontan-Flag zurücksetzen
        }
        else if( _COM_Call_Stat_AR_SpontanFlag)
        {
            COM_Call_Stat_AR_output(); // Nachricht wg. spontaner Änderung ausgeben
            _COM_Call_Stat_AR_SpontanFlag = 0; // Spontan-Flag zurücksetzen
        }
    }
}
/*@@end*/

/*@@caplFunc:COM_Call_Stat_AR_init():*/
COM_Call_Stat_AR_init()
{   /* Botschaft COM_Call_Stat_AR ID: 708 --- Sendeart 5 cyclicAndSpontanWithDelay --- 
BA_ "ApplMessage" BO_ 708 0;
BA_ "NmAsrMessage" BO_ 708 0;
BA_ "GenMsgMinAcceptLength" BO_ 708 8;
BA_ "GenMsgILSupport" BO_ 708 1;
BA_ "DiagState" BO_ 708 0;
BA_ "DiagRequest" BO_ 708 0;
BA_ "DiagResponse" BO_ 708 0;
BA_ "GenMsgStartValue" BO_ 708 "0";
BA_ "GenMsgDelayTime" BO_ 708 20;
BA_ "GenMsgNrOfRepetitions" BO_ 708 0;
BA_ "GenMsgCycleTime" BO_ 708 500;
BA_ "GenMsgSendType" BO_ 708 5;
    */
    _COM_Call_Stat_AR_Timebase =         c_tDBKomTimer_20ms;
    _COM_Call_Stat_AR_CycleCount =      500 / _COM_Call_Stat_AR_Timebase;
    _COM_Call_Stat_AR_StartDelay =        0 / _COM_Call_Stat_AR_Timebase;
    _COM_Call_Stat_AR_Cnt = _COM_Call_Stat_AR_StartDelay;
    _COM_Call_Stat_AR_SpontanFlag = 0;

    putValue( HMI__STMSGSD_COM_Call_Stat_AR, _COM_Call_Stat_AR_StartDelay * _COM_Call_Stat_AR_Timebase );

    _mCOM_Call_Stat_AR.ECall_SOS_Rdy.phys = getValue( HMI_ECall_SOS_Rdy );
    _mCOM_Call_Stat_AR.MBCall_Call_Type.phys = getValue( HMI_MBCall_Call_Type );
    _mCOM_Call_Stat_AR.MBCall_CallScreen_Rq.phys = getValue( HMI_MBCall_CallScreen_Rq );
    _mCOM_Call_Stat_AR.MBCall_CellFieldStr.phys = getValue( HMI_MBCall_CellFieldStr );
    _mCOM_Call_Stat_AR.MBCall_Lat_Deg.phys = getValue( HMI_MBCall_Lat_Deg );
    _mCOM_Call_Stat_AR.MBCall_Lat_Min.phys = getValue( HMI_MBCall_Lat_Min );
    _mCOM_Call_Stat_AR.MBCall_Lat_N_S.phys = getValue( HMI_MBCall_Lat_N_S );
    _mCOM_Call_Stat_AR.MBCall_Lat_Sec.phys = getValue( HMI_MBCall_Lat_Sec );
    _mCOM_Call_Stat_AR.MBCall_Long_Deg.phys = getValue( HMI_MBCall_Long_Deg );
    _mCOM_Call_Stat_AR.MBCall_Long_Min.phys = getValue( HMI_MBCall_Long_Min );
    _mCOM_Call_Stat_AR.MBCall_Long_Sec.phys = getValue( HMI_MBCall_Long_Sec );
    _mCOM_Call_Stat_AR.MBCall_Long_W_E.phys = getValue( HMI_MBCall_Long_W_E );
    _mCOM_Call_Stat_AR.MBCall_Trck_Actv.phys = getValue( HMI_MBCall_Trck_Actv );
    _mCOM_Call_Stat_AR.OfflineMd_Stat.phys = getValue( HMI_OfflineMd_Stat );
    _mCOM_Call_Stat_AR.ServCall_DPP_Msg_Rq.phys = getValue( HMI_ServCall_DPP_Msg_Rq );
    _mCOM_Call_Stat_AR.ServCall_MtPopupSupp.phys = getValue( HMI_ServCall_MtPopupSupp );
    _mCOM_Call_Stat_AR.UserDataReset_Rq.phys = getValue( HMI_UserDataReset_Rq );
}
/*@@end*/

/*@@caplFunc:COM_Call_Stat_AR_output():*/
COM_Call_Stat_AR_output(void)
{
    output( _mCOM_Call_Stat_AR );
}
/*@@end*/

/*@@caplFunc:COM_Call_Stat_AR_saveEnvVars(dword):*/
COM_Call_Stat_AR_saveEnvVars( dword hFile )
{
    filePutString("\n// Knoten EIS: COM_Call_Stat_AR\n", 28, hFile );
    snprintf( buffer, elcount( buffer ), "0.0000 HMI__STMSG_COM_Call_Stat_AR := %X\n", getValue( HMI__STMSG_COM_Call_Stat_AR ) );            filePutString ( buffer, elcount( buffer ), hFile );
    snprintf( buffer, elcount( buffer ), "0.0000 HMI__STMSGT_COM_Call_Stat_AR := %X\n", getValue( HMI__STMSGT_COM_Call_Stat_AR ) );        filePutString ( buffer, elcount( buffer ), hFile );
    snprintf( buffer, elcount( buffer ), "0.0000 HMI_ECall_SOS_Rdy := %X\n", getValue( HMI_ECall_SOS_Rdy ) );    filePutString ( buffer, elcount( buffer ), hFile );
    snprintf( buffer, elcount( buffer ), "0.0000 HMI_MBCall_Call_Type := %X\n", getValue( HMI_MBCall_Call_Type ) );    filePutString ( buffer, elcount( buffer ), hFile );
    snprintf( buffer, elcount( buffer ), "0.0000 HMI_MBCall_CallScreen_Rq := %X\n", getValue( HMI_MBCall_CallScreen_Rq ) );    filePutString ( buffer, elcount( buffer ), hFile );
    snprintf( buffer, elcount( buffer ), "0.0000 HMI_MBCall_CellFieldStr := %X\n", getValue( HMI_MBCall_CellFieldStr ) );    filePutString ( buffer, elcount( buffer ), hFile );
    snprintf( buffer, elcount( buffer ), "0.0000 HMI_MBCall_Lat_Deg := %X\n", getValue( HMI_MBCall_Lat_Deg ) );    filePutString ( buffer, elcount( buffer ), hFile );
    snprintf( buffer, elcount( buffer ), "0.0000 HMI_MBCall_Lat_Min := %X\n", getValue( HMI_MBCall_Lat_Min ) );    filePutString ( buffer, elcount( buffer ), hFile );
    snprintf( buffer, elcount( buffer ), "0.0000 HMI_MBCall_Lat_N_S := %X\n", getValue( HMI_MBCall_Lat_N_S ) );    filePutString ( buffer, elcount( buffer ), hFile );
    snprintf( buffer, elcount( buffer ), "0.0000 HMI_MBCall_Lat_Sec := %X\n", getValue( HMI_MBCall_Lat_Sec ) );    filePutString ( buffer, elcount( buffer ), hFile );
    snprintf( buffer, elcount( buffer ), "0.0000 HMI_MBCall_Long_Deg := %X\n", getValue( HMI_MBCall_Long_Deg ) );    filePutString ( buffer, elcount( buffer ), hFile );
    snprintf( buffer, elcount( buffer ), "0.0000 HMI_MBCall_Long_Min := %X\n", getValue( HMI_MBCall_Long_Min ) );    filePutString ( buffer, elcount( buffer ), hFile );
    snprintf( buffer, elcount( buffer ), "0.0000 HMI_MBCall_Long_Sec := %X\n", getValue( HMI_MBCall_Long_Sec ) );    filePutString ( buffer, elcount( buffer ), hFile );
    snprintf( buffer, elcount( buffer ), "0.0000 HMI_MBCall_Long_W_E := %X\n", getValue( HMI_MBCall_Long_W_E ) );    filePutString ( buffer, elcount( buffer ), hFile );
    snprintf( buffer, elcount( buffer ), "0.0000 HMI_MBCall_Trck_Actv := %X\n", getValue( HMI_MBCall_Trck_Actv ) );    filePutString ( buffer, elcount( buffer ), hFile );
    snprintf( buffer, elcount( buffer ), "0.0000 HMI_OfflineMd_Stat := %X\n", getValue( HMI_OfflineMd_Stat ) );    filePutString ( buffer, elcount( buffer ), hFile );
    snprintf( buffer, elcount( buffer ), "0.0000 HMI_ServCall_DPP_Msg_Rq := %X\n", getValue( HMI_ServCall_DPP_Msg_Rq ) );    filePutString ( buffer, elcount( buffer ), hFile );
    snprintf( buffer, elcount( buffer ), "0.0000 HMI_ServCall_MtPopupSupp := %X\n", getValue( HMI_ServCall_MtPopupSupp ) );    filePutString ( buffer, elcount( buffer ), hFile );
    snprintf( buffer, elcount( buffer ), "0.0000 HMI_UserDataReset_Rq := %X\n", getValue( HMI_UserDataReset_Rq ) );    filePutString ( buffer, elcount( buffer ), hFile );
}
/*@@end*/

/*@@timer:_tCOM_Call_Stat_AR:*/
on timer _tCOM_Call_Stat_AR
{
    putValue( HMI__STMSG_COM_Call_Stat_AR, 0 );
}
/*@@end*/

/*@@envVar:HMI__STMSG_COM_Call_Stat_AR:*/
on EnvVar HMI__STMSG_COM_Call_Stat_AR
{
    long tDelay;
    if( getValue( this ) == 2 )
    {
        tDelay = getValue( HMI__STMSGT_COM_Call_Stat_AR );
        if( tDelay > 0)    
            setTimer( _tCOM_Call_Stat_AR, tDelay );
        else
            putValue( HMI__STMSG_COM_Call_Stat_AR, 0 );
    }
}
/*@@end*/

/*@@envVar:HMI_ECall_SOS_Rdy:*/
on envVar HMI_ECall_SOS_Rdy
{
    _mCOM_Call_Stat_AR.ECall_SOS_Rdy.phys = getValue(this);
    _COM_Call_Stat_AR_SpontanFlag = 1;
}
/*@@end*/

/*@@envVar:HMI_MBCall_Call_Type:*/
on envVar HMI_MBCall_Call_Type
{
    _mCOM_Call_Stat_AR.MBCall_Call_Type.phys = getValue(this);
    _COM_Call_Stat_AR_SpontanFlag = 1;
}
/*@@end*/

/*@@envVar:HMI_MBCall_CallScreen_Rq:*/
on envVar HMI_MBCall_CallScreen_Rq
{
    _mCOM_Call_Stat_AR.MBCall_CallScreen_Rq.phys = getValue(this);
    _COM_Call_Stat_AR_SpontanFlag = 1;
}
/*@@end*/

/*@@envVar:HMI_MBCall_CellFieldStr:*/
on envVar HMI_MBCall_CellFieldStr
{
    _mCOM_Call_Stat_AR.MBCall_CellFieldStr.phys = getValue(this);
    _COM_Call_Stat_AR_SpontanFlag = 1;
}
/*@@end*/

/*@@envVar:HMI_MBCall_Lat_Deg:*/
on envVar HMI_MBCall_Lat_Deg
{
    _mCOM_Call_Stat_AR.MBCall_Lat_Deg.phys = getValue(this);
    _COM_Call_Stat_AR_SpontanFlag = 1;
}
/*@@end*/

/*@@envVar:HMI_MBCall_Lat_Min:*/
on envVar HMI_MBCall_Lat_Min
{
    _mCOM_Call_Stat_AR.MBCall_Lat_Min.phys = getValue(this);
    _COM_Call_Stat_AR_SpontanFlag = 1;
}
/*@@end*/

/*@@envVar:HMI_MBCall_Lat_N_S:*/
on envVar HMI_MBCall_Lat_N_S
{
    _mCOM_Call_Stat_AR.MBCall_Lat_N_S.phys = getValue(this);
    _COM_Call_Stat_AR_SpontanFlag = 1;
}
/*@@end*/

/*@@envVar:HMI_MBCall_Lat_Sec:*/
on envVar HMI_MBCall_Lat_Sec
{
    _mCOM_Call_Stat_AR.MBCall_Lat_Sec.phys = getValue(this);
    _COM_Call_Stat_AR_SpontanFlag = 1;
}
/*@@end*/

/*@@envVar:HMI_MBCall_Long_Deg:*/
on envVar HMI_MBCall_Long_Deg
{
    _mCOM_Call_Stat_AR.MBCall_Long_Deg.phys = getValue(this);
    _COM_Call_Stat_AR_SpontanFlag = 1;
}
/*@@end*/

/*@@envVar:HMI_MBCall_Long_Min:*/
on envVar HMI_MBCall_Long_Min
{
    _mCOM_Call_Stat_AR.MBCall_Long_Min.phys = getValue(this);
    _COM_Call_Stat_AR_SpontanFlag = 1;
}
/*@@end*/

/*@@envVar:HMI_MBCall_Long_Sec:*/
on envVar HMI_MBCall_Long_Sec
{
    _mCOM_Call_Stat_AR.MBCall_Long_Sec.phys = getValue(this);
    _COM_Call_Stat_AR_SpontanFlag = 1;
}
/*@@end*/

/*@@envVar:HMI_MBCall_Long_W_E:*/
on envVar HMI_MBCall_Long_W_E
{
    _mCOM_Call_Stat_AR.MBCall_Long_W_E.phys = getValue(this);
    _COM_Call_Stat_AR_SpontanFlag = 1;
}
/*@@end*/

/*@@envVar:HMI_MBCall_Trck_Actv:*/
on envVar HMI_MBCall_Trck_Actv
{
    _mCOM_Call_Stat_AR.MBCall_Trck_Actv.phys = getValue(this);
    _COM_Call_Stat_AR_SpontanFlag = 1;
}
/*@@end*/

/*@@envVar:HMI_OfflineMd_Stat:*/
on envVar HMI_OfflineMd_Stat
{
    _mCOM_Call_Stat_AR.OfflineMd_Stat.phys = getValue(this);
    _COM_Call_Stat_AR_SpontanFlag = 1;
}
/*@@end*/

/*@@envVar:HMI_ServCall_DPP_Msg_Rq:*/
on envVar HMI_ServCall_DPP_Msg_Rq
{
    _mCOM_Call_Stat_AR.ServCall_DPP_Msg_Rq.phys = getValue(this);
    _COM_Call_Stat_AR_SpontanFlag = 1;
}
/*@@end*/

/*@@envVar:HMI_ServCall_MtPopupSupp:*/
on envVar HMI_ServCall_MtPopupSupp
{
    _mCOM_Call_Stat_AR.ServCall_MtPopupSupp.phys = getValue(this);
    _COM_Call_Stat_AR_SpontanFlag = 1;
}
/*@@end*/

/*@@envVar:HMI_UserDataReset_Rq:*/
on envVar HMI_UserDataReset_Rq
{
    _mCOM_Call_Stat_AR.UserDataReset_Rq.phys = getValue(this);
    _COM_Call_Stat_AR_SpontanFlag = 1;
}
/*@@end*/

/*@@caplFunc:COMM_EIS_WMI_ARR_check_output():*/
COMM_EIS_WMI_ARR_check_output()
{
    if( !getValue( HMI__STMSG_COMM_EIS_WMI_AR ) )
    {
        // Botschaft COMM_EIS_WMI_AR ID: 122 --- Sendeart 1 spontanX --- 
        if( _COMM_EIS_WMI_AR_SpontanFlag )
        {
            COMM_EIS_WMI_AR_output(); // Nachricht wg. request ausgeben
            _COMM_EIS_WMI_AR_SpontanFlag = 0;
        }
    }
}
/*@@end*/

/*@@caplFunc:COMM_EIS_WMI_AR_getValue():*/
COMM_EIS_WMI_AR_getValue()
{
    _mCOMM_EIS_WMI_AR.byte( 0 ) = getValue( HMI_COMM_EIS_WMI_Data1 );
    _mCOMM_EIS_WMI_AR.byte( 1 ) = getValue( HMI_COMM_EIS_WMI_Data2 );
    _mCOMM_EIS_WMI_AR.byte( 2 ) = getValue( HMI_COMM_EIS_WMI_Data3 );
    _mCOMM_EIS_WMI_AR.byte( 3 ) = getValue( HMI_COMM_EIS_WMI_Data4 );
    _mCOMM_EIS_WMI_AR.byte( 4 ) = getValue( HMI_COMM_EIS_WMI_Data5 );
    _mCOMM_EIS_WMI_AR.byte( 5 ) = getValue( HMI_COMM_EIS_WMI_Data6 );
    _mCOMM_EIS_WMI_AR.byte( 6 ) = getValue( HMI_COMM_EIS_WMI_Data7 );
    _mCOMM_EIS_WMI_AR.byte( 7 ) = getValue( HMI_COMM_EIS_WMI_Data8 );
}
/*@@end*/

/*@@caplFunc:COMM_EIS_WMI_AR_init():*/
COMM_EIS_WMI_AR_init()
{   /* Botschaft COMM_EIS_WMI_AR ID: 122 --- Sendeart 1 spontanX --- 
BA_ "ApplMessage" BO_ 122 0;
BA_ "NmAsrMessage" BO_ 122 0;
BA_ "GenMsgMinAcceptLength" BO_ 122 8;
BA_ "GenMsgILSupport" BO_ 122 1;
BA_ "DiagState" BO_ 122 0;
BA_ "DiagRequest" BO_ 122 0;
BA_ "DiagResponse" BO_ 122 0;
BA_ "GenMsgStartValue" BO_ 122 "0";
BA_ "GenMsgDelayTime" BO_ 122 10;
BA_ "GenMsgNrOfRepetitions" BO_ 122 0;
BA_ "GenMsgSendType" BO_ 122 1;
    */
    _COMM_EIS_WMI_AR_Timebase =        c_tDBKomTimer_20ms;
    _COMM_EIS_WMI_AR_SpontanFlag = 0;

    _mCOMM_EIS_WMI_AR.byte( 0 ) = getValue( HMI_COMM_EIS_WMI_Data1 );
    _mCOMM_EIS_WMI_AR.byte( 1 ) = getValue( HMI_COMM_EIS_WMI_Data2 );
    _mCOMM_EIS_WMI_AR.byte( 2 ) = getValue( HMI_COMM_EIS_WMI_Data3 );
    _mCOMM_EIS_WMI_AR.byte( 3 ) = getValue( HMI_COMM_EIS_WMI_Data4 );
    _mCOMM_EIS_WMI_AR.byte( 4 ) = getValue( HMI_COMM_EIS_WMI_Data5 );
    _mCOMM_EIS_WMI_AR.byte( 5 ) = getValue( HMI_COMM_EIS_WMI_Data6 );
    _mCOMM_EIS_WMI_AR.byte( 6 ) = getValue( HMI_COMM_EIS_WMI_Data7 );
    _mCOMM_EIS_WMI_AR.byte( 7 ) = getValue( HMI_COMM_EIS_WMI_Data8 );
}
/*@@end*/

/*@@caplFunc:COMM_EIS_WMI_AR_output():*/
COMM_EIS_WMI_AR_output(void)
{
    output( _mCOMM_EIS_WMI_AR );
}
/*@@end*/

/*@@caplFunc:COMM_EIS_WMI_AR_saveEnvVars(dword):*/
COMM_EIS_WMI_AR_saveEnvVars( dword hFile )
{
    filePutString("\n// Knoten EIS: COMM_EIS_WMI_AR\n", 32, hFile );
    snprintf( buffer, elcount( buffer ), "0.0000 HMI__STMSG_COMM_EIS_WMI_AR := %X\n", getValue( HMI__STMSG_COMM_EIS_WMI_AR ) );    filePutString( buffer, elcount( buffer ), hFile );
    snprintf( buffer, elcount( buffer ), "0.0000 HMI__STMSGT_COMM_EIS_WMI_AR := %X\n", getValue( HMI__STMSGT_COMM_EIS_WMI_AR ) );    filePutString( buffer, elcount( buffer ), hFile );
    snprintf( buffer, elcount( buffer ), "0.0000 HMI_COMM_EIS_WMI_Data1 := %X\n", getValue( HMI_COMM_EIS_WMI_Data1 ) );    filePutString( buffer, elcount( buffer ), hFile );
    snprintf( buffer, elcount( buffer ), "0.0000 HMI_COMM_EIS_WMI_Data2 := %X\n", getValue( HMI_COMM_EIS_WMI_Data2 ) );    filePutString( buffer, elcount( buffer ), hFile );
    snprintf( buffer, elcount( buffer ), "0.0000 HMI_COMM_EIS_WMI_Data3 := %X\n", getValue( HMI_COMM_EIS_WMI_Data3 ) );    filePutString( buffer, elcount( buffer ), hFile );
    snprintf( buffer, elcount( buffer ), "0.0000 HMI_COMM_EIS_WMI_Data4 := %X\n", getValue( HMI_COMM_EIS_WMI_Data4 ) );    filePutString( buffer, elcount( buffer ), hFile );
    snprintf( buffer, elcount( buffer ), "0.0000 HMI_COMM_EIS_WMI_Data5 := %X\n", getValue( HMI_COMM_EIS_WMI_Data5 ) );    filePutString( buffer, elcount( buffer ), hFile );
    snprintf( buffer, elcount( buffer ), "0.0000 HMI_COMM_EIS_WMI_Data6 := %X\n", getValue( HMI_COMM_EIS_WMI_Data6 ) );    filePutString( buffer, elcount( buffer ), hFile );
    snprintf( buffer, elcount( buffer ), "0.0000 HMI_COMM_EIS_WMI_Data7 := %X\n", getValue( HMI_COMM_EIS_WMI_Data7 ) );    filePutString( buffer, elcount( buffer ), hFile );
    snprintf( buffer, elcount( buffer ), "0.0000 HMI_COMM_EIS_WMI_Data8 := %X\n", getValue( HMI_COMM_EIS_WMI_Data8 ) );    filePutString( buffer, elcount( buffer ), hFile );
}
/*@@end*/

/*@@timer:_tCOMM_EIS_WMI_AR:*/
on timer _tCOMM_EIS_WMI_AR
{
    putValue( HMI__STMSG_COMM_EIS_WMI_AR, 0 );
}
/*@@end*/

/*@@envVar:HMI__STMSG_COMM_EIS_WMI_AR:*/
on EnvVar HMI__STMSG_COMM_EIS_WMI_AR
{
    long tDelay;
    if( getValue( this ) == 2 )
    {
        tDelay = getValue( HMI__STMSGT_COMM_EIS_WMI_AR );
        if( tDelay > 0)    
            setTimer( _tCOMM_EIS_WMI_AR, tDelay );
        else
            putValue( HMI__STMSG_COMM_EIS_WMI_AR, 0 );
    }
}
/*@@end*/

/*@@envVar:HMI_COMM_EIS_WMI_AR_Send:*/
on EnvVar HMI_COMM_EIS_WMI_AR_Send
{
    if( getValue( this ) )
    {
        COMM_EIS_WMI_AR_getValue();
    }
}
/*@@end*/

/*@@caplFunc:CRCM_Disp_Rq_AR_check_output():*/
CRCM_Disp_Rq_AR_check_output()
{
    if( !getValue( HMI__STMSG_CRCM_Disp_Rq_AR ) )
    {
        // Botschaft CRCM_Disp_Rq_AR ID: 1147 --- Sendeart 5 cyclicAndSpontanWithDelay --- 
        _CRCM_Disp_Rq_AR_Cnt--;
        if( _CRCM_Disp_Rq_AR_Cnt < 1 )
        {
            CRCM_Disp_Rq_AR_output(); // Nachricht wg. abgelaufenem Zyklus ausgeben
            _CRCM_Disp_Rq_AR_Cnt = _CRCM_Disp_Rq_AR_CycleCount; // Zyklus-Zähler zurücksetzen
            _CRCM_Disp_Rq_AR_SpontanFlag = 0; // Spontan-Flag zurücksetzen
        }
        else if( _CRCM_Disp_Rq_AR_SpontanFlag)
        {
            CRCM_Disp_Rq_AR_output(); // Nachricht wg. spontaner Änderung ausgeben
            _CRCM_Disp_Rq_AR_SpontanFlag = 0; // Spontan-Flag zurücksetzen
        }
    }
}
/*@@end*/

/*@@caplFunc:CRCM_Disp_Rq_AR_init():*/
CRCM_Disp_Rq_AR_init()
{   /* Botschaft CRCM_Disp_Rq_AR ID: 1147 --- Sendeart 5 cyclicAndSpontanWithDelay --- 
BA_ "ApplMessage" BO_ 1147 0;
BA_ "NmAsrMessage" BO_ 1147 0;
BA_ "GenMsgMinAcceptLength" BO_ 1147 3;
BA_ "GenMsgILSupport" BO_ 1147 1;
BA_ "DiagState" BO_ 1147 0;
BA_ "DiagRequest" BO_ 1147 0;
BA_ "DiagResponse" BO_ 1147 0;
BA_ "GenMsgStartValue" BO_ 1147 "0";
BA_ "GenMsgDelayTime" BO_ 1147 5;
BA_ "GenMsgNrOfRepetitions" BO_ 1147 0;
BA_ "GenMsgCycleTime" BO_ 1147 1000;
BA_ "GenMsgSendType" BO_ 1147 5;
    */
    _CRCM_Disp_Rq_AR_Timebase =           c_tDBKomTimer_20ms;
    _CRCM_Disp_Rq_AR_CycleCount =       1000 / _CRCM_Disp_Rq_AR_Timebase;
    _CRCM_Disp_Rq_AR_StartDelay =          0 / _CRCM_Disp_Rq_AR_Timebase;
    _CRCM_Disp_Rq_AR_Cnt = _CRCM_Disp_Rq_AR_StartDelay;
    _CRCM_Disp_Rq_AR_SpontanFlag = 0;

    putValue( HMI__STMSGSD_CRCM_Disp_Rq_AR, _CRCM_Disp_Rq_AR_StartDelay * _CRCM_Disp_Rq_AR_Timebase );

    _mCRCM_Disp_Rq_AR.CRCM_Msg0.phys = getValue( HMI_CRCM_Msg0 );
    _mCRCM_Disp_Rq_AR.CRCM_Msg1.phys = getValue( HMI_CRCM_Msg1 );
    _mCRCM_Disp_Rq_AR.CRCM_Msg2.phys = getValue( HMI_CRCM_Msg2 );
    _mCRCM_Disp_Rq_AR.CRCM_Msg3.phys = getValue( HMI_CRCM_Msg3 );
    _mCRCM_Disp_Rq_AR.CRCM_Msg4.phys = getValue( HMI_CRCM_Msg4 );
    _mCRCM_Disp_Rq_AR.CRCM_Msg5.phys = getValue( HMI_CRCM_Msg5 );
    _mCRCM_Disp_Rq_AR.CRCM_Msg6.phys = getValue( HMI_CRCM_Msg6 );
    _mCRCM_Disp_Rq_AR.CRCM_Msg7.phys = getValue( HMI_CRCM_Msg7 );
    _mCRCM_Disp_Rq_AR.CRCM_Msg8.phys = getValue( HMI_CRCM_Msg8 );
    _mCRCM_Disp_Rq_AR.CRCM_Msg9.phys = getValue( HMI_CRCM_Msg9 );
    _mCRCM_Disp_Rq_AR.CRCM_Msg10.phys = getValue( HMI_CRCM_Msg10 );
    _mCRCM_Disp_Rq_AR.CRCM_Msg11.phys = getValue( HMI_CRCM_Msg11 );
    _mCRCM_Disp_Rq_AR.CRCM_Msg12.phys = getValue( HMI_CRCM_Msg12 );
    _mCRCM_Disp_Rq_AR.CT_Stat_Img_Disp_Rq.phys = getValue( HMI_CT_Stat_Img_Disp_Rq );
}
/*@@end*/

/*@@caplFunc:CRCM_Disp_Rq_AR_output():*/
CRCM_Disp_Rq_AR_output(void)
{
    output( _mCRCM_Disp_Rq_AR );
}
/*@@end*/

/*@@caplFunc:CRCM_Disp_Rq_AR_saveEnvVars(dword):*/
CRCM_Disp_Rq_AR_saveEnvVars( dword hFile )
{
    filePutString("\n// Knoten EIS: CRCM_Disp_Rq_AR\n", 28, hFile );
    snprintf( buffer, elcount( buffer ), "0.0000 HMI__STMSG_CRCM_Disp_Rq_AR := %X\n", getValue( HMI__STMSG_CRCM_Disp_Rq_AR ) );            filePutString ( buffer, elcount( buffer ), hFile );
    snprintf( buffer, elcount( buffer ), "0.0000 HMI__STMSGT_CRCM_Disp_Rq_AR := %X\n", getValue( HMI__STMSGT_CRCM_Disp_Rq_AR ) );        filePutString ( buffer, elcount( buffer ), hFile );
    snprintf( buffer, elcount( buffer ), "0.0000 HMI_CRCM_Msg0 := %X\n", getValue( HMI_CRCM_Msg0 ) );    filePutString ( buffer, elcount( buffer ), hFile );
    snprintf( buffer, elcount( buffer ), "0.0000 HMI_CRCM_Msg1 := %X\n", getValue( HMI_CRCM_Msg1 ) );    filePutString ( buffer, elcount( buffer ), hFile );
    snprintf( buffer, elcount( buffer ), "0.0000 HMI_CRCM_Msg2 := %X\n", getValue( HMI_CRCM_Msg2 ) );    filePutString ( buffer, elcount( buffer ), hFile );
    snprintf( buffer, elcount( buffer ), "0.0000 HMI_CRCM_Msg3 := %X\n", getValue( HMI_CRCM_Msg3 ) );    filePutString ( buffer, elcount( buffer ), hFile );
    snprintf( buffer, elcount( buffer ), "0.0000 HMI_CRCM_Msg4 := %X\n", getValue( HMI_CRCM_Msg4 ) );    filePutString ( buffer, elcount( buffer ), hFile );
    snprintf( buffer, elcount( buffer ), "0.0000 HMI_CRCM_Msg5 := %X\n", getValue( HMI_CRCM_Msg5 ) );    filePutString ( buffer, elcount( buffer ), hFile );
    snprintf( buffer, elcount( buffer ), "0.0000 HMI_CRCM_Msg6 := %X\n", getValue( HMI_CRCM_Msg6 ) );    filePutString ( buffer, elcount( buffer ), hFile );
    snprintf( buffer, elcount( buffer ), "0.0000 HMI_CRCM_Msg7 := %X\n", getValue( HMI_CRCM_Msg7 ) );    filePutString ( buffer, elcount( buffer ), hFile );
    snprintf( buffer, elcount( buffer ), "0.0000 HMI_CRCM_Msg8 := %X\n", getValue( HMI_CRCM_Msg8 ) );    filePutString ( buffer, elcount( buffer ), hFile );
    snprintf( buffer, elcount( buffer ), "0.0000 HMI_CRCM_Msg9 := %X\n", getValue( HMI_CRCM_Msg9 ) );    filePutString ( buffer, elcount( buffer ), hFile );
    snprintf( buffer, elcount( buffer ), "0.0000 HMI_CRCM_Msg10 := %X\n", getValue( HMI_CRCM_Msg10 ) );    filePutString ( buffer, elcount( buffer ), hFile );
    snprintf( buffer, elcount( buffer ), "0.0000 HMI_CRCM_Msg11 := %X\n", getValue( HMI_CRCM_Msg11 ) );    filePutString ( buffer, elcount( buffer ), hFile );
    snprintf( buffer, elcount( buffer ), "0.0000 HMI_CRCM_Msg12 := %X\n", getValue( HMI_CRCM_Msg12 ) );    filePutString ( buffer, elcount( buffer ), hFile );
    snprintf( buffer, elcount( buffer ), "0.0000 HMI_CT_Stat_Img_Disp_Rq := %X\n", getValue( HMI_CT_Stat_Img_Disp_Rq ) );    filePutString ( buffer, elcount( buffer ), hFile );
}
/*@@end*/

/*@@timer:_tCRCM_Disp_Rq_AR:*/
on timer _tCRCM_Disp_Rq_AR
{
    putValue( HMI__STMSG_CRCM_Disp_Rq_AR, 0 );
}
/*@@end*/

/*@@envVar:HMI__STMSG_CRCM_Disp_Rq_AR:*/
on EnvVar HMI__STMSG_CRCM_Disp_Rq_AR
{
    long tDelay;
    if( getValue( this ) == 2 )
    {
        tDelay = getValue( HMI__STMSGT_CRCM_Disp_Rq_AR );
        if( tDelay > 0)    
            setTimer( _tCRCM_Disp_Rq_AR, tDelay );
        else
            putValue( HMI__STMSG_CRCM_Disp_Rq_AR, 0 );
    }
}
/*@@end*/

/*@@envVar:HMI_CRCM_Msg0:*/
on envVar HMI_CRCM_Msg0
{
    _mCRCM_Disp_Rq_AR.CRCM_Msg0.phys = getValue(this);
    _CRCM_Disp_Rq_AR_SpontanFlag = 1;
}
/*@@end*/

/*@@envVar:HMI_CRCM_Msg1:*/
on envVar HMI_CRCM_Msg1
{
    _mCRCM_Disp_Rq_AR.CRCM_Msg1.phys = getValue(this);
    _CRCM_Disp_Rq_AR_SpontanFlag = 1;
}
/*@@end*/

/*@@envVar:HMI_CRCM_Msg2:*/
on envVar HMI_CRCM_Msg2
{
    _mCRCM_Disp_Rq_AR.CRCM_Msg2.phys = getValue(this);
    _CRCM_Disp_Rq_AR_SpontanFlag = 1;
}
/*@@end*/

/*@@envVar:HMI_CRCM_Msg3:*/
on envVar HMI_CRCM_Msg3
{
    _mCRCM_Disp_Rq_AR.CRCM_Msg3.phys = getValue(this);
    _CRCM_Disp_Rq_AR_SpontanFlag = 1;
}
/*@@end*/

/*@@envVar:HMI_CRCM_Msg4:*/
on envVar HMI_CRCM_Msg4
{
    _mCRCM_Disp_Rq_AR.CRCM_Msg4.phys = getValue(this);
    _CRCM_Disp_Rq_AR_SpontanFlag = 1;
}
/*@@end*/

/*@@envVar:HMI_CRCM_Msg5:*/
on envVar HMI_CRCM_Msg5
{
    _mCRCM_Disp_Rq_AR.CRCM_Msg5.phys = getValue(this);
    _CRCM_Disp_Rq_AR_SpontanFlag = 1;
}
/*@@end*/

/*@@envVar:HMI_CRCM_Msg6:*/
on envVar HMI_CRCM_Msg6
{
    _mCRCM_Disp_Rq_AR.CRCM_Msg6.phys = getValue(this);
    _CRCM_Disp_Rq_AR_SpontanFlag = 1;
}
/*@@end*/

/*@@envVar:HMI_CRCM_Msg7:*/
on envVar HMI_CRCM_Msg7
{
    _mCRCM_Disp_Rq_AR.CRCM_Msg7.phys = getValue(this);
    _CRCM_Disp_Rq_AR_SpontanFlag = 1;
}
/*@@end*/

/*@@envVar:HMI_CRCM_Msg8:*/
on envVar HMI_CRCM_Msg8
{
    _mCRCM_Disp_Rq_AR.CRCM_Msg8.phys = getValue(this);
    _CRCM_Disp_Rq_AR_SpontanFlag = 1;
}
/*@@end*/

/*@@envVar:HMI_CRCM_Msg9:*/
on envVar HMI_CRCM_Msg9
{
    _mCRCM_Disp_Rq_AR.CRCM_Msg9.phys = getValue(this);
    _CRCM_Disp_Rq_AR_SpontanFlag = 1;
}
/*@@end*/

/*@@envVar:HMI_CRCM_Msg10:*/
on envVar HMI_CRCM_Msg10
{
    _mCRCM_Disp_Rq_AR.CRCM_Msg10.phys = getValue(this);
    _CRCM_Disp_Rq_AR_SpontanFlag = 1;
}
/*@@end*/

/*@@envVar:HMI_CT_Stat_Img_Disp_Rq:*/
on envVar HMI_CT_Stat_Img_Disp_Rq
{
    _mCRCM_Disp_Rq_AR.CT_Stat_Img_Disp_Rq.phys = getValue(this);
    _CRCM_Disp_Rq_AR_SpontanFlag = 1;
}
/*@@end*/

/*@@envVar:HMI_CRCM_Msg11:*/
on envVar HMI_CRCM_Msg11
{
    _mCRCM_Disp_Rq_AR.CRCM_Msg11.phys = getValue(this);
    _CRCM_Disp_Rq_AR_SpontanFlag = 1;
}
/*@@end*/

/*@@envVar:HMI_CRCM_Msg12:*/
on envVar HMI_CRCM_Msg12
{
    _mCRCM_Disp_Rq_AR.CRCM_Msg12.phys = getValue(this);
    _CRCM_Disp_Rq_AR_SpontanFlag = 1;
}
/*@@end*/

/*@@caplFunc:CU_RemFunc_Rq3_AR_check_output():*/
CU_RemFunc_Rq3_AR_check_output()
{
    if( !getValue( HMI__STMSG_CU_RemFunc_Rq3_AR ) )
    {
        // Botschaft CU_RemFunc_Rq3_AR ID: 956 --- Sendeart 0 cyclicX
        _CU_RemFunc_Rq3_AR_Cnt--;
        if( _CU_RemFunc_Rq3_AR_Cnt < 1 )
        {
            CU_RemFunc_Rq3_AR_output(); // Nachricht wg. abgelaufenem Zyklus ausgeben
            _CU_RemFunc_Rq3_AR_Cnt = _CU_RemFunc_Rq3_AR_CycleCount; // Zyklus-Zähler zurücksetzen
        }
    }
}
/*@@end*/

/*@@caplFunc:CU_RemFunc_Rq3_AR_init():*/
CU_RemFunc_Rq3_AR_init()
{   /* Botschaft CU_RemFunc_Rq3_AR ID: 956 --- Sendeart 0 cyclicX --- 
BA_ "ApplMessage" BO_ 956 0;
BA_ "NmAsrMessage" BO_ 956 0;
BA_ "GenMsgMinAcceptLength" BO_ 956 8;
BA_ "GenMsgILSupport" BO_ 956 1;
BA_ "DiagState" BO_ 956 0;
BA_ "DiagRequest" BO_ 956 0;
BA_ "DiagResponse" BO_ 956 0;
BA_ "GenMsgStartValue" BO_ 956 "0";
BA_ "GenMsgCycleTime" BO_ 956 500;
BA_ "GenMsgSendType" BO_ 956 0;
    */
    _CU_RemFunc_Rq3_AR_Timebase =         c_tDBKomTimer_20ms;
    _CU_RemFunc_Rq3_AR_CycleCount =     500 / _CU_RemFunc_Rq3_AR_Timebase;
    _CU_RemFunc_Rq3_AR_StartDelay =       0 / _CU_RemFunc_Rq3_AR_Timebase;
    _CU_RemFunc_Rq3_AR_Cnt = _CU_RemFunc_Rq3_AR_StartDelay;

    putValue( HMI__STMSGSD_CU_RemFunc_Rq3_AR, _CU_RemFunc_Rq3_AR_StartDelay * _CU_RemFunc_Rq3_AR_Timebase );

    _mCU_RemFunc_Rq3_AR.TC_Rst_Reset_CU.phys = getValue( HMI_TC_Rst_Reset_CU );
    _mCU_RemFunc_Rq3_AR.TC_Rst_Start_CU.phys = getValue( HMI_TC_Rst_Start_CU );
}
/*@@end*/

/*@@caplFunc:CU_RemFunc_Rq3_AR_output():*/
CU_RemFunc_Rq3_AR_output(void)
{
    output( _mCU_RemFunc_Rq3_AR );
}
/*@@end*/

/*@@caplFunc:CU_RemFunc_Rq3_AR_saveEnvVars(dword):*/
CU_RemFunc_Rq3_AR_saveEnvVars( dword hFile )
{
    filePutString("\n// Knoten EIS: CU_RemFunc_Rq3_AR\n", 31, hFile );
    snprintf( buffer, elcount( buffer ), "0.0000 HMI__STMSG_CU_RemFunc_Rq3_AR := %X\n", getValue( HMI__STMSG_CU_RemFunc_Rq3_AR ) );    filePutString ( buffer, elcount( buffer ), hFile );
    snprintf( buffer, elcount( buffer ), "0.0000 HMI__STMSGT_CU_RemFunc_Rq3_AR := %X\n", getValue( HMI__STMSGT_CU_RemFunc_Rq3_AR ) );    filePutString ( buffer, elcount( buffer ), hFile );
    snprintf( buffer, elcount( buffer ), "0.0000 HMI_TC_Rst_Reset_CU := %X\n", getValue( HMI_TC_Rst_Reset_CU ) );    filePutString ( buffer, elcount( buffer ), hFile );
    snprintf( buffer, elcount( buffer ), "0.0000 HMI_TC_Rst_Start_CU := %X\n", getValue( HMI_TC_Rst_Start_CU ) );    filePutString ( buffer, elcount( buffer ), hFile );
}
/*@@end*/

/*@@timer:_tCU_RemFunc_Rq3_AR:*/
on timer _tCU_RemFunc_Rq3_AR
{
    putValue( HMI__STMSG_CU_RemFunc_Rq3_AR, 0 );
}
/*@@end*/

/*@@envVar:HMI__STMSG_CU_RemFunc_Rq3_AR:*/
on EnvVar HMI__STMSG_CU_RemFunc_Rq3_AR
{
    long tDelay;
    if( getValue( this ) == 2 )
    {
        tDelay = getValue( HMI__STMSGT_CU_RemFunc_Rq3_AR );
        if( tDelay > 0)    
            setTimer( _tCU_RemFunc_Rq3_AR, tDelay );
        else
            putValue( HMI__STMSG_CU_RemFunc_Rq3_AR, 0 );
    }
}
/*@@end*/

/*@@envVar:HMI_TC_Rst_Reset_CU:*/
on EnvVar HMI_TC_Rst_Reset_CU
{
    _mCU_RemFunc_Rq3_AR.TC_Rst_Reset_CU.phys = getValue(this);
}
/*@@end*/

/*@@envVar:HMI_TC_Rst_Start_CU:*/
on EnvVar HMI_TC_Rst_Start_CU
{
    _mCU_RemFunc_Rq3_AR.TC_Rst_Start_CU.phys = getValue(this);
}
/*@@end*/

/*@@caplFunc:DidA_MBContact_State_AR_check_output():*/
DidA_MBContact_State_AR_check_output()
{
    if( !getValue( HMI__STMSG_DidA_MBContact_State_AR ) )
    {
        // Botschaft DidA_MBContact_State_AR ID: 1119 --- Sendeart 5 cyclicAndSpontanWithDelay --- 
        _DidA_MBContact_State_AR_Cnt--;
        if( _DidA_MBContact_State_AR_Cnt < 1 )
        {
            DidA_MBContact_State_AR_output(); // Nachricht wg. abgelaufenem Zyklus ausgeben
            _DidA_MBContact_State_AR_Cnt = _DidA_MBContact_State_AR_CycleCount; // Zyklus-Zähler zurücksetzen
            _DidA_MBContact_State_AR_SpontanFlag = 0; // Spontan-Flag zurücksetzen
        }
        else if( _DidA_MBContact_State_AR_SpontanFlag)
        {
            DidA_MBContact_State_AR_output(); // Nachricht wg. spontaner Änderung ausgeben
            _DidA_MBContact_State_AR_SpontanFlag = 0; // Spontan-Flag zurücksetzen
        }
    }
}
/*@@end*/

/*@@caplFunc:DidA_MBContact_State_AR_init():*/
DidA_MBContact_State_AR_init()
{   /* Botschaft DidA_MBContact_State_AR ID: 1119 --- Sendeart 5 cyclicAndSpontanWithDelay --- 
BA_ "ApplMessage" BO_ 1119 0;
BA_ "NmAsrMessage" BO_ 1119 0;
BA_ "GenMsgMinAcceptLength" BO_ 1119 8;
BA_ "GenMsgILSupport" BO_ 1119 1;
BA_ "DiagState" BO_ 1119 0;
BA_ "DiagRequest" BO_ 1119 0;
BA_ "DiagResponse" BO_ 1119 0;
BA_ "GenMsgStartValue" BO_ 1119 "0";
BA_ "GenMsgStartDelayTime" BO_ 1119 70;
BA_ "GenMsgDelayTime" BO_ 1119 5;
BA_ "GenMsgNrOfRepetitions" BO_ 1119 0;
BA_ "GenMsgCycleTime" BO_ 1119 1000;
BA_ "GenMsgSendType" BO_ 1119 5;
    */
    _DidA_MBContact_State_AR_Timebase =          c_tDBKomTimer_20ms;
    _DidA_MBContact_State_AR_CycleCount =      1000 / _DidA_MBContact_State_AR_Timebase;
    _DidA_MBContact_State_AR_StartDelay =        70 / _DidA_MBContact_State_AR_Timebase;
    _DidA_MBContact_State_AR_Cnt = _DidA_MBContact_State_AR_StartDelay;
    _DidA_MBContact_State_AR_SpontanFlag = 0;

    putValue( HMI__STMSGSD_DidA_MBContact_State_AR, _DidA_MBContact_State_AR_StartDelay * _DidA_MBContact_State_AR_Timebase );

    _mDidA_MBContact_State_AR.DidA_MBContact_DataCollected.phys = getValue( HMI_DidA_MBContact_DataCollected );
    _mDidA_MBContact_State_AR.DidA_MBContact_DataSent.phys = getValue( HMI_DidA_MBContact_DataSent );
    _mDidA_MBContact_State_AR.DidA_MBContact_Stat.phys = getValue( HMI_DidA_MBContact_Stat );
}
/*@@end*/

/*@@caplFunc:DidA_MBContact_State_AR_output():*/
DidA_MBContact_State_AR_output(void)
{
    output( _mDidA_MBContact_State_AR );
}
/*@@end*/

/*@@caplFunc:DidA_MBContact_State_AR_saveEnvVars(dword):*/
DidA_MBContact_State_AR_saveEnvVars( dword hFile )
{
    filePutString("\n// Knoten EIS: DidA_MBContact_State_AR\n", 37, hFile );
    snprintf( buffer, elcount( buffer ), "0.0000 HMI__STMSG_EDidA_MBContact_State_AR := %X\n", getValue( HMI__STMSG_DidA_MBContact_State_AR ) );        filePutString ( buffer, elcount( buffer ), hFile );
    snprintf( buffer, elcount( buffer ), "0.0000 HMI__STMSGT_DidA_MBContact_State_AR := %X\n", getValue( HMI__STMSGT_DidA_MBContact_State_AR ) );        filePutString ( buffer, elcount( buffer ), hFile );
    snprintf( buffer, elcount( buffer ), "0.0000 HMI_DidA_MBContact_DataCollected := %X\n", getValue( HMI_DidA_MBContact_DataCollected ) );        filePutString ( buffer, elcount( buffer ), hFile );
    snprintf( buffer, elcount( buffer ), "0.0000 HMI_DidA_MBContact_DataSent := %X\n", getValue( HMI_DidA_MBContact_DataSent ) );        filePutString ( buffer, elcount( buffer ), hFile );
    snprintf( buffer, elcount( buffer ), "0.0000 HMI_DidA_MBContact_Stat := %X\n", getValue( HMI_DidA_MBContact_Stat ) );        filePutString ( buffer, elcount( buffer ), hFile );
}
/*@@end*/

/*@@timer:_tDidA_MBContact_State_AR:*/
on timer _tDidA_MBContact_State_AR
{
    putValue( HMI__STMSG_DidA_MBContact_State_AR, 0 );
}
/*@@end*/

/*@@envVar:HMI__STMSG_DidA_MBContact_State_AR:*/
on EnvVar HMI__STMSG_DidA_MBContact_State_AR
{
    long tDelay;
    if( getValue( this ) == 2 )
    {
        tDelay = getValue( HMI__STMSGT_DidA_MBContact_State_AR );
        if( tDelay > 0)    
            setTimer( _tDidA_MBContact_State_AR, tDelay );
        else
            putValue( HMI__STMSG_DidA_MBContact_State_AR, 0 );
    }
}
/*@@end*/

/*@@envVar:HMI_DidA_MBContact_DataCollected:*/
on EnvVar HMI_DidA_MBContact_DataCollected
{
    _mDidA_MBContact_State_AR.DidA_MBContact_DataCollected.phys = getValue(this);
    _DidA_MBContact_State_AR_SpontanFlag = 1;
}
/*@@end*/

/*@@envVar:HMI_DidA_MBContact_DataSent:*/
on EnvVar HMI_DidA_MBContact_DataSent
{
    _mDidA_MBContact_State_AR.DidA_MBContact_DataSent.phys = getValue(this);
    _DidA_MBContact_State_AR_SpontanFlag = 1;
}
/*@@end*/

/*@@envVar:HMI_DidA_MBContact_Stat:*/
on EnvVar HMI_DidA_MBContact_Stat
{
    _mDidA_MBContact_State_AR.DidA_MBContact_Stat.phys = getValue(this);
    _DidA_MBContact_State_AR_SpontanFlag = 1;
}
/*@@end*/

/*@@caplFunc:Door_FL_Stat_AR_check_output():*/
Door_FL_Stat_AR_check_output()
{
    if( !getValue( HMI__STMSG_Door_FL_Stat_AR ) )
    {
        // Botschaft Door_FL_Stat_AR ID: 919 --- Sendeart 5 cyclicAndSpontanWithDelay --- 
        if( _Door_FL_Stat_AR_DelayCnt > 0) _Door_FL_Stat_AR_DelayCnt--; // Mindestsendeabstand
        _Door_FL_Stat_AR_Cnt--;
        if( _Door_FL_Stat_AR_Cnt < 1 )
        {
            if( _Door_FL_Stat_AR_DelayCnt < 1 )
            {
                // Nachricht wg. abgelaufenem Zyklus ausgeben (Mindestsendeabstand eingehalten)
                Door_FL_Stat_AR_output();
                _Door_FL_Stat_AR_SpontanFlag = 0; // Spontan-Flag zurücksetzen
                _Door_FL_Stat_AR_DelayCnt = _Door_FL_Stat_AR_MinDelay;
            }
            else
            {
                // Spontanflag setzen damit nach Ablauf Mindestsendeabstand gesendet wird
                 _Door_FL_Stat_AR_SpontanFlag = 1;
            }
            _Door_FL_Stat_AR_Cnt = _Door_FL_Stat_AR_CycleCount; // Zyklus-Zähler zurücksetzen
        }
        else if( _Door_FL_Stat_AR_SpontanFlag)
        {
            if( _Door_FL_Stat_AR_DelayCnt < 1 )
            {
                // Nachricht wg. spontaner Änderung ausgeben (Mindestsendeabstand eingehalten)
                Door_FL_Stat_AR_output();
                _Door_FL_Stat_AR_SpontanFlag = 0; // Spontan-Flag zurücksetzen
                _Door_FL_Stat_AR_DelayCnt = _Door_FL_Stat_AR_MinDelay;
            }
        }
    }
}
/*@@end*/

/*@@caplFunc:Door_FL_Stat_AR_init():*/
Door_FL_Stat_AR_init()
{   /* Botschaft Door_FL_Stat_AR ID: 919 --- Sendeart 5 cyclicAndSpontanWithDelay --- 
BA_ "ApplMessage" BO_ 919 0;
BA_ "NmAsrMessage" BO_ 919 0;
BA_ "GenMsgMinAcceptLength" BO_ 919 8;
BA_ "GenMsgILSupport" BO_ 919 1;
BA_ "DiagState" BO_ 919 0;
BA_ "DiagRequest" BO_ 919 0;
BA_ "DiagResponse" BO_ 919 0;
BA_ "GenMsgStartValue" BO_ 919 "0";
BA_ "GenMsgDelayTime" BO_ 919 5;
BA_ "GenMsgNrOfRepetitions" BO_ 919 0;
BA_ "GenMsgCycleTime" BO_ 919 500;
BA_ "GenMsgSendType" BO_ 919 5;
    */
    _Door_FL_Stat_AR_Timebase =           c_tDBKomTimer_20ms;
    _Door_FL_Stat_AR_CycleCount =       500 / _Door_FL_Stat_AR_Timebase;
    _Door_FL_Stat_AR_StartDelay =         0 / _Door_FL_Stat_AR_Timebase;
    _Door_FL_Stat_AR_MinDelay =           5 / _Door_FL_Stat_AR_Timebase;
    _Door_FL_Stat_AR_Cnt = _Door_FL_Stat_AR_StartDelay;
    _Door_FL_Stat_AR_SpontanFlag = 0;
    _Door_FL_Stat_AR_DelayCnt = 0;

    putValue( HMI__STMSGSD_Door_FL_Stat_AR, _Door_FL_Stat_AR_StartDelay * _Door_FL_Stat_AR_Timebase );

    _mDoor_FL_Stat_AR.AddTurnLmp_Lt_Flt.phys = getValue( HMI_AddTurnLmp_Lt_Flt );
    _mDoor_FL_Stat_AR.AutoDrLk_Rq_DM_FL.phys = getValue( HMI_AutoDrLk_Rq_DM_FL );
    _mDoor_FL_Stat_AR.BSM_WarnUnit_Lt_Stat.phys = getValue( HMI_BSM_WarnUnit_Lt_Stat );
    _mDoor_FL_Stat_AR.CLkS_Sw_FL_Psd.phys = getValue( HMI_CLkS_Sw_FL_Psd );
    _mDoor_FL_Stat_AR.DL_RemActn_LHD_Stat.phys = getValue( HMI_DL_RemActn_LHD_Stat );
    _mDoor_FL_Stat_AR.Door_FL_Stat_UB.phys = getValue( HMI_Door_FL_Stat_UB );
    _mDoor_FL_Stat_AR.DrPreLtch_FL_Engg.phys = getValue( HMI_DrPreLtch_FL_Engg );
    _mDoor_FL_Stat_AR.DrRLtch_FL_Stat.phys = getValue( HMI_DrRLtch_FL_Stat );
    _mDoor_FL_Stat_AR.ElecTrlrHtrch_Sw_Psd_FL.phys = getValue( HMI_ElecTrlrHtrch_Sw_Psd_FL );
    _mDoor_FL_Stat_AR.Mirr_FL_Bl.phys = getValue( HMI_Mirr_FL_Bl );
    _mDoor_FL_Stat_AR.MirrAdjSw_Stat_LHD_V2.phys = getValue( HMI_MirrAdjSw_Stat_LHD_V2 );
    _mDoor_FL_Stat_AR.MirrFld_Stat_LHD.phys = getValue( HMI_MirrFld_Stat_LHD );
    _mDoor_FL_Stat_AR.MirrFldPk_LHD_Stat.phys = getValue( HMI_MirrFldPk_LHD_Stat );
    _mDoor_FL_Stat_AR.PwrCls_FL_Actv.phys = getValue( HMI_PwrCls_FL_Actv );
    _mDoor_FL_Stat_AR.RemTank_Unlk_Sw_FL.phys = getValue( HMI_RemTank_Unlk_Sw_FL );
    _mDoor_FL_Stat_AR.Rsrv1_Door_FL_Stat.phys = getValue( HMI_Rsrv1_Door_FL_Stat );
    _mDoor_FL_Stat_AR.SeatAdj_P_LHD_Actv.phys = getValue( HMI_SeatAdj_P_LHD_Actv );
    _mDoor_FL_Stat_AR.Tweeter_FL_Posn_Stat.phys = getValue( HMI_Tweeter_FL_Posn_Stat );
}
/*@@end*/

/*@@caplFunc:Door_FL_Stat_AR_output():*/
void Door_FL_Stat_AR_output(void)
{
    byte crc;
    byte SQC_help;

    if( !getValue( HMI_SQC_Door_FL_Stat_Auto ) )
    {
        // berechne message counter
        SQC_help = getValue( HMI_SQC_Door_FL_Stat );
        if( SQC_help >= 15 ) SQC_help = 0;
        else SQC_help++;
        putValue( HMI_SQC_Door_FL_Stat, SQC_help );
        _mDoor_FL_Stat_AR.SQC_Door_FL_Stat = SQC_help;
    }
    else
          _mDoor_FL_Stat_AR.SQC_Door_FL_Stat = getValue( HMI_SQC_Door_FL_Stat );

    if( getValue( HMI_CRC_Door_FL_Stat_Profile_02 ) )
    {
        if( !getValue( HMI_CRC_Door_FL_Stat_Auto ) )
        {   // CRC according Profile_02 ( W213 )
            // berechne crc
            crc = 0xFF;
//            crc = crctable_profile02[crc ^ _mDoor_FL_Stat_AR.byte( 0 )];  CRC
            crc = crctable_profile02[crc ^ _mDoor_FL_Stat_AR.byte( 1 )];
//            crc = crctable_profile02[crc ^ _mDoor_FL_Stat_AR.byte( 2 )];
//            crc = crctable_profile02[crc ^ _mDoor_FL_Stat_AR.byte( 3 )];
//            crc = crctable_profile02[crc ^ _mDoor_FL_Stat_AR.byte( 4 )];
//            crc = crctable_profile02[crc ^ _mDoor_FL_Stat_AR.byte( 5 )];
//            crc = crctable_profile02[crc ^ _mDoor_FL_Stat_AR.byte( 6 )];
//            crc = crctable_profile02[crc ^ _mDoor_FL_Stat_AR.byte( 7 )];
            crc = crctable_profile02[crc ^ _Door_FL_Stat_AR_CRC_Offset[ _mDoor_FL_Stat_AR.SQC_Door_FL_Stat ] ]; // load offset
            crc = (crc ^ 0xFF);
            if( getValue(  HMI_CRC_Door_FL_Stat_Invalid ) )
                crc++;
            _mDoor_FL_Stat_AR.CRC_Door_FL_Stat = crc;
            putValue( HMI_CRC_Door_FL_Stat, crc );
        }
        else
            _mDoor_FL_Stat_AR.CRC_Door_FL_Stat = getValue( HMI_CRC_Door_FL_Stat );
    }
    else
    {
        if( !getValue( HMI_CRC_Door_FL_Stat_Auto ) )
        {   // CRC according to SAE1850 ( W222 )
            // berechne crc
            crc = 0xFF;
//            crc = crctable[crc ^ _mDoor_FL_Stat_AR.byte( 0 )];  CRC
            crc = crctable[crc ^ _mDoor_FL_Stat_AR.byte( 1 )];
//            crc = crctable[crc ^ _mDoor_FL_Stat_AR.byte( 2 )];
//            crc = crctable[crc ^ _mDoor_FL_Stat_AR.byte( 3 )];
//            crc = crctable[crc ^ _mDoor_FL_Stat_AR.byte( 4 )];
//            crc = crctable[crc ^ _mDoor_FL_Stat_AR.byte( 5 )];
//            crc = crctable[crc ^ _mDoor_FL_Stat_AR.byte( 6 )];
//            crc = crctable[crc ^ _mDoor_FL_Stat_AR.byte( 7 )];
            crc = (crc ^ 0xFF);
            if( getValue(  HMI_CRC_Door_FL_Stat_Invalid ) )
                crc++;
            _mDoor_FL_Stat_AR.CRC_Door_FL_Stat = crc;
            putValue( HMI_CRC_Door_FL_Stat, crc );
        }
        else
            _mDoor_FL_Stat_AR.CRC_Door_FL_Stat = getValue( HMI_CRC_Door_FL_Stat );
    }
    output( _mDoor_FL_Stat_AR );
}
/*@@end*/

/*@@caplFunc:Door_FL_Stat_AR_saveEnvVars(dword):*/
Door_FL_Stat_AR_saveEnvVars( dword hFile )
{
    filePutString("\n// Knoten EIS: Door_FL_Stat_AR\n", 29, hFile );
    snprintf( buffer, elcount( buffer ), "0.0000 HMI__STMSG_Door_FL_Stat_AR := %X\n", getValue( HMI__STMSG_Door_FL_Stat_AR ) );        filePutString ( buffer, elcount( buffer ), hFile );
    snprintf( buffer, elcount( buffer ), "0.0000 HMI__STMSGT_Door_FL_Stat_AR := %X\n", getValue( HMI__STMSGT_Door_FL_Stat_AR ) );        filePutString ( buffer, elcount( buffer ), hFile );
    snprintf( buffer, elcount( buffer ), "0.0000 HMI_AddTurnLmp_Lt_Flt := %X\n", getValue( HMI_AddTurnLmp_Lt_Flt ) );        filePutString ( buffer, elcount( buffer ), hFile );
    snprintf( buffer, elcount( buffer ), "0.0000 HMI_AutoDrLk_Rq_DM_FL := %X\n", getValue( HMI_AutoDrLk_Rq_DM_FL ) );        filePutString ( buffer, elcount( buffer ), hFile );
    snprintf( buffer, elcount( buffer ), "0.0000 HMI_BSM_WarnUnit_Lt_Stat := %X\n", getValue( HMI_BSM_WarnUnit_Lt_Stat ) );        filePutString ( buffer, elcount( buffer ), hFile );
    snprintf( buffer, elcount( buffer ), "0.0000 HMI_CLkS_Sw_FL_Psd := %X\n", getValue( HMI_CLkS_Sw_FL_Psd ) );        filePutString ( buffer, elcount( buffer ), hFile );
    snprintf( buffer, elcount( buffer ), "0.0000 HMI_CRC_Door_FL_Stat := %X\n", getValue( HMI_CRC_Door_FL_Stat ) );        filePutString ( buffer, elcount( buffer ), hFile );
    snprintf( buffer, elcount( buffer ), "0.0000 HMI_CRC_Door_FL_Stat_Auto := %X\n", getValue( HMI_CRC_Door_FL_Stat_Auto ) );        filePutString ( buffer, elcount( buffer ), hFile );
    snprintf( buffer, elcount( buffer ), "0.0000 HMI_DL_RemActn_LHD_Stat := %X\n", getValue( HMI_DL_RemActn_LHD_Stat ) );        filePutString ( buffer, elcount( buffer ), hFile );
    snprintf( buffer, elcount( buffer ), "0.0000 HMI_Door_FL_Stat_UB := %X\n", getValue( HMI_Door_FL_Stat_UB ) );        filePutString ( buffer, elcount( buffer ), hFile );
    snprintf( buffer, elcount( buffer ), "0.0000 HMI_DrPreLtch_FL_Engg := %X\n", getValue( HMI_DrPreLtch_FL_Engg ) );        filePutString ( buffer, elcount( buffer ), hFile );
    snprintf( buffer, elcount( buffer ), "0.0000 HMI_DrRLtch_FL_Stat := %X\n", getValue( HMI_DrRLtch_FL_Stat ) );        filePutString ( buffer, elcount( buffer ), hFile );
    snprintf( buffer, elcount( buffer ), "0.0000 HMI_ElecTrlrHtrch_Sw_Psd_FL := %X\n", getValue( HMI_ElecTrlrHtrch_Sw_Psd_FL ) );        filePutString ( buffer, elcount( buffer ), hFile );
    snprintf( buffer, elcount( buffer ), "0.0000 HMI_Mirr_FL_Bl := %X\n", getValue( HMI_Mirr_FL_Bl ) );        filePutString ( buffer, elcount( buffer ), hFile );
    snprintf( buffer, elcount( buffer ), "0.0000 HMI_MirrAdjSw_Stat_LHD_V2 := %X\n", getValue( HMI_MirrAdjSw_Stat_LHD_V2 ) );        filePutString ( buffer, elcount( buffer ), hFile );
    snprintf( buffer, elcount( buffer ), "0.0000 HMI_MirrFld_Stat_LHD := %X\n", getValue( HMI_MirrFld_Stat_LHD ) );        filePutString ( buffer, elcount( buffer ), hFile );
    snprintf( buffer, elcount( buffer ), "0.0000 HMI_MirrFldPk_LHD_Stat := %X\n", getValue( HMI_MirrFldPk_LHD_Stat ) );        filePutString ( buffer, elcount( buffer ), hFile );
    snprintf( buffer, elcount( buffer ), "0.0000 HMI_PwrCls_FL_Actv := %X\n", getValue( HMI_PwrCls_FL_Actv ) );        filePutString ( buffer, elcount( buffer ), hFile );
    snprintf( buffer, elcount( buffer ), "0.0000 HMI_RemTank_Unlk_Sw_FL := %X\n", getValue( HMI_RemTank_Unlk_Sw_FL ) );        filePutString ( buffer, elcount( buffer ), hFile );
    snprintf( buffer, elcount( buffer ), "0.0000 HMI_Rsrv1_Door_FL_Stat := %X\n", getValue( HMI_Rsrv1_Door_FL_Stat ) );        filePutString ( buffer, elcount( buffer ), hFile );
    snprintf( buffer, elcount( buffer ), "0.0000 HMI_SeatAdj_P_LHD_Actv := %X\n", getValue( HMI_SeatAdj_P_LHD_Actv ) );        filePutString ( buffer, elcount( buffer ), hFile );
    snprintf( buffer, elcount( buffer ), "0.0000 HMI_SQC_Door_FL_Stat := %X\n", getValue( HMI_SQC_Door_FL_Stat ) );        filePutString ( buffer, elcount( buffer ), hFile );
    snprintf( buffer, elcount( buffer ), "0.0000 HMI_SQC_Door_FL_Stat_Auto := %X\n", getValue( HMI_SQC_Door_FL_Stat_Auto ) );        filePutString ( buffer, elcount( buffer ), hFile );
    snprintf( buffer, elcount( buffer ), "0.0000 HMI_Tweeter_FL_Posn_Stat := %X\n", getValue( HMI_Tweeter_FL_Posn_Stat ) );        filePutString ( buffer, elcount( buffer ), hFile );
}
/*@@end*/

/*@@timer:_tDoor_FL_Stat_AR:*/
on timer _tDoor_FL_Stat_AR
{
    putValue( HMI__STMSG_Door_FL_Stat_AR, 0 );
}
/*@@end*/

/*@@envVar:HMI__STMSG_Door_FL_Stat_AR:*/
on EnvVar HMI__STMSG_Door_FL_Stat_AR
{
    long tDelay;
    if( getValue( this ) == 2 )
    {
        tDelay = getValue( HMI__STMSGT_Door_FL_Stat_AR );
        if( tDelay > 0)    
            setTimer( _tDoor_FL_Stat_AR, tDelay );
        else
            putValue( HMI__STMSG_Door_FL_Stat_AR, 0 );
    }
}
/*@@end*/

/*@@envVar:HMI_AddTurnLmp_Lt_Flt:*/
on EnvVar HMI_AddTurnLmp_Lt_Flt
{
    _mDoor_FL_Stat_AR.AddTurnLmp_Lt_Flt.phys = getValue(this);
    _Door_FL_Stat_AR_SpontanFlag = 1;
}
/*@@end*/

/*@@envVar:HMI_AutoDrLk_Rq_DM_FL:*/
on EnvVar HMI_AutoDrLk_Rq_DM_FL
{
    _mDoor_FL_Stat_AR.AutoDrLk_Rq_DM_FL.phys = getValue(this);
    _Door_FL_Stat_AR_SpontanFlag = 1;
}
/*@@end*/

/*@@envVar:HMI_BSM_WarnUnit_Lt_Stat:*/
on EnvVar HMI_BSM_WarnUnit_Lt_Stat
{
    _mDoor_FL_Stat_AR.BSM_WarnUnit_Lt_Stat.phys = getValue(this);
    _Door_FL_Stat_AR_SpontanFlag = 1;
}
/*@@end*/

/*@@envVar:HMI_CLkS_Sw_FL_Psd:*/
on EnvVar HMI_CLkS_Sw_FL_Psd
{
    _mDoor_FL_Stat_AR.CLkS_Sw_FL_Psd.phys = getValue(this);
    _Door_FL_Stat_AR_SpontanFlag = 1;
}
/*@@end*/

/*@@envVar:HMI_Door_FL_Stat_UB:*/
on EnvVar HMI_Door_FL_Stat_UB
{
    _mDoor_FL_Stat_AR.Door_FL_Stat_UB.phys = getValue(this);
    _Door_FL_Stat_AR_SpontanFlag = 1;
}
/*@@end*/

/*@@envVar:HMI_DL_RemActn_LHD_Stat:*/
on EnvVar HMI_DL_RemActn_LHD_Stat
{
    _mDoor_FL_Stat_AR.DL_RemActn_LHD_Stat.phys = getValue(this);
    _Door_FL_Stat_AR_SpontanFlag = 1;
}
/*@@end*/

/*@@envVar:HMI_DrPreLtch_FL_Engg:*/
on EnvVar HMI_DrPreLtch_FL_Engg
{
    _mDoor_FL_Stat_AR.DrPreLtch_FL_Engg.phys = getValue(this);
    _Door_FL_Stat_AR_SpontanFlag = 1;
}
/*@@end*/

/*@@envVar:HMI_DrRLtch_FL_Stat:*/
on EnvVar HMI_DrRLtch_FL_Stat
{
    if( ( getValue( Env_Stress__StresstestMainActiv ) == 0 )   &&
        ( getValue( HMI__NM_EIS_AutomaticNM_Switching ) == 0 )    )
    {
        _SetCommRequest( cFLDoorNMRequest );
        setTimer( t_DoorNMCancelTimer, c_NMCancelTimer_05sec ); // 5 seconds for auto-shut-off
    }
    _mDoor_FL_Stat_AR.DrRLtch_FL_Stat.phys = getValue(this);
    _Door_FL_Stat_AR_SpontanFlag = 1;
}
/*@@end*/

/*@@envVar:HMI_ElecTrlrHtrch_Sw_Psd_FL:*/
on EnvVar HMI_ElecTrlrHtrch_Sw_Psd_FL
{
    _mDoor_FL_Stat_AR.ElecTrlrHtrch_Sw_Psd_FL.phys = getValue(this);
    _Door_FL_Stat_AR_SpontanFlag = 1;
}
/*@@end*/

/*@@envVar:HMI_Mirr_FL_Bl:*/
on EnvVar HMI_Mirr_FL_Bl
{
    _mDoor_FL_Stat_AR.Mirr_FL_Bl.phys = getValue(this);
    _Door_FL_Stat_AR_SpontanFlag = 1;
}
/*@@end*/

/*@@envVar:HMI_MirrAdjSw_Stat_LHD_V2:*/
on EnvVar HMI_MirrAdjSw_Stat_LHD_V2
{
    _mDoor_FL_Stat_AR.MirrAdjSw_Stat_LHD_V2.phys = getValue(this);
    _Door_FL_Stat_AR_SpontanFlag = 1;
}
/*@@end*/

/*@@envVar:HMI_MirrFld_Stat_LHD:*/
on EnvVar HMI_MirrFld_Stat_LHD
{
    _mDoor_FL_Stat_AR.MirrFld_Stat_LHD.phys = getValue(this);
    _Door_FL_Stat_AR_SpontanFlag = 1;
}
/*@@end*/

/*@@envVar:HMI_MirrFldPk_LHD_Stat:*/
on EnvVar HMI_MirrFldPk_LHD_Stat
{
    _mDoor_FL_Stat_AR.MirrFldPk_LHD_Stat.phys = getValue(this);
    _Door_FL_Stat_AR_SpontanFlag = 1;
}
/*@@end*/

/*@@envVar:HMI_PwrCls_FL_Actv:*/
on EnvVar HMI_PwrCls_FL_Actv
{
    _mDoor_FL_Stat_AR.PwrCls_FL_Actv.phys = getValue(this);
    _Door_FL_Stat_AR_SpontanFlag = 1;
}
/*@@end*/

/*@@envVar:HMI_RemTank_Unlk_Sw_FL:*/
on EnvVar HMI_RemTank_Unlk_Sw_FL
{
    _mDoor_FL_Stat_AR.RemTank_Unlk_Sw_FL.phys = getValue(this);
    _Door_FL_Stat_AR_SpontanFlag = 1;
}
/*@@end*/

/*@@envVar:HMI_Rsrv1_Door_FL_Stat:*/
on EnvVar HMI_Rsrv1_Door_FL_Stat
{
    _mDoor_FL_Stat_AR.Rsrv1_Door_FL_Stat.phys = getValue(this);
    _Door_FL_Stat_AR_SpontanFlag = 1;
}
/*@@end*/

/*@@envVar:HMI_SeatAdj_P_LHD_Actv:*/
on EnvVar HMI_SeatAdj_P_LHD_Actv
{
    _mDoor_FL_Stat_AR.SeatAdj_P_LHD_Actv.phys = getValue(this);
    _Door_FL_Stat_AR_SpontanFlag = 1;
}
/*@@end*/

/*@@envVar:HMI_Tweeter_FL_Posn_Stat:*/
on EnvVar HMI_Tweeter_FL_Posn_Stat
{
    _mDoor_FL_Stat_AR.Tweeter_FL_Posn_Stat.phys = getValue(this);
    _Door_FL_Stat_AR_SpontanFlag = 1;
}
/*@@end*/

/*@@caplFunc:Door_FR_Stat_AR_check_output():*/
Door_FR_Stat_AR_check_output()
{
    if( !getValue( HMI__STMSG_Door_FR_Stat_AR ) )
    {
        // Botschaft Door_FR_Stat_AR ID: 923 --- Sendeart 5 cyclicAndSpontanWithDelay --- 
        if( _Door_FR_Stat_AR_DelayCnt > 0) _Door_FR_Stat_AR_DelayCnt--; // Mindestsendeabstand
        _Door_FR_Stat_AR_Cnt--;
        if( _Door_FR_Stat_AR_Cnt < 1 )
        {
            if( _Door_FR_Stat_AR_DelayCnt < 1 )
            {
                // Nachricht wg. abgelaufenem Zyklus ausgeben (Mindestsendeabstand eingehalten)
                Door_FR_Stat_AR_output();
                _Door_FR_Stat_AR_SpontanFlag = 0; // Spontan-Flag zurücksetzen
                _Door_FR_Stat_AR_DelayCnt = _Door_FR_Stat_AR_MinDelay;
            }
            else
            {
                // Spontanflag setzen damit nach Ablauf Mindestsendeabstand gesendet wird
                 _Door_FR_Stat_AR_SpontanFlag = 1;
            }
            _Door_FR_Stat_AR_Cnt = _Door_FR_Stat_AR_CycleCount; // Zyklus-Zähler zurücksetzen
        }
        else if( _Door_FR_Stat_AR_SpontanFlag)
        {
            if( _Door_FR_Stat_AR_DelayCnt < 1 )
            {
                // Nachricht wg. spontaner Änderung ausgeben (Mindestsendeabstand eingehalten)
                Door_FR_Stat_AR_output();
                _Door_FR_Stat_AR_SpontanFlag = 0; // Spontan-Flag zurücksetzen
                _Door_FR_Stat_AR_DelayCnt = _Door_FR_Stat_AR_MinDelay;
            }
        }
    }
}
/*@@end*/

/*@@caplFunc:Door_FR_Stat_AR_init():*/
Door_FR_Stat_AR_init()
{   /* Botschaft Door_FR_Stat_AR ID: 923 --- Sendeart 5 cyclicAndSpontanWithDelay --- 
BA_ "ApplMessage" BO_ 923 0;
BA_ "NmAsrMessage" BO_ 923 0;
BA_ "GenMsgMinAcceptLength" BO_ 923 8;
BA_ "GenMsgILSupport" BO_ 923 1;
BA_ "DiagState" BO_ 923 0;
BA_ "DiagRequest" BO_ 923 0;
BA_ "DiagResponse" BO_ 923 0;
BA_ "GenMsgStartValue" BO_ 923 "0";
BA_ "GenMsgDelayTime" BO_ 923 5;
BA_ "GenMsgNrOfRepetitions" BO_ 923 0;
BA_ "GenMsgCycleTime" BO_ 923 500;
BA_ "GenMsgSendType" BO_ 923 5;
    */
    _Door_FR_Stat_AR_Timebase =          c_tDBKomTimer_20ms;
    _Door_FR_Stat_AR_CycleCount =       500 / _Door_FR_Stat_AR_Timebase;
    _Door_FR_Stat_AR_StartDelay =         0 / _Door_FR_Stat_AR_Timebase;
    _Door_FR_Stat_AR_MinDelay =           5 / _Door_FR_Stat_AR_Timebase;
    _Door_FR_Stat_AR_Cnt = _Door_FR_Stat_AR_StartDelay;
    _Door_FR_Stat_AR_SpontanFlag = 0;
    _Door_FR_Stat_AR_DelayCnt = 0;

    putValue( HMI__STMSGSD_Door_FR_Stat_AR, _Door_FR_Stat_AR_StartDelay * _Door_FR_Stat_AR_Timebase );

    _mDoor_FR_Stat_AR.AddTurnLmp_Rt_Flt.phys = getValue( HMI_AddTurnLmp_Rt_Flt );
    _mDoor_FR_Stat_AR.AutoDrLk_Rq_DM_FR.phys = getValue( HMI_AutoDrLk_Rq_DM_FR );
    _mDoor_FR_Stat_AR.BSM_WarnUnit_Rt_Stat.phys = getValue( HMI_BSM_WarnUnit_Rt_Stat );
    _mDoor_FR_Stat_AR.CLkS_Sw_FR_Psd.phys = getValue( HMI_CLkS_Sw_FR_Psd );
    _mDoor_FR_Stat_AR.Door_FR_Stat_UB.phys = getValue( HMI_Door_FR_Stat_UB );
    _mDoor_FR_Stat_AR.DL_RemActn_RHD_Stat.phys = getValue( HMI_DL_RemActn_RHD_Stat );
    _mDoor_FR_Stat_AR.DrPreLtch_FR_Engg.phys = getValue( HMI_DrPreLtch_FR_Engg );
    _mDoor_FR_Stat_AR.DrRLtch_FR_Stat.phys = getValue( HMI_DrRLtch_FR_Stat );
    _mDoor_FR_Stat_AR.ElecTrlrHtrch_Sw_Psd_FR.phys = getValue( HMI_ElecTrlrHtrch_Sw_Psd_FR );
    _mDoor_FR_Stat_AR.Mirr_FR_Bl.phys = getValue( HMI_Mirr_FR_Bl );
    _mDoor_FR_Stat_AR.MirrAdjSw_Stat_RHD_V2.phys = getValue( HMI_MirrAdjSw_Stat_RHD_V2 );
    _mDoor_FR_Stat_AR.MirrFld_Stat_RHD.phys = getValue( HMI_MirrFld_Stat_RHD );
    _mDoor_FR_Stat_AR.MirrFldPk_RHD_Stat.phys = getValue( HMI_MirrFldPk_RHD_Stat );
    _mDoor_FR_Stat_AR.PwrCls_FR_Actv.phys = getValue( HMI_PwrCls_FR_Actv );
    _mDoor_FR_Stat_AR.RemTank_Unlk_Sw_FR.phys = getValue( HMI_RemTank_Unlk_Sw_FR );
    _mDoor_FR_Stat_AR.Rsrv1_Door_FR_Stat.phys = getValue( HMI_Rsrv1_Door_FR_Stat );
    _mDoor_FR_Stat_AR.SeatAdj_P_RHD_Actv.phys = getValue( HMI_SeatAdj_P_RHD_Actv );
    _mDoor_FR_Stat_AR.Tweeter_FR_Posn_Stat.phys = getValue( HMI_Tweeter_FR_Posn_Stat );
}
/*@@end*/

/*@@caplFunc:Door_FR_Stat_AR_output():*/
void Door_FR_Stat_AR_output(void)
{
    byte crc;
    byte SQC_help;

    if( !getValue( HMI_SQC_Door_FR_Stat_Auto ) )
    {
        // berechne message counter
        SQC_help = getValue( HMI_SQC_Door_FR_Stat );
        if( SQC_help >= 15 ) SQC_help = 0;
        else SQC_help++;
        putValue( HMI_SQC_Door_FR_Stat, SQC_help );
        _mDoor_FR_Stat_AR.SQC_Door_FR_Stat = SQC_help;
    }
    else
          _mDoor_FR_Stat_AR.SQC_Door_FR_Stat = getValue( HMI_SQC_Door_FR_Stat );

    if( getValue( HMI_CRC_Door_FR_Stat_Profile_02 ) )
    {
        if( !getValue( HMI_CRC_Door_FR_Stat_Auto ) )
        {   // CRC according Profile_02 ( W213 )
            // berechne crc
            crc = 0xFF;
//            crc = crctable_profile02[crc ^ _mDoor_FR_Stat_AR.byte(  )];  CRC
            crc = crctable_profile02[crc ^ _mDoor_FR_Stat_AR.byte( 1 )];
//            crc = crctable_profile02[crc ^ _mDoor_FR_Stat_AR.byte( 2 )];
//            crc = crctable_profile02[crc ^ _mDoor_FR_Stat_AR.byte( 3 )];
//            crc = crctable_profile02[crc ^ _mDoor_FR_Stat_AR.byte( 4 )];
//            crc = crctable_profile02[crc ^ _mDoor_FR_Stat_AR.byte( 5 )];
//            crc = crctable_profile02[crc ^ _mDoor_FR_Stat_AR.byte( 6 )];
//            crc = crctable_profile02[crc ^ _mDoor_FR_Stat_AR.byte( 7 )];
//            crc = crctable_profile02[crc ^ _Door_FR_Stat_AR_CRC_Offset[ _mDoor_FR_Stat_AR.SQC_Door_FR_Stat ] ]; // load offset
            crc = (crc ^ 0xFF);
            if( getValue(  HMI_CRC_Door_FR_Stat_Invalid ) )
                crc++;
            _mDoor_FR_Stat_AR.CRC_Door_FR_Stat = crc;
            putValue( HMI_CRC_Door_FR_Stat, crc );
        }
        else
            _mDoor_FR_Stat_AR.CRC_Door_FR_Stat = getValue( HMI_CRC_Door_FR_Stat );
    }
    else
    {
        if( !getValue( HMI_CRC_Door_FR_Stat_Auto ) )
        {   // CRC according to SAE1850 ( W222 )
            // berechne crc
            crc = 0xFF;
//            crc = crctable[crc ^ _mDoor_FR_Stat_AR.byte( 0 )];  CRC
            crc = crctable[crc ^ _mDoor_FR_Stat_AR.byte( 1 )];
//            crc = crctable[crc ^ _mDoor_FR_Stat_AR.byte( 2 )];
//            crc = crctable[crc ^ _mDoor_FR_Stat_AR.byte( 3 )];
//            crc = crctable[crc ^ _mDoor_FR_Stat_AR.byte( 4 )];
//            crc = crctable[crc ^ _mDoor_FR_Stat_AR.byte( 5 )];
//            crc = crctable[crc ^ _mDoor_FR_Stat_AR.byte( 6 )];
//            crc = crctable[crc ^ _mDoor_FR_Stat_AR.byte( 7 )];
            crc = (crc ^ 0xFF);
            if( getValue(  HMI_CRC_Door_FR_Stat_Invalid ) )
                crc++;
            _mDoor_FR_Stat_AR.CRC_Door_FR_Stat = crc;
            putValue( HMI_CRC_Door_FR_Stat, crc );
        }
        else
            _mDoor_FR_Stat_AR.CRC_Door_FR_Stat = getValue( HMI_CRC_Door_FR_Stat );
    }
    output( _mDoor_FR_Stat_AR );
}
/*@@end*/

/*@@caplFunc:Door_FR_Stat_AR_saveEnvVars(dword):*/
Door_FR_Stat_AR_saveEnvVars( dword hFile )
{
    filePutString("\n// Knoten EIS: Door_FR_Stat_AR\n", 29, hFile );
    snprintf( buffer, elcount( buffer ), "0.0000 HMI__STMSG_Door_FR_Stat_AR := %X\n", getValue( HMI__STMSG_Door_FR_Stat_AR ) );        filePutString ( buffer, elcount( buffer ), hFile );
    snprintf( buffer, elcount( buffer ), "0.0000 HMI__STMSGT_Door_FR_Stat_AR := %X\n", getValue( HMI__STMSGT_Door_FR_Stat_AR ) );        filePutString ( buffer, elcount( buffer ), hFile );
    snprintf( buffer, elcount( buffer ), "0.0000 HMI_AddTurnLmp_Rt_Flt := %X\n", getValue( HMI_AddTurnLmp_Rt_Flt ) );        filePutString ( buffer, elcount( buffer ), hFile );
    snprintf( buffer, elcount( buffer ), "0.0000 HMI_AutoDrLk_Rq_DM_FR := %X\n", getValue( HMI_AutoDrLk_Rq_DM_FR ) );        filePutString ( buffer, elcount( buffer ), hFile );
    snprintf( buffer, elcount( buffer ), "0.0000 HMI_BSM_WarnUnit_Rt_Stat := %X\n", getValue( HMI_BSM_WarnUnit_Rt_Stat ) );        filePutString ( buffer, elcount( buffer ), hFile );
    snprintf( buffer, elcount( buffer ), "0.0000 HMI_CLkS_Sw_FR_Psd := %X\n", getValue( HMI_CLkS_Sw_FR_Psd ) );        filePutString ( buffer, elcount( buffer ), hFile );
    snprintf( buffer, elcount( buffer ), "0.0000 HMI_CRC_Door_FL_Stat := %X\n", getValue( HMI_CRC_Door_FL_Stat ) );        filePutString ( buffer, elcount( buffer ), hFile );
    snprintf( buffer, elcount( buffer ), "0.0000 HMI_CRC_Door_FL_Stat_Auto := %X\n", getValue( HMI_CRC_Door_FL_Stat_Auto ) );        filePutString ( buffer, elcount( buffer ), hFile );
    snprintf( buffer, elcount( buffer ), "0.0000 HMI_DL_RemActn_RHD_Stat := %X\n", getValue( HMI_DL_RemActn_RHD_Stat ) );        filePutString ( buffer, elcount( buffer ), hFile );
    snprintf( buffer, elcount( buffer ), "0.0000 HMI_Door_FL_Stat_UB := %X\n", getValue( HMI_Door_FL_Stat_UB ) );        filePutString ( buffer, elcount( buffer ), hFile );
    snprintf( buffer, elcount( buffer ), "0.0000 HMI_DrPreLtch_FR_Engg := %X\n", getValue( HMI_DrPreLtch_FR_Engg ) );        filePutString ( buffer, elcount( buffer ), hFile );
    snprintf( buffer, elcount( buffer ), "0.0000 HMI_DrRLtch_FR_Stat := %X\n", getValue( HMI_DrRLtch_FR_Stat ) );        filePutString ( buffer, elcount( buffer ), hFile );
    snprintf( buffer, elcount( buffer ), "0.0000 HMI_ElecTrlrHtrch_Sw_Psd_FR := %X\n", getValue( HMI_ElecTrlrHtrch_Sw_Psd_FR ) );        filePutString ( buffer, elcount( buffer ), hFile );
    snprintf( buffer, elcount( buffer ), "0.0000 HMI_Mirr_FR_Bl := %X\n", getValue( HMI_Mirr_FR_Bl ) );        filePutString ( buffer, elcount( buffer ), hFile );
    snprintf( buffer, elcount( buffer ), "0.0000 HMI_MirrAdjSw_Stat_RHD_V2 := %X\n", getValue( HMI_MirrAdjSw_Stat_RHD_V2 ) );        filePutString ( buffer, elcount( buffer ), hFile );
    snprintf( buffer, elcount( buffer ), "0.0000 HMI_MirrFld_Stat_RHD := %X\n", getValue( HMI_MirrFld_Stat_RHD ) );        filePutString ( buffer, elcount( buffer ), hFile );
    snprintf( buffer, elcount( buffer ), "0.0000 HMI_MirrFldPk_RHD_Stat := %X\n", getValue( HMI_MirrFldPk_RHD_Stat ) );        filePutString ( buffer, elcount( buffer ), hFile );
    snprintf( buffer, elcount( buffer ), "0.0000 HMI_RemTank_Unlk_Sw_FR := %X\n", getValue( HMI_RemTank_Unlk_Sw_FR ) );        filePutString ( buffer, elcount( buffer ), hFile );
    snprintf( buffer, elcount( buffer ), "0.0000 HMI_Rsrv1_Door_FL_Stat := %X\n", getValue( HMI_Rsrv1_Door_FL_Stat ) );        filePutString ( buffer, elcount( buffer ), hFile );
    snprintf( buffer, elcount( buffer ), "0.0000 HMI_SeatAdj_P_RHD_Actv := %X\n", getValue( HMI_SeatAdj_P_RHD_Actv ) );        filePutString ( buffer, elcount( buffer ), hFile );
    snprintf( buffer, elcount( buffer ), "0.0000 HMI_SQC_Door_FL_Stat := %X\n", getValue( HMI_SQC_Door_FL_Stat ) );        filePutString ( buffer, elcount( buffer ), hFile );
    snprintf( buffer, elcount( buffer ), "0.0000 HMI_SQC_Door_FL_Stat_Auto := %X\n", getValue( HMI_SQC_Door_FL_Stat_Auto ) );        filePutString ( buffer, elcount( buffer ), hFile );
    snprintf( buffer, elcount( buffer ), "0.0000 HMI_Tweeter_FR_Posn_Stat := %X\n", getValue( HMI_Tweeter_FR_Posn_Stat ) );        filePutString ( buffer, elcount( buffer ), hFile );
}
/*@@end*/

/*@@timer:_tDoor_FR_Stat_AR:*/
on timer _tDoor_FR_Stat_AR
{
    putValue( HMI__STMSG_Door_FR_Stat_AR, 0 );
}
/*@@end*/

/*@@envVar:HMI__STMSG_Door_FR_Stat_AR:*/
on EnvVar HMI__STMSG_Door_FR_Stat_AR
{
    long tDelay;
    if( getValue( this ) == 2 )
    {
        tDelay = getValue( HMI__STMSGT_Door_FR_Stat_AR );
        if( tDelay > 0)    
            setTimer( _tDoor_FR_Stat_AR, tDelay );
        else
            putValue( HMI__STMSG_Door_FR_Stat_AR, 0 );
    }
}
/*@@end*/

/*@@envVar:HMI_AddTurnLmp_Rt_Flt:*/
on EnvVar HMI_AddTurnLmp_Rt_Flt
{
    _mDoor_FR_Stat_AR.AddTurnLmp_Rt_Flt.phys = getValue(this);
    _Door_FR_Stat_AR_SpontanFlag = 1;
}
/*@@end*/

/*@@envVar:HMI_AutoDrLk_Rq_DM_FR:*/
on EnvVar HMI_AutoDrLk_Rq_DM_FR
{
    _mDoor_FR_Stat_AR.AutoDrLk_Rq_DM_FR.phys = getValue(this);
    _Door_FR_Stat_AR_SpontanFlag = 1;
}
/*@@end*/

/*@@envVar:HMI_BSM_WarnUnit_Rt_Stat:*/
on EnvVar HMI_BSM_WarnUnit_Rt_Stat
{
    _mDoor_FR_Stat_AR.BSM_WarnUnit_Rt_Stat.phys = getValue(this);
    _Door_FR_Stat_AR_SpontanFlag = 1;
}
/*@@end*/

/*@@envVar:HMI_CLkS_Sw_FR_Psd:*/
on EnvVar HMI_CLkS_Sw_FR_Psd
{
    _mDoor_FR_Stat_AR.CLkS_Sw_FR_Psd.phys = getValue(this);
    _Door_FR_Stat_AR_SpontanFlag = 1;
}
/*@@end*/

/*@@envVar:HMI_DL_RemActn_RHD_Stat:*/
on EnvVar HMI_DL_RemActn_RHD_Stat
{
    _mDoor_FR_Stat_AR.DL_RemActn_RHD_Stat.phys = getValue(this);
    _Door_FR_Stat_AR_SpontanFlag = 1;
}
/*@@end*/

/*@@envVar:HMI_Door_FR_Stat_UB:*/
on EnvVar HMI_Door_FR_Stat_UB
{
    _mDoor_FR_Stat_AR.Door_FR_Stat_UB.phys = getValue(this);
    _Door_FR_Stat_AR_SpontanFlag = 1;
}
/*@@end*/

/*@@envVar:HMI_DrPreLtch_FR_Engg:*/
on EnvVar HMI_DrPreLtch_FR_Engg
{
    _mDoor_FR_Stat_AR.DrPreLtch_FR_Engg.phys = getValue(this);
    _Door_FR_Stat_AR_SpontanFlag = 1;
}
/*@@end*/

/*@@envVar:HMI_DrRLtch_FR_Stat:*/
on EnvVar HMI_DrRLtch_FR_Stat
{
    if( ( getValue( Env_Stress__StresstestMainActiv ) == 0 )   &&
        ( getValue( HMI__NM_EIS_AutomaticNM_Switching ) == 0 )    )
    {
        _SetCommRequest( cFRDoorNMRequest );
        setTimer( t_DoorNMCancelTimer, c_NMCancelTimer_05sec ); // 5 seconds for auto-shut-off
    }
    _mDoor_FR_Stat_AR.DrRLtch_FR_Stat.phys = getValue(this);
    _Door_FR_Stat_AR_SpontanFlag = 1;
}
/*@@end*/

/*@@envVar:HMI_ElecTrlrHtrch_Sw_Psd_FR:*/
on EnvVar HMI_ElecTrlrHtrch_Sw_Psd_FR
{
    _mDoor_FR_Stat_AR.ElecTrlrHtrch_Sw_Psd_FR.phys = getValue(this);
    _Door_FR_Stat_AR_SpontanFlag = 1;
}
/*@@end*/

/*@@envVar:HMI_Mirr_FR_Bl:*/
on EnvVar HMI_Mirr_FR_Bl
{
    _mDoor_FR_Stat_AR.Mirr_FR_Bl.phys = getValue(this);
    _Door_FR_Stat_AR_SpontanFlag = 1;
}
/*@@end*/

/*@@envVar:HMI_MirrAdjSw_Stat_RHD_V2:*/
on EnvVar HMI_MirrAdjSw_Stat_RHD_V2
{
    _mDoor_FR_Stat_AR.MirrAdjSw_Stat_RHD_V2.phys = getValue(this);
    _Door_FR_Stat_AR_SpontanFlag = 1;
}
/*@@end*/

/*@@envVar:HMI_MirrFld_Stat_RHD:*/
on EnvVar HMI_MirrFld_Stat_RHD
{
    _mDoor_FR_Stat_AR.MirrFld_Stat_RHD.phys = getValue(this);
    _Door_FR_Stat_AR_SpontanFlag = 1;
}
/*@@end*/

/*@@envVar:HMI_MirrFldPk_RHD_Stat:*/
on EnvVar HMI_MirrFldPk_RHD_Stat
{
    _mDoor_FR_Stat_AR.MirrFldPk_RHD_Stat.phys = getValue(this);
    _Door_FR_Stat_AR_SpontanFlag = 1;
}
/*@@end*/

/*@@envVar:HMI_PwrCls_FR_Actv:*/
on EnvVar HMI_PwrCls_FR_Actv
{
    _mDoor_FR_Stat_AR.PwrCls_FR_Actv.phys = getValue(this);
    _Door_FR_Stat_AR_SpontanFlag = 1;
}
/*@@end*/

/*@@envVar:HMI_RemTank_Unlk_Sw_FR:*/
on EnvVar HMI_RemTank_Unlk_Sw_FR
{
    _mDoor_FR_Stat_AR.RemTank_Unlk_Sw_FR.phys = getValue(this);
    _Door_FR_Stat_AR_SpontanFlag = 1;
}
/*@@end*/

/*@@envVar:HMI_Rsrv1_Door_FR_Stat:*/
on EnvVar HMI_Rsrv1_Door_FR_Stat
{
    _mDoor_FR_Stat_AR.Rsrv1_Door_FR_Stat.phys = getValue(this);
    _Door_FR_Stat_AR_SpontanFlag = 1;
}
/*@@end*/

/*@@envVar:HMI_SeatAdj_P_RHD_Actv:*/
on EnvVar HMI_SeatAdj_P_RHD_Actv
{
    _mDoor_FR_Stat_AR.SeatAdj_P_RHD_Actv.phys = getValue(this);
    _Door_FR_Stat_AR_SpontanFlag = 1;
}
/*@@end*/

/*@@envVar:HMI_Tweeter_FR_Posn_Stat:*/
on EnvVar HMI_Tweeter_FR_Posn_Stat
{
    _mDoor_FR_Stat_AR.Tweeter_FR_Posn_Stat.phys = getValue(this);
    _Door_FR_Stat_AR_SpontanFlag = 1;
}
/*@@end*/

/*@@caplFunc:Door_RL_Stat_AR_check_output():*/
Door_RL_Stat_AR_check_output()
{
    if( !getValue( HMI__STMSG_Door_RL_Stat_AR ) )
    {
        // Botschaft Door_RL_Stat_AR_AR ID: 931 --- Sendeart 5 cyclicAndSpontanWithDelay --- 
        if( _Door_RL_Stat_AR_DelayCnt > 0) _Door_RL_Stat_AR_DelayCnt--; // Mindestsendeabstand
        _Door_RL_Stat_AR_Cnt--;
        if( _Door_RL_Stat_AR_Cnt < 1 )
        {
            if( _Door_RL_Stat_AR_DelayCnt < 1 )
            {
                // Nachricht wg. abgelaufenem Zyklus ausgeben (Mindestsendeabstand eingehalten)
                Door_RL_Stat_AR_output();
                 _Door_RL_Stat_AR_SpontanFlag = 0; // Spontan-Flag zurücksetzen
                _Door_RL_Stat_AR_DelayCnt = _Door_RL_Stat_AR_MinDelay;
            }
            else
            {
                // Spontanflag setzen damit nach Ablauf Mindestsendeabstand gesendet wird
                 _Door_RL_Stat_AR_SpontanFlag = 1;
            }
            _Door_RL_Stat_AR_Cnt = _Door_RL_Stat_AR_CycleCount; // Zyklus-Zähler zurücksetzen
        }
        else if( _Door_RL_Stat_AR_SpontanFlag)
        {
            if( _Door_RL_Stat_AR_DelayCnt < 1 )
            {
                // Nachricht wg. spontaner Änderung ausgeben (Mindestsendeabstand eingehalten)
                Door_RL_Stat_AR_output();
                _Door_RL_Stat_AR_SpontanFlag = 0; // Spontan-Flag zurücksetzen
                _Door_RL_Stat_AR_DelayCnt = _Door_RL_Stat_AR_MinDelay;
            }
        }
    }
}
/*@@end*/

/*@@caplFunc:Door_RL_Stat_AR_init():*/
Door_RL_Stat_AR_init()
{   /* Botschaft Door_RL_Stat_AR ID: 931 --- Sendeart 5 cyclicAndSpontanWithDelay --- 
BA_ "ApplMessage" BO_ 931 0;
BA_ "NmAsrMessage" BO_ 931 0;
BA_ "GenMsgMinAcceptLength" BO_ 931 8;
BA_ "GenMsgILSupport" BO_ 931 1;
BA_ "DiagState" BO_ 931 0;
BA_ "DiagRequest" BO_ 931 0;
BA_ "DiagResponse" BO_ 931 0;
BA_ "GenMsgStartValue" BO_ 931 "0";
BA_ "GenMsgDelayTime" BO_ 931 5;
BA_ "GenMsgNrOfRepetitions" BO_ 931 0;
BA_ "GenMsgCycleTime" BO_ 931 500;
BA_ "GenMsgSendType" BO_ 931 5;
    */
    _Door_RL_Stat_AR_Timebase =               c_tDBKomTimer_20ms;
    _Door_RL_Stat_AR_CycleCount =           500 / _Door_RL_Stat_AR_Timebase;
    _Door_RL_Stat_AR_StartDelay =             0 / _Door_RL_Stat_AR_Timebase;
    _Door_RL_Stat_AR_MinDelay =               5 / _Door_RL_Stat_AR_Timebase;
    _Door_RL_Stat_AR_Cnt = _Door_RL_Stat_AR_StartDelay;
    _Door_RL_Stat_AR_SpontanFlag = 0;
    _Door_RL_Stat_AR_DelayCnt = 0;

    putValue( HMI__STMSGSD_Door_RL_Stat_AR, _Door_RL_Stat_AR_StartDelay * _Door_RL_Stat_AR_Timebase );

    _mDoor_RL_Stat_AR.CSL_SeatOprtn_RHD_Actv.phys = getValue( HMI_CSL_SeatOprtn_RHD_Actv );
    _mDoor_RL_Stat_AR.Door_RL_Stat_UB.phys = getValue( HMI_Door_RL_Stat_UB );
    _mDoor_RL_Stat_AR.DrPreLtch_RL_Engg.phys = getValue( HMI_DrPreLtch_RL_Engg );
    _mDoor_RL_Stat_AR.DrRLtch_RL_Stat.phys = getValue( HMI_DrRLtch_RL_Stat );
    _mDoor_RL_Stat_AR.FtSeatAdj_RL_Actv.phys = getValue( HMI_FtSeatAdj_RL_Actv );
    _mDoor_RL_Stat_AR.PwrCls_RL_Actv.phys = getValue( HMI_PwrCls_RL_Actv );
    _mDoor_RL_Stat_AR.Rsrv1_Door_RL_Stat.phys = getValue( HMI_Rsrv1_Door_RL_Stat );
    _mDoor_RL_Stat_AR.Tweeter_RL_Posn_Stat.phys = getValue( HMI_Tweeter_RL_Posn_Stat );
}
/*@@end*/

/*@@caplFunc:Door_RL_Stat_AR_output():*/
void Door_RL_Stat_AR_output(void)
{
    byte crc;
    byte SQC_help;

    if( !getValue( HMI_SQC_Door_RL_Stat_Auto ) )
    {
        // berechne message counter
        SQC_help = getValue( HMI_SQC_Door_RL_Stat );
        if( SQC_help >= 15 ) SQC_help = 0;
        else SQC_help++;
        putValue( HMI_SQC_Door_RL_Stat, SQC_help );
        _mDoor_RL_Stat_AR.SQC_Door_RL_Stat = SQC_help;
    }
    else
          _mDoor_RL_Stat_AR.SQC_Door_RL_Stat = getValue( HMI_SQC_Door_RL_Stat );

    if( getValue( HMI_CRC_Door_RL_Stat_Profile_02 ) )
    {
        if( !getValue( HMI_CRC_Door_RL_Stat_Auto ) )
        {   // CRC according Profile_02 ( W213 )
            // berechne crc
            crc = 0xFF;
//            crc = crctable_profile02[crc ^ _mDoor_RL_Stat_AR.byte( 0 )];  CRC
            crc = crctable_profile02[crc ^ _mDoor_RL_Stat_AR.byte( 1 )];
//            crc = crctable_profile02[crc ^ _mDoor_RL_Stat_AR.byte( 2 )];
//            crc = crctable_profile02[crc ^ _mDoor_RL_Stat_AR.byte( 3 )];
//            crc = crctable_profile02[crc ^ _mDoor_RL_Stat_AR.byte( 4 )];
//            crc = crctable_profile02[crc ^ _mDoor_RL_Stat_AR.byte( 5 )];
//            crc = crctable_profile02[crc ^ _mDoor_RL_Stat_AR.byte( 6 )];
//            crc = crctable_profile02[crc ^ _mDoor_RL_Stat_AR.byte( 7 )];
            crc = crctable_profile02[crc ^ _Door_RL_Stat_AR_CRC_Offset[ _mDoor_RL_Stat_AR.SQC_Door_RL_Stat ] ]; // load offset
            crc = (crc ^ 0xFF);
            if( getValue(  HMI_CRC_Door_RL_Stat_Invalid ) )
                crc++;
            _mDoor_RL_Stat_AR.CRC_Door_RL_Stat = crc;
            putValue( HMI_CRC_Door_RL_Stat, crc );
        }
        else
            _mDoor_RL_Stat_AR.CRC_Door_RL_Stat = getValue( HMI_CRC_Door_RL_Stat );
    }
    else
    {
        if( !getValue( HMI_CRC_Door_RL_Stat_Auto ) )
        {   // CRC according to SAE1850 ( W222 )
            // berechne crc
            crc = 0xFF;
//            crc = crctable[crc ^ _mDoor_RL_Stat_AR.byte( 0 )];  CRC
            crc = crctable[crc ^ _mDoor_RL_Stat_AR.byte( 1 )];
//            crc = crctable[crc ^ _mDoor_RL_Stat_AR.byte( 2 )];
//            crc = crctable[crc ^ _mDoor_RL_Stat_AR.byte( 3 )];
//            crc = crctable[crc ^ _mDoor_RL_Stat_AR.byte( 4 )];
//            crc = crctable[crc ^ _mDoor_RL_Stat_AR.byte( 5 )];
//            crc = crctable[crc ^ _mDoor_RL_Stat_AR.byte( 6 )];
//            crc = crctable[crc ^ _mDoor_RL_Stat_AR.byte( 7 )];
            crc = (crc ^ 0xFF);
            if( getValue(  HMI_CRC_Door_RL_Stat_Invalid ) )
                crc++;
            _mDoor_RL_Stat_AR.CRC_Door_RL_Stat = crc;
            putValue( HMI_CRC_Door_RL_Stat, crc );
        }
        else
            _mDoor_RL_Stat_AR.CRC_Door_RL_Stat = getValue( HMI_CRC_Door_RL_Stat );
    }
    output( _mDoor_RL_Stat_AR );
}
/*@@end*/

/*@@caplFunc:Door_RL_Stat_AR_saveEnvVars(dword):*/
Door_RL_Stat_AR_saveEnvVars( dword hFile )
{
    filePutString("\n// Knoten EIS: Door_RL_Stat_AR\n", 29, hFile );
    snprintf( buffer, elcount( buffer ), "0.0000 HMI__STMSG_Door_RL_Stat_AR := %X\n", getValue( HMI__STMSG_Door_RL_Stat_AR ) );        filePutString ( buffer, elcount( buffer ), hFile );
    snprintf( buffer, elcount( buffer ), "0.0000 HMI__STMSGT_Door_RL_Stat_AR := %X\n", getValue( HMI__STMSGT_Door_RL_Stat_AR ) );        filePutString ( buffer, elcount( buffer ), hFile );
    snprintf( buffer, elcount( buffer ), "0.0000 HMI_CSL_SeatOprtn_RHD_Actv := %X\n", getValue( HMI_CSL_SeatOprtn_RHD_Actv ) );        filePutString ( buffer, elcount( buffer ), hFile );
    snprintf( buffer, elcount( buffer ), "0.0000 HMI_CRC_Door_RL_Stat := %X\n", getValue( HMI_CRC_Door_RL_Stat ) );        filePutString ( buffer, elcount( buffer ), hFile );
    snprintf( buffer, elcount( buffer ), "0.0000 HMI_CRC_Door_RL_Stat_Auto := %X\n", getValue( HMI_CRC_Door_RL_Stat_Auto ) );        filePutString ( buffer, elcount( buffer ), hFile );
    snprintf( buffer, elcount( buffer ), "0.0000 HMI_Door_RL_Stat_UB := %X\n", getValue( HMI_Door_RL_Stat_UB ) );        filePutString ( buffer, elcount( buffer ), hFile );
    snprintf( buffer, elcount( buffer ), "0.0000 HMI_DrPreLtch_RL_Engg := %X\n", getValue( HMI_DrPreLtch_RL_Engg ) );        filePutString ( buffer, elcount( buffer ), hFile );
    snprintf( buffer, elcount( buffer ), "0.0000 HMI_DrRLtch_RL_Stat := %X\n", getValue( HMI_DrRLtch_RL_Stat ) );        filePutString ( buffer, elcount( buffer ), hFile );
    snprintf( buffer, elcount( buffer ), "0.0000 HMI_FtSeatAdj_RL_Actv := %X\n", getValue( HMI_FtSeatAdj_RL_Actv ) );        filePutString ( buffer, elcount( buffer ), hFile );
    snprintf( buffer, elcount( buffer ), "0.0000 HMI_PwrCls_RL_Actv := %X\n", getValue( HMI_PwrCls_RL_Actv ) );        filePutString ( buffer, elcount( buffer ), hFile );
    snprintf( buffer, elcount( buffer ), "0.0000 HMI_Rsrv1_Door_RL_Stat := %X\n", getValue( HMI_Rsrv1_Door_RL_Stat ) );        filePutString ( buffer, elcount( buffer ), hFile );
    snprintf( buffer, elcount( buffer ), "0.0000 HMI_SQC_Door_RL_Stat := %X\n", getValue( HMI_SQC_Door_RL_Stat ) );        filePutString ( buffer, elcount( buffer ), hFile );
    snprintf( buffer, elcount( buffer ), "0.0000 HMI_SQC_Door_RL_Stat_Auto := %X\n", getValue( HMI_SQC_Door_RL_Stat_Auto ) );        filePutString ( buffer, elcount( buffer ), hFile );
    snprintf( buffer, elcount( buffer ), "0.0000 HMI_Tweeter_RL_Posn_Stat := %X\n", getValue( HMI_Tweeter_RL_Posn_Stat ) );        filePutString ( buffer, elcount( buffer ), hFile );
}
/*@@end*/

/*@@timer:_tDoor_RL_Stat_AR:*/
on timer _tDoor_RL_Stat_AR
{
    putValue( HMI__STMSG_Door_RL_Stat_AR, 0 );
}
/*@@end*/

/*@@envVar:HMI__STMSG_Door_RL_Stat_AR:*/
on EnvVar HMI__STMSG_Door_RL_Stat_AR
{
    long tDelay;
    if( getValue( this ) == 2 )
    {
        tDelay = getValue( HMI__STMSGT_Door_RL_Stat_AR );
        if( tDelay > 0)    
            setTimer( _tDoor_RL_Stat_AR, tDelay );
        else
            putValue( HMI__STMSG_Door_RL_Stat_AR, 0 );
    }
}
/*@@end*/

/*@@envVar:HMI_CSL_SeatOprtn_RHD_Actv:*/
on EnvVar HMI_CSL_SeatOprtn_RHD_Actv
{
    _mDoor_RL_Stat_AR.CSL_SeatOprtn_RHD_Actv.phys = getValue(this);
    _Door_RL_Stat_AR_SpontanFlag = 1;
}
/*@@end*/

/*@@envVar:HMI_Door_RL_Stat_UB:*/
on EnvVar HMI_Door_RL_Stat_UB
{
    _mDoor_RL_Stat_AR.Door_RL_Stat_UB.phys = getValue(this);
    _Door_RL_Stat_AR_SpontanFlag = 1;
}
/*@@end*/

/*@@envVar:HMI_DrPreLtch_RL_Engg:*/
on EnvVar HMI_DrPreLtch_RL_Engg
{
    _mDoor_RL_Stat_AR.DrPreLtch_RL_Engg.phys = getValue(this);
    _Door_RL_Stat_AR_SpontanFlag = 1;
}
/*@@end*/

/*@@envVar:HMI_DrRLtch_RL_Stat:*/
on EnvVar HMI_DrRLtch_RL_Stat
{
    if( ( getValue( Env_Stress__StresstestMainActiv ) == 0 )   &&
        ( getValue( HMI__NM_EIS_AutomaticNM_Switching ) == 0 )    )
    {
        _SetCommRequest( cRLDoorNMRequest );
        setTimer( t_DoorNMCancelTimer, c_NMCancelTimer_05sec ); // 5 seconds for auto-shut-off
    }
    _mDoor_RL_Stat_AR.DrRLtch_RL_Stat.phys = getValue(this);
    _Door_RL_Stat_AR_SpontanFlag = 1;
}
/*@@end*/

/*@@envVar:HMI_FtSeatAdj_RL_Actv:*/
on EnvVar HMI_FtSeatAdj_RL_Actv
{
    _mDoor_RL_Stat_AR.FtSeatAdj_RL_Actv.phys = getValue(this);
    _Door_RL_Stat_AR_SpontanFlag = 1;
}
/*@@end*/

/*@@envVar:HMI_PwrCls_RL_Actv:*/
on EnvVar HMI_PwrCls_RL_Actv
{
    _mDoor_RL_Stat_AR.PwrCls_RL_Actv.phys = getValue(this);
    _Door_RL_Stat_AR_SpontanFlag = 1;
}
/*@@end*/

/*@@envVar:HMI_Rsrv1_Door_RL_Stat:*/
on EnvVar HMI_Rsrv1_Door_RL_Stat
{
    _mDoor_RL_Stat_AR.Rsrv1_Door_RL_Stat.phys = getValue(this);
    _Door_RL_Stat_AR_SpontanFlag = 1;
}
/*@@end*/

/*@@envVar:HMI_Tweeter_RL_Posn_Stat:*/
on EnvVar HMI_Tweeter_RL_Posn_Stat
{
    _mDoor_RL_Stat_AR.Tweeter_RL_Posn_Stat.phys = getValue(this);
    _Door_RL_Stat_AR_SpontanFlag = 1;
}
/*@@end*/

/*@@caplFunc:Door_RR_Stat_AR_check_output():*/
Door_RR_Stat_AR_check_output()
{
    if( !getValue( HMI__STMSG_Door_RR_Stat_AR ) )
    {
        // Botschaft Door_RR_Stat ID: 933 --- Sendeart 5 cyclicAndSpontanWithDelay --- 
        if( _Door_RR_Stat_AR_DelayCnt > 0) _Door_RR_Stat_AR_DelayCnt--; // Mindestsendeabstand
        _Door_RR_Stat_AR_Cnt--;
        if( _Door_RR_Stat_AR_Cnt < 1 )
        {
            if( _Door_RR_Stat_AR_DelayCnt < 1 )
            {
                // Nachricht wg. abgelaufenem Zyklus ausgeben (Mindestsendeabstand eingehalten)
                Door_RR_Stat_AR_output();
                 _Door_RR_Stat_AR_SpontanFlag = 0; // Spontan-Flag zurücksetzen
                _Door_RR_Stat_AR_DelayCnt = _Door_RR_Stat_AR_MinDelay;
            }
            else
            {
                // Spontanflag setzen damit nach Ablauf Mindestsendeabstand gesendet wird
                 _Door_RR_Stat_AR_SpontanFlag = 1;
            }
            _Door_RR_Stat_AR_Cnt = _Door_RR_Stat_AR_CycleCount; // Zyklus-Zähler zurücksetzen
        }
        else if( _Door_RR_Stat_AR_SpontanFlag)
        {
            if( _Door_RR_Stat_AR_DelayCnt < 1 )
            {
                // Nachricht wg. spontaner Änderung ausgeben (Mindestsendeabstand eingehalten)
                Door_RR_Stat_AR_output();
                _Door_RR_Stat_AR_SpontanFlag = 0; // Spontan-Flag zurücksetzen
                _Door_RR_Stat_AR_DelayCnt = _Door_RR_Stat_AR_MinDelay;
            }
        }
    }
}
/*@@end*/

/*@@caplFunc:Door_RR_Stat_AR_init():*/
Door_RR_Stat_AR_init()
{   /* Botschaft Door_RR_Stat_AR ID: 933 --- Sendeart 5 cyclicAndSpontanWithDelay --- 
BA_ "ApplMessage" BO_ 933 0;
BA_ "NmAsrMessage" BO_ 933 0;
BA_ "GenMsgMinAcceptLength" BO_ 933 8;
BA_ "GenMsgILSupport" BO_ 933 1;
BA_ "DiagState" BO_ 933 0;
BA_ "DiagRequest" BO_ 933 0;
BA_ "DiagResponse" BO_ 933 0;
BA_ "GenMsgStartValue" BO_ 933 "0";
BA_ "GenMsgDelayTime" BO_ 933 5;
BA_ "GenMsgNrOfRepetitions" BO_ 933 0;
BA_ "GenMsgCycleTime" BO_ 933 500;
BA_ "GenMsgSendType" BO_ 933 5;
    */
    _Door_RR_Stat_AR_Timebase =          c_tDBKomTimer_20ms;
    _Door_RR_Stat_AR_CycleCount =      500 / _Door_RR_Stat_AR_Timebase;
    _Door_RR_Stat_AR_StartDelay =        0 / _Door_RR_Stat_AR_Timebase;
    _Door_RR_Stat_AR_MinDelay =          5 / _Door_RR_Stat_AR_Timebase;
    _Door_RR_Stat_AR_Cnt = _Door_RR_Stat_AR_StartDelay;
    _Door_RR_Stat_AR_SpontanFlag = 0;
    _Door_RR_Stat_AR_DelayCnt = 0;

    putValue( HMI__STMSGSD_Door_RR_Stat_AR, _Door_RR_Stat_AR_StartDelay * _Door_RR_Stat_AR_Timebase );

    _mDoor_RR_Stat_AR.CSL_SeatOprtn_LHD_Actv.phys = getValue( HMI_CSL_SeatOprtn_LHD_Actv );
    _mDoor_RR_Stat_AR.Door_RR_Stat_UB.phys = getValue( HMI_Door_RR_Stat_UB );
    _mDoor_RR_Stat_AR.DrPreLtch_RR_Engg.phys = getValue( HMI_DrPreLtch_RR_Engg );
    _mDoor_RR_Stat_AR.DrRLtch_RR_Stat.phys = getValue( HMI_DrRLtch_RR_Stat );
    _mDoor_RR_Stat_AR.FtSeatAdj_RR_Actv.phys = getValue( HMI_FtSeatAdj_RR_Actv );
    _mDoor_RR_Stat_AR.PwrCls_RR_Actv.phys = getValue( HMI_PwrCls_RR_Actv );
    _mDoor_RR_Stat_AR.Rsrv1_Door_RR_Stat.phys = getValue( HMI_Rsrv1_Door_RR_Stat );
    _mDoor_RR_Stat_AR.Tweeter_RR_Posn_Stat.phys = getValue( HMI_Tweeter_RR_Posn_Stat );
}
/*@@end*/

/*@@caplFunc:Door_RR_Stat_AR_output():*/
void Door_RR_Stat_AR_output(void)
{
    byte crc;
    byte SQC_help;

    if( !getValue( HMI_SQC_Door_RR_Stat_Auto ) )
    {
        // berechne message counter
        SQC_help = getValue( HMI_SQC_Door_RR_Stat );
        if( SQC_help >= 15 ) SQC_help = 0;
        else SQC_help++;
        putValue( HMI_SQC_Door_RR_Stat, SQC_help );
        _mDoor_RR_Stat_AR.SQC_Door_RR_Stat = SQC_help;
    }
    else
          _mDoor_RR_Stat_AR.SQC_Door_RR_Stat = getValue( HMI_SQC_Door_RR_Stat );

    if( getValue( HMI_CRC_Door_RR_Stat_Profile_02 ) )
    {
        if( !getValue( HMI_CRC_Door_RR_Stat_Auto ) )
        {   // CRC according Profile_02 ( W213 )
            // berechne crc
            crc = 0xFF;
//            crc = crctable_profile02[crc ^ _mDoor_RR_Stat_AR.byte( 0 )];  CRC
            crc = crctable_profile02[crc ^ _mDoor_RR_Stat_AR.byte( 1 )];
//            crc = crctable_profile02[crc ^ _mDoor_RR_Stat_AR.byte( 2 )];
//            crc = crctable_profile02[crc ^ _mDoor_RR_Stat_AR.byte( 3 )];
//            crc = crctable_profile02[crc ^ _mDoor_RR_Stat_AR.byte( 4 )];
//            crc = crctable_profile02[crc ^ _mDoor_RR_Stat_AR.byte( 5 )];
//            crc = crctable_profile02[crc ^ _mDoor_RR_Stat_AR.byte( 6 )];
//            crc = crctable_profile02[crc ^ _mDoor_RR_Stat_AR.byte( 7 )];
            crc = crctable_profile02[crc ^ _Door_RR_Stat_AR_CRC_Offset[ _mDoor_RR_Stat_AR.SQC_Door_RR_Stat ] ]; // load offset
            crc = (crc ^ 0xFF);
            if( getValue(  HMI_CRC_Door_RR_Stat_Invalid ) )
                crc++;
            _mDoor_RR_Stat_AR.CRC_Door_RR_Stat = crc;
            putValue( HMI_CRC_Door_RR_Stat, crc );
        }
        else
            _mDoor_RR_Stat_AR.CRC_Door_RR_Stat = getValue( HMI_CRC_Door_RR_Stat );
    }
    else
    {
        if( !getValue( HMI_CRC_Door_RR_Stat_Auto ) )
        {   // CRC according to SAE1850 ( W222 )
            // berechne crc
            crc = 0xFF;
//            crc = crctable[crc ^ _mDoor_RR_Stat_AR.byte( 0 )];  CRC
            crc = crctable[crc ^ _mDoor_RR_Stat_AR.byte( 1 )];
//            crc = crctable[crc ^ _mDoor_RR_Stat_AR.byte( 2 )];
//            crc = crctable[crc ^ _mDoor_RR_Stat_AR.byte( 3 )];
//            crc = crctable[crc ^ _mDoor_RR_Stat_AR.byte( 4 )];
//            crc = crctable[crc ^ _mDoor_RR_Stat_AR.byte( 5 )];
//            crc = crctable[crc ^ _mDoor_RR_Stat_AR.byte( 6 )];
//            crc = crctable[crc ^ _mDoor_RR_Stat_AR.byte( 7 )];
            crc = (crc ^ 0xFF);
            if( getValue(  HMI_CRC_Door_RR_Stat_Invalid ) )
                crc++;
            _mDoor_RR_Stat_AR.CRC_Door_RR_Stat = crc;
            putValue( HMI_CRC_Door_RR_Stat, crc );
        }
        else
            _mDoor_RR_Stat_AR.CRC_Door_RR_Stat = getValue( HMI_CRC_Door_RR_Stat );
    }
    output( _mDoor_RR_Stat_AR );
}
/*@@end*/

/*@@caplFunc:Door_RR_Stat_AR_saveEnvVars(dword):*/
Door_RR_Stat_AR_saveEnvVars( dword hFile )
{
    filePutString("\n// Knoten EIS: Door_RR_Stat_AR\n", 29, hFile );
    snprintf( buffer, elcount( buffer ), "0.0000 HMI__STMSG_Door_RR_Stat_AR := %X\n", getValue( HMI__STMSG_Door_RR_Stat_AR ) );        filePutString ( buffer, elcount( buffer ), hFile );
    snprintf( buffer, elcount( buffer ), "0.0000 HMI__STMSGT_Door_RR_Stat_AR := %X\n", getValue( HMI__STMSGT_Door_RR_Stat_AR ) );        filePutString ( buffer, elcount( buffer ), hFile );
    snprintf( buffer, elcount( buffer ), "0.0000 HMI_CSL_SeatOprtn_LHD_Actv := %X\n", getValue( HMI_CSL_SeatOprtn_LHD_Actv ) );        filePutString ( buffer, elcount( buffer ), hFile );
    snprintf( buffer, elcount( buffer ), "0.0000 HMI_CRC_Door_RR_Stat := %X\n", getValue( HMI_CRC_Door_RR_Stat ) );        filePutString ( buffer, elcount( buffer ), hFile );
    snprintf( buffer, elcount( buffer ), "0.0000 HMI_CRC_Door_RR_Stat_Auto := %X\n", getValue( HMI_CRC_Door_RR_Stat_Auto ) );        filePutString ( buffer, elcount( buffer ), hFile );
    snprintf( buffer, elcount( buffer ), "0.0000 HMI_Door_RR_Stat_UB := %X\n", getValue( HMI_Door_RR_Stat_UB ) );        filePutString ( buffer, elcount( buffer ), hFile );
    snprintf( buffer, elcount( buffer ), "0.0000 HMI_DrPreLtch_RR_Engg := %X\n", getValue( HMI_DrPreLtch_RR_Engg ) );        filePutString ( buffer, elcount( buffer ), hFile );
    snprintf( buffer, elcount( buffer ), "0.0000 HMI_DrRLtch_RR_Stat := %X\n", getValue( HMI_DrRLtch_RR_Stat ) );        filePutString ( buffer, elcount( buffer ), hFile );
    snprintf( buffer, elcount( buffer ), "0.0000 HMI_FtSeatAdj_RR_Actv := %X\n", getValue( HMI_FtSeatAdj_RR_Actv ) );        filePutString ( buffer, elcount( buffer ), hFile );
    snprintf( buffer, elcount( buffer ), "0.0000 HMI_PwrCls_RR_Actv := %X\n", getValue( HMI_PwrCls_RR_Actv ) );        filePutString ( buffer, elcount( buffer ), hFile );
    snprintf( buffer, elcount( buffer ), "0.0000 HMI_Rsrv1_Door_RR_Stat := %X\n", getValue( HMI_Rsrv1_Door_RR_Stat ) );        filePutString ( buffer, elcount( buffer ), hFile );
    snprintf( buffer, elcount( buffer ), "0.0000 HMI_SQC_Door_RR_Stat := %X\n", getValue( HMI_SQC_Door_RR_Stat ) );        filePutString ( buffer, elcount( buffer ), hFile );
    snprintf( buffer, elcount( buffer ), "0.0000 HMI_SQC_Door_RR_Stat_Auto := %X\n", getValue( HMI_SQC_Door_RR_Stat_Auto ) );        filePutString ( buffer, elcount( buffer ), hFile );
    snprintf( buffer, elcount( buffer ), "0.0000 HMI_Tweeter_RR_Posn_Stat := %X\n", getValue( HMI_Tweeter_RR_Posn_Stat ) );        filePutString ( buffer, elcount( buffer ), hFile );
}
/*@@end*/

/*@@timer:_tDoor_RR_Stat_AR:*/
on timer _tDoor_RR_Stat_AR
{
    putValue( HMI__STMSG_Door_RR_Stat_AR, 0 );
}
/*@@end*/

/*@@envVar:HMI__STMSG_Door_RR_Stat_AR:*/
on EnvVar HMI__STMSG_Door_RR_Stat_AR
{
    long tDelay;
    if( getValue( this ) == 2 )
    {
        tDelay = getValue( HMI__STMSGT_Door_RR_Stat_AR );
        if( tDelay > 0)    
            setTimer( _tDoor_RR_Stat_AR, tDelay );
        else
            putValue( HMI__STMSG_Door_RR_Stat_AR, 0 );
    }
}
/*@@end*/

/*@@envVar:HMI_CSL_SeatOprtn_LHD_Actv:*/
on EnvVar HMI_CSL_SeatOprtn_LHD_Actv
{
    _mDoor_RR_Stat_AR.CSL_SeatOprtn_LHD_Actv.phys = getValue(this);
    _Door_RR_Stat_AR_SpontanFlag = 1;
}
/*@@end*/

/*@@envVar:HMI_Door_RR_Stat_UB:*/
on EnvVar HMI_Door_RR_Stat_UB
{
    _mDoor_RR_Stat_AR.Door_RR_Stat_UB.phys = getValue(this);
    _Door_RR_Stat_AR_SpontanFlag = 1;
}
/*@@end*/

/*@@envVar:HMI_DrPreLtch_RR_Engg:*/
on EnvVar HMI_DrPreLtch_RR_Engg
{
    _mDoor_RR_Stat_AR.DrPreLtch_RR_Engg.phys = getValue(this);
    _Door_RR_Stat_AR_SpontanFlag = 1;
}
/*@@end*/

/*@@envVar:HMI_DrRLtch_RR_Stat:*/
on EnvVar HMI_DrRLtch_RR_Stat
{
    if( ( getValue( Env_Stress__StresstestMainActiv ) == 0 )   &&
        ( getValue( HMI__NM_EIS_AutomaticNM_Switching ) == 0 )    )
    {
        _SetCommRequest( cRRDoorNMRequest );
        setTimer( t_DoorNMCancelTimer, c_NMCancelTimer_05sec ); // 5 seconds for auto-shut-off
    }
    _mDoor_RR_Stat_AR.DrRLtch_RR_Stat.phys = getValue(this);
    _Door_RR_Stat_AR_SpontanFlag = 1;
}
/*@@end*/

/*@@envVar:HMI_FtSeatAdj_RR_Actv:*/
on EnvVar HMI_FtSeatAdj_RR_Actv
{
    _mDoor_RR_Stat_AR.FtSeatAdj_RR_Actv.phys = getValue(this);
    _Door_RR_Stat_AR_SpontanFlag = 1;
}
/*@@end*/

/*@@envVar:HMI_PwrCls_RR_Actv:*/
on EnvVar HMI_PwrCls_RR_Actv
{
    _mDoor_RR_Stat_AR.PwrCls_RR_Actv.phys = getValue(this);
    _Door_RR_Stat_AR_SpontanFlag = 1;
}
/*@@end*/

/*@@envVar:HMI_Rsrv1_Door_RR_Stat:*/
on EnvVar HMI_Rsrv1_Door_RR_Stat
{
    _mDoor_RR_Stat_AR.Rsrv1_Door_RR_Stat.phys = getValue(this);
    _Door_RR_Stat_AR_SpontanFlag = 1;
}
/*@@end*/

/*@@envVar:HMI_Tweeter_RR_Posn_Stat:*/
on EnvVar HMI_Tweeter_RR_Posn_Stat
{
    _mDoor_RR_Stat_AR.Tweeter_RR_Posn_Stat.phys = getValue(this);
    _Door_RR_Stat_AR_SpontanFlag = 1;
}
/*@@end*/

/*@@caplFunc:DPC_Disp_Rq_AR_check_output():*/
DPC_Disp_Rq_AR_check_output()
{
    if( !getValue( HMI__STMSG_DPC_Disp_Rq_AR ) )
    {
        // Botschaft DPC_Disp_Rq_AR ID: 629 --- Sendeart 5 cyclicAndSpontanWithDelay --- 
        if( _DPC_Disp_Rq_AR_DelayCnt > 0) _DPC_Disp_Rq_AR_DelayCnt--; // Mindestsendeabstand
        _DPC_Disp_Rq_AR_Cnt--;
        if( _DPC_Disp_Rq_AR_Cnt < 1 )
        {
            if( _DPC_Disp_Rq_AR_DelayCnt < 1 )
            {
                // Nachricht wg. abgelaufenem Zyklus ausgeben (Mindestsendeabstand eingehalten)
                DPC_Disp_Rq_AR_output();
                 _DPC_Disp_Rq_AR_SpontanFlag = 0; // Spontan-Flag zurücksetzen
                _DPC_Disp_Rq_AR_DelayCnt = _DPC_Disp_Rq_AR_MinDelay;
            }
            else
            {
                // Spontanflag setzen damit nach Ablauf Mindestsendeabstand gesendet wird
                 _DPC_Disp_Rq_AR_SpontanFlag = 1;
            }
            _DPC_Disp_Rq_AR_Cnt = _DPC_Disp_Rq_AR_CycleCount; // Zyklus-Zähler zurücksetzen
        }
        else if( _DPC_Disp_Rq_AR_SpontanFlag)
        {
            if( _DPC_Disp_Rq_AR_DelayCnt < 1 )
            {
                // Nachricht wg. spontaner Änderung ausgeben (Mindestsendeabstand eingehalten)
                DPC_Disp_Rq_AR_output();
                _DPC_Disp_Rq_AR_SpontanFlag = 0; // Spontan-Flag zurücksetzen
                _DPC_Disp_Rq_AR_DelayCnt = _DPC_Disp_Rq_AR_MinDelay;
            }
        }
    }
}
/*@@end*/

/*@@caplFunc:DPC_Disp_Rq_AR_init():*/
DPC_Disp_Rq_AR_init()
{   /* Botschaft DPC_Disp_Rq_AR ID: 629 --- Sendeart 5 cyclicAndSpontanWithDelay --- 
BA_ "ApplMessage" BO_ 629 0;
BA_ "NmAsrMessage" BO_ 629 0;
BA_ "GenMsgMinAcceptLength" BO_ 629 8;
BA_ "GenMsgILSupport" BO_ 629 1;
BA_ "DiagState" BO_ 629 0;
BA_ "DiagRequest" BO_ 629 0;
BA_ "DiagResponse" BO_ 629 0;
BA_ "GenMsgStartValue" BO_ 629 "0";
BA_ "GenMsgStartDelayTime" BO_ 629 0;
BA_ "GenMsgDelayTime" BO_ 629 20;
BA_ "GenMsgNrOfRepetitions" BO_ 629 0;
BA_ "GenMsgCycleTime" BO_ 629 100;
BA_ "GenMsgSendType" BO_ 629 5;
    */
    _DPC_Disp_Rq_AR_Timebase =            c_tDBKomTimer_20ms;
    _DPC_Disp_Rq_AR_CycleCount =        100 / _DPC_Disp_Rq_AR_Timebase;
    _DPC_Disp_Rq_AR_StartDelay =          0 / _DPC_Disp_Rq_AR_Timebase;
    _DPC_Disp_Rq_AR_MinDelay =           20 / _DPC_Disp_Rq_AR_Timebase;
    _DPC_Disp_Rq_AR_Cnt = _DPC_Disp_Rq_AR_StartDelay;
    _DPC_Disp_Rq_AR_SpontanFlag = 0;
    _DPC_Disp_Rq_AR_DelayCnt = 0;

    putValue( HMI__STMSGSD_DPC_Disp_Rq_AR, _DPC_Disp_Rq_AR_StartDelay * _DPC_Disp_Rq_AR_Timebase );

    _mDPC_Disp_Rq_AR.DPC_Md_Disp_Rq.phys = getValue( HMI_DPC_Md_Disp_Rq );
    _mDPC_Disp_Rq_AR.DPC_Offroad_Abort_Disp_Rq.phys = getValue( HMI_DPC_Offroad_Abort_Disp_Rq );
    _mDPC_Disp_Rq_AR.DPC_OnroadMd_Disp_Rq.phys = getValue( HMI_DPC_OnroadMd_Disp_Rq );
    _mDPC_Disp_Rq_AR.DPC_OnroadMd_Disp_TrgRq.phys = getValue( HMI_DPC_OnroadMd_Disp_TrgRq );
    _mDPC_Disp_Rq_AR.DPC_OnroadMd_Style.phys = getValue( HMI_DPC_OnroadMd_Style );
    _mDPC_Disp_Rq_AR.Rsrv1_DPC_Disp_Rq.phys = getValue( HMI_Rsrv1_DPC_Disp_Rq );
    _mDPC_Disp_Rq_AR.Rsrv2_DPC_Disp_Rq.phys = getValue( HMI_Rsrv2_DPC_Disp_Rq );
}
/*@@end*/

/*@@caplFunc:DPC_Disp_Rq_AR_output():*/
void DPC_Disp_Rq_AR_output(void)
{
    byte crc;
    byte SQC_help;

    if( !getValue( HMI_SQC_DPC_Disp_Rq_Auto ) )
    {
        // berechne message counter
        SQC_help = getValue( HMI_SQC_DPC_Disp_Rq );
        if( SQC_help >= 15 ) SQC_help = 0;
        else SQC_help++;
        putValue( HMI_SQC_DPC_Disp_Rq, SQC_help );
        _mDPC_Disp_Rq_AR.SQC_DPC_Disp_Rq = SQC_help;
    }
    else
          _mDPC_Disp_Rq_AR.SQC_DPC_Disp_Rq = getValue( HMI_SQC_DPC_Disp_Rq );

    if( getValue( HMI_CRC_DPC_Disp_Rq_Profile_02 ) )
    {
        if( !getValue( HMI_CRC_DPC_Disp_Rq_Auto ) )
        {   // CRC according Profile_02 ( W213 )
            // berechne crc
            crc = 0xFF;
//            crc = crctable_profile02[crc ^ _mDPC_Disp_Rq_AR.byte( 0 )];  CRC
            crc = crctable_profile02[crc ^ _mDPC_Disp_Rq_AR.byte( 1 )];
            crc = crctable_profile02[crc ^ _mDPC_Disp_Rq_AR.byte( 2 )];
            crc = crctable_profile02[crc ^ _mDPC_Disp_Rq_AR.byte( 3 )];
            crc = crctable_profile02[crc ^ _mDPC_Disp_Rq_AR.byte( 4 )];
            crc = crctable_profile02[crc ^ _mDPC_Disp_Rq_AR.byte( 5 )];
//            crc = crctable_profile02[crc ^ _mDPC_Disp_Rq_AR.byte( 6 )];
//            crc = crctable_profile02[crc ^ _mDPC_Disp_Rq_AR.byte( 7 )];
            crc = crctable_profile02[crc ^ _DPC_Disp_Rq_AR_CRC_Offset[ _mDPC_Disp_Rq_AR.SQC_DPC_Disp_Rq ] ]; // load offset
            crc = (crc ^ 0xFF);
            if( getValue(  HMI_CRC_DPC_Disp_Rq_Invalid ) )
                crc++;
            _mDPC_Disp_Rq_AR.CRC_DPC_Disp_Rq = crc;
            putValue( HMI_CRC_DPC_Disp_Rq, crc );
        }
        else
            _mDPC_Disp_Rq_AR.CRC_DPC_Disp_Rq = getValue( HMI_CRC_DPC_Disp_Rq );
    }
    else
    {
        if( !getValue( HMI_CRC_DPC_Disp_Rq_Auto ) )
        {   // CRC according to SAE1850 ( W222 )
            // berechne crc
            crc = 0xFF;
//            crc = crctable[crc ^ _mDPC_Disp_Rq_AR.byte( 0 )];  CRC
            crc = crctable[crc ^ _mDPC_Disp_Rq_AR.byte( 1 )];
            crc = crctable[crc ^ _mDPC_Disp_Rq_AR.byte( 2 )];
            crc = crctable[crc ^ _mDPC_Disp_Rq_AR.byte( 3 )];
            crc = crctable[crc ^ _mDPC_Disp_Rq_AR.byte( 4 )];
            crc = crctable[crc ^ _mDPC_Disp_Rq_AR.byte( 5 )];
//            crc = crctable[crc ^ _mDPC_Disp_Rq_AR.byte( 6 )];
//            crc = crctable[crc ^ _mDPC_Disp_Rq_AR.byte( 7 )];
            crc = (crc ^ 0xFF);
            if( getValue(  HMI_CRC_DPC_Disp_Rq_Invalid ) )
                crc++;
            _mDPC_Disp_Rq_AR.CRC_DPC_Disp_Rq = crc;
            putValue( HMI_CRC_DPC_Disp_Rq, crc );
        }
        else
            _mDPC_Disp_Rq_AR.CRC_DPC_Disp_Rq = getValue( HMI_CRC_DPC_Disp_Rq );
    }
    output( _mDPC_Disp_Rq_AR );
}
/*@@end*/

/*@@caplFunc:DPC_Disp_Rq_AR_saveEnvVars(dword):*/
DPC_Disp_Rq_AR_saveEnvVars( dword hFile )
{
    filePutString("\n// Knoten EIS: DPC_Disp_Rq_AR\n", 29, hFile );
    snprintf( buffer, elcount( buffer ), "0.0000 HMI__STMSG_DPC_Disp_Rq_AR := %X\n", getValue( HMI__STMSG_DPC_Disp_Rq_AR ) );        filePutString ( buffer, elcount( buffer ), hFile );
    snprintf( buffer, elcount( buffer ), "0.0000 HMI__STMSGT_DPC_Disp_Rq_AR := %X\n", getValue( HMI__STMSGT_DPC_Disp_Rq_AR ) );        filePutString ( buffer, elcount( buffer ), hFile );
    snprintf( buffer, elcount( buffer ), "0.0000 HMI_CRC_DPC_Disp_Rq := %X\n", getValue( HMI_CRC_DPC_Disp_Rq ) );        filePutString ( buffer, elcount( buffer ), hFile );
    snprintf( buffer, elcount( buffer ), "0.0000 HMI_CRC_DPC_Disp_Rq_Auto := %X\n", getValue( HMI_CRC_DPC_Disp_Rq_Auto ) );        filePutString ( buffer, elcount( buffer ), hFile );
    snprintf( buffer, elcount( buffer ), "0.0000 HMI_DPC_Md_Disp_Rq := %X\n", getValue( HMI_DPC_Md_Disp_Rq ) );        filePutString ( buffer, elcount( buffer ), hFile );
    snprintf( buffer, elcount( buffer ), "0.0000 HMI_DPC_Offroad_Abort_Disp_Rq := %X\n", getValue( HMI_DPC_Offroad_Abort_Disp_Rq ) );        filePutString ( buffer, elcount( buffer ), hFile );
    snprintf( buffer, elcount( buffer ), "0.0000 HMI_DPC_OnroadMd_Disp_Rq := %X\n", getValue( HMI_DPC_OnroadMd_Disp_Rq ) );        filePutString ( buffer, elcount( buffer ), hFile );
    snprintf( buffer, elcount( buffer ), "0.0000 HMI_DPC_OnroadMd_Disp_TrgRq := %X\n", getValue( HMI_DPC_OnroadMd_Disp_TrgRq ) );        filePutString ( buffer, elcount( buffer ), hFile );
    snprintf( buffer, elcount( buffer ), "0.0000 HMI_DPC_OnroadMd_Style := %X\n", getValue( HMI_DPC_OnroadMd_Style ) );        filePutString ( buffer, elcount( buffer ), hFile );
    snprintf( buffer, elcount( buffer ), "0.0000 HMI_Rsrv1_DPC_Disp_Rq := %X\n", getValue( HMI_Rsrv1_DPC_Disp_Rq ) );        filePutString ( buffer, elcount( buffer ), hFile );
    snprintf( buffer, elcount( buffer ), "0.0000 HMI_Rsrv2_DPC_Disp_Rq := %X\n", getValue( HMI_Rsrv2_DPC_Disp_Rq ) );        filePutString ( buffer, elcount( buffer ), hFile );
    snprintf( buffer, elcount( buffer ), "0.0000 HMI_SQC_DPC_Disp_Rq := %X\n", getValue( HMI_SQC_DPC_Disp_Rq ) );        filePutString ( buffer, elcount( buffer ), hFile );
    snprintf( buffer, elcount( buffer ), "0.0000 HMI_SQC_DPC_Disp_Rq_Auto := %X\n", getValue( HMI_SQC_DPC_Disp_Rq_Auto ) );        filePutString ( buffer, elcount( buffer ), hFile );
}
/*@@end*/

/*@@timer:_tDPC_Disp_Rq_AR:*/
on timer _tDPC_Disp_Rq_AR
{
    putValue( HMI__STMSG_DPC_Disp_Rq_AR, 0 );
}
/*@@end*/

/*@@envVar:HMI__STMSG_DPC_Disp_Rq_AR:*/
on EnvVar HMI__STMSG_DPC_Disp_Rq_AR
{
    long tDelay;
    if( getValue( this ) == 2 )
    {
        tDelay = getValue( HMI__STMSGT_DPC_Disp_Rq_AR );
        if( tDelay > 0)    
            setTimer( _tDPC_Disp_Rq_AR, tDelay );
        else
            putValue( HMI__STMSG_DPC_Disp_Rq_AR, 0 );
    }
}
/*@@end*/

/*@@envVar:HMI_DPC_Md_Disp_Rq:*/
on EnvVar HMI_DPC_Md_Disp_Rq
{
    _mDPC_Disp_Rq_AR.DPC_Md_Disp_Rq.phys = getValue(this);
    _DPC_Disp_Rq_AR_SpontanFlag = 1;
}
/*@@end*/

/*@@envVar:HMI_DPC_Offroad_Abort_Disp_Rq:*/
on EnvVar HMI_DPC_Offroad_Abort_Disp_Rq
{
    _mDPC_Disp_Rq_AR.DPC_Offroad_Abort_Disp_Rq.phys = getValue(this);
    _DPC_Disp_Rq_AR_SpontanFlag = 1;
}
/*@@end*/

/*@@envVar:HMI_DPC_OnroadMd_Disp_Rq:*/
on EnvVar HMI_DPC_OnroadMd_Disp_Rq
{
    _mDPC_Disp_Rq_AR.DPC_OnroadMd_Disp_Rq.phys = getValue(this);
    _DPC_Disp_Rq_AR_SpontanFlag = 1;
}
/*@@end*/

/*@@envVar:HMI_DPC_OnroadMd_Disp_TrgRq:*/
on EnvVar HMI_DPC_OnroadMd_Disp_TrgRq
{
    _mDPC_Disp_Rq_AR.DPC_OnroadMd_Disp_TrgRq.phys = getValue(this);
    _DPC_Disp_Rq_AR_SpontanFlag = 1;
}
/*@@end*/

/*@@envVar:HMI_DPC_OnroadMd_Style:*/
on EnvVar HMI_DPC_OnroadMd_Style
{
    _mDPC_Disp_Rq_AR.DPC_OnroadMd_Style.phys = getValue(this);
    _DPC_Disp_Rq_AR_SpontanFlag = 1;
}
/*@@end*/

/*@@envVar:HMI_Rsrv1_DPC_Disp_Rq:*/
on EnvVar HMI_Rsrv1_DPC_Disp_Rq
{
    _mDPC_Disp_Rq_AR.Rsrv1_DPC_Disp_Rq.phys = getValue(this);
    _DPC_Disp_Rq_AR_SpontanFlag = 1;
}
/*@@end*/

/*@@envVar:HMI_Rsrv2_DPC_Disp_Rq:*/
on EnvVar HMI_Rsrv2_DPC_Disp_Rq
{
    _mDPC_Disp_Rq_AR.Rsrv2_DPC_Disp_Rq.phys = getValue(this);
    _DPC_Disp_Rq_AR_SpontanFlag = 1;
}
/*@@end*/

/*@@caplFunc:DPC_IndMd_Stat_AR_check_output():*/
DPC_IndMd_Stat_AR_check_output()
{
    if( !getValue( HMI__STMSG_DPC_IndMd_Stat_AR ) )
    {
        // Botschaft DPC_IndMd_Stat_AR ID: 633 --- Sendeart 5 cyclicAndSpontanWithDelay --- 
        if( _DPC_IndMd_Stat_AR_DelayCnt > 0) _DPC_IndMd_Stat_AR_DelayCnt--; // Mindestsendeabstand
        _DPC_IndMd_Stat_AR_Cnt--;
        if( _DPC_IndMd_Stat_AR_Cnt < 1 )
        {
            if( _DPC_IndMd_Stat_AR_DelayCnt < 1 )
            {
                // Nachricht wg. abgelaufenem Zyklus ausgeben (Mindestsendeabstand eingehalten)
                DPC_IndMd_Stat_AR_output();
                 _DPC_IndMd_Stat_AR_SpontanFlag = 0; // Spontan-Flag zurücksetzen
                _DPC_IndMd_Stat_AR_DelayCnt = _DPC_IndMd_Stat_AR_MinDelay;
            }
            else
            {
                // Spontanflag setzen damit nach Ablauf Mindestsendeabstand gesendet wird
                 _DPC_IndMd_Stat_AR_SpontanFlag = 1;
            }
            _DPC_IndMd_Stat_AR_Cnt = _DPC_IndMd_Stat_AR_CycleCount; // Zyklus-Zähler zurücksetzen
        }
        else if( _DPC_IndMd_Stat_AR_SpontanFlag)
        {
            if( _DPC_IndMd_Stat_AR_DelayCnt < 1 )
            {
                // Nachricht wg. spontaner Änderung ausgeben (Mindestsendeabstand eingehalten)
                DPC_IndMd_Stat_AR_output();
                _DPC_IndMd_Stat_AR_SpontanFlag = 0; // Spontan-Flag zurücksetzen
                _DPC_IndMd_Stat_AR_DelayCnt = _DPC_IndMd_Stat_AR_MinDelay;
            }
        }
    }
}
/*@@end*/

/*@@caplFunc:DPC_IndMd_Stat_AR_init():*/
DPC_IndMd_Stat_AR_init()
{   /* Botschaft DPC_IndMd_Stat_AR ID: 633 --- Sendeart 5 cyclicAndSpontanWithDelay --- 
BA_ "ApplMessage" BO_ 633 0;
BA_ "NmAsrMessage" BO_ 633 0;
BA_ "GenMsgMinAcceptLength" BO_ 633 8;
BA_ "GenMsgILSupport" BO_ 633 1;
BA_ "DiagState" BO_ 633 0;
BA_ "DiagRequest" BO_ 633 0;
BA_ "DiagResponse" BO_ 633 0;
BA_ "GenMsgStartValue" BO_ 633 "0";
BA_ "GenMsgStartDelayTime" BO_ 633 0;
BA_ "GenMsgDelayTime" BO_ 633 20;
BA_ "GenMsgNrOfRepetitions" BO_ 633 0;
BA_ "GenMsgCycleTime" BO_ 633 100;
BA_ "GenMsgSendType" BO_ 633 5;
    */
    _DPC_IndMd_Stat_AR_Timebase =         c_tDBKomTimer_20ms;
    _DPC_IndMd_Stat_AR_CycleCount =     100 / _DPC_IndMd_Stat_AR_Timebase;
    _DPC_IndMd_Stat_AR_StartDelay =       0 / _DPC_IndMd_Stat_AR_Timebase;
    _DPC_IndMd_Stat_AR_MinDelay =        20 / _DPC_IndMd_Stat_AR_Timebase;
    _DPC_IndMd_Stat_AR_Cnt = _DPC_IndMd_Stat_AR_StartDelay;
    _DPC_IndMd_Stat_AR_SpontanFlag = 0;
    _DPC_IndMd_Stat_AR_DelayCnt = 0;

    putValue( HMI__STMSGSD_DPC_IndMd_Stat_AR, _DPC_IndMd_Stat_AR_StartDelay * _DPC_IndMd_Stat_AR_Timebase );

    _mDPC_IndMd_Stat_AR.DPC_IndMd_AC_Stat.phys = getValue( HMI_DPC_IndMd_AC_Stat );
    _mDPC_IndMd_Stat_AR.DPC_IndMd_AS_Stat.phys = getValue( HMI_DPC_IndMd_AS_Stat );
    _mDPC_IndMd_Stat_AR.DPC_IndMd_ECO_Assist_Stat.phys = getValue( HMI_DPC_IndMd_ECO_Assist_Stat );
    _mDPC_IndMd_Stat_AR.DPC_IndMd_eDrv_Stat.phys = getValue( HMI_DPC_IndMd_eDrv_Stat );
    _mDPC_IndMd_Stat_AR.DPC_IndMd_ESP_Stat.phys = getValue( HMI_DPC_IndMd_ESP_Stat );
    _mDPC_IndMd_Stat_AR.DPC_IndMd_ExhstFlap_Stat.phys = getValue( HMI_DPC_IndMd_ExhstFlap_Stat );
    _mDPC_IndMd_Stat_AR.DPC_IndMd_Ht_Stat.phys = getValue( HMI_DPC_IndMd_Ht_Stat );
    _mDPC_IndMd_Stat_AR.DPC_IndMd_PT_Stat.phys = getValue( HMI_DPC_IndMd_PT_Stat );
    _mDPC_IndMd_Stat_AR.DPC_IndMd_PwrFreeD_Plus_Stat.phys = getValue( HMI_DPC_IndMd_PwrFreeD_Plus_Stat );
    _mDPC_IndMd_Stat_AR.DPC_IndMd_SSA_Stat.phys = getValue( HMI_DPC_IndMd_SSA_Stat );
    _mDPC_IndMd_Stat_AR.DPC_IndMd_St_Stat.phys = getValue( HMI_DPC_IndMd_St_Stat );
    _mDPC_IndMd_Stat_AR.DPC_IndMd_Susp_Stat.phys = getValue( HMI_DPC_IndMd_Susp_Stat );
    _mDPC_IndMd_Stat_AR.DPC_IndMd_Tx_Stat.phys = getValue( HMI_DPC_IndMd_Tx_Stat );
    _mDPC_IndMd_Stat_AR.DPC_OffroadMd_Stat.phys = getValue( HMI_DPC_OffroadMd_Stat );
    _mDPC_IndMd_Stat_AR.Rsrv2_DPC_IndMd_Stat.phys = getValue( HMI_Rsrv2_DPC_IndMd_Stat );
    _mDPC_IndMd_Stat_AR.Rsrv3_DPC_IndMd_Stat.phys = getValue( HMI_Rsrv3_DPC_IndMd_Stat );
}
/*@@end*/

/*@@caplFunc:DPC_IndMd_Stat_AR_output():*/
void DPC_IndMd_Stat_AR_output(void)
{
    byte crc;
    byte SQC_help;

    if( !getValue( HMI_SQC_DPC_IndMd_Stat_Auto ) )
    {
        // berechne message counter
        SQC_help = getValue( HMI_SQC_DPC_IndMd_Stat );
        if( SQC_help >= 15 ) SQC_help = 0;
        else SQC_help++;
        putValue( HMI_SQC_DPC_IndMd_Stat, SQC_help );
        _mDPC_IndMd_Stat_AR.SQC_DPC_IndMd_Stat = SQC_help;
    }
    else
          _mDPC_IndMd_Stat_AR.SQC_DPC_IndMd_Stat = getValue( HMI_SQC_DPC_IndMd_Stat );

    if( getValue( HMI_CRC_DPC_IndMd_Stat_Profile_02 ) )
    {
        if( !getValue( HMI_CRC_DPC_IndMd_Stat_Auto ) )
        {   // CRC according Profile_02 ( W213 )
            // berechne crc
            crc = 0xFF;
//            crc = crctable_profile02[crc ^ _mDPC_IndMd_Stat_AR.byte( 0 )];  CRC
            crc = crctable_profile02[crc ^ _mDPC_IndMd_Stat_AR.byte( 1 )];
            crc = crctable_profile02[crc ^ _mDPC_IndMd_Stat_AR.byte( 2 )];
            crc = crctable_profile02[crc ^ _mDPC_IndMd_Stat_AR.byte( 3 )];
            crc = crctable_profile02[crc ^ _mDPC_IndMd_Stat_AR.byte( 4 )];
            crc = crctable_profile02[crc ^ _mDPC_IndMd_Stat_AR.byte( 5 )];
            crc = crctable_profile02[crc ^ _mDPC_IndMd_Stat_AR.byte( 6 )];
            crc = crctable_profile02[crc ^ _mDPC_IndMd_Stat_AR.byte( 7 )];
            crc = crctable_profile02[crc ^ _DPC_IndMd_Stat_AR_CRC_Offset[ _mDPC_IndMd_Stat_AR.SQC_DPC_IndMd_Stat ] ]; // load offset
            crc = (crc ^ 0xFF);
            if( getValue(  HMI_CRC_DPC_IndMd_Stat_Invalid ) )
                crc++;
            _mDPC_IndMd_Stat_AR.CRC_DPC_IndMd_Stat = crc;
            putValue( HMI_CRC_DPC_IndMd_Stat, crc );
        }
        else
            _mDPC_IndMd_Stat_AR.CRC_DPC_IndMd_Stat = getValue( HMI_CRC_DPC_IndMd_Stat );
    }
    else
    {
        if( !getValue( HMI_CRC_DPC_IndMd_Stat_Auto ) )
        {   // CRC according to SAE1850 ( W222 )
            // berechne crc
            crc = 0xFF;
//            crc = crctable[crc ^ _mDPC_IndMd_Stat_AR.byte( 0 )];  CRC
            crc = crctable[crc ^ _mDPC_IndMd_Stat_AR.byte( 1 )];
            crc = crctable[crc ^ _mDPC_IndMd_Stat_AR.byte( 2 )];
            crc = crctable[crc ^ _mDPC_IndMd_Stat_AR.byte( 3 )];
            crc = crctable[crc ^ _mDPC_IndMd_Stat_AR.byte( 4 )];
            crc = crctable[crc ^ _mDPC_IndMd_Stat_AR.byte( 5 )];
            crc = crctable[crc ^ _mDPC_IndMd_Stat_AR.byte( 6 )];
            crc = crctable[crc ^ _mDPC_IndMd_Stat_AR.byte( 7 )];
            crc = (crc ^ 0xFF);
            if( getValue(  HMI_CRC_DPC_IndMd_Stat_Invalid ) )
                crc++;
            _mDPC_IndMd_Stat_AR.CRC_DPC_IndMd_Stat = crc;
            putValue( HMI_CRC_DPC_IndMd_Stat, crc );
        }
        else
            _mDPC_IndMd_Stat_AR.CRC_DPC_IndMd_Stat = getValue( HMI_CRC_DPC_IndMd_Stat );
    }
    output( _mDPC_IndMd_Stat_AR );
}
/*@@end*/

/*@@caplFunc:DPC_IndMd_Stat_AR_saveEnvVars(dword):*/
DPC_IndMd_Stat_AR_saveEnvVars( dword hFile )
{
    filePutString("\n// Knoten EIS: DPC_IndMd_Stat_AR\n", 29, hFile );
    snprintf( buffer, elcount( buffer ), "0.0000 HMI__STMSG_DPC_IndMd_Stat_AR := %X\n", getValue( HMI__STMSG_DPC_IndMd_Stat_AR ) );        filePutString ( buffer, elcount( buffer ), hFile );
    snprintf( buffer, elcount( buffer ), "0.0000 HMI__STMSGT_DPC_IndMd_Stat_AR := %X\n", getValue( HMI__STMSGT_DPC_IndMd_Stat_AR ) );        filePutString ( buffer, elcount( buffer ), hFile );
    snprintf( buffer, elcount( buffer ), "0.0000 HMI_CRC_DPC_IndMd_Stat := %X\n", getValue( HMI_CRC_DPC_IndMd_Stat ) );        filePutString ( buffer, elcount( buffer ), hFile );
    snprintf( buffer, elcount( buffer ), "0.0000 HMI_CRC_DPC_IndMd_Stat_Auto := %X\n", getValue( HMI_CRC_DPC_IndMd_Stat_Auto ) );        filePutString ( buffer, elcount( buffer ), hFile );
    snprintf( buffer, elcount( buffer ), "0.0000 HMI_DPC_IndMd_ABC_Stat := %X\n", getValue( HMI_DPC_IndMd_ABC_Stat ) );        filePutString ( buffer, elcount( buffer ), hFile );
    snprintf( buffer, elcount( buffer ), "0.0000 HMI_DPC_IndMd_AC_Stat := %X\n", getValue( HMI_DPC_IndMd_AC_Stat ) );        filePutString ( buffer, elcount( buffer ), hFile );
    snprintf( buffer, elcount( buffer ), "0.0000 HMI_DPC_IndMd_AS_Stat := %X\n", getValue( HMI_DPC_IndMd_AS_Stat ) );        filePutString ( buffer, elcount( buffer ), hFile );
    snprintf( buffer, elcount( buffer ), "0.0000 HMI_DPC_IndMd_ECO_Assist_Stat := %X\n", getValue( HMI_DPC_IndMd_ECO_Assist_Stat ) );        filePutString ( buffer, elcount( buffer ), hFile );
    snprintf( buffer, elcount( buffer ), "0.0000 HMI_DPC_IndMd_eDrv_Stat := %X\n", getValue( HMI_DPC_IndMd_eDrv_Stat ) );        filePutString ( buffer, elcount( buffer ), hFile );
    snprintf( buffer, elcount( buffer ), "0.0000 HMI_DPC_IndMd_ESP_Stat := %X\n", getValue( HMI_DPC_IndMd_ESP_Stat ) );        filePutString ( buffer, elcount( buffer ), hFile );
    snprintf( buffer, elcount( buffer ), "0.0000 HMI_DPC_IndMd_ExhstFlap_Stat := %X\n", getValue( HMI_DPC_IndMd_ExhstFlap_Stat ) );        filePutString ( buffer, elcount( buffer ), hFile );
    snprintf( buffer, elcount( buffer ), "0.0000 HMI_DPC_IndMd_Ht_Stat := %X\n", getValue( HMI_DPC_IndMd_Ht_Stat ) );        filePutString ( buffer, elcount( buffer ), hFile );
    snprintf( buffer, elcount( buffer ), "0.0000 HMI_DPC_IndMd_PT_Stat := %X\n", getValue( HMI_DPC_IndMd_PT_Stat ) );        filePutString ( buffer, elcount( buffer ), hFile );
    snprintf( buffer, elcount( buffer ), "0.0000 HMI_DPC_IndMd_PwrFreeD_Plus_Stat := %X\n", getValue( HMI_DPC_IndMd_PwrFreeD_Plus_Stat ) );        filePutString ( buffer, elcount( buffer ), hFile );
    snprintf( buffer, elcount( buffer ), "0.0000 HMI_DPC_IndMd_SSA_Stat := %X\n", getValue( HMI_DPC_IndMd_SSA_Stat ) );        filePutString ( buffer, elcount( buffer ), hFile );
    snprintf( buffer, elcount( buffer ), "0.0000 HMI_DPC_IndMd_St_Stat := %X\n", getValue( HMI_DPC_IndMd_St_Stat ) );        filePutString ( buffer, elcount( buffer ), hFile );
    snprintf( buffer, elcount( buffer ), "0.0000 HMI_DPC_IndMd_Susp_Stat := %X\n", getValue( HMI_DPC_IndMd_Susp_Stat ) );        filePutString ( buffer, elcount( buffer ), hFile );
    snprintf( buffer, elcount( buffer ), "0.0000 HMI_DPC_IndMd_Tx_Stat := %X\n", getValue( HMI_DPC_IndMd_Tx_Stat ) );        filePutString ( buffer, elcount( buffer ), hFile );
    snprintf( buffer, elcount( buffer ), "0.0000 HMI_DPC_OffroadMd_Stat := %X\n", getValue( HMI_DPC_OffroadMd_Stat ) );        filePutString ( buffer, elcount( buffer ), hFile );
    snprintf( buffer, elcount( buffer ), "0.0000 HMI_Rsrv2_DPC_IndMd_Stat := %X\n", getValue( HMI_Rsrv2_DPC_IndMd_Stat ) );        filePutString ( buffer, elcount( buffer ), hFile );
    snprintf( buffer, elcount( buffer ), "0.0000 HMI_Rsrv3_DPC_IndMd_Stat := %X\n", getValue( HMI_Rsrv3_DPC_IndMd_Stat ) );        filePutString ( buffer, elcount( buffer ), hFile );
    snprintf( buffer, elcount( buffer ), "0.0000 HMI_SQC_DPC_IndMd_Stat := %X\n", getValue( HMI_SQC_DPC_IndMd_Stat ) );        filePutString ( buffer, elcount( buffer ), hFile );
    snprintf( buffer, elcount( buffer ), "0.0000 HMI_SQC_DPC_IndMd_Stat_Auto := %X\n", getValue( HMI_SQC_DPC_IndMd_Stat_Auto ) );        filePutString ( buffer, elcount( buffer ), hFile );
}
/*@@end*/

/*@@timer:_tDPC_IndMd_Stat_AR:*/
on timer _tDPC_IndMd_Stat_AR
{
    putValue( HMI__STMSG_DPC_IndMd_Stat_AR, 0 );
}
/*@@end*/

/*@@envVar:HMI__STMSG_DPC_IndMd_Stat_AR:*/
on EnvVar HMI__STMSG_DPC_IndMd_Stat_AR
{
    long tDelay;
    if( getValue( this ) == 2 )
    {
        tDelay = getValue( HMI__STMSGT_DPC_IndMd_Stat_AR );
        if( tDelay > 0)    
            setTimer( _tDPC_IndMd_Stat_AR, tDelay );
        else
            putValue( HMI__STMSG_DPC_IndMd_Stat_AR, 0 );
    }
}
/*@@end*/

/*@@envVar:HMI_DPC_IndMd_ABC_Stat:*/
on EnvVar HMI_DPC_IndMd_ABC_Stat
{
    _mDPC_IndMd_Stat_AR.DPC_IndMd_ABC_Stat.phys = getValue(this);
    _DPC_IndMd_Stat_AR_SpontanFlag = 1;
}
/*@@end*/

/*@@envVar:HMI_DPC_IndMd_AC_Stat:*/
on EnvVar HMI_DPC_IndMd_AC_Stat
{
    _mDPC_IndMd_Stat_AR.DPC_IndMd_AC_Stat.phys = getValue(this);
    _DPC_IndMd_Stat_AR_SpontanFlag = 1;
}
/*@@end*/

/*@@envVar:HMI_DPC_IndMd_AS_Stat:*/
on EnvVar HMI_DPC_IndMd_AS_Stat
{
    _mDPC_IndMd_Stat_AR.DPC_IndMd_AS_Stat.phys = getValue(this);
    _DPC_IndMd_Stat_AR_SpontanFlag = 1;
}
/*@@end*/

/*@@envVar:HMI_DPC_IndMd_ECO_Assist_Stat:*/
on EnvVar HMI_DPC_IndMd_ECO_Assist_Stat
{
    _mDPC_IndMd_Stat_AR.DPC_IndMd_ECO_Assist_Stat.phys = getValue(this);
    _DPC_IndMd_Stat_AR_SpontanFlag = 1;
}
/*@@end*/

/*@@envVar:HMI_DPC_IndMd_eDrv_Stat:*/
on EnvVar HMI_DPC_IndMd_eDrv_Stat
{
    _mDPC_IndMd_Stat_AR.DPC_IndMd_eDrv_Stat.phys = getValue(this);
    _DPC_IndMd_Stat_AR_SpontanFlag = 1;
}
/*@@end*/

/*@@envVar:HMI_DPC_IndMd_ESP_Stat:*/
on EnvVar HMI_DPC_IndMd_ESP_Stat
{
    _mDPC_IndMd_Stat_AR.DPC_IndMd_ESP_Stat.phys = getValue(this);
    _DPC_IndMd_Stat_AR_SpontanFlag = 1;
}
/*@@end*/

/*@@envVar:HMI_DPC_IndMd_ExhstFlap_Stat:*/
on EnvVar HMI_DPC_IndMd_ExhstFlap_Stat
{
    _mDPC_IndMd_Stat_AR.DPC_IndMd_ExhstFlap_Stat.phys = getValue(this);
    _DPC_IndMd_Stat_AR_SpontanFlag = 1;
}
/*@@end*/

/*@@envVar:HMI_DPC_IndMd_Ht_Stat:*/
on EnvVar HMI_DPC_IndMd_Ht_Stat
{
    _mDPC_IndMd_Stat_AR.DPC_IndMd_Ht_Stat.phys = getValue(this);
    _DPC_IndMd_Stat_AR_SpontanFlag = 1;
}
/*@@end*/

/*@@envVar:HMI_DPC_IndMd_PT_Stat:*/
on EnvVar HMI_DPC_IndMd_PT_Stat
{
    _mDPC_IndMd_Stat_AR.DPC_IndMd_PT_Stat.phys = getValue(this);
    _DPC_IndMd_Stat_AR_SpontanFlag = 1;
}
/*@@end*/

/*@@envVar:HMI_DPC_IndMd_PwrFreeD_Plus_Stat:*/
on EnvVar HMI_DPC_IndMd_PwrFreeD_Plus_Stat
{
    _mDPC_IndMd_Stat_AR.DPC_IndMd_PwrFreeD_Plus_Stat.phys = getValue(this);
    _DPC_IndMd_Stat_AR_SpontanFlag = 1;
}
/*@@end*/

/*@@envVar:HMI_DPC_IndMd_SSA_Stat:*/
on EnvVar HMI_DPC_IndMd_SSA_Stat
{
    _mDPC_IndMd_Stat_AR.DPC_IndMd_SSA_Stat.phys = getValue(this);
    _DPC_IndMd_Stat_AR_SpontanFlag = 1;
}
/*@@end*/

/*@@envVar:HMI_DPC_IndMd_St_Stat:*/
on EnvVar HMI_DPC_IndMd_St_Stat
{
    _mDPC_IndMd_Stat_AR.DPC_IndMd_St_Stat.phys = getValue(this);
    _DPC_IndMd_Stat_AR_SpontanFlag = 1;
}
/*@@end*/

/*@@envVar:HMI_DPC_IndMd_Susp_Stat:*/
on EnvVar HMI_DPC_IndMd_Susp_Stat
{
    _mDPC_IndMd_Stat_AR.DPC_IndMd_Susp_Stat.phys = getValue(this);
    _DPC_IndMd_Stat_AR_SpontanFlag = 1;
}
/*@@end*/

/*@@envVar:HMI_DPC_IndMd_Tx_Stat:*/
on EnvVar HMI_DPC_IndMd_Tx_Stat
{
    _mDPC_IndMd_Stat_AR.DPC_IndMd_Tx_Stat.phys = getValue(this);
    _DPC_IndMd_Stat_AR_SpontanFlag = 1;
}
/*@@end*/

/*@@envVar:HMI_DPC_OffroadMd_Stat:*/
on EnvVar HMI_DPC_OffroadMd_Stat
{
    _mDPC_IndMd_Stat_AR.DPC_OffroadMd_Stat.phys = getValue(this);
    _DPC_IndMd_Stat_AR_SpontanFlag = 1;
}
/*@@end*/

/*@@envVar:HMI_Rsrv2_DPC_IndMd_Stat:*/
on EnvVar HMI_Rsrv2_DPC_IndMd_Stat
{
    _mDPC_IndMd_Stat_AR.Rsrv2_DPC_IndMd_Stat.phys = getValue(this);
    _DPC_IndMd_Stat_AR_SpontanFlag = 1;
}
/*@@end*/

/*@@envVar:HMI_Rsrv3_DPC_IndMd_Stat:*/
on EnvVar HMI_Rsrv3_DPC_IndMd_Stat
{
    _mDPC_IndMd_Stat_AR.Rsrv3_DPC_IndMd_Stat.phys = getValue(this);
    _DPC_IndMd_Stat_AR_SpontanFlag = 1;
}
/*@@end*/

/*@@caplFunc:DPC_IndMd_Style_AR_check_output():*/
DPC_IndMd_Style_AR_check_output()
{
    if( !getValue( HMI__STMSG_DPC_IndMd_Style_AR ) )
    {
        // Botschaft DPC_IndMd_Style_AR ID: 778 --- Sendeart 0 cyclic --- 
        _DPC_IndMd_Style_AR_Cnt--;
        if( _DPC_IndMd_Style_AR_Cnt < 1 )
        {
            // Nachricht wg. abgelaufenem Zyklus ausgeben
            DPC_IndMd_Style_AR_output();
            // Zyklus-Zähler zurücksetzen
            _DPC_IndMd_Style_AR_Cnt = _DPC_IndMd_Style_AR_CycleCount;
        }
    }
}
/*@@end*/

/*@@caplFunc:DPC_IndMd_Style_AR_init():*/
DPC_IndMd_Style_AR_init()
{   /* Botschaft DPC_IndMd_Style_AR ID: 778 --- Sendeart 0 cyclicX --- 
BA_ "ApplMessage" BO_ 778 0;
BA_ "NmAsrMessage" BO_ 778 0;
BA_ "GenMsgMinAcceptLength" BO_ 778 8;
BA_ "GenMsgILSupport" BO_ 778 1;
BA_ "DiagState" BO_ 778 0;
BA_ "DiagRequest" BO_ 778 0;
BA_ "DiagResponse" BO_ 778 0;
BA_ "GenMsgStartValue" BO_ 778 "0";
BA_ "GenMsgStartDelayTime" BO_ 778 0;
BA_ "GenMsgCycleTime" BO_ 778 1000;
BA_ "GenMsgSendType" BO_ 778 0;
    */
    _DPC_IndMd_Style_AR_Timebase =         c_tDBKomTimer_20ms;
    _DPC_IndMd_Style_AR_CycleCount =     1000 / _DPC_IndMd_Style_AR_Timebase;
    _DPC_IndMd_Style_AR_StartDelay =        0 / _DPC_IndMd_Style_AR_Timebase;
    _DPC_IndMd_Style_AR_Cnt = _DPC_IndMd_Style_AR_StartDelay;
    _DPC_IndMd_Style_AR_DelayCnt = 0;

    putValue( HMI__STMSGSD_DPC_IndMd_Style_AR, _DPC_IndMd_Style_AR_StartDelay * _DPC_IndMd_Style_AR_Timebase );

    _mDPC_IndMd_Style_AR.DPC_IndMd_AC_Style.phys = getValue( HMI_DPC_IndMd_AC_Style );
    _mDPC_IndMd_Style_AR.DPC_IndMd_AS_Style.phys = getValue( HMI_DPC_IndMd_AS_Style );
    _mDPC_IndMd_Style_AR.DPC_IndMd_ECO_Assist_Style.phys = getValue( HMI_DPC_IndMd_ECO_Assist_Style );
    _mDPC_IndMd_Style_AR.DPC_IndMd_eDrv_Style.phys = getValue( HMI_DPC_IndMd_eDrv_Style );
    _mDPC_IndMd_Style_AR.DPC_IndMd_ESP_Style.phys = getValue( HMI_DPC_IndMd_ESP_Style );
    _mDPC_IndMd_Style_AR.DPC_IndMd_ExhstFlap_Style.phys = getValue( HMI_DPC_IndMd_ExhstFlap_Style );
    _mDPC_IndMd_Style_AR.DPC_IndMd_Ht_Style.phys = getValue( HMI_DPC_IndMd_Ht_Style );
    _mDPC_IndMd_Style_AR.DPC_IndMd_PT_Style.phys = getValue( HMI_DPC_IndMd_PT_Style );
    _mDPC_IndMd_Style_AR.DPC_IndMd_PwrFreeD_Plus_Style.phys = getValue( HMI_DPC_IndMd_PwrFreeD_Plus_Style );
    _mDPC_IndMd_Style_AR.DPC_IndMd_SSA_Style.phys = getValue( HMI_DPC_IndMd_SSA_Style );
    _mDPC_IndMd_Style_AR.DPC_IndMd_St_Style.phys = getValue( HMI_DPC_IndMd_St_Style );
    _mDPC_IndMd_Style_AR.DPC_IndMd_Susp_Style.phys = getValue( HMI_DPC_IndMd_Susp_Style );
    _mDPC_IndMd_Style_AR.DPC_IndMd_Tx_Style.phys = getValue( HMI_DPC_IndMd_Tx_Style );
    _mDPC_IndMd_Style_AR.DPC_OffroadMd_Style.phys = getValue( HMI_DPC_OffroadMd_Style );
}
/*@@end*/

/*@@caplFunc:DPC_IndMd_Style_AR_output():*/
DPC_IndMd_Style_AR_output()
{
    byte crc;
    byte SQC_help;

    if( !getValue( HMI_SQC_DPC_IndMd_Style_Auto ) )
    {
        // berechne message counter
        SQC_help = getValue( HMI_SQC_DPC_IndMd_Style );
        if( SQC_help >= 15 ) SQC_help = 0;
        else SQC_help++;
        putValue( HMI_SQC_DPC_IndMd_Style, SQC_help );
        _mDPC_IndMd_Style_AR.SQC_DPC_IndMd_Style = SQC_help;
    }
    else
        _mDPC_IndMd_Style_AR.SQC_DPC_IndMd_Style = getValue( HMI_SQC_DPC_IndMd_Style );

    if( getValue( HMI_CRC_DPC_IndMd_Style_Profile_02 ) )
    {
        if( !getValue( HMI_CRC_DPC_IndMd_Style_Auto ) )
        {   // CRC according Profile_02 ( W213 )
            // berechne crc
            crc = 0xFF;
//            crc = crctable_profile02[crc ^ _mDPC_IndMd_Style_AR.byte( 0 )];  CRC
            crc = crctable_profile02[crc ^ _mDPC_IndMd_Style_AR.byte( 1 )];
            crc = crctable_profile02[crc ^ _mDPC_IndMd_Style_AR.byte( 2 )];
            crc = crctable_profile02[crc ^ _mDPC_IndMd_Style_AR.byte( 3 )];
            crc = crctable_profile02[crc ^ _mDPC_IndMd_Style_AR.byte( 4 )];
            crc = crctable_profile02[crc ^ _mDPC_IndMd_Style_AR.byte( 5 )];
            crc = crctable_profile02[crc ^ _mDPC_IndMd_Style_AR.byte( 6 )];
            crc = crctable_profile02[crc ^ _mDPC_IndMd_Style_AR.byte( 7 )];
            crc = crctable_profile02[crc ^ _DPC_IndMd_Style_AR_CRC_Offset[ _mDPC_IndMd_Style_AR.SQC_DPC_IndMd_Style ] ]; // load offset
            crc = (crc ^ 0xFF);
            if( getValue(  HMI_CRC_DPC_IndMd_Style_Invalid ) )
                crc++;
            _mDPC_IndMd_Style_AR.CRC_DPC_IndMd_Style = crc;
            putValue( HMI_CRC_DPC_IndMd_Style, crc );
        }
        else
            _mDPC_IndMd_Style_AR.CRC_DPC_IndMd_Style = getValue( HMI_CRC_DPC_IndMd_Style );
    }
    else
    {
        if( !getValue( HMI_CRC_DPC_IndMd_Style_Auto ) )
        {   // CRC according to SAE1850 ( W222 )
            // berechne crc
            crc = 0xFF;
//            crc = crctable[crc ^ _mDPC_IndMd_Style_AR.byte( 0 )];  CRC
            crc = crctable[crc ^ _mDPC_IndMd_Style_AR.byte( 1 )];
            crc = crctable[crc ^ _mDPC_IndMd_Style_AR.byte( 2 )];
            crc = crctable[crc ^ _mDPC_IndMd_Style_AR.byte( 3 )];
            crc = crctable[crc ^ _mDPC_IndMd_Style_AR.byte( 4 )];
            crc = crctable[crc ^ _mDPC_IndMd_Style_AR.byte( 5 )];
            crc = crctable[crc ^ _mDPC_IndMd_Style_AR.byte( 6 )];
            crc = crctable[crc ^ _mDPC_IndMd_Style_AR.byte( 7 )];
            crc = (crc ^ 0xFF);
            if( getValue(  HMI_CRC_DPC_IndMd_Style_Invalid ) )
                crc++;
            _mDPC_IndMd_Style_AR.CRC_DPC_IndMd_Style = crc;
            putValue( HMI_CRC_DPC_IndMd_Style, crc );
        }
        else
            _mDPC_IndMd_Style_AR.CRC_DPC_IndMd_Style = getValue( HMI_CRC_DPC_IndMd_Style );
    }
    output( _mDPC_IndMd_Style_AR );
}
/*@@end*/

/*@@caplFunc:DPC_IndMd_Style_AR_saveEnvVars(dword):*/
DPC_IndMd_Style_AR_saveEnvVars( dword hFile )
{
    filePutString("\n// Knoten EIS: DPC_IndMd_Style_AR\n", 25, hFile );
    snprintf( buffer, elcount( buffer ), "0.0000 HMI__STMSG_DPC_IndMd_Style_AR := %X\n", getValue( HMI__STMSG_DPC_IndMd_Style_AR ) );        filePutString ( buffer, elcount( buffer ), hFile );
    snprintf( buffer, elcount( buffer ), "0.0000 HMI__STMSGT_DPC_IndMd_Style_AR := %X\n", getValue( HMI__STMSGT_DPC_IndMd_Style_AR ) );        filePutString ( buffer, elcount( buffer ), hFile );
    snprintf( buffer, elcount( buffer ), "0.0000 HMI_CRC_DPC_IndMd_Style := %X\n", getValue( HMI_CRC_DPC_IndMd_Style ) );        filePutString ( buffer, elcount( buffer ), hFile );
    snprintf( buffer, elcount( buffer ), "0.0000 HMI_CRC_DPC_IndMd_Style_Auto := %X\n", getValue( HMI_CRC_DPC_IndMd_Style_Auto ) );        filePutString ( buffer, elcount( buffer ), hFile );
    snprintf( buffer, elcount( buffer ), "0.0000 HMI_DPC_IndMd_AC_Style := %X\n", getValue( HMI_DPC_IndMd_AC_Style ) );        filePutString ( buffer, elcount( buffer ), hFile );
    snprintf( buffer, elcount( buffer ), "0.0000 HMI_DPC_IndMd_AS_Style := %X\n", getValue( HMI_DPC_IndMd_AS_Style ) );        filePutString ( buffer, elcount( buffer ), hFile );
    snprintf( buffer, elcount( buffer ), "0.0000 HMI_DPC_IndMd_ECO_Assist_Style := %X\n", getValue( HMI_DPC_IndMd_ECO_Assist_Style ) );        filePutString ( buffer, elcount( buffer ), hFile );
    snprintf( buffer, elcount( buffer ), "0.0000 HMI_DPC_IndMd_eDrv_Style := %X\n", getValue( HMI_DPC_IndMd_eDrv_Style ) );        filePutString ( buffer, elcount( buffer ), hFile );
    snprintf( buffer, elcount( buffer ), "0.0000 HMI_DPC_IndMd_ESP_Style := %X\n", getValue( HMI_DPC_IndMd_ESP_Style ) );        filePutString ( buffer, elcount( buffer ), hFile );
    snprintf( buffer, elcount( buffer ), "0.0000 HMI_DPC_IndMd_ExhstFlap_Style := %X\n", getValue( HMI_DPC_IndMd_ExhstFlap_Style ) );        filePutString ( buffer, elcount( buffer ), hFile );
    snprintf( buffer, elcount( buffer ), "0.0000 HMI_DPC_IndMd_Ht_Style := %X\n", getValue( HMI_DPC_IndMd_Ht_Style ) );        filePutString ( buffer, elcount( buffer ), hFile );
    snprintf( buffer, elcount( buffer ), "0.0000 HMI_DPC_IndMd_PT_Style := %X\n", getValue( HMI_DPC_IndMd_PT_Style ) );        filePutString ( buffer, elcount( buffer ), hFile );
    snprintf( buffer, elcount( buffer ), "0.0000 HMI_DPC_IndMd_PwrFreeD_Plus_Style := %X\n", getValue( HMI_DPC_IndMd_PwrFreeD_Plus_Style ) );        filePutString ( buffer, elcount( buffer ), hFile );
    snprintf( buffer, elcount( buffer ), "0.0000 HMI_DPC_IndMd_SSA_Style := %X\n", getValue( HMI_DPC_IndMd_SSA_Style ) );        filePutString ( buffer, elcount( buffer ), hFile );
    snprintf( buffer, elcount( buffer ), "0.0000 HMI_DPC_IndMd_St_Style := %X\n", getValue( HMI_DPC_IndMd_St_Style ) );        filePutString ( buffer, elcount( buffer ), hFile );
    snprintf( buffer, elcount( buffer ), "0.0000 HMI_DPC_IndMd_Susp_Style := %X\n", getValue( HMI_DPC_IndMd_Susp_Style ) );        filePutString ( buffer, elcount( buffer ), hFile );
    snprintf( buffer, elcount( buffer ), "0.0000 HMI_DPC_IndMd_Tx_Style := %X\n", getValue( HMI_DPC_IndMd_Tx_Style ) );        filePutString ( buffer, elcount( buffer ), hFile );
    snprintf( buffer, elcount( buffer ), "0.0000 HMI_DPC_OffroadMd_Style := %X\n", getValue( HMI_DPC_OffroadMd_Style ) );        filePutString ( buffer, elcount( buffer ), hFile );
    snprintf( buffer, elcount( buffer ), "0.0000 HMI_SQC_DPC_IndMd_Style := %X\n", getValue( HMI_SQC_DPC_IndMd_Style ) );        filePutString ( buffer, elcount( buffer ), hFile );
    snprintf( buffer, elcount( buffer ), "0.0000 HMI_SQC_DPC_IndMd_Style_Auto := %X\n", getValue( HMI_SQC_DPC_IndMd_Style_Auto ) );        filePutString ( buffer, elcount( buffer ), hFile );
}
/*@@end*/

/*@@timer:_tDPC_IndMd_Style_AR:*/
on timer _tDPC_IndMd_Style_AR
{
    putValue( HMI__STMSG_DPC_IndMd_Style_AR, 0 );
}
/*@@end*/

/*@@envVar:HMI__STMSG_DPC_IndMd_Style_AR:*/
on EnvVar HMI__STMSG_DPC_IndMd_Style_AR
{
    long tDelay;
    if( getValue( this ) == 2 )
    {
        tDelay = getValue( HMI__STMSGT_DPC_IndMd_Style_AR );
        if( tDelay > 0)    
            setTimer( _tDPC_IndMd_Style_AR, tDelay );
        else
            putValue( HMI__STMSG_DPC_IndMd_Style_AR, 0 );
    }
}
/*@@end*/

/*@@envVar:HMI_DPC_IndMd_AC_Style:*/
on EnvVar HMI_DPC_IndMd_AC_Style
{
    _mDPC_IndMd_Style_AR.DPC_IndMd_AC_Style.phys = getValue(this);
}
/*@@end*/

/*@@envVar:HMI_DPC_IndMd_AS_Style:*/
on EnvVar HMI_DPC_IndMd_AS_Style
{
    _mDPC_IndMd_Style_AR.DPC_IndMd_AS_Style.phys = getValue(this);
}
/*@@end*/

/*@@envVar:HMI_DPC_IndMd_ECO_Assist_Style:*/
on EnvVar HMI_DPC_IndMd_ECO_Assist_Style
{
    _mDPC_IndMd_Style_AR.DPC_IndMd_ECO_Assist_Style.phys = getValue(this);
}
/*@@end*/

/*@@envVar:HMI_DPC_IndMd_eDrv_Style:*/
on EnvVar HMI_DPC_IndMd_eDrv_Style
{
    _mDPC_IndMd_Style_AR.DPC_IndMd_eDrv_Style.phys = getValue(this);
}
/*@@end*/

/*@@envVar:HMI_DPC_IndMd_ESP_Style:*/
on EnvVar HMI_DPC_IndMd_ESP_Style
{
    _mDPC_IndMd_Style_AR.DPC_IndMd_ESP_Style.phys = getValue(this);
}
/*@@end*/

/*@@envVar:HMI_DPC_IndMd_ExhstFlap_Style:*/
on EnvVar HMI_DPC_IndMd_ExhstFlap_Style
{
    _mDPC_IndMd_Style_AR.DPC_IndMd_ExhstFlap_Style.phys = getValue(this);
}
/*@@end*/

/*@@envVar:HMI_DPC_IndMd_Ht_Style:*/
on EnvVar HMI_DPC_IndMd_Ht_Style
{
    _mDPC_IndMd_Style_AR.DPC_IndMd_Ht_Style.phys = getValue(this);
}
/*@@end*/

/*@@envVar:HMI_DPC_IndMd_PT_Style:*/
on EnvVar HMI_DPC_IndMd_PT_Style
{
    _mDPC_IndMd_Style_AR.DPC_IndMd_PT_Style.phys = getValue(this);
}
/*@@end*/

/*@@envVar:HMI_DPC_IndMd_SSA_Style:*/
on EnvVar HMI_DPC_IndMd_SSA_Style
{
    _mDPC_IndMd_Style_AR.DPC_IndMd_SSA_Style.phys = getValue(this);
}
/*@@end*/

/*@@envVar:HMI_DPC_IndMd_St_Style:*/
on EnvVar HMI_DPC_IndMd_St_Style
{
    _mDPC_IndMd_Style_AR.DPC_IndMd_St_Style.phys = getValue(this);
}
/*@@end*/

/*@@envVar:HMI_DPC_IndMd_Susp_Style:*/
on EnvVar HMI_DPC_IndMd_Susp_Style
{
    _mDPC_IndMd_Style_AR.DPC_IndMd_Susp_Style.phys = getValue(this);
}
/*@@end*/

/*@@envVar:HMI_DPC_IndMd_Tx_Style:*/
on EnvVar HMI_DPC_IndMd_Tx_Style
{
    _mDPC_IndMd_Style_AR.DPC_IndMd_Tx_Style.phys = getValue(this);
}
/*@@end*/

/*@@envVar:HMI_DPC_OffroadMd_Style:*/
on EnvVar HMI_DPC_OffroadMd_Style
{
    _mDPC_IndMd_Style_AR.DPC_OffroadMd_Style.phys = getValue(this);
}
/*@@end*/

/*@@caplFunc:DPC_IndMd_Style2_AR_check_output():*/
DPC_IndMd_Style2_AR_check_output()
{
    if( !getValue( HMI__STMSG_DPC_IndMd_Style2_AR ) )
    {
        // Botschaft DPC_IndMd_Style2_AR --- Sendeart 0 cyclicX
        _DPC_IndMd_Style2_AR_Cnt--;
        if( _DPC_IndMd_Style2_AR_Cnt < 1 )
        {
            // Nachricht wg. abgelaufenem Zyklus ausgeben
            DPC_IndMd_Style2_AR_output();
            // Zyklus-Zähler zurücksetzen
            _DPC_IndMd_Style2_AR_Cnt = _DPC_IndMd_Style2_AR_CycleCount;
        }
    }
}
/*@@end*/

/*@@caplFunc:DPC_IndMd_Style2_AR_init():*/
DPC_IndMd_Style2_AR_init()
{   /* Botschaft DPC_IndMd_Style2_AR ID: 790 --- Sendeart 0 cyclicX --- 
BA_ "ApplMessage" BO_ 790 0;
BA_ "NmAsrMessage" BO_ 790 0;
BA_ "GenMsgMinAcceptLength" BO_ 790 8;
BA_ "GenMsgILSupport" BO_ 790 1;
BA_ "DiagState" BO_ 790 0;
BA_ "DiagRequest" BO_ 790 0;
BA_ "DiagResponse" BO_ 790 0;
BA_ "GenMsgStartValue" BO_ 790 "0";
BA_ "GenMsgCycleTime" BO_ 790 1000;
BA_ "GenMsgSendType" BO_ 790 0;
    */
    _DPC_IndMd_Style2_AR_Timebase =          c_tDBKomTimer_20ms;
    _DPC_IndMd_Style2_AR_CycleCount =      1000 / _DPC_IndMd_Style2_AR_Timebase;
    _DPC_IndMd_Style2_AR_StartDelay =         0 / _DPC_IndMd_Style2_AR_Timebase;
    _DPC_IndMd_Style2_AR_Cnt = _DPC_IndMd_Style2_AR_StartDelay;

    putValue( HMI__STMSGSD_DPC_IndMd_Style2_AR, _DPC_IndMd_Style2_AR_StartDelay * _DPC_IndMd_Style2_AR_Timebase );

    _mDPC_IndMd_Style2_AR.DPC_IndMd_ABC_Style.phys = getValue( HMI_DPC_IndMd_ABC_Style );
    _mDPC_IndMd_Style2_AR.Rsrv1_DPC_IndMd_Style2.phys = getValue( HMI_Rsrv1_DPC_IndMd_Style2 );
    _mDPC_IndMd_Style2_AR.Rsrv2_DPC_IndMd_Style2.phys = getValue( HMI_Rsrv2_DPC_IndMd_Style2 );
    _mDPC_IndMd_Style2_AR.Rsrv3_DPC_IndMd_Style2.phys = getValue( HMI_Rsrv3_DPC_IndMd_Style2 );
    _mDPC_IndMd_Style2_AR.Rsrv4_DPC_IndMd_Style2.phys = getValue( HMI_Rsrv4_DPC_IndMd_Style2 );
    _mDPC_IndMd_Style2_AR.Rsrv5_DPC_IndMd_Style2.phys = getValue( HMI_Rsrv5_DPC_IndMd_Style2 );
    _mDPC_IndMd_Style2_AR.Rsrv6_DPC_IndMd_Style2.phys = getValue( HMI_Rsrv6_DPC_IndMd_Style2 );
}
/*@@end*/

/*@@caplFunc:DPC_IndMd_Style2_AR_output():*/
DPC_IndMd_Style2_AR_output()
{
    byte crc;
    byte SQC_help;

    if( !getValue( HMI_SQC_DPC_IndMd_Style2_Auto ) )
    {
        // berechne message counter
        SQC_help = getValue( HMI_SQC_DPC_IndMd_Style2 );
        if( SQC_help >= 15 ) SQC_help = 0;
        else SQC_help++;
        putValue( HMI_SQC_DPC_IndMd_Style2, SQC_help );
        _mDPC_IndMd_Style2_AR.SQC_DPC_IndMd_Style2 = SQC_help;
    }
    else
        _mDPC_IndMd_Style2_AR.SQC_DPC_IndMd_Style2 = getValue( HMI_SQC_DPC_IndMd_Style2 );

    if( getValue( HMI_CRC_DPC_IndMd_Style2_Profile_02 ) )
    {
    if( !getValue( HMI_CRC_DPC_IndMd_Style2_Auto ) )
        {   // CRC according Profile_02 ( W213 )
            // berechne crc
            crc = 0xFF;
//            crc = crctable_profile02[crc ^ _mDPC_IndMd_Style2_AR.byte( 0 )];  CRC
            crc = crctable_profile02[crc ^ _mDPC_IndMd_Style2_AR.byte( 1 )];
            crc = crctable_profile02[crc ^ _mDPC_IndMd_Style2_AR.byte( 2 )];
            crc = crctable_profile02[crc ^ _mDPC_IndMd_Style2_AR.byte( 3 )];
            crc = crctable_profile02[crc ^ _mDPC_IndMd_Style2_AR.byte( 4 )];
            crc = crctable_profile02[crc ^ _mDPC_IndMd_Style2_AR.byte( 5 )];
            crc = crctable_profile02[crc ^ _mDPC_IndMd_Style2_AR.byte( 6 )];
            crc = crctable_profile02[crc ^ _mDPC_IndMd_Style2_AR.byte( 7 )];
            crc = crctable_profile02[crc ^ _DPC_IndMd_Style2_AR_CRC_Offset[ _mDPC_IndMd_Style2_AR.SQC_DPC_IndMd_Style2 ] ]; // load offset
            crc = (crc ^ 0xFF);
            if( getValue(  HMI_CRC_DPC_IndMd_Style2_Invalid ) )
                crc++;
            _mDPC_IndMd_Style2_AR.CRC_DPC_IndMd_Style2 = crc;
            putValue( HMI_CRC_DPC_IndMd_Style2, crc );
        }
        else
            _mDPC_IndMd_Style2_AR.CRC_DPC_IndMd_Style2 = getValue( HMI_CRC_DPC_IndMd_Style2 );
    }
    else
    {
        if( !getValue( HMI_CRC_DPC_IndMd_Style2_Auto ) )
        {   // CRC according to SAE1850 ( W222 )
            // berechne crc
            crc = 0xFF;
//            crc = crctable[crc ^ _mDPC_IndMd_Style2_AR.byte( 0 )];  CRC
            crc = crctable[crc ^ _mDPC_IndMd_Style2_AR.byte( 1 )];
            crc = crctable[crc ^ _mDPC_IndMd_Style2_AR.byte( 2 )];
            crc = crctable[crc ^ _mDPC_IndMd_Style2_AR.byte( 3 )];
            crc = crctable[crc ^ _mDPC_IndMd_Style2_AR.byte( 4 )];
            crc = crctable[crc ^ _mDPC_IndMd_Style2_AR.byte( 5 )];
            crc = crctable[crc ^ _mDPC_IndMd_Style2_AR.byte( 6 )];
            crc = crctable[crc ^ _mDPC_IndMd_Style2_AR.byte( 7 )];
            crc = (crc ^ 0xFF);
            if( getValue(  HMI_CRC_DPC_IndMd_Style2_Invalid ) )
                crc++;
            _mDPC_IndMd_Style2_AR.CRC_DPC_IndMd_Style2 = crc;
            putValue( HMI_CRC_DPC_IndMd_Style2, crc );
        }
        else
            _mDPC_IndMd_Style2_AR.CRC_DPC_IndMd_Style2 = getValue( HMI_CRC_DPC_IndMd_Style2 );
    }
    output( _mDPC_IndMd_Style2_AR );
}
/*@@end*/

/*@@caplFunc:DPC_IndMd_Style2_AR_saveEnvVars(dword):*/
DPC_IndMd_Style2_AR_saveEnvVars( dword hFile )
{
    filePutString("\n// Knoten EIS: DPC_IndMd_Style2_AR\n", 25, hFile );
    snprintf( buffer, elcount( buffer ), "0.0000 HMI__STMSG_DPC_IndMd_Style2_AR := %X\n", getValue( HMI__STMSG_DPC_IndMd_Style2_AR ) );        filePutString ( buffer, elcount( buffer ), hFile );
    snprintf( buffer, elcount( buffer ), "0.0000 HMI__STMSGT_DPC_IndMd_Style2_AR := %X\n", getValue( HMI__STMSGT_DPC_IndMd_Style2_AR ) );        filePutString ( buffer, elcount( buffer ), hFile );
    snprintf( buffer, elcount( buffer ), "0.0000 HMI_CRC_DPC_IndMd_Style2 := %X\n", getValue( HMI_CRC_DPC_IndMd_Style2 ) );        filePutString ( buffer, elcount( buffer ), hFile );
    snprintf( buffer, elcount( buffer ), "0.0000 HMI_CRC_DPC_IndMd_Style2_Auto := %X\n", getValue( HMI_CRC_DPC_IndMd_Style2_Auto ) );        filePutString ( buffer, elcount( buffer ), hFile );
    snprintf( buffer, elcount( buffer ), "0.0000 HMI_CRC_DPC_IndMd_Style2_Profile_02 := %X\n", getValue( HMI_CRC_DPC_IndMd_Style2_Profile_02 ) );        filePutString ( buffer, elcount( buffer ), hFile );
    snprintf( buffer, elcount( buffer ), "0.0000 HMI_DPC_IndMd_ABC_Style := %X\n", getValue( HMI_DPC_IndMd_ABC_Style ) );        filePutString ( buffer, elcount( buffer ), hFile );
    snprintf( buffer, elcount( buffer ), "0.0000 HMI_Rsrv1_DPC_IndMd_Style2 := %X\n", getValue( HMI_Rsrv1_DPC_IndMd_Style2 ) );        filePutString ( buffer, elcount( buffer ), hFile );
    snprintf( buffer, elcount( buffer ), "0.0000 HMI_Rsrv2_DPC_IndMd_Style2 := %X\n", getValue( HMI_Rsrv2_DPC_IndMd_Style2 ) );        filePutString ( buffer, elcount( buffer ), hFile );
    snprintf( buffer, elcount( buffer ), "0.0000 HMI_Rsrv3_DPC_IndMd_Style2 := %X\n", getValue( HMI_Rsrv3_DPC_IndMd_Style2 ) );        filePutString ( buffer, elcount( buffer ), hFile );
    snprintf( buffer, elcount( buffer ), "0.0000 HMI_Rsrv4_DPC_IndMd_Style2 := %X\n", getValue( HMI_Rsrv4_DPC_IndMd_Style2 ) );        filePutString ( buffer, elcount( buffer ), hFile );
    snprintf( buffer, elcount( buffer ), "0.0000 HMI_Rsrv5_DPC_IndMd_Style2 := %X\n", getValue( HMI_Rsrv5_DPC_IndMd_Style2 ) );        filePutString ( buffer, elcount( buffer ), hFile );
    snprintf( buffer, elcount( buffer ), "0.0000 HMI_Rsrv6_DPC_IndMd_Style2 := %X\n", getValue( HMI_Rsrv6_DPC_IndMd_Style2 ) );        filePutString ( buffer, elcount( buffer ), hFile );
    snprintf( buffer, elcount( buffer ), "0.0000 HMI_SQC_DPC_IndMd_Style2 := %X\n", getValue( HMI_SQC_DPC_IndMd_Style2 ) );        filePutString ( buffer, elcount( buffer ), hFile );
    snprintf( buffer, elcount( buffer ), "0.0000 HMI_SQC_DPC_IndMd_Style2_Auto := %X\n", getValue( HMI_SQC_DPC_IndMd_Style2_Auto ) );        filePutString ( buffer, elcount( buffer ), hFile );
}
/*@@end*/

/*@@timer:_tDPC_IndMd_Style2_AR:*/
on timer _tDPC_IndMd_Style2_AR
{
    putValue( HMI__STMSG_DPC_IndMd_Style2_AR, 0 );
}
/*@@end*/

/*@@envVar:HMI__STMSG_DPC_IndMd_Style2_AR:*/
on EnvVar HMI__STMSG_DPC_IndMd_Style2_AR
{
    long tDelay;
    if( getValue( this ) == 2 )
    {
        tDelay = getValue( HMI__STMSGT_DPC_IndMd_Style2_AR );
        if( tDelay > 0)    
            setTimer( _tDPC_IndMd_Style2_AR, tDelay );
        else
            putValue( HMI__STMSG_DPC_IndMd_Style2_AR, 0 );
    }
}
/*@@end*/

/*@@envVar:HMI_DPC_IndMd_ABC_Style:*/
on EnvVar HMI_DPC_IndMd_ABC_Style
{
    _mDPC_IndMd_Style2_AR.DPC_IndMd_ABC_Style.phys = getValue(this);
}
/*@@end*/

/*@@envVar:HMI_Rsrv1_DPC_IndMd_Style2:*/
on EnvVar HMI_Rsrv1_DPC_IndMd_Style2
{
    _mDPC_IndMd_Style2_AR.Rsrv1_DPC_IndMd_Style2.phys = getValue(this);
}
/*@@end*/

/*@@envVar:HMI_Rsrv2_DPC_IndMd_Style2:*/
on EnvVar HMI_Rsrv2_DPC_IndMd_Style2
{
    _mDPC_IndMd_Style2_AR.Rsrv2_DPC_IndMd_Style2.phys = getValue(this);
}
/*@@end*/

/*@@envVar:HMI_Rsrv3_DPC_IndMd_Style2:*/
on EnvVar HMI_Rsrv3_DPC_IndMd_Style2
{
    _mDPC_IndMd_Style2_AR.Rsrv3_DPC_IndMd_Style2.phys = getValue(this);
}
/*@@end*/

/*@@envVar:HMI_Rsrv4_DPC_IndMd_Style2:*/
on EnvVar HMI_Rsrv4_DPC_IndMd_Style2
{
    _mDPC_IndMd_Style2_AR.Rsrv4_DPC_IndMd_Style2.phys = getValue(this);
}
/*@@end*/

/*@@envVar:HMI_Rsrv5_DPC_IndMd_Style2:*/
on EnvVar HMI_Rsrv5_DPC_IndMd_Style2
{
    _mDPC_IndMd_Style2_AR.Rsrv5_DPC_IndMd_Style2.phys = getValue(this);
}
/*@@end*/

/*@@envVar:HMI_Rsrv6_DPC_IndMd_Style2:*/
on EnvVar HMI_Rsrv6_DPC_IndMd_Style2
{
    _mDPC_IndMd_Style2_AR.Rsrv6_DPC_IndMd_Style2.phys = getValue(this);
}
/*@@end*/

/*@@caplFunc:DPC_Master_Rq_AR_check_output():*/
DPC_Master_Rq_AR_check_output()
{
    if( !getValue( HMI__STMSG_DPC_Master_Rq_AR ) )
    {
        // Botschaft DPC_Master_Rq_AR ID: 625 --- Sendeart 5 cyclicAndSpontanWithDelay --- 
        if( _DPC_Master_Rq_AR_DelayCnt > 0) _DPC_Master_Rq_AR_DelayCnt--; // Mindestsendeabstand
        _DPC_Master_Rq_AR_Cnt--;
        if( _DPC_Master_Rq_AR_Cnt < 1 )
        {
            if( _DPC_Master_Rq_AR_DelayCnt < 1 )
            {
                // Nachricht wg. abgelaufenem Zyklus ausgeben (Mindestsendeabstand eingehalten)
                DPC_Master_Rq_AR_output();
                 _DPC_Master_Rq_AR_SpontanFlag = 0; // Spontan-Flag zurücksetzen
                _DPC_Master_Rq_AR_DelayCnt = _DPC_Master_Rq_AR_MinDelay;
            }
            else
            {
                // Spontanflag setzen damit nach Ablauf Mindestsendeabstand gesendet wird
                 _DPC_Master_Rq_AR_SpontanFlag = 1;
            }
            _DPC_Master_Rq_AR_Cnt = _DPC_Master_Rq_AR_CycleCount; // Zyklus-Zähler zurücksetzen
        }
        else if( _DPC_Master_Rq_AR_SpontanFlag)
        {
            if( _DPC_Master_Rq_AR_DelayCnt < 1 )
            {
                // Nachricht wg. spontaner Änderung ausgeben (Mindestsendeabstand eingehalten)
                DPC_Master_Rq_AR_output();
                _DPC_Master_Rq_AR_SpontanFlag = 0; // Spontan-Flag zurücksetzen
                _DPC_Master_Rq_AR_DelayCnt = _DPC_Master_Rq_AR_MinDelay;
            }
        }
    }
}
/*@@end*/

/*@@caplFunc:DPC_Master_Rq_AR_init():*/
DPC_Master_Rq_AR_init()
{   /* Botschaft DPC_Master_Rq_AR ID: 625 --- Sendeart 5 cyclicAndSpontanWithDelay --- 
BA_ "ApplMessage" BO_ 625 0;
BA_ "NmAsrMessage" BO_ 625 0;
BA_ "GenMsgMinAcceptLength" BO_ 625 8;
BA_ "GenMsgILSupport" BO_ 625 1;
BA_ "DiagState" BO_ 625 0;
BA_ "DiagRequest" BO_ 625 0;
BA_ "DiagResponse" BO_ 625 0;
BA_ "GenMsgStartValue" BO_ 625 "0";
BA_ "GenMsgStartDelayTime" BO_ 625 0;
BA_ "GenMsgDelayTime" BO_ 625 20;
BA_ "GenMsgNrOfRepetitions" BO_ 625 0;
BA_ "GenMsgCycleTime" BO_ 625 100;
BA_ "GenMsgSendType" BO_ 625 5;
    */
    _DPC_Master_Rq_AR_Timebase =            c_tDBKomTimer_20ms;
    _DPC_Master_Rq_AR_CycleCount =        100 / _DPC_Master_Rq_AR_Timebase;
    _DPC_Master_Rq_AR_StartDelay =          0 / _DPC_Master_Rq_AR_Timebase;
    _DPC_Master_Rq_AR_MinDelay =           20 / _DPC_Master_Rq_AR_Timebase;
    _DPC_Master_Rq_AR_Cnt = _DPC_Master_Rq_AR_StartDelay;
    _DPC_Master_Rq_AR_SpontanFlag = 0;
    _DPC_Master_Rq_AR_DelayCnt = 0;

    putValue( HMI__STMSGSD_DPC_Master_Rq_AR, _DPC_Master_Rq_AR_StartDelay * _DPC_Master_Rq_AR_Timebase );

    _mDPC_Master_Rq_AR.DPC_GlobalMd_Rq.phys = getValue( HMI_DPC_GlobalMd_Rq );
    _mDPC_Master_Rq_AR.DPC_Md_ABC_Carv_Rq.phys = getValue( HMI_DPC_Md_ABC_Carv_Rq );
    _mDPC_Master_Rq_AR.DPC_Md_ABC_Preview_Rq.phys = getValue( HMI_DPC_Md_ABC_Preview_Rq );
    _mDPC_Master_Rq_AR.DPC_Md_AC_Rq.phys = getValue( HMI_DPC_Md_AC_Master_Rq );
    _mDPC_Master_Rq_AR.DPC_Md_AS_Rq.phys = getValue( HMI_DPC_Md_AS_Master_Rq );
    _mDPC_Master_Rq_AR.DPC_Md_ECO_Assist_Rq.phys = getValue( HMI_DPC_Md_ECO_Assist_Master_Rq );
    _mDPC_Master_Rq_AR.DPC_Md_eDrv_Rq.phys = getValue( HMI_DPC_Md_eDrv_Master_Rq );
    _mDPC_Master_Rq_AR.DPC_Md_ESP_Rq.phys = getValue( HMI_DPC_Md_ESP_Rq );
    _mDPC_Master_Rq_AR.DPC_Md_ExhstFlap_Rq.phys = getValue( HMI_DPC_Md_ExhstFlap_Rq );
    _mDPC_Master_Rq_AR.DPC_Md_Ht_Rq.phys = getValue( HMI_DPC_Md_Ht_Master_Rq );
    _mDPC_Master_Rq_AR.DPC_Md_PT_Rq.phys = getValue( HMI_DPC_Md_PT_Master_Rq );
    _mDPC_Master_Rq_AR.DPC_Md_PwrFreeD_Plus_Rq.phys = getValue( HMI_DPC_Md_PwrFreeD_Plus_Master_Rq );
    _mDPC_Master_Rq_AR.DPC_Md_SSA_Rq.phys = getValue( HMI_DPC_Md_SSA_Master_Rq );
    _mDPC_Master_Rq_AR.DPC_Md_St_Rq.phys = getValue( HMI_DPC_Md_St_Master_Rq );
    _mDPC_Master_Rq_AR.DPC_Md_Susp_Rq_V2.phys = getValue( HMI_DPC_Md_Susp_Master_Rq_V2 );
    _mDPC_Master_Rq_AR.DPC_Md_Tx_Rq.phys = getValue( HMI_DPC_Md_Tx_Rq );
    _mDPC_Master_Rq_AR.DPC_PopupDisp_Rq.phys = getValue( HMI_DPC_PopupDisp_Rq );
    _mDPC_Master_Rq_AR.DPC_PopupSupp_Rq.phys = getValue( HMI_DPC_PopupSupp_Rq );
    _mDPC_Master_Rq_AR.Rsrv2_DPC_Master_Rq.phys = getValue( HMI_Rsrv2_DPC_Master_Rq );
    _mDPC_Master_Rq_AR.Rsrv3_DPC_Master_Rq.phys = getValue( HMI_Rsrv3_DPC_Master_Rq );
}
/*@@end*/

/*@@caplFunc:DPC_Master_Rq_AR_output():*/
void DPC_Master_Rq_AR_output(void)
{
    byte crc;
    byte SQC_help;

    if( !getValue( HMI_SQC_DPC_Master_Rq_Auto ) )
    {
        // berechne message counter
        SQC_help = getValue( HMI_SQC_DPC_Master_Rq );
        if( SQC_help >= 15 ) SQC_help = 0;
        else SQC_help++;
        putValue( HMI_SQC_DPC_Master_Rq, SQC_help );
        _mDPC_Master_Rq_AR.SQC_DPC_Master_Rq = SQC_help;
    }
    else
          _mDPC_Master_Rq_AR.SQC_DPC_Master_Rq = getValue( HMI_SQC_DPC_Master_Rq );

    if( getValue( HMI_CRC_DPC_Master_Rq_Profile_02 ) )
    {
        if( !getValue( HMI_CRC_DPC_Master_Rq_Auto ) )
        {   // CRC according Profile_02 ( W213 )
            // berechne crc
            crc = 0xFF;
//            crc = crctable_profile02[crc ^ _mDPC_Master_Rq_AR.byte( 0 )];  CRC
            crc = crctable_profile02[crc ^ _mDPC_Master_Rq_AR.byte( 1 )];
            crc = crctable_profile02[crc ^ _mDPC_Master_Rq_AR.byte( 2 )];
            crc = crctable_profile02[crc ^ _mDPC_Master_Rq_AR.byte( 3 )];
            crc = crctable_profile02[crc ^ _mDPC_Master_Rq_AR.byte( 4 )];
            crc = crctable_profile02[crc ^ _mDPC_Master_Rq_AR.byte( 5 )];
            crc = crctable_profile02[crc ^ _mDPC_Master_Rq_AR.byte( 6 )];
            crc = crctable_profile02[crc ^ _mDPC_Master_Rq_AR.byte( 7 )];
            crc = crctable_profile02[crc ^ _DPC_Master_Rq_AR_CRC_Offset[ _mDPC_Master_Rq_AR.SQC_DPC_Master_Rq ] ]; // load offset
            crc = (crc ^ 0xFF);
            if( getValue(  HMI_CRC_DPC_Master_Rq_Invalid ) )
                crc++;
            _mDPC_Master_Rq_AR.CRC_DPC_Master_Rq = crc;
            putValue( HMI_CRC_DPC_Master_Rq, crc );
        }
        else
            _mDPC_Master_Rq_AR.CRC_DPC_Master_Rq = getValue( HMI_CRC_DPC_Master_Rq );
    }
    else
    {
        if( !getValue( HMI_CRC_DPC_Master_Rq_Auto ) )
        {   // CRC according to SAE1850 ( W222 )
            // berechne crc
            crc = 0xFF;
//            crc = crctable[crc ^ _mDPC_Master_Rq_AR.byte( 0 )];  CRC
            crc = crctable[crc ^ _mDPC_Master_Rq_AR.byte( 1 )];
            crc = crctable[crc ^ _mDPC_Master_Rq_AR.byte( 2 )];
            crc = crctable[crc ^ _mDPC_Master_Rq_AR.byte( 3 )];
            crc = crctable[crc ^ _mDPC_Master_Rq_AR.byte( 4 )];
            crc = crctable[crc ^ _mDPC_Master_Rq_AR.byte( 5 )];
            crc = crctable[crc ^ _mDPC_Master_Rq_AR.byte( 6 )];
            crc = crctable[crc ^ _mDPC_Master_Rq_AR.byte( 7 )];
            crc = (crc ^ 0xFF);
            if( getValue(  HMI_CRC_DPC_Master_Rq_Invalid ) )
                crc++;
            _mDPC_Master_Rq_AR.CRC_DPC_Master_Rq = crc;
            putValue( HMI_CRC_DPC_Master_Rq, crc );
        }
        else
            _mDPC_Master_Rq_AR.CRC_DPC_Master_Rq = getValue( HMI_CRC_DPC_Master_Rq );
    }
    output( _mDPC_Master_Rq_AR );
}
/*@@end*/

/*@@caplFunc:DPC_Master_Rq_AR_saveEnvVars(dword):*/
DPC_Master_Rq_AR_saveEnvVars( dword hFile )
{
    filePutString("\n// Knoten EIS: DPC_Master_Rq_AR\n", 29, hFile );
    snprintf( buffer, elcount( buffer ), "0.0000 HMI__STMSG_DPC_Master_Rq_AR := %X\n", getValue( HMI__STMSG_DPC_Master_Rq_AR ) );        filePutString ( buffer, elcount( buffer ), hFile );
    snprintf( buffer, elcount( buffer ), "0.0000 HMI__STMSGT_DPC_Master_Rq_AR := %X\n", getValue( HMI__STMSGT_DPC_Master_Rq_AR ) );        filePutString ( buffer, elcount( buffer ), hFile );
    snprintf( buffer, elcount( buffer ), "0.0000 HMI_CRC_DPC_Master_Rq := %X\n", getValue( HMI_CRC_DPC_Master_Rq ) );        filePutString ( buffer, elcount( buffer ), hFile );
    snprintf( buffer, elcount( buffer ), "0.0000 HMI_CRC_DPC_Master_Rq_Auto := %X\n", getValue( HMI_CRC_DPC_Master_Rq_Auto ) );        filePutString ( buffer, elcount( buffer ), hFile );
    snprintf( buffer, elcount( buffer ), "0.0000 HMI_DPC_GlobalMd_Rq := %X\n", getValue( HMI_DPC_GlobalMd_Rq ) );        filePutString ( buffer, elcount( buffer ), hFile );
    snprintf( buffer, elcount( buffer ), "0.0000 HMI_DPC_Md_ABC_Carv_Rq := %X\n", getValue( HMI_DPC_Md_ABC_Carv_Rq ) );        filePutString ( buffer, elcount( buffer ), hFile );
    snprintf( buffer, elcount( buffer ), "0.0000 HMI_DPC_Md_ABC_Preview_Rq := %X\n", getValue( HMI_DPC_Md_ABC_Preview_Rq ) );        filePutString ( buffer, elcount( buffer ), hFile );
    snprintf( buffer, elcount( buffer ), "0.0000 HMI_DPC_Md_AC_Rq := %X\n", getValue( HMI_DPC_Md_AC_Master_Rq ) );        filePutString ( buffer, elcount( buffer ), hFile );
    snprintf( buffer, elcount( buffer ), "0.0000 HMI_DPC_Md_AS_Rq := %X\n", getValue( HMI_DPC_Md_AS_Master_Rq ) );        filePutString ( buffer, elcount( buffer ), hFile );
    snprintf( buffer, elcount( buffer ), "0.0000 HMI_DPC_Md_ECO_Assist_Rq := %X\n", getValue( HMI_DPC_Md_ECO_Assist_Master_Rq ) );        filePutString ( buffer, elcount( buffer ), hFile );
    snprintf( buffer, elcount( buffer ), "0.0000 HMI_DPC_Md_eDrv_Rq := %X\n", getValue( HMI_DPC_Md_eDrv_Master_Rq ) );        filePutString ( buffer, elcount( buffer ), hFile );
    snprintf( buffer, elcount( buffer ), "0.0000 HMI_DPC_Md_ESP_Rq := %X\n", getValue( HMI_DPC_Md_ESP_Rq ) );        filePutString ( buffer, elcount( buffer ), hFile );
    snprintf( buffer, elcount( buffer ), "0.0000 HMI_DPC_Md_ExhstFlap_Rq := %X\n", getValue( HMI_DPC_Md_ExhstFlap_Rq ) );        filePutString ( buffer, elcount( buffer ), hFile );
    snprintf( buffer, elcount( buffer ), "0.0000 HMI_DPC_Md_Ht_Rq := %X\n", getValue( HMI_DPC_Md_Ht_Master_Rq ) );        filePutString ( buffer, elcount( buffer ), hFile );
    snprintf( buffer, elcount( buffer ), "0.0000 HMI_DPC_Md_PT_Rq := %X\n", getValue( HMI_DPC_Md_PT_Master_Rq ) );        filePutString ( buffer, elcount( buffer ), hFile );
    snprintf( buffer, elcount( buffer ), "0.0000 HMI_DPC_Md_PwrFreeD_Plus_Rq := %X\n", getValue( HMI_DPC_Md_PwrFreeD_Plus_Master_Rq ) );        filePutString ( buffer, elcount( buffer ), hFile );
    snprintf( buffer, elcount( buffer ), "0.0000 HMI_DPC_Md_SSA_Rq := %X\n", getValue( HMI_DPC_Md_SSA_Master_Rq ) );        filePutString ( buffer, elcount( buffer ), hFile );
    snprintf( buffer, elcount( buffer ), "0.0000 HMI_DPC_Md_St_Rq := %X\n", getValue( HMI_DPC_Md_St_Master_Rq ) );        filePutString ( buffer, elcount( buffer ), hFile );
    snprintf( buffer, elcount( buffer ), "0.0000 HMI_DPC_Md_Susp_Rq_V2 := %X\n", getValue( HMI_DPC_Md_Susp_Master_Rq_V2 ) );        filePutString ( buffer, elcount( buffer ), hFile );
    snprintf( buffer, elcount( buffer ), "0.0000 HMI_DPC_Md_Tx_Rq := %X\n", getValue( HMI_DPC_Md_Tx_Rq ) );        filePutString ( buffer, elcount( buffer ), hFile );
    snprintf( buffer, elcount( buffer ), "0.0000 HMI_DPC_PopupDisp_Rq := %X\n", getValue( HMI_DPC_PopupDisp_Rq ) );        filePutString ( buffer, elcount( buffer ), hFile );
    snprintf( buffer, elcount( buffer ), "0.0000 HMI_DPC_PopupSupp_Rq := %X\n", getValue( HMI_DPC_PopupSupp_Rq ) );        filePutString ( buffer, elcount( buffer ), hFile );
    snprintf( buffer, elcount( buffer ), "0.0000 HMI_Rsrv2_DPC_Master_Rq := %X\n", getValue( HMI_Rsrv2_DPC_Master_Rq ) );        filePutString ( buffer, elcount( buffer ), hFile );
    snprintf( buffer, elcount( buffer ), "0.0000 HMI_Rsrv3_DPC_Master_Rq := %X\n", getValue( HMI_Rsrv3_DPC_Master_Rq ) );        filePutString ( buffer, elcount( buffer ), hFile );
    snprintf( buffer, elcount( buffer ), "0.0000 HMI_SQC_DPC_Master_Rq := %X\n", getValue( HMI_SQC_DPC_Master_Rq ) );        filePutString ( buffer, elcount( buffer ), hFile );
    snprintf( buffer, elcount( buffer ), "0.0000 HMI_SQC_DPC_Master_Rq_Auto := %X\n", getValue( HMI_SQC_DPC_Master_Rq_Auto ) );        filePutString ( buffer, elcount( buffer ), hFile );
}
/*@@end*/

/*@@timer:_tDPC_Master_Rq_AR:*/
on timer _tDPC_Master_Rq_AR
{
    putValue( HMI__STMSG_DPC_Master_Rq_AR, 0 );
}
/*@@end*/

/*@@envVar:HMI__STMSG_DPC_Master_Rq_AR:*/
on EnvVar HMI__STMSG_DPC_Master_Rq_AR
{
    long tDelay;
    if( getValue( this ) == 2 )
    {
        tDelay = getValue( HMI__STMSGT_DPC_Master_Rq_AR );
        if( tDelay > 0)    
            setTimer( _tDPC_Master_Rq_AR, tDelay );
        else
            putValue( HMI__STMSG_DPC_Master_Rq_AR, 0 );
    }
}
/*@@end*/

/*@@envVar:HMI_DPC_GlobalMd_Rq:*/
on EnvVar HMI_DPC_GlobalMd_Rq
{
    _mDPC_Master_Rq_AR.DPC_GlobalMd_Rq.phys = getValue(this);
    _DPC_Disp_Rq_AR_SpontanFlag = 1;
}
/*@@end*/

/*@@envVar:HMI_DPC_Md_ABC_Carv_Rq:*/
on EnvVar HMI_DPC_Md_ABC_Carv_Rq
{
    _mDPC_Master_Rq_AR.DPC_Md_ABC_Carv_Rq.phys = getValue(this);
    _DPC_Master_Rq_AR_SpontanFlag = 1;
}
/*@@end*/

/*@@envVar:HMI_DPC_Md_ABC_Preview_Rq:*/
on EnvVar HMI_DPC_Md_ABC_Preview_Rq
{
    _mDPC_Master_Rq_AR.DPC_Md_ABC_Preview_Rq.phys = getValue(this);
    _DPC_Master_Rq_AR_SpontanFlag = 1;
}
/*@@end*/

/*@@envVar:HMI_DPC_Md_AC_Master_Rq:*/
on EnvVar HMI_DPC_Md_AC_Master_Rq
{
    _mDPC_Master_Rq_AR.DPC_Md_AC_Rq.phys = getValue(this);
    _DPC_Master_Rq_AR_SpontanFlag = 1;
}
/*@@end*/

/*@@envVar:HMI_DPC_Md_AS_Master_Rq:*/
on EnvVar HMI_DPC_Md_AS_Master_Rq
{
    _mDPC_Master_Rq_AR.DPC_Md_AS_Rq.phys = getValue(this);
    _DPC_Master_Rq_AR_SpontanFlag = 1;
}
/*@@end*/

/*@@envVar:HMI_DPC_Md_ECO_Assist_Master_Rq:*/
on EnvVar HMI_DPC_Md_ECO_Assist_Master_Rq
{
    _mDPC_Master_Rq_AR.DPC_Md_ECO_Assist_Rq.phys = getValue(this);
    _DPC_Master_Rq_AR_SpontanFlag = 1;
}
/*@@end*/

/*@@envVar:HMI_DPC_Md_eDrv_Master_Rq:*/
on EnvVar HMI_DPC_Md_eDrv_Master_Rq
{
    _mDPC_Master_Rq_AR.DPC_Md_eDrv_Rq.phys = getValue(this);
    _DPC_Master_Rq_AR_SpontanFlag = 1;
}
/*@@end*/

/*@@envVar:HMI_DPC_Md_ExhstFlap_Rq:*/
on EnvVar HMI_DPC_Md_ExhstFlap_Rq
{
    _mDPC_Master_Rq_AR.DPC_Md_ExhstFlap_Rq.phys = getValue(this);
    _DPC_Master_Rq_AR_SpontanFlag = 1;
}
/*@@end*/

/*@@envVar:HMI_DPC_Md_ESP_Rq:*/
on EnvVar HMI_DPC_Md_ESP_Rq
{
    _mDPC_Master_Rq_AR.DPC_Md_ESP_Rq.phys = getValue(this);
    _DPC_Master_Rq_AR_SpontanFlag = 1;
}
/*@@end*/

/*@@envVar:HMI_DPC_Md_Ht_Master_Rq:*/
on EnvVar HMI_DPC_Md_Ht_Master_Rq
{
    _mDPC_Master_Rq_AR.DPC_Md_Ht_Rq.phys = getValue(this);
    _DPC_Master_Rq_AR_SpontanFlag = 1;
}
/*@@end*/

/*@@envVar:HMI_DPC_Md_PT_Master_Rq:*/
on EnvVar HMI_DPC_Md_PT_Master_Rq
{
    _mDPC_Master_Rq_AR.DPC_Md_PT_Rq.phys = getValue(this);
    _DPC_Master_Rq_AR_SpontanFlag = 1;
}
/*@@end*/

/*@@envVar:HMI_DPC_Md_PwrFreeD_Plus_Master_Rq:*/
on EnvVar HMI_DPC_Md_PwrFreeD_Plus_Master_Rq
{
    _mDPC_Master_Rq_AR.DPC_Md_PwrFreeD_Plus_Rq.phys = getValue(this);
    _DPC_Master_Rq_AR_SpontanFlag = 1;
}
/*@@end*/

/*@@envVar:HMI_DPC_Md_SSA_Master_Rq:*/
on EnvVar HMI_DPC_Md_SSA_Master_Rq
{
    _mDPC_Master_Rq_AR.DPC_Md_SSA_Rq.phys = getValue(this);
    _DPC_Master_Rq_AR_SpontanFlag = 1;
}
/*@@end*/

/*@@envVar:HMI_DPC_Md_St_Master_Rq:*/
on EnvVar HMI_DPC_Md_St_Master_Rq
{
    _mDPC_Master_Rq_AR.DPC_Md_St_Rq.phys = getValue(this);
    _DPC_Master_Rq_AR_SpontanFlag = 1;
}
/*@@end*/

/*@@envVar:HMI_DPC_Md_Susp_Master_Rq_V2:*/
on EnvVar HMI_DPC_Md_Susp_Master_Rq_V2
{
    _mDPC_Master_Rq_AR.DPC_Md_Susp_Rq_V2.phys = getValue(this);
    _DPC_Master_Rq_AR_SpontanFlag = 1;
}
/*@@end*/

/*@@envVar:HMI_DPC_Md_Tx_Rq:*/
on EnvVar HMI_DPC_Md_Tx_Rq
{
    _mDPC_Master_Rq_AR.DPC_Md_Tx_Rq.phys = getValue(this);
    _DPC_Master_Rq_AR_SpontanFlag = 1;
}
/*@@end*/

/*@@envVar:HMI_DPC_PopupDisp_Rq:*/
on EnvVar HMI_DPC_PopupDisp_Rq
{
    _mDPC_Master_Rq_AR.DPC_PopupDisp_Rq.phys = getValue(this);
    _DPC_Master_Rq_AR_SpontanFlag = 1;
}
/*@@end*/

/*@@envVar:HMI_DPC_PopupSupp_Rq:*/
on EnvVar HMI_DPC_PopupSupp_Rq
{
    _mDPC_Master_Rq_AR.DPC_PopupSupp_Rq.phys = getValue(this);
    _DPC_Master_Rq_AR_SpontanFlag = 1;
}
/*@@end*/

/*@@envVar:HMI_Rsrv2_DPC_Master_Rq:*/
on EnvVar HMI_Rsrv2_DPC_Master_Rq
{
    _mDPC_Master_Rq_AR.Rsrv2_DPC_Master_Rq.phys = getValue(this);
    _DPC_Master_Rq_AR_SpontanFlag = 1;
}
/*@@end*/

/*@@envVar:HMI_Rsrv3_DPC_Master_Rq:*/
on EnvVar HMI_Rsrv3_DPC_Master_Rq
{
    _mDPC_Master_Rq_AR.Rsrv3_DPC_Master_Rq.phys = getValue(this);
    _DPC_Master_Rq_AR_SpontanFlag = 1;
}
/*@@end*/

/*@@caplFunc:ECO_Score_Disp_Rq_AR_check_output():*/
ECO_Score_Disp_Rq_AR_check_output()
{
    if( !getValue( HMI__STMSG_ECO_Score_Disp_Rq_AR ) )
    {
        // Botschaft ECO_Score_Disp_Rq_AR ID: 1129 --- Sendeart 0 cyclic --- 
        _ECO_Score_Disp_Rq_AR_Cnt--;
        if( _ECO_Score_Disp_Rq_AR_Cnt < 1 )
        {
            ECO_Score_Disp_Rq_AR_output(); // Nachricht wg. abgelaufenem Zyklus ausgeben
            _ECO_Score_Disp_Rq_AR_Cnt = _ECO_Score_Disp_Rq_AR_CycleCount; // Zyklus-Zähler zurücksetzen
        }
    }
}
/*@@end*/

/*@@caplFunc:ECO_Score_Disp_Rq_AR_init():*/
ECO_Score_Disp_Rq_AR_init()
{   /* Botschaft ECO_Score_Disp_Rq_AR ID: 1129 --- Sendeart 0 cyclicX --- 
BA_ "ApplMessage" BO_ 1129 0;
BA_ "NmAsrMessage" BO_ 1129 0;
BA_ "GenMsgMinAcceptLength" BO_ 1129 8;
BA_ "GenMsgILSupport" BO_ 1129 1;
BA_ "DiagState" BO_ 1129 0;
BA_ "DiagRequest" BO_ 1129 0;
BA_ "DiagResponse" BO_ 1129 0;
BA_ "GenMsgStartValue" BO_ 1129 "0";
BA_ "GenMsgStartDelayTime" BO_ 1129 0;
BA_ "GenMsgCycleTime" BO_ 1129 200;
BA_ "GenMsgSendType" BO_ 1129 0;
    */
    _ECO_Score_Disp_Rq_AR_Timebase =       c_tDBKomTimer_20ms;
    _ECO_Score_Disp_Rq_AR_CycleCount =   200 / _ECO_Score_Disp_Rq_AR_Timebase;
    _ECO_Score_Disp_Rq_AR_StartDelay =     0 / _ECO_Score_Disp_Rq_AR_Timebase;
    _ECO_Score_Disp_Rq_AR_Cnt = _ECO_Score_Disp_Rq_AR_StartDelay;
    _ECO_Score_Disp_Rq_AR_DelayCnt = 0;

    putValue( HMI__STMSGSD_ECO_Score_Disp_Rq_AR, _ECO_Score_Disp_Rq_AR_StartDelay * _ECO_Score_Disp_Rq_AR_Timebase );

    _mECO_Score_Disp_Rq_AR.ECO_Score_Accel_Disp_Rq.phys = getValue( HMI_ECO_Score_Accel_Disp_Rq );
    _mECO_Score_Disp_Rq_AR.ECO_Score_Accel_Trnd_Disp_Rq.phys = getValue( HMI_ECO_Score_Accel_Trnd_Disp_Rq );
    _mECO_Score_Disp_Rq_AR.ECO_Score_BonusRng_Disp_Rq.phys = getValue( HMI_ECO_Score_BonusRng_Disp_Rq );
    _mECO_Score_Disp_Rq_AR.ECO_Score_Const_Disp_Rq.phys = getValue( HMI_ECO_Score_Const_Disp_Rq );
    _mECO_Score_Disp_Rq_AR.ECO_Score_Const_Trnd_Disp_Rq.phys = getValue( HMI_ECO_Score_Const_Trnd_Disp_Rq );
    _mECO_Score_Disp_Rq_AR.ECO_Score_FreeWhl_Disp_Rq.phys = getValue( HMI_ECO_Score_FreeWhl_Disp_Rq );
    _mECO_Score_Disp_Rq_AR.ECO_Score_FreeWhl_Trnd_Disp_Rq.phys = getValue( HMI_ECO_Score_FreeWhl_Trnd_Disp_Rq );
    _mECO_Score_Disp_Rq_AR.ECO_Score_Total_Disp_Rq.phys = getValue( HMI_ECO_Score_Total_Disp_Rq );
}
/*@@end*/

/*@@caplFunc:ECO_Score_Disp_Rq_AR_output():*/
ECO_Score_Disp_Rq_AR_output(void)
{
    output( _mECO_Score_Disp_Rq_AR );
}
/*@@end*/

/*@@caplFunc:ECO_Score_Disp_Rq_AR_saveEnvVars(dword):*/
ECO_Score_Disp_Rq_AR_saveEnvVars( dword hFile )
{
    filePutString("\n// Knoten EIS: ECO_Score_Disp_Rq_AR\n", 25, hFile );
    snprintf( buffer, elcount( buffer ), "0.0000 HMI__STMSG_ECO_Score_Disp_Rq_AR := %X\n", getValue( HMI__STMSG_ECO_Score_Disp_Rq_AR ) );        filePutString ( buffer, elcount( buffer ), hFile );
    snprintf( buffer, elcount( buffer ), "0.0000 HMI__STMSGT_ECO_Score_Disp_Rq_AR := %X\n", getValue( HMI__STMSGT_ECO_Score_Disp_Rq_AR ) );        filePutString ( buffer, elcount( buffer ), hFile );
    snprintf( buffer, elcount( buffer ), "0.0000 HMI_ECO_Score_Accel_Disp_Rq := %X\n", getValue( HMI_ECO_Score_Accel_Disp_Rq ) );        filePutString ( buffer, elcount( buffer ), hFile );
    snprintf( buffer, elcount( buffer ), "0.0000 HMI_ECO_Score_Accel_Trnd_Disp_Rq := %X\n", getValue( HMI_ECO_Score_Accel_Trnd_Disp_Rq ) );        filePutString ( buffer, elcount( buffer ), hFile );
    snprintf( buffer, elcount( buffer ), "0.0000 HMI_ECO_Score_BonusRng_Disp_Rq := %X\n", getValue( HMI_ECO_Score_BonusRng_Disp_Rq ) );        filePutString ( buffer, elcount( buffer ), hFile );
    snprintf( buffer, elcount( buffer ), "0.0000 HMI_ECO_Score_Const_Disp_Rq := %X\n", getValue( HMI_ECO_Score_Const_Disp_Rq ) );        filePutString ( buffer, elcount( buffer ), hFile );
    snprintf( buffer, elcount( buffer ), "0.0000 HMI_ECO_Score_Const_Trnd_Disp_Rq := %X\n", getValue( HMI_ECO_Score_Const_Trnd_Disp_Rq ) );        filePutString ( buffer, elcount( buffer ), hFile );
    snprintf( buffer, elcount( buffer ), "0.0000 HMI_ECO_Score_FreeWhl_Disp_Rq := %X\n", getValue( HMI_ECO_Score_FreeWhl_Disp_Rq ) );        filePutString ( buffer, elcount( buffer ), hFile );
    snprintf( buffer, elcount( buffer ), "0.0000 HMI_ECO_Score_FreeWhl_Trnd_Disp_Rq := %X\n", getValue( HMI_ECO_Score_FreeWhl_Trnd_Disp_Rq ) );        filePutString ( buffer, elcount( buffer ), hFile );
    snprintf( buffer, elcount( buffer ), "0.0000 HMI_ECO_Score_Total_Disp_Rq := %X\n", getValue( HMI_ECO_Score_Total_Disp_Rq ) );        filePutString ( buffer, elcount( buffer ), hFile );
}
/*@@end*/

/*@@timer:_tECO_Score_Disp_Rq_AR:*/
on timer _tECO_Score_Disp_Rq_AR
{
    putValue( HMI__STMSG_ECO_Score_Disp_Rq_AR, 0 );
}
/*@@end*/

/*@@envVar:HMI__STMSG_ECO_Score_Disp_Rq_AR:*/
on EnvVar HMI__STMSG_ECO_Score_Disp_Rq_AR
{
    long tDelay;
    if( getValue( this ) == 2 )
    {
        tDelay = getValue( HMI__STMSGT_ECO_Score_Disp_Rq_AR );
        if( tDelay > 0)    
            setTimer( _tECO_Score_Disp_Rq_AR, tDelay );
        else
            putValue( HMI__STMSG_ECO_Score_Disp_Rq_AR, 0 );
    }
}
/*@@end*/

/*@@envVar:HMI_ECO_Score_Accel_Disp_Rq:*/
on EnvVar HMI_ECO_Score_Accel_Disp_Rq
{
    _mECO_Score_Disp_Rq_AR.ECO_Score_Accel_Disp_Rq.phys = getValue(this);
}
/*@@end*/

/*@@envVar:HMI_ECO_Score_Accel_Trnd_Disp_Rq:*/
on EnvVar HMI_ECO_Score_Accel_Trnd_Disp_Rq
{
    _mECO_Score_Disp_Rq_AR.ECO_Score_Accel_Trnd_Disp_Rq.phys = getValue(this);
}
/*@@end*/

/*@@envVar:HMI_ECO_Score_BonusRng_Disp_Rq:*/
on EnvVar HMI_ECO_Score_BonusRng_Disp_Rq
{
    _mECO_Score_Disp_Rq_AR.ECO_Score_BonusRng_Disp_Rq.phys = getValue(this);
}
/*@@end*/

/*@@envVar:HMI_ECO_Score_Const_Disp_Rq:*/
on EnvVar HMI_ECO_Score_Const_Disp_Rq
{
    _mECO_Score_Disp_Rq_AR.ECO_Score_Const_Disp_Rq.phys = getValue(this);
}
/*@@end*/

/*@@envVar:HMI_ECO_Score_Const_Trnd_Disp_Rq:*/
on EnvVar HMI_ECO_Score_Const_Trnd_Disp_Rq
{
    _mECO_Score_Disp_Rq_AR.ECO_Score_Const_Trnd_Disp_Rq.phys = getValue(this);
}
/*@@end*/

/*@@envVar:HMI_ECO_Score_FreeWhl_Disp_Rq:*/
on EnvVar HMI_ECO_Score_FreeWhl_Disp_Rq
{
    _mECO_Score_Disp_Rq_AR.ECO_Score_FreeWhl_Disp_Rq.phys = getValue(this);
}
/*@@end*/

/*@@envVar:HMI_ECO_Score_FreeWhl_Trnd_Disp_Rq:*/
on EnvVar HMI_ECO_Score_FreeWhl_Trnd_Disp_Rq
{
    _mECO_Score_Disp_Rq_AR.ECO_Score_FreeWhl_Trnd_Disp_Rq.phys = getValue(this);
}
/*@@end*/

/*@@envVar:HMI_ECO_Score_Total_Disp_Rq:*/
on EnvVar HMI_ECO_Score_Total_Disp_Rq
{
    _mECO_Score_Disp_Rq_AR.ECO_Score_Total_Disp_Rq.phys = getValue(this);
}
/*@@end*/

/*@@caplFunc:EL_Ft_Disp_Rq_AR_check_output():*/
EL_Ft_Disp_Rq_AR_check_output()
{
    if( !getValue( HMI__STMSG_EL_Ft_Disp_Rq_AR ) )
    {
        // Botschaft EL_Ft_Disp_Rq_AR ID: 827 --- Sendeart 5 cyclicAndSpontanWithDelay --- 
        _EL_Ft_Disp_Rq_AR_Cnt--;
        if( _EL_Ft_Disp_Rq_AR_Cnt < 1 )
        {
            // Nachricht wg. abgelaufenem Zyklus ausgeben
            EL_Ft_Disp_Rq_AR_output();
            _EL_Ft_Disp_Rq_AR_Cnt = _EL_Ft_Disp_Rq_AR_CycleCount; // Zyklus-Zähler zurücksetzen
            _EL_Ft_Disp_Rq_AR_SpontanFlag = 0; // Spontan-Flag zurücksetzen
        }
        else if( _EL_Ft_Disp_Rq_AR_SpontanFlag)
        {
            // Nachricht wg. spontaner Änderung ausgeben
            EL_Ft_Disp_Rq_AR_output();
            _EL_Ft_Disp_Rq_AR_SpontanFlag = 0; // Spontan-Flag zurücksetzen
        }
    }
}
/*@@end*/

/*@@caplFunc:EL_Ft_Disp_Rq_AR_init():*/
EL_Ft_Disp_Rq_AR_init()
{   /* Botschaft EL_Ft_Disp_Rq_AR ID: 827 --- Sendeart 5 cyclicAndSpontanWithDelay --- 
BA_ "ApplMessage" BO_ 827 0;
BA_ "NmAsrMessage" BO_ 827 0;
BA_ "GenMsgMinAcceptLength" BO_ 827 8;
BA_ "GenMsgILSupport" BO_ 827 1;
BA_ "DiagState" BO_ 827 0;
BA_ "DiagRequest" BO_ 827 0;
BA_ "DiagResponse" BO_ 827 0;
BA_ "GenMsgStartValue" BO_ 827 "0";
BA_ "GenMsgStartDelayTime" BO_ 827 0;
BA_ "GenMsgDelayTime" BO_ 827 5;
BA_ "GenMsgNrOfRepetitions" BO_ 827 0;
BA_ "GenMsgCycleTime" BO_ 827 1000;
BA_ "GenMsgSendType" BO_ 827 5;
    */
    _EL_Ft_Disp_Rq_AR_Timebase =          c_tDBKomTimer_20ms;
    _EL_Ft_Disp_Rq_AR_CycleCount =      1000 / _EL_Ft_Disp_Rq_AR_Timebase;
    _EL_Ft_Disp_Rq_AR_StartDelay =         0 / _EL_Ft_Disp_Rq_AR_Timebase;
    _EL_Ft_Disp_Rq_AR_Cnt = _EL_Ft_Disp_Rq_AR_StartDelay;
    _EL_Ft_Disp_Rq_AR_SpontanFlag = 0;

    putValue( HMI__STMSGSD_EL_Ft_Disp_Rq_AR, _EL_Ft_Disp_Rq_AR_StartDelay * _EL_Ft_Disp_Rq_AR_Timebase );

    _mEL_Ft_Disp_Rq_AR.DRL_Lt_Flt.phys = getValue( HMI_DRL_Lt_Flt );
    _mEL_Ft_Disp_Rq_AR.DRL_Rt_Flt.phys = getValue( HMI_DRL_Rt_Flt );
    _mEL_Ft_Disp_Rq_AR.EF_Flt.phys = getValue( HMI_EF_Flt );
    _mEL_Ft_Disp_Rq_AR.EmgLgtPath_Flt_BC_F.phys = getValue( HMI_EmgLgtPath_Flt_BC_F );
    _mEL_Ft_Disp_Rq_AR.ExtLmp_IC_Disp_On_Rq.phys = getValue( HMI_ExtLmp_IC_Disp_On_Rq );
    _mEL_Ft_Disp_Rq_AR.ExtLmp_RLS_Warn_Rq.phys = getValue( HMI_ExtLmp_RLS_Warn_Rq );
    _mEL_Ft_Disp_Rq_AR.FogLmp_FL_Flt.phys = getValue( HMI_FogLmp_FL_Flt );
    _mEL_Ft_Disp_Rq_AR.FogLmp_FR_Flt.phys = getValue( HMI_FogLmp_FR_Flt );
    _mEL_Ft_Disp_Rq_AR.HiBm_Lt_Flt.phys = getValue( HMI_HiBm_Lt_Flt );
    _mEL_Ft_Disp_Rq_AR.HiBm_Rt_Flt.phys = getValue( HMI_HiBm_Rt_Flt );
    _mEL_Ft_Disp_Rq_AR.IHC_Actv.phys = getValue( HMI_IHC_Actv );
    _mEL_Ft_Disp_Rq_AR.IHC_FltDisp_Rq.phys = getValue( HMI_IHC_FltDisp_Rq );
    _mEL_Ft_Disp_Rq_AR.IHC_Menu_Rq.phys = getValue( HMI_IHC_Menu_Rq );
    _mEL_Ft_Disp_Rq_AR.IrLmp_Lt_Flt.phys = getValue( HMI_IrLmp_Lt_Flt );
    _mEL_Ft_Disp_Rq_AR.IrLmp_Rt_Flt.phys = getValue( HMI_IrLmp_Rt_Flt );
    _mEL_Ft_Disp_Rq_AR.LoBm_Lt_Flt.phys = getValue( HMI_LoBm_Lt_Flt );
    _mEL_Ft_Disp_Rq_AR.LoBm_Rt_Flt.phys = getValue( HMI_LoBm_Rt_Flt );
    _mEL_Ft_Disp_Rq_AR.NS_IllDur_Cfg_Stat.phys = getValue( HMI_NS_IllDur_Cfg_Stat );
    _mEL_Ft_Disp_Rq_AR.PkLmp_FL_Flt.phys = getValue( HMI_PkLmp_FL_Flt );
    _mEL_Ft_Disp_Rq_AR.PkLmp_FR_Flt.phys = getValue( HMI_PkLmp_FR_Flt );
    _mEL_Ft_Disp_Rq_AR.Rsrv1_EL_Ft_FltDisp_Rq.phys = getValue( HMI_Rsrv1_EL_Ft_FltDisp_Rq );
    _mEL_Ft_Disp_Rq_AR.SM_FL_Flt.phys = getValue( HMI_SM_FL_Flt );
    _mEL_Ft_Disp_Rq_AR.SM_FR_Flt.phys = getValue( HMI_SM_FR_Flt );
    _mEL_Ft_Disp_Rq_AR.SurrIll_Cfg_Stat.phys = getValue( HMI_SurrIll_Cfg_Stat );
    _mEL_Ft_Disp_Rq_AR.TM_Timeout_Flt.phys = getValue( HMI_TM_Timeout_Flt );
    _mEL_Ft_Disp_Rq_AR.TurnLmp_FL_Flt.phys = getValue( HMI_TurnLmp_FL_Flt );
    _mEL_Ft_Disp_Rq_AR.TurnLmp_FR_Flt.phys = getValue( HMI_TurnLmp_FR_Flt );
    _mEL_Ft_Disp_Rq_AR.TurnLmp_R_Flt.phys = getValue( HMI_TurnLmp_R_Flt );
    _mEL_Ft_Disp_Rq_AR.TurnLmp_R_Flt_TM.phys = getValue( HMI_TurnLmp_R_Flt_TM );
    _mEL_Ft_Disp_Rq_AR.VCS_Flt.phys = getValue( HMI_VCS_Flt );
}
/*@@end*/

/*@@caplFunc:EL_Ft_Disp_Rq_AR_output():*/
void EL_Ft_Disp_Rq_AR_output(void)
{
    byte crc;
    byte SQC_help;

    if( !getValue( HMI_SQC_EL_Ft_FltDisp_Rq_Auto ) )
    {
        // berechne message counter
        SQC_help = getValue( HMI_SQC_EL_Ft_FltDisp_Rq );
        if( SQC_help >= 15 ) SQC_help = 0;
        else SQC_help++;
        putValue( HMI_SQC_EL_Ft_FltDisp_Rq, SQC_help );
        _mEL_Ft_Disp_Rq_AR.SQC_EL_Ft_FltDisp_Rq = SQC_help;
    }
    else
          _mEL_Ft_Disp_Rq_AR.SQC_EL_Ft_FltDisp_Rq = getValue( HMI_SQC_EL_Ft_FltDisp_Rq );

    if( getValue( HMI_CRC_EL_Ft_FltDisp_Rq_Profile_02 ) )
    {
        if( !getValue( HMI_CRC_EL_Ft_FltDisp_Rq_Auto ) )
        {   // CRC according Profile_02 ( W213 )
            // berechne crc
            crc = 0xFF;
//            crc = crctable_profile02[crc ^ _mEL_Ft_Disp_Rq_AR.byte( 0 )];  CRC
            crc = crctable_profile02[crc ^ _mEL_Ft_Disp_Rq_AR.byte( 1 )];
            crc = crctable_profile02[crc ^ _mEL_Ft_Disp_Rq_AR.byte( 2 )];
            crc = crctable_profile02[crc ^ _mEL_Ft_Disp_Rq_AR.byte( 3 )];
            crc = crctable_profile02[crc ^ _mEL_Ft_Disp_Rq_AR.byte( 4 )];
//            crc = crctable_profile02[crc ^ _mEL_Ft_Disp_Rq_AR.byte( 5 )];
//            crc = crctable_profile02[crc ^ _mEL_Ft_Disp_Rq_AR.byte( 6 )];
//            crc = crctable_profile02[crc ^ _mEL_Ft_Disp_Rq_AR.byte( 7 )];
            crc = crctable_profile02[crc ^ _EL_Ft_Disp_Rq_AR_CRC_Offset[ _mEL_Ft_Disp_Rq_AR.SQC_EL_Ft_FltDisp_Rq ] ]; // load offset
            crc = (crc ^ 0xFF);
            if( getValue(  HMI_CRC_EL_Ft_FltDisp_Rq_Invalid ) )
                crc++;
            _mEL_Ft_Disp_Rq_AR.CRC_EL_Ft_FltDisp_Rq = crc;
            putValue( HMI_CRC_EL_Ft_FltDisp_Rq, crc );
        }
        else
            _mEL_Ft_Disp_Rq_AR.CRC_EL_Ft_FltDisp_Rq = getValue( HMI_CRC_EL_Ft_FltDisp_Rq );
    }
    // no CRC for W222 / 205
    output( _mEL_Ft_Disp_Rq_AR );
}
/*@@end*/

/*@@caplFunc:EL_Ft_Disp_Rq_AR_saveEnvVars(dword):*/
EL_Ft_Disp_Rq_AR_saveEnvVars( dword hFile )
{
    filePutString("\n// Knoten EIS: EL_Ft_Disp_Rq_AR\n", 30, hFile );
    snprintf( buffer, elcount( buffer ), "0.0000 HMI__STMSG_EL_Ft_Disp_Rq_AR := %X\n", getValue( HMI__STMSG_EL_Ft_Disp_Rq_AR ) );        filePutString ( buffer, elcount( buffer ), hFile );
    snprintf( buffer, elcount( buffer ), "0.0000 HMI__STMSGT_EL_Ft_Disp_Rq_AR := %X\n", getValue( HMI__STMSGT_EL_Ft_Disp_Rq_AR ) );        filePutString ( buffer, elcount( buffer ), hFile );
    snprintf( buffer, elcount( buffer ), "0.0000 HMI_CRC_EL_Ft_FltDisp_Rq := %X\n", getValue( HMI_CRC_EL_Ft_FltDisp_Rq ) );        filePutString ( buffer, elcount( buffer ), hFile );
    snprintf( buffer, elcount( buffer ), "0.0000 HMI_CRC_EL_Ft_FltDisp_Rq_Auto := %X\n", getValue( HMI_CRC_EL_Ft_FltDisp_Rq_Auto ) );        filePutString ( buffer, elcount( buffer ), hFile );
    snprintf( buffer, elcount( buffer ), "0.0000 HMI_CRC_EL_Ft_FltDisp_Rq_Profile_02 := %X\n", getValue( HMI_CRC_EL_Ft_FltDisp_Rq_Profile_02 ) );        filePutString ( buffer, elcount( buffer ), hFile );
    snprintf( buffer, elcount( buffer ), "0.0000 HMI_DRL_Lt_Flt := %X\n", getValue( HMI_DRL_Lt_Flt ) );        filePutString ( buffer, elcount( buffer ), hFile );
    snprintf( buffer, elcount( buffer ), "0.0000 HMI_DRL_Rt_Flt := %X\n", getValue( HMI_DRL_Rt_Flt ) );        filePutString ( buffer, elcount( buffer ), hFile );
    snprintf( buffer, elcount( buffer ), "0.0000 HMI_EF_Flt := %X\n", getValue( HMI_EF_Flt ) );        filePutString ( buffer, elcount( buffer ), hFile );
    snprintf( buffer, elcount( buffer ), "0.0000 HMI_EmgLgtPath_Flt_BC_F := %X\n", getValue( HMI_EmgLgtPath_Flt_BC_F ) );        filePutString ( buffer, elcount( buffer ), hFile );
    snprintf( buffer, elcount( buffer ), "0.0000 HMI_ExtLmp_IC_Disp_On_Rq := %X\n", getValue( HMI_ExtLmp_IC_Disp_On_Rq ) );        filePutString ( buffer, elcount( buffer ), hFile );
    snprintf( buffer, elcount( buffer ), "0.0000 HMI_ExtLmp_RLS_Warn_Rq := %X\n", getValue( HMI_ExtLmp_RLS_Warn_Rq ) );        filePutString ( buffer, elcount( buffer ), hFile );
    snprintf( buffer, elcount( buffer ), "0.0000 HMI_FogLmp_FL_Flt := %X\n", getValue( HMI_FogLmp_FL_Flt ) );        filePutString ( buffer, elcount( buffer ), hFile );
    snprintf( buffer, elcount( buffer ), "0.0000 HMI_FogLmp_FR_Flt := %X\n", getValue( HMI_FogLmp_FR_Flt ) );        filePutString ( buffer, elcount( buffer ), hFile );
    snprintf( buffer, elcount( buffer ), "0.0000 HMI_HiBm_Lt_Flt := %X\n", getValue( HMI_HiBm_Lt_Flt ) );        filePutString ( buffer, elcount( buffer ), hFile );
    snprintf( buffer, elcount( buffer ), "0.0000 HMI_HiBm_Rt_Flt := %X\n", getValue( HMI_HiBm_Rt_Flt ) );        filePutString ( buffer, elcount( buffer ), hFile );
    snprintf( buffer, elcount( buffer ), "0.0000 HMI_IHC_Actv := %X\n", getValue( HMI_IHC_Actv ) );        filePutString ( buffer, elcount( buffer ), hFile );
    snprintf( buffer, elcount( buffer ), "0.0000 HMI_IHC_FltDisp_Rq := %X\n", getValue( HMI_IHC_FltDisp_Rq ) );        filePutString ( buffer, elcount( buffer ), hFile );
    snprintf( buffer, elcount( buffer ), "0.0000 HMI_IHC_Menu_Rq := %X\n", getValue( HMI_IHC_Menu_Rq ) );        filePutString ( buffer, elcount( buffer ), hFile );
    snprintf( buffer, elcount( buffer ), "0.0000 HMI_IrLmp_Lt_Flt := %X\n", getValue( HMI_IrLmp_Lt_Flt ) );        filePutString ( buffer, elcount( buffer ), hFile );
    snprintf( buffer, elcount( buffer ), "0.0000 HMI_IrLmp_Rt_Flt := %X\n", getValue( HMI_IrLmp_Rt_Flt ) );        filePutString ( buffer, elcount( buffer ), hFile );
    snprintf( buffer, elcount( buffer ), "0.0000 HMI_LoBm_Lt_Flt := %X\n", getValue( HMI_LoBm_Lt_Flt ) );        filePutString ( buffer, elcount( buffer ), hFile );
    snprintf( buffer, elcount( buffer ), "0.0000 HMI_LoBm_Rt_Flt := %X\n", getValue( HMI_LoBm_Rt_Flt ) );        filePutString ( buffer, elcount( buffer ), hFile );
    snprintf( buffer, elcount( buffer ), "0.0000 HMI_NS_IllDur_Cfg_Stat := %X\n", getValue( HMI_NS_IllDur_Cfg_Stat ) );        filePutString ( buffer, elcount( buffer ), hFile );
    snprintf( buffer, elcount( buffer ), "0.0000 HMI_PkLmp_FL_Flt := %X\n", getValue( HMI_PkLmp_FL_Flt ) );        filePutString ( buffer, elcount( buffer ), hFile );
    snprintf( buffer, elcount( buffer ), "0.0000 HMI_PkLmp_FR_Flt := %X\n", getValue( HMI_PkLmp_FR_Flt ) );        filePutString ( buffer, elcount( buffer ), hFile );
    snprintf( buffer, elcount( buffer ), "0.0000 HMI_Rsrv1_EL_Ft_FltDisp_Rq := %X\n", getValue( HMI_Rsrv1_EL_Ft_FltDisp_Rq ) );        filePutString ( buffer, elcount( buffer ), hFile );
    snprintf( buffer, elcount( buffer ), "0.0000 HMI_SM_FL_Flt := %X\n", getValue( HMI_SM_FL_Flt ) );        filePutString ( buffer, elcount( buffer ), hFile );
    snprintf( buffer, elcount( buffer ), "0.0000 HMI_SM_FR_Flt := %X\n", getValue( HMI_SM_FR_Flt ) );        filePutString ( buffer, elcount( buffer ), hFile );
    snprintf( buffer, elcount( buffer ), "0.0000 HMI_SQC_EL_Ft_FltDisp_Rq := %X\n", getValue( HMI_SQC_EL_Ft_FltDisp_Rq ) );        filePutString ( buffer, elcount( buffer ), hFile );
    snprintf( buffer, elcount( buffer ), "0.0000 HMI_SQC_EL_Ft_FltDisp_Rq_Auto := %X\n", getValue( HMI_SQC_EL_Ft_FltDisp_Rq_Auto ) );        filePutString ( buffer, elcount( buffer ), hFile );
    snprintf( buffer, elcount( buffer ), "0.0000 HMI_SurrIll_Cfg_Stat := %X\n", getValue( HMI_SurrIll_Cfg_Stat ) );        filePutString ( buffer, elcount( buffer ), hFile );
    snprintf( buffer, elcount( buffer ), "0.0000 HMI_TM_Timeout_Flt := %X\n", getValue( HMI_TM_Timeout_Flt ) );        filePutString ( buffer, elcount( buffer ), hFile );
    snprintf( buffer, elcount( buffer ), "0.0000 HMI_TurnLmp_FL_Flt := %X\n", getValue( HMI_TurnLmp_FL_Flt ) );        filePutString ( buffer, elcount( buffer ), hFile );
    snprintf( buffer, elcount( buffer ), "0.0000 HMI_TurnLmp_FR_Flt := %X\n", getValue( HMI_TurnLmp_FR_Flt ) );        filePutString ( buffer, elcount( buffer ), hFile );
    snprintf( buffer, elcount( buffer ), "0.0000 HMI_TurnLmp_R_Flt := %X\n", getValue( HMI_TurnLmp_R_Flt ) );        filePutString ( buffer, elcount( buffer ), hFile );
    snprintf( buffer, elcount( buffer ), "0.0000 HMI_TurnLmp_R_Flt_TM := %X\n", getValue( HMI_TurnLmp_R_Flt_TM ) );        filePutString ( buffer, elcount( buffer ), hFile );
    snprintf( buffer, elcount( buffer ), "0.0000 HMI_VCS_Flt := %X\n", getValue( HMI_VCS_Flt ) );        filePutString ( buffer, elcount( buffer ), hFile );
}
/*@@end*/

/*@@timer:_tEL_Ft_Disp_Rq_AR:*/
on timer _tEL_Ft_Disp_Rq_AR
{
    putValue( HMI__STMSG_EL_Ft_Disp_Rq_AR, 0 );
}
/*@@end*/

/*@@envVar:HMI__STMSG_EL_Ft_Disp_Rq_AR:*/
on EnvVar HMI__STMSG_EL_Ft_Disp_Rq_AR
{
    long tDelay;
    if( getValue( this ) == 2 )
    {
        tDelay = getValue( HMI__STMSGT_EL_Ft_Disp_Rq_AR );
        if( tDelay > 0)    
            setTimer( _tEL_Ft_Disp_Rq_AR, tDelay );
        else
            putValue( HMI__STMSG_EL_Ft_Disp_Rq_AR, 0 );
    }
}
/*@@end*/

/*@@envVar:HMI_DRL_Lt_Flt:*/
on EnvVar HMI_DRL_Lt_Flt
{
    _mEL_Ft_Disp_Rq_AR.DRL_Lt_Flt.phys = getValue(this);
    _EL_Ft_Disp_Rq_AR_SpontanFlag = 1;
}
/*@@end*/

/*@@envVar:HMI_DRL_Rt_Flt:*/
on EnvVar HMI_DRL_Rt_Flt
{
    _mEL_Ft_Disp_Rq_AR.DRL_Rt_Flt.phys = getValue(this);
    _EL_Ft_Disp_Rq_AR_SpontanFlag = 1;
}
/*@@end*/

/*@@envVar:HMI_EF_Flt:*/
on EnvVar HMI_EF_Flt
{
    _mEL_Ft_Disp_Rq_AR.EF_Flt.phys = getValue(this);
    _EL_Ft_Disp_Rq_AR_SpontanFlag = 1;
}
/*@@end*/

/*@@envVar:HMI_EmgLgtPath_Flt_BC_F:*/
on EnvVar HMI_EmgLgtPath_Flt_BC_F
{
    _mEL_Ft_Disp_Rq_AR.EmgLgtPath_Flt_BC_F.phys = getValue(this);
    _EL_Ft_Disp_Rq_AR_SpontanFlag = 1;
}
/*@@end*/

/*@@envVar:HMI_ExtLmp_IC_Disp_On_Rq:*/
on EnvVar HMI_ExtLmp_IC_Disp_On_Rq
{
    _mEL_Ft_Disp_Rq_AR.ExtLmp_IC_Disp_On_Rq.phys = getValue(this);
    _EL_Ft_Disp_Rq_AR_SpontanFlag = 1;
}
/*@@end*/

/*@@envVar:HMI_ExtLmp_RLS_Warn_Rq:*/
on EnvVar HMI_ExtLmp_RLS_Warn_Rq
{
    _mEL_Ft_Disp_Rq_AR.ExtLmp_RLS_Warn_Rq.phys = getValue(this);
    _EL_Ft_Disp_Rq_AR_SpontanFlag = 1;
}
/*@@end*/

/*@@envVar:HMI_FogLmp_FL_Flt:*/
on EnvVar HMI_FogLmp_FL_Flt
{
    _mEL_Ft_Disp_Rq_AR.FogLmp_FL_Flt.phys = getValue(this);
    _EL_Ft_Disp_Rq_AR_SpontanFlag = 1;
}
/*@@end*/

/*@@envVar:HMI_FogLmp_FR_Flt:*/
on EnvVar HMI_FogLmp_FR_Flt
{
    _mEL_Ft_Disp_Rq_AR.FogLmp_FR_Flt.phys = getValue(this);
    _EL_Ft_Disp_Rq_AR_SpontanFlag = 1;
}
/*@@end*/

/*@@envVar:HMI_HiBm_Lt_Flt:*/
on EnvVar HMI_HiBm_Lt_Flt
{
    _mEL_Ft_Disp_Rq_AR.HiBm_Lt_Flt.phys = getValue(this);
    _EL_Ft_Disp_Rq_AR_SpontanFlag = 1;
}
/*@@end*/

/*@@envVar:HMI_HiBm_Rt_Flt:*/
on EnvVar HMI_HiBm_Rt_Flt
{
    _mEL_Ft_Disp_Rq_AR.HiBm_Rt_Flt.phys = getValue(this);
    _EL_Ft_Disp_Rq_AR_SpontanFlag = 1;
}
/*@@end*/

/*@@envVar:HMI_IHC_Actv:*/
on EnvVar HMI_IHC_Actv
{
    _mEL_Ft_Disp_Rq_AR.IHC_Actv.phys = getValue(this);
    _EL_Ft_Disp_Rq_AR_SpontanFlag = 1;
}
/*@@end*/

/*@@envVar:HMI_IHC_FltDisp_Rq:*/
on EnvVar HMI_IHC_FltDisp_Rq
{
    _mEL_Ft_Disp_Rq_AR.IHC_FltDisp_Rq.phys = getValue(this);
    _EL_Ft_Disp_Rq_AR_SpontanFlag = 1;
}
/*@@end*/

/*@@envVar:HMI_IHC_Menu_Rq:*/
on EnvVar HMI_IHC_Menu_Rq
{
    _mEL_Ft_Disp_Rq_AR.IHC_Menu_Rq.phys = getValue(this);
    _EL_Ft_Disp_Rq_AR_SpontanFlag = 1;
}
/*@@end*/

/*@@envVar:HMI_IrLmp_Lt_Flt:*/
on EnvVar HMI_IrLmp_Lt_Flt
{
    _mEL_Ft_Disp_Rq_AR.IrLmp_Lt_Flt.phys = getValue(this);
    _EL_Ft_Disp_Rq_AR_SpontanFlag = 1;
}
/*@@end*/

/*@@envVar:HMI_IrLmp_Rt_Flt:*/
on EnvVar HMI_IrLmp_Rt_Flt
{
    _mEL_Ft_Disp_Rq_AR.IrLmp_Rt_Flt.phys = getValue(this);
    _EL_Ft_Disp_Rq_AR_SpontanFlag = 1;
}
/*@@end*/

/*@@envVar:HMI_LoBm_Lt_Flt:*/
on EnvVar HMI_LoBm_Lt_Flt
{
    _mEL_Ft_Disp_Rq_AR.LoBm_Lt_Flt.phys = getValue(this);
    _EL_Ft_Disp_Rq_AR_SpontanFlag = 1;
}
/*@@end*/

/*@@envVar:HMI_LoBm_Rt_Flt:*/
on EnvVar HMI_LoBm_Rt_Flt
{
    _mEL_Ft_Disp_Rq_AR.LoBm_Rt_Flt.phys = getValue(this);
    _EL_Ft_Disp_Rq_AR_SpontanFlag = 1;
}
/*@@end*/

/*@@envVar:HMI_NS_IllDur_Cfg_Stat:*/
on EnvVar HMI_NS_IllDur_Cfg_Stat
{
    _mEL_Ft_Disp_Rq_AR.NS_IllDur_Cfg_Stat.phys = getValue(this);
    _EL_Ft_Disp_Rq_AR_SpontanFlag = 1;
}
/*@@end*/

/*@@envVar:HMI_PkLmp_FL_Flt:*/
on EnvVar HMI_PkLmp_FL_Flt
{
    _mEL_Ft_Disp_Rq_AR.PkLmp_FL_Flt.phys = getValue(this);
    _EL_Ft_Disp_Rq_AR_SpontanFlag = 1;
}
/*@@end*/

/*@@envVar:HMI_PkLmp_FR_Flt:*/
on EnvVar HMI_PkLmp_FR_Flt
{
    _mEL_Ft_Disp_Rq_AR.PkLmp_FR_Flt.phys = getValue(this);
    _EL_Ft_Disp_Rq_AR_SpontanFlag = 1;
}
/*@@end*/

/*@@envVar:HMI_SM_FL_Flt:*/
on EnvVar HMI_SM_FL_Flt
{
    _mEL_Ft_Disp_Rq_AR.SM_FL_Flt.phys = getValue(this);
    _EL_Ft_Disp_Rq_AR_SpontanFlag = 1;
}
/*@@end*/

/*@@envVar:HMI_SM_FR_Flt:*/
on EnvVar HMI_SM_FR_Flt
{
    _mEL_Ft_Disp_Rq_AR.SM_FR_Flt.phys = getValue(this);
    _EL_Ft_Disp_Rq_AR_SpontanFlag = 1;
}
/*@@end*/

/*@@envVar:HMI_SurrIll_Cfg_Stat:*/
on EnvVar HMI_SurrIll_Cfg_Stat
{
    _mEL_Ft_Disp_Rq_AR.SurrIll_Cfg_Stat.phys = getValue(this);
    _EL_Ft_Disp_Rq_AR_SpontanFlag = 1;
}
/*@@end*/

/*@@envVar:HMI_TM_Timeout_Flt:*/
on EnvVar HMI_TM_Timeout_Flt
{
    _mEL_Ft_Disp_Rq_AR.TM_Timeout_Flt.phys = getValue(this);
    _EL_Ft_Disp_Rq_AR_SpontanFlag = 1;
}
/*@@end*/

/*@@envVar:HMI_TurnLmp_FL_Flt:*/
on EnvVar HMI_TurnLmp_FL_Flt
{
    _mEL_Ft_Disp_Rq_AR.TurnLmp_FL_Flt.phys = getValue(this);
    _EL_Ft_Disp_Rq_AR_SpontanFlag = 1;
}
/*@@end*/

/*@@envVar:HMI_TurnLmp_FR_Flt:*/
on EnvVar HMI_TurnLmp_FR_Flt
{
    _mEL_Ft_Disp_Rq_AR.TurnLmp_FR_Flt.phys = getValue(this);
    _EL_Ft_Disp_Rq_AR_SpontanFlag = 1;
}
/*@@end*/

/*@@envVar:HMI_TurnLmp_R_Flt:*/
on EnvVar HMI_TurnLmp_R_Flt
{
    _mEL_Ft_Disp_Rq_AR.TurnLmp_R_Flt.phys = getValue(this);
    _EL_Ft_Disp_Rq_AR_SpontanFlag = 1;
}
/*@@end*/

/*@@envVar:HMI_TurnLmp_R_Flt_TM:*/
on EnvVar HMI_TurnLmp_R_Flt_TM
{
    _mEL_Ft_Disp_Rq_AR.TurnLmp_R_Flt_TM.phys = getValue(this);
    _EL_Ft_Disp_Rq_AR_SpontanFlag = 1;
}
/*@@end*/

/*@@envVar:HMI_VCS_Flt:*/
on EnvVar HMI_VCS_Flt
{
    _mEL_Ft_Disp_Rq_AR.VCS_Flt.phys = getValue(this);
    _EL_Ft_Disp_Rq_AR_SpontanFlag = 1;
}
/*@@end*/

/*@@caplFunc:EL_R_Disp_Rq_AR_check_output():*/
EL_R_Disp_Rq_AR_check_output()
{
    if( !getValue( HMI__STMSG_EL_R_Disp_Rq_AR ) )
    {
        // Botschaft EL_R_Disp_Rq_AR ID: 897 --- Sendeart 5 cyclicAndSpontanWithDelay --- 
        _EL_R_Disp_Rq_AR_Cnt--;
        if( _EL_R_Disp_Rq_AR_Cnt < 1 )
        {
            // Nachricht wg. abgelaufenem Zyklus ausgeben
            EL_R_Disp_Rq_AR_output();
            _EL_R_Disp_Rq_AR_Cnt = _EL_R_Disp_Rq_AR_CycleCount; // Zyklus-Zähler zurücksetzen
            _EL_R_Disp_Rq_AR_SpontanFlag = 0; // Spontan-Flag zurücksetzen
        }
        else if( _EL_R_Disp_Rq_AR_SpontanFlag)
        {
            // Nachricht wg. spontaner Änderung ausgeben
            EL_R_Disp_Rq_AR_output();
            _EL_R_Disp_Rq_AR_SpontanFlag = 0; // Spontan-Flag zurücksetzen
        }
    }
}
/*@@end*/

/*@@caplFunc:EL_R_Disp_Rq_AR_init():*/
EL_R_Disp_Rq_AR_init()
{   /* Botschaft EL_R_Disp_Rq_AR ID: 897 --- Sendeart 5 cyclicAndSpontanWithDelay --- 
BA_ "ApplMessage" BO_ 897 0;
BA_ "NmAsrMessage" BO_ 897 0;
BA_ "GenMsgMinAcceptLength" BO_ 897 8;
BA_ "GenMsgILSupport" BO_ 897 1;
BA_ "DiagState" BO_ 897 0;
BA_ "DiagRequest" BO_ 897 0;
BA_ "DiagResponse" BO_ 897 0;
BA_ "GenMsgStartValue" BO_ 897 "0";
BA_ "GenMsgStartDelayTime" BO_ 897 0;
BA_ "GenMsgDelayTime" BO_ 897 5;
BA_ "GenMsgNrOfRepetitions" BO_ 897 0;
BA_ "GenMsgCycleTime" BO_ 897 200;
BA_ "GenMsgSendType" BO_ 897 5;
    */
    _EL_R_Disp_Rq_AR_Timebase =          c_tDBKomTimer_20ms;
    _EL_R_Disp_Rq_AR_CycleCount =       200 / _EL_R_Disp_Rq_AR_Timebase;
    _EL_R_Disp_Rq_AR_StartDelay =         0 / _EL_R_Disp_Rq_AR_Timebase;
    _EL_R_Disp_Rq_AR_Cnt = _EL_R_Disp_Rq_AR_StartDelay;
    _EL_R_Disp_Rq_AR_SpontanFlag = 0;

    putValue( HMI__STMSGSD_EL_R_Disp_Rq_AR, _EL_R_Disp_Rq_AR_StartDelay * _EL_R_Disp_Rq_AR_Timebase );

    _mEL_R_Disp_Rq_AR.BrkLmp3_Flt.phys = getValue( HMI_BrkLmp3_Flt );
    _mEL_R_Disp_Rq_AR.BrkLmp_Lt_Flt.phys = getValue( HMI_BrkLmp_Lt_Flt );
    _mEL_R_Disp_Rq_AR.BrkLmp_Rt_Flt.phys = getValue( HMI_BrkLmp_Rt_Flt );
    _mEL_R_Disp_Rq_AR.BrkTlLmp_Lt_Flt.phys = getValue( HMI_BrkTlLmp_Lt_Flt );
    _mEL_R_Disp_Rq_AR.BrkTlLmp_Rt_Flt.phys = getValue( HMI_BrkTlLmp_Rt_Flt );
    _mEL_R_Disp_Rq_AR.BuLmp_Lt_Flt.phys = getValue( HMI_BuLmp_Lt_Flt );
    _mEL_R_Disp_Rq_AR.BuLmp_Rt_Flt.phys = getValue( HMI_BuLmp_Rt_Flt );
    _mEL_R_Disp_Rq_AR.EmgLgtPath_Flt_SAM_R.phys = getValue( HMI_EmgLgtPath_Flt_SAM_R );
    _mEL_R_Disp_Rq_AR.FogLmp_RL_Flt.phys = getValue( HMI_FogLmp_RL_Flt );
    _mEL_R_Disp_Rq_AR.FogLmp_RR_Flt.phys = getValue( HMI_FogLmp_RR_Flt );
    _mEL_R_Disp_Rq_AR.LP_Lmp_Lt_Flt.phys = getValue( HMI_LP_Lmp_Lt_Flt );
    _mEL_R_Disp_Rq_AR.LP_Lmp_Rt_Flt.phys = getValue( HMI_LP_Lmp_Rt_Flt );
    _mEL_R_Disp_Rq_AR.Rsrv1_EL_R_FltDisp_Rq.phys = getValue( HMI_Rsrv1_EL_R_FltDisp_Rq );
    _mEL_R_Disp_Rq_AR.SM_RL_Flt.phys = getValue( HMI_SM_RL_Flt );
    _mEL_R_Disp_Rq_AR.SM_RR_Flt.phys = getValue( HMI_SM_RR_Flt );
    _mEL_R_Disp_Rq_AR.SVS_ExtLmp_Stat.phys = getValue( HMI_SVS_ExtLmp_Stat );
    _mEL_R_Disp_Rq_AR.Term54_Flt_BC_R.phys = getValue( HMI_Term54_Flt_BC_R );
    _mEL_R_Disp_Rq_AR.TlLmp_Lt_Flt.phys = getValue( HMI_TlLmp_Lt_Flt );
    _mEL_R_Disp_Rq_AR.TlLmp_Rt_Flt.phys = getValue( HMI_TlLmp_Rt_Flt );
    _mEL_R_Disp_Rq_AR.TurnLmp_RL_Flt.phys = getValue( HMI_TurnLmp_RL_Flt );
    _mEL_R_Disp_Rq_AR.TurnLmp_RR_Flt.phys = getValue( HMI_TurnLmp_RR_Flt );
}
/*@@end*/

/*@@caplFunc:EL_R_Disp_Rq_AR_output():*/
void EL_R_Disp_Rq_AR_output(void)
{
    byte crc;
    byte SQC_help;

    if( !getValue( HMI_SQC_EL_R_FltDisp_Rq_Auto ) )
    {
        // berechne message counter
        SQC_help = getValue( HMI_SQC_EL_R_FltDisp_Rq );
        if( SQC_help >= 15 ) SQC_help = 0;
        else SQC_help++;
        putValue( HMI_SQC_EL_R_FltDisp_Rq, SQC_help );
        _mEL_R_Disp_Rq_AR.SQC_EL_R_FltDisp_Rq = SQC_help;
    }
    else
          _mEL_R_Disp_Rq_AR.SQC_EL_R_FltDisp_Rq = getValue( HMI_SQC_EL_R_FltDisp_Rq );

    if( getValue( HMI_CRC_EL_R_FltDisp_Rq_Profile_02 ) )
    {
        if( !getValue( HMI_CRC_EL_R_FltDisp_Rq_Auto ) )
        {   // CRC according Profile_02 ( W213 )
            // berechne crc
            crc = 0xFF;
//            crc = crctable_profile02[crc ^ _mEL_R_Disp_Rq_AR.byte( 1 )];  CRC
            crc = crctable_profile02[crc ^ _mEL_R_Disp_Rq_AR.byte( 1 )];
            crc = crctable_profile02[crc ^ _mEL_R_Disp_Rq_AR.byte( 2 )];
            crc = crctable_profile02[crc ^ _mEL_R_Disp_Rq_AR.byte( 3 )];
//            crc = crctable_profile02[crc ^ _mEL_R_Disp_Rq_AR.byte( 4 )];
//            crc = crctable_profile02[crc ^ _mEL_R_Disp_Rq_AR.byte( 5 )];
//            crc = crctable_profile02[crc ^ _mEL_R_Disp_Rq_AR.byte( 6 )];
//            crc = crctable_profile02[crc ^ _mEL_R_Disp_Rq_AR.byte( 7 )];
            crc = crctable_profile02[crc ^ _EL_R_Disp_Rq_AR_CRC_Offset[ _mEL_R_Disp_Rq_AR.SQC_EL_R_FltDisp_Rq ] ]; // load offset
            crc = (crc ^ 0xFF);
            if( getValue(  HMI_CRC_EL_R_FltDisp_Rq_Invalid ) )
                crc++;
            _mEL_R_Disp_Rq_AR.CRC_EL_R_FltDisp_Rq = crc;
            putValue( HMI_CRC_EL_R_FltDisp_Rq, crc );
        }
        else
            _mEL_R_Disp_Rq_AR.CRC_EL_R_FltDisp_Rq = getValue( HMI_CRC_EL_R_FltDisp_Rq );
    }
    else
    {
        if( !getValue( HMI_CRC_EL_R_FltDisp_Rq_Auto ) )
        {   // CRC according to SAE1850 ( W222 )
            // berechne crc
            crc = 0xFF;
//            crc = crctable[crc ^ _mEL_R_Disp_Rq_AR.byte( 0 )];  CRC
            crc = crctable[crc ^ _mEL_R_Disp_Rq_AR.byte( 1 )];
            crc = crctable[crc ^ _mEL_R_Disp_Rq_AR.byte( 2 )];
            crc = crctable[crc ^ _mEL_R_Disp_Rq_AR.byte( 3 )];
//            crc = crctable[crc ^ _mEL_R_Disp_Rq_AR.byte( 4 )];
//            crc = crctable[crc ^ _mEL_R_Disp_Rq_AR.byte( 5 )];
//            crc = crctable[crc ^ _mEL_R_Disp_Rq_AR.byte( 6 )];
//            crc = crctable[crc ^ _mEL_R_Disp_Rq_AR.byte( 7 )];
            crc = (crc ^ 0xFF);
            if( getValue(  HMI_CRC_EL_R_FltDisp_Rq_Invalid ) )
                crc++;
            _mEL_R_Disp_Rq_AR.CRC_EL_R_FltDisp_Rq = crc;
            putValue( HMI_CRC_EL_R_FltDisp_Rq, crc );
        }
        else
            _mEL_R_Disp_Rq_AR.CRC_EL_R_FltDisp_Rq = getValue( HMI_CRC_EL_R_FltDisp_Rq );
    }
    output( _mEL_R_Disp_Rq_AR );
}
/*@@end*/

/*@@caplFunc:EL_R_Disp_Rq_AR_saveEnvVars(dword):*/
EL_R_Disp_Rq_AR_saveEnvVars( dword hFile )
{
    filePutString("\n// Knoten EIS: EL_R_Disp_Rq_AR\n", 29, hFile );
    snprintf( buffer, elcount( buffer ), "0.0000 HMI__STMSG_EL_R_Disp_Rq_AR := %X\n", getValue( HMI__STMSG_EL_R_Disp_Rq_AR ) );        filePutString ( buffer, elcount( buffer ), hFile );
    snprintf( buffer, elcount( buffer ), "0.0000 HMI__STMSGT_EL_R_Disp_Rq_AR := %X\n", getValue( HMI__STMSGT_EL_R_Disp_Rq_AR ) );        filePutString ( buffer, elcount( buffer ), hFile );
    snprintf( buffer, elcount( buffer ), "0.0000 HMI_BrkLmp3_Flt := %X\n", getValue( HMI_BrkLmp3_Flt ) );        filePutString ( buffer, elcount( buffer ), hFile );
    snprintf( buffer, elcount( buffer ), "0.0000 HMI_BrkLmp_Lt_Flt := %X\n", getValue( HMI_BrkLmp_Lt_Flt ) );        filePutString ( buffer, elcount( buffer ), hFile );
    snprintf( buffer, elcount( buffer ), "0.0000 HMI_BrkLmp_Rt_Flt := %X\n", getValue( HMI_BrkLmp_Rt_Flt ) );        filePutString ( buffer, elcount( buffer ), hFile );
    snprintf( buffer, elcount( buffer ), "0.0000 HMI_BrkTlLmp_Lt_Flt := %X\n", getValue( HMI_BrkTlLmp_Lt_Flt ) );        filePutString ( buffer, elcount( buffer ), hFile );
    snprintf( buffer, elcount( buffer ), "0.0000 HMI_BrkTlLmp_Rt_Flt := %X\n", getValue( HMI_BrkTlLmp_Rt_Flt ) );        filePutString ( buffer, elcount( buffer ), hFile );
    snprintf( buffer, elcount( buffer ), "0.0000 HMI_BuLmp_Lt_Flt := %X\n", getValue( HMI_BuLmp_Lt_Flt ) );        filePutString ( buffer, elcount( buffer ), hFile );
    snprintf( buffer, elcount( buffer ), "0.0000 HMI_BuLmp_Rt_Flt := %X\n", getValue( HMI_BuLmp_Rt_Flt ) );        filePutString ( buffer, elcount( buffer ), hFile );
    snprintf( buffer, elcount( buffer ), "0.0000 HMI_CRC_EL_R_FltDisp_Rq := %X\n", getValue( HMI_CRC_EL_R_FltDisp_Rq ) );        filePutString ( buffer, elcount( buffer ), hFile );
    snprintf( buffer, elcount( buffer ), "0.0000 HMI_CRC_EL_R_FltDisp_Rq_Auto := %X\n", getValue( HMI_CRC_EL_R_FltDisp_Rq_Auto ) );        filePutString ( buffer, elcount( buffer ), hFile );
    snprintf( buffer, elcount( buffer ), "0.0000 HMI_CRC_EL_R_FltDisp_Rq_Profilr_02 := %X\n", getValue( HMI_CRC_EL_R_FltDisp_Rq_Profile_02 ) );        filePutString ( buffer, elcount( buffer ), hFile );
    snprintf( buffer, elcount( buffer ), "0.0000 HMI_EmgLgtPath_Flt_SAM_R := %X\n", getValue( HMI_EmgLgtPath_Flt_SAM_R ) );        filePutString ( buffer, elcount( buffer ), hFile );
    snprintf( buffer, elcount( buffer ), "0.0000 HMI_FogLmp_RL_Flt := %X\n", getValue( HMI_FogLmp_RL_Flt ) );        filePutString ( buffer, elcount( buffer ), hFile );
    snprintf( buffer, elcount( buffer ), "0.0000 HMI_FogLmp_RR_Flt := %X\n", getValue( HMI_FogLmp_RR_Flt ) );        filePutString ( buffer, elcount( buffer ), hFile );
    snprintf( buffer, elcount( buffer ), "0.0000 HMI_LP_Lmp_Lt_Flt := %X\n", getValue( HMI_LP_Lmp_Lt_Flt ) );        filePutString ( buffer, elcount( buffer ), hFile );
    snprintf( buffer, elcount( buffer ), "0.0000 HMI_LP_Lmp_Rt_Flt := %X\n", getValue( HMI_LP_Lmp_Rt_Flt ) );        filePutString ( buffer, elcount( buffer ), hFile );
    snprintf( buffer, elcount( buffer ), "0.0000 HMI_Rsrv1_EL_R_FltDisp_Rq := %X\n", getValue( HMI_Rsrv1_EL_R_FltDisp_Rq ) );        filePutString ( buffer, elcount( buffer ), hFile );
    snprintf( buffer, elcount( buffer ), "0.0000 HMI_SM_RL_Flt := %X\n", getValue( HMI_SM_RL_Flt ) );        filePutString ( buffer, elcount( buffer ), hFile );
    snprintf( buffer, elcount( buffer ), "0.0000 HMI_SM_RR_Flt := %X\n", getValue( HMI_SM_RR_Flt ) );        filePutString ( buffer, elcount( buffer ), hFile );
    snprintf( buffer, elcount( buffer ), "0.0000 HMI_SQC_EL_R_FltDisp_Rq := %X\n", getValue( HMI_SQC_EL_R_FltDisp_Rq ) );        filePutString ( buffer, elcount( buffer ), hFile );
    snprintf( buffer, elcount( buffer ), "0.0000 HMI_SQC_EL_R_FltDisp_Rq_Auto := %X\n", getValue( HMI_SQC_EL_R_FltDisp_Rq_Auto ) );        filePutString ( buffer, elcount( buffer ), hFile );
    snprintf( buffer, elcount( buffer ), "0.0000 HMI_SVS_ExtLmp_Stat := %X\n", getValue( HMI_SVS_ExtLmp_Stat ) );        filePutString ( buffer, elcount( buffer ), hFile );
    snprintf( buffer, elcount( buffer ), "0.0000 HMI_Term54_Flt_BC_R := %X\n", getValue( HMI_Term54_Flt_BC_R ) );        filePutString ( buffer, elcount( buffer ), hFile );
    snprintf( buffer, elcount( buffer ), "0.0000 HMI_TlLmp_Lt_Flt := %X\n", getValue( HMI_TlLmp_Lt_Flt ) );        filePutString ( buffer, elcount( buffer ), hFile );
    snprintf( buffer, elcount( buffer ), "0.0000 HMI_TlLmp_Rt_Flt := %X\n", getValue( HMI_TlLmp_Rt_Flt ) );        filePutString ( buffer, elcount( buffer ), hFile );
    snprintf( buffer, elcount( buffer ), "0.0000 HMI_TurnLmp_RL_Flt := %X\n", getValue( HMI_TurnLmp_RL_Flt ) );        filePutString ( buffer, elcount( buffer ), hFile );
    snprintf( buffer, elcount( buffer ), "0.0000 HMI_TurnLmp_RR_Flt := %X\n", getValue( HMI_TurnLmp_RR_Flt ) );        filePutString ( buffer, elcount( buffer ), hFile );
}
/*@@end*/

/*@@timer:_tEL_R_Disp_Rq_AR:*/
on timer _tEL_R_Disp_Rq_AR
{
    putValue( HMI__STMSG_EL_R_Disp_Rq_AR, 0 );
}
/*@@end*/

/*@@envVar:HMI__STMSG_EL_R_Disp_Rq_AR:*/
on EnvVar HMI__STMSG_EL_R_Disp_Rq_AR
{
    long tDelay;
    if( getValue( this ) == 2 )
    {
        tDelay = getValue( HMI__STMSGT_EL_R_Disp_Rq_AR );
        if( tDelay > 0)    
            setTimer( _tEL_R_Disp_Rq_AR, tDelay );
        else
            putValue( HMI__STMSG_EL_R_Disp_Rq_AR, 0 );
    }
}
/*@@end*/

/*@@envVar:HMI_BrkLmp3_Flt:*/
on EnvVar HMI_BrkLmp3_Flt
{
    _mEL_R_Disp_Rq_AR.BrkLmp3_Flt.phys = getValue(this);
    _EL_R_Disp_Rq_AR_SpontanFlag = 1;
}
/*@@end*/

/*@@envVar:HMI_BrkLmp_Lt_Flt:*/
on EnvVar HMI_BrkLmp_Lt_Flt
{
    _mEL_R_Disp_Rq_AR.BrkLmp_Lt_Flt.phys = getValue(this);
    _EL_R_Disp_Rq_AR_SpontanFlag = 1;
}
/*@@end*/

/*@@envVar:HMI_BrkLmp_Rt_Flt:*/
on EnvVar HMI_BrkLmp_Rt_Flt
{
    _mEL_R_Disp_Rq_AR.BrkLmp_Rt_Flt.phys = getValue(this);
    _EL_R_Disp_Rq_AR_SpontanFlag = 1;
}
/*@@end*/

/*@@envVar:HMI_BrkTlLmp_Lt_Flt:*/
on EnvVar HMI_BrkTlLmp_Lt_Flt
{
    _mEL_R_Disp_Rq_AR.BrkTlLmp_Lt_Flt.phys = getValue(this);
    _EL_R_Disp_Rq_AR_SpontanFlag = 1;
}
/*@@end*/

/*@@envVar:HMI_BrkTlLmp_Rt_Flt:*/
on EnvVar HMI_BrkTlLmp_Rt_Flt
{
    _mEL_R_Disp_Rq_AR.BrkTlLmp_Rt_Flt.phys = getValue(this);
    _EL_R_Disp_Rq_AR_SpontanFlag = 1;
}
/*@@end*/

/*@@envVar:HMI_BuLmp_Lt_Flt:*/
on EnvVar HMI_BuLmp_Lt_Flt
{
    _mEL_R_Disp_Rq_AR.BuLmp_Lt_Flt.phys = getValue(this);
    _EL_R_Disp_Rq_AR_SpontanFlag = 1;
}
/*@@end*/

/*@@envVar:HMI_BuLmp_Rt_Flt:*/
on EnvVar HMI_BuLmp_Rt_Flt
{
    _mEL_R_Disp_Rq_AR.BuLmp_Rt_Flt.phys = getValue(this);
    _EL_R_Disp_Rq_AR_SpontanFlag = 1;
}
/*@@end*/

/*@@envVar:HMI_EmgLgtPath_Flt_SAM_R:*/
on EnvVar HMI_EmgLgtPath_Flt_SAM_R
{
    _mEL_R_Disp_Rq_AR.EmgLgtPath_Flt_SAM_R.phys = getValue(this);
    _EL_R_Disp_Rq_AR_SpontanFlag = 1;
}
/*@@end*/

/*@@envVar:HMI_FogLmp_RL_Flt:*/
on EnvVar HMI_FogLmp_RL_Flt
{
    _mEL_R_Disp_Rq_AR.FogLmp_RL_Flt.phys = getValue(this);
    _EL_R_Disp_Rq_AR_SpontanFlag = 1;
}
/*@@end*/

/*@@envVar:HMI_FogLmp_RR_Flt:*/
on EnvVar HMI_FogLmp_RR_Flt
{
    _mEL_R_Disp_Rq_AR.FogLmp_RR_Flt.phys = getValue(this);
    _EL_R_Disp_Rq_AR_SpontanFlag = 1;
}
/*@@end*/

/*@@envVar:HMI_LP_Lmp_Lt_Flt:*/
on EnvVar HMI_LP_Lmp_Lt_Flt
{
    _mEL_R_Disp_Rq_AR.LP_Lmp_Lt_Flt.phys = getValue(this);
    _EL_R_Disp_Rq_AR_SpontanFlag = 1;
}
/*@@end*/

/*@@envVar:HMI_LP_Lmp_Rt_Flt:*/
on EnvVar HMI_LP_Lmp_Rt_Flt
{
    _mEL_R_Disp_Rq_AR.LP_Lmp_Rt_Flt.phys = getValue(this);
    _EL_R_Disp_Rq_AR_SpontanFlag = 1;
}
/*@@end*/

/*@@envVar:HMI_Rsrv1_EL_R_FltDisp_Rq:*/
on EnvVar HMI_Rsrv1_EL_R_FltDisp_Rq
{
    _mEL_R_Disp_Rq_AR.Rsrv1_EL_R_FltDisp_Rq.phys = getValue(this);
    _EL_R_Disp_Rq_AR_SpontanFlag = 1;
}
/*@@end*/

/*@@envVar:HMI_SM_RL_Flt:*/
on EnvVar HMI_SM_RL_Flt
{
    _mEL_R_Disp_Rq_AR.SM_RL_Flt.phys = getValue(this);
    _EL_R_Disp_Rq_AR_SpontanFlag = 1;
}
/*@@end*/

/*@@envVar:HMI_SM_RR_Flt:*/
on EnvVar HMI_SM_RR_Flt
{
    _mEL_R_Disp_Rq_AR.SM_RR_Flt.phys = getValue(this);
    _EL_R_Disp_Rq_AR_SpontanFlag = 1;
}
/*@@end*/

/*@@envVar:HMI_SVS_ExtLmp_Stat:*/
on EnvVar HMI_SVS_ExtLmp_Stat
{
    _mEL_R_Disp_Rq_AR.SVS_ExtLmp_Stat.phys = getValue(this);
    _EL_R_Disp_Rq_AR_SpontanFlag = 1;
}
/*@@end*/

/*@@envVar:HMI_Term54_Flt_BC_R:*/
on EnvVar HMI_Term54_Flt_BC_R
{
    _mEL_R_Disp_Rq_AR.Term54_Flt_BC_R.phys = getValue(this);
    _EL_R_Disp_Rq_AR_SpontanFlag = 1;
}
/*@@end*/

/*@@envVar:HMI_TlLmp_Lt_Flt:*/
on EnvVar HMI_TlLmp_Lt_Flt
{
    _mEL_R_Disp_Rq_AR.TlLmp_Lt_Flt.phys = getValue(this);
    _EL_R_Disp_Rq_AR_SpontanFlag = 1;
}
/*@@end*/

/*@@envVar:HMI_TlLmp_Rt_Flt:*/
on EnvVar HMI_TlLmp_Rt_Flt
{
    _mEL_R_Disp_Rq_AR.TlLmp_Rt_Flt.phys = getValue(this);
    _EL_R_Disp_Rq_AR_SpontanFlag = 1;
}
/*@@end*/

/*@@envVar:HMI_TurnLmp_RL_Flt:*/
on EnvVar HMI_TurnLmp_RL_Flt
{
    _mEL_R_Disp_Rq_AR.TurnLmp_RL_Flt.phys = getValue(this);
    _EL_R_Disp_Rq_AR_SpontanFlag = 1;
}
/*@@end*/

/*@@envVar:HMI_TurnLmp_RR_Flt:*/
on EnvVar HMI_TurnLmp_RR_Flt
{
    _mEL_R_Disp_Rq_AR.TurnLmp_RR_Flt.phys = getValue(this);
    _EL_R_Disp_Rq_AR_SpontanFlag = 1;
}
/*@@end*/

/*@@caplFunc:EL_Stat_AR_check_output():*/
EL_Stat_AR_check_output()
{
    if( !getValue( HMI__STMSG_EL_Stat_AR ) )
    {
        // Botschaft EL_Stat_AR ID: 829 --- Sendeart 5 cyclicAndSpontanWithDelay --- 
        _EL_Stat_AR_Cnt--;
        if( _EL_Stat_AR_Cnt < 1 )
        {
            // Nachricht wg. abgelaufenem Zyklus ausgeben
            EL_Stat_AR_output();
            _EL_Stat_AR_Cnt = _EL_Stat_AR_CycleCount; // Zyklus-Zähler zurücksetzen
            _EL_Stat_AR_SpontanFlag = 0; // Spontan-Flag zurücksetzen
        }
        else if( _EL_Stat_AR_SpontanFlag)
        {
            // Nachricht wg. spontaner Änderung ausgeben
            EL_Stat_AR_output();
            _EL_Stat_AR_SpontanFlag = 0; // Spontan-Flag zurücksetzen
        }
    }
}
/*@@end*/

/*@@caplFunc:EL_Stat_AR_init():*/
EL_Stat_AR_init()
{   /* Botschaft EL_Stat_AR ID: 829 --- Sendeart 5 cyclicAndSpontanWithDelay --- 
BA_ "ApplMessage" BO_ 829 0;
BA_ "NmAsrMessage" BO_ 829 0;
BA_ "GenMsgMinAcceptLength" BO_ 829 8;
BA_ "GenMsgILSupport" BO_ 829 1;
BA_ "DiagState" BO_ 829 0;
BA_ "DiagRequest" BO_ 829 0;
BA_ "DiagResponse" BO_ 829 0;
BA_ "GenMsgStartValue" BO_ 829 "0";
BA_ "GenMsgStartDelayTime" BO_ 829 0;
BA_ "GenMsgDelayTime" BO_ 829 5;
BA_ "GenMsgNrOfRepetitions" BO_ 829 0;
BA_ "GenMsgCycleTime" BO_ 829 200;
BA_ "GenMsgSendType" BO_ 829 5;
    */
    _EL_Stat_AR_Timebase =              c_tDBKomTimer_20ms;
    _EL_Stat_AR_CycleCount =          200 / _EL_Stat_AR_Timebase;
    _EL_Stat_AR_StartDelay =            0 / _EL_Stat_AR_Timebase;
    _EL_Stat_AR_Cnt = _EL_Stat_AR_StartDelay;
    _EL_Stat_AR_SpontanFlag = 0;

    putValue( HMI__STMSGSD_EL_Stat_AR, _EL_Stat_AR_StartDelay * _EL_Stat_AR_Timebase );

    _mEL_Stat_AR.BuLmp_Lt_On_Rq.phys = getValue( HMI_BuLmp_Lt_On_Rq );
    _mEL_Stat_AR.BuLmp_Rt_On_Rq.phys = getValue( HMI_BuLmp_Rt_On_Rq );
    _mEL_Stat_AR.DrHdlRecLgt_On_Rq.phys = getValue( HMI_DrHdlRecLgt_On_Rq );
    _mEL_Stat_AR.DRL_Dim_Actv.phys = getValue( HMI_DRL_Dim_Actv );
    _mEL_Stat_AR.DRL_LT_On_Rq.phys = getValue( HMI_DRL_LT_On_Rq );
    _mEL_Stat_AR.DRL_RT_On_Rq.phys = getValue( HMI_DRL_RT_On_Rq );
    _mEL_Stat_AR.ElecPwr_Inc_Rq.phys = getValue( HMI_ElecPwr_Inc_Rq );
    _mEL_Stat_AR.EntrLmp_Front_LT_On_Rq.phys = getValue( HMI_EntrLmp_Front_LT_On_Rq );
    _mEL_Stat_AR.EntrLmp_Front_RT_On_Rq.phys = getValue( HMI_EntrLmp_Front_RT_On_Rq );
    _mEL_Stat_AR.EntrLmp_Rear_Lt_On_Rq.phys = getValue( HMI_EntrLmp_Rear_Lt_On_Rq );
    _mEL_Stat_AR.EntrLmp_Rear_Rt_On_Rq.phys = getValue( HMI_EntrLmp_Rear_Rt_On_Rq );
    _mEL_Stat_AR.ExtLmp_AcustWarn_On_Rq.phys = getValue( HMI_ExtLmp_AcustWarn_On_Rq );
    _mEL_Stat_AR.FogLmp_Ft_IndLmp_On_Rq.phys = getValue( HMI_FogLmp_Ft_IndLmp_On_Rq );
    _mEL_Stat_AR.FogLmp_Ft_On_Rq.phys = getValue( HMI_FogLmp_Ft_On_Rq );
    _mEL_Stat_AR.FogLmp_R_IndLmp_On_Rq.phys = getValue( HMI_FogLmp_R_IndLmp_On_Rq );
    _mEL_Stat_AR.FogLmp_R_On_Rq.phys = getValue( HMI_FogLmp_R_On_Rq );
    _mEL_Stat_AR.FogLmp_RL_On_Rq.phys = getValue( HMI_FogLmp_RL_On_Rq );
    _mEL_Stat_AR.FogLmp_RR_On_Rq.phys = getValue( HMI_FogLmp_RR_On_Rq );
    _mEL_Stat_AR.HiBm_IndLmp_On_Rq.phys = getValue( HMI_HiBm_IndLmp_On_Rq );
    _mEL_Stat_AR.HiBm_Md_On_Rq.phys = getValue( HMI_HiBm_Md_On_Rq );
    _mEL_Stat_AR.HiBm_On.phys = getValue( HMI_HiBm_On );
    _mEL_Stat_AR.IHC_Sys_Stat.phys = getValue( HMI_IHC_Sys_Stat );
    _mEL_Stat_AR.IrLmp_Stat.phys = getValue( HMI_IrLmp_Stat );
    _mEL_Stat_AR.LoBm_IndLmp_On_Rq.phys = getValue( HMI_LoBm_IndLmp_On_Rq );
    _mEL_Stat_AR.LoBm_On_Rq.phys = getValue( HMI_LoBm_On_Rq );
    _mEL_Stat_AR.LP_Lmp_Lt_On_Rq.phys = getValue( HMI_LP_Lmp_Lt_On_Rq );
    _mEL_Stat_AR.NS_Ill_Actv.phys = getValue( HMI_NS_Ill_Actv );
    _mEL_Stat_AR.PkLmp_Lt_On_Rq.phys = getValue( HMI_PkLmp_Lt_On_Rq );
    _mEL_Stat_AR.PkLmp_Rt_On_Rq.phys = getValue( HMI_PkLmp_Rt_On_Rq );
    _mEL_Stat_AR.PosnLmp_IndLmp_On_Rq.phys = getValue( HMI_PosnLmp_IndLmp_On_Rq );
    _mEL_Stat_AR.PosnLmp_On_Rq.phys = getValue( HMI_PosnLmp_On_Rq );
    _mEL_Stat_AR.Rsrv1_ExtLgt_Lmp_On_Rq.phys = getValue( HMI_Rsrv1_ExtLgt_Lmp_On_Rq );
    _mEL_Stat_AR.SM_RL_On_Rq.phys = getValue( HMI_SM_RL_On_Rq );
    _mEL_Stat_AR.SM_RR_On_Rq.phys = getValue( HMI_SM_RR_On_Rq );
    _mEL_Stat_AR.SurrIll_Stat.phys = getValue( HMI_SurrIll_Stat );
    _mEL_Stat_AR.SVS_ExtLmp_Actv_V2.phys = getValue( HMI_SVS_ExtLmp_Actv_V2 );
    _mEL_Stat_AR.TlLmp_Lt_On_Rq.phys = getValue( HMI_TlLmp_Lt_On_Rq );
    _mEL_Stat_AR.TlLmp_Rt_On_Rq.phys = getValue( HMI_TlLmp_Rt_On_Rq );
}
/*@@end*/

/*@@caplFunc:EL_Stat_AR_output():*/
void EL_Stat_AR_output(void)
{
    byte crc;
    byte SQC_help;

    if( !getValue( HMI_SQC_ExtLgt_Lmp_On_Rq_Auto ) )
    {
        // berechne message counter
        SQC_help = getValue( HMI_SQC_ExtLgt_Lmp_On_Rq );
        if( SQC_help >= 15 ) SQC_help = 0;
        else SQC_help++;
        putValue( HMI_SQC_ExtLgt_Lmp_On_Rq, SQC_help );
        _mEL_Stat_AR.SQC_ExtLgt_Lmp_On_Rq = SQC_help;
    }
    else
          _mEL_Stat_AR.SQC_ExtLgt_Lmp_On_Rq = getValue( HMI_SQC_ExtLgt_Lmp_On_Rq );

    if( !getValue( HMI_CRC_ExtLgt_Lmp_On_Rq_Profile_02 ) )
    {
    if( !getValue( HMI_CRC_ExtLgt_Lmp_On_Rq_Auto ) )
        {   // CRC according Profile_02 ( W213 )
            // berechne crc
            crc = 0xFF;
//            crc = crctable_profile02[crc ^ _mEL_Stat_AR.byte( 0 )];  CRC
            crc = crctable_profile02[crc ^ _mEL_Stat_AR.byte( 1 )];
            crc = crctable_profile02[crc ^ _mEL_Stat_AR.byte( 2 )];
            crc = crctable_profile02[crc ^ _mEL_Stat_AR.byte( 3 )];
//            crc = crctable_profile02[crc ^ _mEL_Stat_AR.byte( 4 )];
//            crc = crctable_profile02[crc ^ _mEL_Stat_AR.byte( 5 )];
//            crc = crctable_profile02[crc ^ _mEL_Stat_AR.byte( 6 )];
//            crc = crctable_profile02[crc ^ _mEL_Stat_AR.byte( 7 )];
            crc = crctable_profile02[crc ^ _EL_Stat_AR_CRC_Offset[ _mEL_Stat_AR.SQC_ExtLgt_Lmp_On_Rq ] ]; // load offset
            crc = (crc ^ 0xFF);
            if( getValue(  HMI_CRC_ExtLgt_Lmp_On_Rq_Invalid ) )
                crc++;
            _mEL_Stat_AR.CRC_ExtLgt_Lmp_On_Rq = crc;
            putValue( HMI_CRC_ExtLgt_Lmp_On_Rq, crc );
        }
        else
            _mEL_Stat_AR.CRC_ExtLgt_Lmp_On_Rq = getValue( HMI_CRC_ExtLgt_Lmp_On_Rq );
    }
    else
    {
        if( !getValue( HMI_CRC_ExtLgt_Lmp_On_Rq_Auto ) )
        {   // CRC according to SAE1850 ( W222 )
            // berechne crc
            crc = 0xFF;
//            crc = crctable[crc ^ _mEL_Stat_AR.byte( 0 )];  CRC
            crc = crctable[crc ^ _mEL_Stat_AR.byte( 1 )];
            crc = crctable[crc ^ _mEL_Stat_AR.byte( 2 )];
            crc = crctable[crc ^ _mEL_Stat_AR.byte( 3 )];
//            crc = crctable[crc ^ _mEL_Stat_AR.byte( 4 )];
//            crc = crctable[crc ^ _mEL_Stat_AR.byte( 5 )];
//            crc = crctable[crc ^ _mEL_Stat_AR.byte( 6 )];
//            crc = crctable[crc ^ _mEL_Stat_AR.byte( 7 )];
            crc = (crc ^ 0xFF);
            if( getValue(  HMI_CRC_ExtLgt_Lmp_On_Rq_Invalid ) )
                crc++;
            _mEL_Stat_AR.CRC_ExtLgt_Lmp_On_Rq = crc;
            putValue( HMI_CRC_ExtLgt_Lmp_On_Rq, crc );
        }
        else
            _mEL_Stat_AR.CRC_ExtLgt_Lmp_On_Rq = getValue( HMI_CRC_ExtLgt_Lmp_On_Rq );
    }
    output( _mEL_Stat_AR );
}
/*@@end*/

/*@@caplFunc:EL_Stat_AR_saveEnvVars(dword):*/
EL_Stat_AR_saveEnvVars( dword hFile )
{
    filePutString("\n// Knoten EIS: EL_Stat_AR\n", 24, hFile );
    snprintf( buffer, elcount( buffer ), "0.0000 HMI__STMSG_EL_Stat_AR := %X\n", getValue( HMI__STMSG_EL_Stat_AR ) );        filePutString ( buffer, elcount( buffer ), hFile );
    snprintf( buffer, elcount( buffer ), "0.0000 HMI__STMSGT_EL_Stat_AR := %X\n", getValue( HMI__STMSGT_EL_Stat_AR ) );        filePutString ( buffer, elcount( buffer ), hFile );
    snprintf( buffer, elcount( buffer ), "0.0000 HMI_BuLmp_Lt_On_Rq := %X\n", getValue( HMI_BuLmp_Lt_On_Rq ) );        filePutString ( buffer, elcount( buffer ), hFile );
    snprintf( buffer, elcount( buffer ), "0.0000 HMI_BuLmp_Rt_On_Rq := %X\n", getValue( HMI_BuLmp_Rt_On_Rq ) );        filePutString ( buffer, elcount( buffer ), hFile );
    snprintf( buffer, elcount( buffer ), "0.0000 HMI_CRC_ExtLgt_Lmp_On_Rq := %X\n", getValue( HMI_CRC_ExtLgt_Lmp_On_Rq ) );        filePutString ( buffer, elcount( buffer ), hFile );
    snprintf( buffer, elcount( buffer ), "0.0000 HMI_CRC_ExtLgt_Lmp_On_Rq_Auto := %X\n", getValue( HMI_CRC_ExtLgt_Lmp_On_Rq_Auto ) );        filePutString ( buffer, elcount( buffer ), hFile );
    snprintf( buffer, elcount( buffer ), "0.0000 HMI_DrHdlRecLgt_On_Rq := %X\n", getValue( HMI_DrHdlRecLgt_On_Rq ) );        filePutString ( buffer, elcount( buffer ), hFile );
    snprintf( buffer, elcount( buffer ), "0.0000 HMI_DRL_Dim_Actv := %X\n", getValue( HMI_DRL_Dim_Actv ) );        filePutString ( buffer, elcount( buffer ), hFile );
    snprintf( buffer, elcount( buffer ), "0.0000 HMI_DRL_LT_On_Rq := %X\n", getValue( HMI_DRL_LT_On_Rq ) );        filePutString ( buffer, elcount( buffer ), hFile );
    snprintf( buffer, elcount( buffer ), "0.0000 HMI_DRL_RT_On_Rq := %X\n", getValue( HMI_DRL_RT_On_Rq ) );        filePutString ( buffer, elcount( buffer ), hFile );
    snprintf( buffer, elcount( buffer ), "0.0000 HMI_ElecPwr_Inc_Rq := %X\n", getValue( HMI_ElecPwr_Inc_Rq ) );        filePutString ( buffer, elcount( buffer ), hFile );
    snprintf( buffer, elcount( buffer ), "0.0000 HMI_EntrLmp_Front_LT_On_Rq := %X\n", getValue( HMI_EntrLmp_Front_LT_On_Rq ) );        filePutString ( buffer, elcount( buffer ), hFile );
    snprintf( buffer, elcount( buffer ), "0.0000 HMI_EntrLmp_Front_RT_On_Rq := %X\n", getValue( HMI_EntrLmp_Front_RT_On_Rq ) );        filePutString ( buffer, elcount( buffer ), hFile );
    snprintf( buffer, elcount( buffer ), "0.0000 HMI_EntrLmp_Rear_Lt_On_Rq := %X\n", getValue( HMI_EntrLmp_Rear_Lt_On_Rq ) );        filePutString ( buffer, elcount( buffer ), hFile );
    snprintf( buffer, elcount( buffer ), "0.0000 HMI_EntrLmp_Rear_Rt_On_Rq := %X\n", getValue( HMI_EntrLmp_Rear_Rt_On_Rq ) );        filePutString ( buffer, elcount( buffer ), hFile );
    snprintf( buffer, elcount( buffer ), "0.0000 HMI_ExtLmp_AcustWarn_On_Rq := %X\n", getValue( HMI_ExtLmp_AcustWarn_On_Rq ) );        filePutString ( buffer, elcount( buffer ), hFile );
    snprintf( buffer, elcount( buffer ), "0.0000 HMI_FogLmp_Ft_IndLmp_On_Rq := %X\n", getValue( HMI_FogLmp_Ft_IndLmp_On_Rq ) );        filePutString ( buffer, elcount( buffer ), hFile );
    snprintf( buffer, elcount( buffer ), "0.0000 HMI_FogLmp_Ft_On_Rq := %X\n", getValue( HMI_FogLmp_Ft_On_Rq ) );        filePutString ( buffer, elcount( buffer ), hFile );
    snprintf( buffer, elcount( buffer ), "0.0000 HMI_FogLmp_R_IndLmp_On_Rq := %X\n", getValue( HMI_FogLmp_R_IndLmp_On_Rq ) );        filePutString ( buffer, elcount( buffer ), hFile );
    snprintf( buffer, elcount( buffer ), "0.0000 HMI_FogLmp_R_On_Rq := %X\n", getValue( HMI_FogLmp_R_On_Rq ) );        filePutString ( buffer, elcount( buffer ), hFile );
    snprintf( buffer, elcount( buffer ), "0.0000 HMI_FogLmp_RL_On_Rq := %X\n", getValue( HMI_FogLmp_RL_On_Rq ) );        filePutString ( buffer, elcount( buffer ), hFile );
    snprintf( buffer, elcount( buffer ), "0.0000 HMI_FogLmp_RR_On_Rq := %X\n", getValue( HMI_FogLmp_RR_On_Rq ) );        filePutString ( buffer, elcount( buffer ), hFile );
    snprintf( buffer, elcount( buffer ), "0.0000 HMI_HiBm_IndLmp_On_Rq := %X\n", getValue( HMI_HiBm_IndLmp_On_Rq ) );        filePutString ( buffer, elcount( buffer ), hFile );
    snprintf( buffer, elcount( buffer ), "0.0000 HMI_HiBm_Md_On_Rq := %X\n", getValue( HMI_HiBm_Md_On_Rq ) );        filePutString ( buffer, elcount( buffer ), hFile );
    snprintf( buffer, elcount( buffer ), "0.0000 HMI_HiBm_On := %X\n", getValue( HMI_HiBm_On ) );        filePutString ( buffer, elcount( buffer ), hFile );
    snprintf( buffer, elcount( buffer ), "0.0000 HMI_IHC_Sys_Stat := %X\n", getValue( HMI_IHC_Sys_Stat ) );        filePutString ( buffer, elcount( buffer ), hFile );
    snprintf( buffer, elcount( buffer ), "0.0000 HMI_IrLmp_Stat := %X\n", getValue( HMI_IrLmp_Stat ) );        filePutString ( buffer, elcount( buffer ), hFile );
    snprintf( buffer, elcount( buffer ), "0.0000 HMI_LoBm_IndLmp_On_Rq := %X\n", getValue( HMI_LoBm_IndLmp_On_Rq ) );        filePutString ( buffer, elcount( buffer ), hFile );
    snprintf( buffer, elcount( buffer ), "0.0000 HMI_LoBm_On_Rq := %X\n", getValue( HMI_LoBm_On_Rq ) );        filePutString ( buffer, elcount( buffer ), hFile );
    snprintf( buffer, elcount( buffer ), "0.0000 HMI_LP_Lmp_Lt_On_Rq := %X\n", getValue( HMI_LP_Lmp_Lt_On_Rq ) );        filePutString ( buffer, elcount( buffer ), hFile );
    snprintf( buffer, elcount( buffer ), "0.0000 HMI_NS_Ill_Actv := %X\n", getValue( HMI_NS_Ill_Actv ) );        filePutString ( buffer, elcount( buffer ), hFile );
    snprintf( buffer, elcount( buffer ), "0.0000 HMI_PkLmp_Lt_On_Rq := %X\n", getValue( HMI_PkLmp_Lt_On_Rq ) );        filePutString ( buffer, elcount( buffer ), hFile );
    snprintf( buffer, elcount( buffer ), "0.0000 HMI_PkLmp_Rt_On_Rq := %X\n", getValue( HMI_PkLmp_Rt_On_Rq ) );        filePutString ( buffer, elcount( buffer ), hFile );
    snprintf( buffer, elcount( buffer ), "0.0000 HMI_PosnLmp_IndLmp_On_Rq := %X\n", getValue( HMI_PosnLmp_IndLmp_On_Rq ) );        filePutString ( buffer, elcount( buffer ), hFile );
    snprintf( buffer, elcount( buffer ), "0.0000 HMI_PosnLmp_On_Rq := %X\n", getValue( HMI_PosnLmp_On_Rq ) );        filePutString ( buffer, elcount( buffer ), hFile );
    snprintf( buffer, elcount( buffer ), "0.0000 HMI_Rsrv1_ExtLgt_Lmp_On_Rq := %X\n", getValue( HMI_Rsrv1_ExtLgt_Lmp_On_Rq ) );        filePutString ( buffer, elcount( buffer ), hFile );
    snprintf( buffer, elcount( buffer ), "0.0000 HMI_SM_RL_On_Rq := %X\n", getValue( HMI_SM_RL_On_Rq ) );        filePutString ( buffer, elcount( buffer ), hFile );
    snprintf( buffer, elcount( buffer ), "0.0000 HMI_SM_RR_On_Rq := %X\n", getValue( HMI_SM_RR_On_Rq ) );        filePutString ( buffer, elcount( buffer ), hFile );
    snprintf( buffer, elcount( buffer ), "0.0000 HMI_SQC_ExtLgt_Lmp_On_Rq := %X\n", getValue( HMI_SQC_ExtLgt_Lmp_On_Rq ) );        filePutString ( buffer, elcount( buffer ), hFile );
    snprintf( buffer, elcount( buffer ), "0.0000 HMI_SQC_ExtLgt_Lmp_On_Rq_Auto := %X\n", getValue( HMI_SQC_ExtLgt_Lmp_On_Rq_Auto ) );        filePutString ( buffer, elcount( buffer ), hFile );
    snprintf( buffer, elcount( buffer ), "0.0000 HMI_SurrIll_Stat := %X\n", getValue( HMI_SurrIll_Stat ) );        filePutString ( buffer, elcount( buffer ), hFile );
    snprintf( buffer, elcount( buffer ), "0.0000 HMI_SVS_ExtLmp_Actv_V2 := %X\n", getValue( HMI_SVS_ExtLmp_Actv_V2 ) );        filePutString ( buffer, elcount( buffer ), hFile );
    snprintf( buffer, elcount( buffer ), "0.0000 HMI_TlLmp_Lt_On_Rq := %X\n", getValue( HMI_TlLmp_Lt_On_Rq ) );        filePutString ( buffer, elcount( buffer ), hFile );
    snprintf( buffer, elcount( buffer ), "0.0000 HMI_TlLmp_Rt_On_Rq := %X\n", getValue( HMI_TlLmp_Rt_On_Rq ) );        filePutString ( buffer, elcount( buffer ), hFile );
}
/*@@end*/

/*@@timer:_tEL_Stat_AR:*/
on timer _tEL_Stat_AR
{
    putValue( HMI__STMSG_EL_Stat_AR, 0 );
}
/*@@end*/

/*@@envVar:HMI__STMSG_EL_Stat_AR:*/
on EnvVar HMI__STMSG_EL_Stat_AR
{
    long tDelay;
    if( getValue( this ) == 2 )
    {
        tDelay = getValue( HMI__STMSGT_EL_Stat_AR );
        if( tDelay > 0)    
            setTimer( _tEL_Stat_AR, tDelay );
        else
            putValue( HMI__STMSG_EL_Stat_AR, 0 );
    }
}
/*@@end*/

/*@@envVar:HMI_BuLmp_Lt_On_Rq:*/
on EnvVar HMI_BuLmp_Lt_On_Rq
{
    _mEL_Stat_AR.BuLmp_Lt_On_Rq.phys = getValue(this);
    _EL_Stat_AR_SpontanFlag = 1;
}
/*@@end*/

/*@@envVar:HMI_BuLmp_Rt_On_Rq:*/
on EnvVar HMI_BuLmp_Rt_On_Rq
{
    _mEL_Stat_AR.BuLmp_Rt_On_Rq.phys = getValue(this);
    _EL_Stat_AR_SpontanFlag = 1;
}
/*@@end*/

/*@@envVar:HMI_DrHdlRecLgt_On_Rq:*/
on EnvVar HMI_DrHdlRecLgt_On_Rq
{
    _mEL_Stat_AR.DrHdlRecLgt_On_Rq.phys = getValue(this);
    _EL_Stat_AR_SpontanFlag = 1;
}
/*@@end*/

/*@@envVar:HMI_DRL_Dim_Actv:*/
on EnvVar HMI_DRL_Dim_Actv
{
    _mEL_Stat_AR.DRL_Dim_Actv.phys = getValue(this);
    _EL_Stat_AR_SpontanFlag = 1;
}
/*@@end*/

/*@@envVar:HMI_DRL_LT_On_Rq:*/
on EnvVar HMI_DRL_LT_On_Rq
{
    _mEL_Stat_AR.DRL_LT_On_Rq.phys = getValue(this);
    _EL_Stat_AR_SpontanFlag = 1;
}
/*@@end*/

/*@@envVar:HMI_DRL_RT_On_Rq:*/
on EnvVar HMI_DRL_RT_On_Rq
{
    _mEL_Stat_AR.DRL_RT_On_Rq.phys = getValue(this);
    _EL_Stat_AR_SpontanFlag = 1;
}
/*@@end*/

/*@@envVar:HMI_ElecPwr_Inc_Rq:*/
on EnvVar HMI_ElecPwr_Inc_Rq
{
    _mEL_Stat_AR.ElecPwr_Inc_Rq.phys = getValue(this);
    _EL_Stat_AR_SpontanFlag = 1;
}
/*@@end*/

/*@@envVar:HMI_EntrLmp_Front_LT_On_Rq:*/
on EnvVar HMI_EntrLmp_Front_LT_On_Rq
{
    _mEL_Stat_AR.EntrLmp_Front_LT_On_Rq.phys = getValue(this);
    _EL_Stat_AR_SpontanFlag = 1;
}
/*@@end*/

/*@@envVar:HMI_EntrLmp_Front_RT_On_Rq:*/
on EnvVar HMI_EntrLmp_Front_RT_On_Rq
{
    _mEL_Stat_AR.EntrLmp_Front_RT_On_Rq.phys = getValue(this);
    _EL_Stat_AR_SpontanFlag = 1;
}
/*@@end*/

/*@@envVar:HMI_EntrLmp_Rear_Lt_On_Rq:*/
on EnvVar HMI_EntrLmp_Rear_Lt_On_Rq
{
    _mEL_Stat_AR.EntrLmp_Rear_Lt_On_Rq.phys = getValue(this);
    _EL_Stat_AR_SpontanFlag = 1;
}
/*@@end*/

/*@@envVar:HMI_EntrLmp_Rear_Rt_On_Rq:*/
on EnvVar HMI_EntrLmp_Rear_Rt_On_Rq
{
    _mEL_Stat_AR.EntrLmp_Rear_Rt_On_Rq.phys = getValue(this);
    _EL_Stat_AR_SpontanFlag = 1;
}
/*@@end*/

/*@@envVar:HMI_ExtLmp_AcustWarn_On_Rq:*/
on EnvVar HMI_ExtLmp_AcustWarn_On_Rq
{
    _mEL_Stat_AR.ExtLmp_AcustWarn_On_Rq.phys = getValue(this);
    _EL_Stat_AR_SpontanFlag = 1;
}
/*@@end*/

/*@@envVar:HMI_FogLmp_Ft_IndLmp_On_Rq:*/
on EnvVar HMI_FogLmp_Ft_IndLmp_On_Rq
{
    _mEL_Stat_AR.FogLmp_Ft_IndLmp_On_Rq.phys = getValue(this);
    _EL_Stat_AR_SpontanFlag = 1;
}
/*@@end*/

/*@@envVar:HMI_FogLmp_Ft_On_Rq:*/
on EnvVar HMI_FogLmp_Ft_On_Rq
{
    _mEL_Stat_AR.FogLmp_Ft_On_Rq.phys = getValue(this);
    _EL_Stat_AR_SpontanFlag = 1;
}
/*@@end*/

/*@@envVar:HMI_FogLmp_R_IndLmp_On_Rq:*/
on EnvVar HMI_FogLmp_R_IndLmp_On_Rq
{
    _mEL_Stat_AR.FogLmp_R_IndLmp_On_Rq.phys = getValue(this);
    _EL_Stat_AR_SpontanFlag = 1;
}
/*@@end*/

/*@@envVar:HMI_FogLmp_R_On_Rq:*/
on EnvVar HMI_FogLmp_R_On_Rq
{
    _mEL_Stat_AR.FogLmp_R_On_Rq.phys = getValue(this);
    _EL_Stat_AR_SpontanFlag = 1;
}
/*@@end*/

/*@@envVar:HMI_FogLmp_RL_On_Rq:*/
on EnvVar HMI_FogLmp_RL_On_Rq
{
    _mEL_Stat_AR.FogLmp_RL_On_Rq.phys = getValue(this);
    _EL_Stat_AR_SpontanFlag = 1;
}
/*@@end*/

/*@@envVar:HMI_FogLmp_RR_On_Rq:*/
on EnvVar HMI_FogLmp_RR_On_Rq
{
    _mEL_Stat_AR.FogLmp_RR_On_Rq.phys = getValue(this);
    _EL_Stat_AR_SpontanFlag = 1;
}
/*@@end*/

/*@@envVar:HMI_HiBm_IndLmp_On_Rq:*/
on EnvVar HMI_HiBm_IndLmp_On_Rq
{
    _mEL_Stat_AR.HiBm_IndLmp_On_Rq.phys = getValue(this);
    _EL_Stat_AR_SpontanFlag = 1;
}
/*@@end*/

/*@@envVar:HMI_HiBm_Md_On_Rq:*/
on EnvVar HMI_HiBm_Md_On_Rq
{
    _mEL_Stat_AR.HiBm_Md_On_Rq.phys = getValue(this);
    _EL_Stat_AR_SpontanFlag = 1;
}
/*@@end*/

/*@@envVar:HMI_HiBm_On:*/
on EnvVar HMI_HiBm_On
{
    _mEL_Stat_AR.HiBm_On.phys = getValue(this);
    _EL_Stat_AR_SpontanFlag = 1;
}
/*@@end*/

/*@@envVar:HMI_IHC_Sys_Stat:*/
on EnvVar HMI_IHC_Sys_Stat
{
    _mEL_Stat_AR.IHC_Sys_Stat.phys = getValue(this);
    _EL_Stat_AR_SpontanFlag = 1;
}
/*@@end*/

/*@@envVar:HMI_IrLmp_Stat:*/
on EnvVar HMI_IrLmp_Stat
{
    _mEL_Stat_AR.IrLmp_Stat.phys = getValue(this);
    _EL_Stat_AR_SpontanFlag = 1;
}
/*@@end*/

/*@@envVar:HMI_LoBm_IndLmp_On_Rq:*/
on EnvVar HMI_LoBm_IndLmp_On_Rq
{
    if( ( getValue( Env_Stress__StresstestMainActiv ) == 0 )   &&
        ( getValue( HMI__NM_EIS_AutomaticNM_Switching ) == 0 )    )
    {
        if( getValue( this ) )
            _SetCommRequest( cLowBeamNMRequest );
        else
            _ReleaseCommRequest( cLowBeamNMRequest );
    }
    _mEL_Stat_AR.LoBm_IndLmp_On_Rq.phys = getValue(this);
    _EL_Stat_AR_SpontanFlag = 1;
}
/*@@end*/

/*@@envVar:HMI_LoBm_On_Rq:*/
on EnvVar HMI_LoBm_On_Rq
{
    _mEL_Stat_AR.LoBm_On_Rq.phys = getValue(this);
    _EL_Stat_AR_SpontanFlag = 1;
}
/*@@end*/

/*@@envVar:HMI_LP_Lmp_Lt_On_Rq:*/
on EnvVar HMI_LP_Lmp_Lt_On_Rq
{
    _mEL_Stat_AR.LP_Lmp_Lt_On_Rq.phys = getValue(this);
    _EL_Stat_AR_SpontanFlag = 1;
}
/*@@end*/

/*@@envVar:HMI_NS_Ill_Actv:*/
on EnvVar HMI_NS_Ill_Actv
{
    _mEL_Stat_AR.NS_Ill_Actv.phys = getValue(this);
    _EL_Stat_AR_SpontanFlag = 1;
}
/*@@end*/

/*@@envVar:HMI_PkLmp_Lt_On_Rq:*/
on EnvVar HMI_PkLmp_Lt_On_Rq
{
    _mEL_Stat_AR.PkLmp_Lt_On_Rq.phys = getValue(this);
    _EL_Stat_AR_SpontanFlag = 1;
}
/*@@end*/

/*@@envVar:HMI_PkLmp_Rt_On_Rq:*/
on EnvVar HMI_PkLmp_Rt_On_Rq
{
    _mEL_Stat_AR.PkLmp_Rt_On_Rq.phys = getValue(this);
    _EL_Stat_AR_SpontanFlag = 1;
}
/*@@end*/

/*@@envVar:HMI_PosnLmp_IndLmp_On_Rq:*/
on EnvVar HMI_PosnLmp_IndLmp_On_Rq
{
    if( ( getValue( Env_Stress__StresstestMainActiv ) == 0 )   &&
        ( getValue( HMI__NM_EIS_AutomaticNM_Switching ) == 0 )    )
    {
        _SetCommRequest( cIlluNMRequest );
        setTimer( t_IlluNMCancelTimer, c_NMCancelTimer_05sec ); // 5 seconds for auto-shut-off
    }
    _mEL_Stat_AR.PosnLmp_IndLmp_On_Rq.phys = getValue(this);
    _EL_Stat_AR_SpontanFlag = 1;
}
/*@@end*/

/*@@envVar:HMI_PosnLmp_On_Rq:*/
on EnvVar HMI_PosnLmp_On_Rq
{
    if( ( getValue( Env_Stress__StresstestMainActiv ) == 0 )   &&
        ( getValue( HMI__NM_EIS_AutomaticNM_Switching ) == 0 )    )
    {
        _SetCommRequest( cIlluNMRequest );
        setTimer( t_IlluNMCancelTimer, c_NMCancelTimer_05sec ); // 5 seconds for auto-shut-off
    }
    _mEL_Stat_AR.PosnLmp_On_Rq.phys = getValue(this);
    _EL_Stat_AR_SpontanFlag = 1;
}
/*@@end*/

/*@@envVar:HMI_Rsrv1_ExtLgt_Lmp_On_Rq:*/
on EnvVar HMI_Rsrv1_ExtLgt_Lmp_On_Rq
{
    _mEL_Stat_AR.Rsrv1_ExtLgt_Lmp_On_Rq.phys = getValue(this);
    _EL_Stat_AR_SpontanFlag = 1;
}
/*@@end*/

/*@@envVar:HMI_SM_RL_On_Rq:*/
on EnvVar HMI_SM_RL_On_Rq
{
    _mEL_Stat_AR.SM_RL_On_Rq.phys = getValue(this);
    _EL_Stat_AR_SpontanFlag = 1;
}
/*@@end*/

/*@@envVar:HMI_SM_RR_On_Rq:*/
on EnvVar HMI_SM_RR_On_Rq
{
    _mEL_Stat_AR.SM_RR_On_Rq.phys = getValue(this);
    _EL_Stat_AR_SpontanFlag = 1;
}
/*@@end*/

/*@@envVar:HMI_SurrIll_Stat:*/
on EnvVar HMI_SurrIll_Stat
{
    _mEL_Stat_AR.SurrIll_Stat.phys = getValue(this);
    _EL_Stat_AR_SpontanFlag = 1;
}
/*@@end*/

/*@@envVar:HMI_SVS_ExtLmp_Actv_V2:*/
on EnvVar HMI_SVS_ExtLmp_Actv_V2
{
    _mEL_Stat_AR.SVS_ExtLmp_Actv_V2.phys = getValue(this);
    _EL_Stat_AR_SpontanFlag = 1;
}
/*@@end*/

/*@@envVar:HMI_TlLmp_Lt_On_Rq:*/
on EnvVar HMI_TlLmp_Lt_On_Rq
{
    _mEL_Stat_AR.TlLmp_Lt_On_Rq.phys = getValue(this);
    _EL_Stat_AR_SpontanFlag = 1;
}
/*@@end*/

/*@@envVar:HMI_TlLmp_Rt_On_Rq:*/
on EnvVar HMI_TlLmp_Rt_On_Rq
{
    _mEL_Stat_AR.TlLmp_Rt_On_Rq.phys = getValue(this);
    _EL_Stat_AR_SpontanFlag = 1;
}
/*@@end*/

/*@@caplFunc:EL_TurnInd_Rq_AR_check_output():*/
EL_TurnInd_Rq_AR_check_output()
{
    if( !getValue( HMI__STMSG_EL_TurnInd_Rq_AR ) )
    {
        // Botschaft EL_TurnInd_Rq_AR ID: 287 --- Sendeart 1 spontanX --- 
        if( _EL_TurnInd_Rq_AR_SpontanFlag)
        {
            // Nachricht wg. spontaner Änderung ausgeben
            EL_TurnInd_Rq_AR_output();
            // Spontan-Flag zurücksetzen
             _EL_TurnInd_Rq_AR_SpontanFlag = 0;
        }
    }
}
/*@@end*/

/*@@caplFunc:EL_TurnInd_Rq_AR_init():*/
EL_TurnInd_Rq_AR_init()
{   /* Botschaft EL_TurnInd_Rq_AR ID: 287 --- Sendeart 1 spontanX --- 
BA_ "ApplMessage" BO_ 287 0;
BA_ "NmAsrMessage" BO_ 287 0;
BA_ "GenMsgMinAcceptLength" BO_ 287 4;
BA_ "GenMsgILSupport" BO_ 287 1;
BA_ "DiagState" BO_ 287 0;
BA_ "DiagRequest" BO_ 287 0;
BA_ "DiagResponse" BO_ 287 0;
BA_ "GenMsgStartValue" BO_ 287 "0";
BA_ "GenMsgDelayTime" BO_ 287 5;
BA_ "GenMsgNrOfRepetitions" BO_ 287 0;
BA_ "GenMsgSendType" BO_ 287 1;
    */
    _EL_TurnInd_Rq_AR_Timebase =         c_tDBKomTimer_5ms ;
    _EL_TurnInd_Rq_AR_SpontanFlag = 0;

    putValue( HMI_TurnLmpOnDur, 600 );
    _mEL_TurnInd_Rq_AR.EF_Actv.phys = getValue( HMI_EF_Actv );
    _mEL_TurnInd_Rq_AR.Rsrv1_EL_TurnInd_On_Rq.phys = getValue( HMI_Rsrv1_EL_TurnInd_On_Rq );
    _mEL_TurnInd_Rq_AR.TurnInd_FL_On_Rq.phys = getValue( HMI_TurnInd_FL_On_Rq );
    _mEL_TurnInd_Rq_AR.TurnInd_FR_On_Rq.phys = getValue( HMI_TurnInd_FR_On_Rq );
    _mEL_TurnInd_Rq_AR.TurnInd_Lt_On.phys = getValue( HMI_TurnInd_Lt_On );
    _mEL_TurnInd_Rq_AR.TurnInd_RL_On_Rq.phys = getValue( HMI_TurnInd_RL_On_Rq );
    _mEL_TurnInd_Rq_AR.TurnInd_RR_On_Rq.phys = getValue( HMI_TurnInd_RR_On_Rq );
    _mEL_TurnInd_Rq_AR.TurnInd_Rt_On.phys = getValue( HMI_TurnInd_Rt_On );
    _mEL_TurnInd_Rq_AR.TurnLmpOnDur.phys = getValue( HMI_TurnLmpOnDur );
}
/*@@end*/

/*@@caplFunc:EL_TurnInd_Rq_AR_output():*/
void EL_TurnInd_Rq_AR_output(void)
{
    byte crc;
    byte SQC_help;

    if( !getValue( HMI_SQC_EL_TurnInd_On_Rq_Auto ) )
    {
        // berechne message counter
        SQC_help = getValue( HMI_SQC_EL_TurnInd_On_Rq );
        if( SQC_help >= 15 ) SQC_help = 0;
        else SQC_help++;
        putValue( HMI_SQC_EL_TurnInd_On_Rq, SQC_help );
        _mEL_TurnInd_Rq_AR.SQC_EL_TurnInd_On_Rq = SQC_help;
    }
    else
          _mEL_TurnInd_Rq_AR.SQC_EL_TurnInd_On_Rq = getValue( HMI_SQC_EL_TurnInd_On_Rq );

    if( getValue( HMI_CRC_EL_TurnInd_On_Rq_Profile_02 ) )
    {
        if( !getValue( HMI_CRC_EL_TurnInd_On_Rq_Auto ) )
        {   // CRC according Profile_02 ( W213 )
            // berechne crc
            crc = 0xFF;
//            crc = crctable_profile02[crc ^ _mEL_TurnInd_Rq_AR.byte( 0 )];  CRC
            crc = crctable_profile02[crc ^ _mEL_TurnInd_Rq_AR.byte( 1 )];
            crc = crctable_profile02[crc ^ _mEL_TurnInd_Rq_AR.byte( 2 )];
            crc = crctable_profile02[crc ^ _mEL_TurnInd_Rq_AR.byte( 3 )];
//            crc = crctable_profile02[crc ^ _mEL_TurnInd_Rq_AR.byte( 4 )];
//            crc = crctable_profile02[crc ^ _mEL_TurnInd_Rq_AR.byte( 5 )];
//            crc = crctable_profile02[crc ^ _mEL_TurnInd_Rq_AR.byte( 6 )];
//            crc = crctable_profile02[crc ^ _mEL_TurnInd_Rq_AR.byte( 7 )];
            crc = crctable_profile02[crc ^ _EL_TurnInd_Rq_AR_CRC_Offset[ _mEL_TurnInd_Rq_AR.SQC_EL_TurnInd_On_Rq ] ]; // load offset
            crc = (crc ^ 0xFF);
            if( getValue(  HMI_CRC_EL_TurnInd_On_Rq_Invalid ) )
                crc++;
            _mEL_TurnInd_Rq_AR.CRC_EL_TurnInd_On_Rq = crc;
            putValue( HMI_CRC_EL_TurnInd_On_Rq, crc );
        }
        else
            _mEL_TurnInd_Rq_AR.CRC_EL_TurnInd_On_Rq = getValue( HMI_CRC_EL_TurnInd_On_Rq );
    }
    output( _mEL_TurnInd_Rq_AR );
}
/*@@end*/

/*@@caplFunc:EL_TurnInd_Rq_AR_saveEnvVars(dword):*/
EL_TurnInd_Rq_AR_saveEnvVars( dword hFile )
{
    filePutString("\n// Knoten EIS: EL_TurnInd_Rq_AR\n", 30, hFile );
    snprintf( buffer, elcount( buffer ), "0.0000 HMI__STMSG_EL_TurnInd_Rq_AR := %X\n", getValue( HMI__STMSG_EL_TurnInd_Rq_AR ) );        filePutString ( buffer, elcount( buffer ), hFile );
    snprintf( buffer, elcount( buffer ), "0.0000 HMI__STMSGT_EL_TurnInd_Rq_AR := %X\n", getValue( HMI__STMSGT_EL_TurnInd_Rq_AR ) );        filePutString ( buffer, elcount( buffer ), hFile );
    snprintf( buffer, elcount( buffer ), "0.0000 HMI_CRC_EL_TurnInd_On_Rq := %X\n", getValue( HMI_CRC_EL_TurnInd_On_Rq ) );        filePutString ( buffer, elcount( buffer ), hFile );
    snprintf( buffer, elcount( buffer ), "0.0000 HMI_CRC_EL_TurnInd_On_Rq_Auto := %X\n", getValue( HMI_CRC_EL_TurnInd_On_Rq_Auto ) );        filePutString ( buffer, elcount( buffer ), hFile );
    snprintf( buffer, elcount( buffer ), "0.0000 HMI_CRC_EL_TurnInd_On_Rq_Profile_02 := %X\n", getValue( HMI_CRC_EL_TurnInd_On_Rq_Profile_02 ) );        filePutString ( buffer, elcount( buffer ), hFile );
    snprintf( buffer, elcount( buffer ), "0.0000 HMI_EF_Actv := %X\n", getValue( HMI_EF_Actv ) );        filePutString ( buffer, elcount( buffer ), hFile );
    snprintf( buffer, elcount( buffer ), "0.0000 HMI_Rsrv1_EL_TurnInd_On_Rq := %X\n", getValue( HMI_Rsrv1_EL_TurnInd_On_Rq ) );        filePutString ( buffer, elcount( buffer ), hFile );
    snprintf( buffer, elcount( buffer ), "0.0000 HMI_SQC_EL_TurnInd_On_Rq := %X\n", getValue( HMI_SQC_EL_TurnInd_On_Rq ) );        filePutString ( buffer, elcount( buffer ), hFile );
    snprintf( buffer, elcount( buffer ), "0.0000 HMI_SQC_EL_TurnInd_On_Rq_Auto := %X\n", getValue( HMI_SQC_EL_TurnInd_On_Rq_Auto ) );        filePutString ( buffer, elcount( buffer ), hFile );
    snprintf( buffer, elcount( buffer ), "0.0000 HMI_TurnInd_FL_On_Rq := %X\n", getValue( HMI_TurnInd_FL_On_Rq ) );        filePutString ( buffer, elcount( buffer ), hFile );
    snprintf( buffer, elcount( buffer ), "0.0000 HMI_TurnInd_FR_On_Rq := %X\n", getValue( HMI_TurnInd_FR_On_Rq ) );        filePutString ( buffer, elcount( buffer ), hFile );
    snprintf( buffer, elcount( buffer ), "0.0000 HMI_TurnInd_Lt_On := %X\n", getValue( HMI_TurnInd_Lt_On ) );        filePutString ( buffer, elcount( buffer ), hFile );
    snprintf( buffer, elcount( buffer ), "0.0000 HMI_TurnInd_RL_On_Rq := %X\n", getValue( HMI_TurnInd_RL_On_Rq ) );        filePutString ( buffer, elcount( buffer ), hFile );
    snprintf( buffer, elcount( buffer ), "0.0000 HMI_TurnInd_RR_On_Rq := %X\n", getValue( HMI_TurnInd_RR_On_Rq ) );        filePutString ( buffer, elcount( buffer ), hFile );
    snprintf( buffer, elcount( buffer ), "0.0000 HMI_TurnInd_Rt_On := %X\n", getValue( HMI_TurnInd_Rt_On ) );        filePutString ( buffer, elcount( buffer ), hFile );
    snprintf( buffer, elcount( buffer ), "0.0000 HMI_TurnLmpOnDur := %X\n", getValue( HMI_TurnLmpOnDur ) );        filePutString ( buffer, elcount( buffer ), hFile );
}
/*@@end*/

/*@@timer:_tEL_TurnInd_Rq_AR:*/
on timer _tEL_TurnInd_Rq_AR
{
    putValue( HMI__STMSG_EL_TurnInd_Rq_AR, 0 );
}
/*@@end*/

/*@@envVar:HMI__STMSG_EL_TurnInd_Rq_AR:*/
on EnvVar HMI__STMSG_EL_TurnInd_Rq_AR
{
    long tDelay;
    if( getValue( this ) == 2 )
    {
        tDelay = getValue( HMI__STMSGT_EL_TurnInd_Rq_AR );
        if( tDelay > 0)    
            setTimer( _tEL_TurnInd_Rq_AR, tDelay );
        else
            putValue( HMI__STMSG_EL_TurnInd_Rq_AR, 0 );
    }
}
/*@@end*/

/*@@envVar:HMI__STMSP_EL_TurnInd_Rq_AR:*/
on EnvVar HMI__STMSP_EL_TurnInd_Rq_AR
{
/* HJH inserted VDO */
    _EL_TurnInd_Rq_AR_SpontanFlag = 1;
    if( getValue( this ) )
        putValue( this, 0 );
}
/*@@end*/

/*@@envVar:HMI_EF_Actv:*/
on EnvVar HMI_EF_Actv
{
    _mEL_TurnInd_Rq_AR.EF_Actv.phys = getValue(this);
    _EL_TurnInd_Rq_AR_SpontanFlag = 1;
}
/*@@end*/

/*@@envVar:HMI_Rsrv1_EL_TurnInd_On_Rq:*/
on EnvVar HMI_Rsrv1_EL_TurnInd_On_Rq
{
    _mEL_TurnInd_Rq_AR.Rsrv1_EL_TurnInd_On_Rq.phys = getValue(this);
    _EL_TurnInd_Rq_AR_SpontanFlag = 1;
}
/*@@end*/

/*@@envVar:HMI_TurnInd_FL_On_Rq:*/
on EnvVar HMI_TurnInd_FL_On_Rq
{
    _mEL_TurnInd_Rq_AR.TurnInd_FL_On_Rq.phys = getValue(this);
    _EL_TurnInd_Rq_AR_SpontanFlag = 1;
}
/*@@end*/

/*@@envVar:HMI_TurnInd_FR_On_Rq:*/
on EnvVar HMI_TurnInd_FR_On_Rq
{
    _mEL_TurnInd_Rq_AR.TurnInd_FR_On_Rq.phys = getValue(this);
    _EL_TurnInd_Rq_AR_SpontanFlag = 1;
}
/*@@end*/

/*@@envVar:HMI_TurnInd_Lt_On:*/
on EnvVar HMI_TurnInd_Lt_On
{
    _mEL_TurnInd_Rq_AR.TurnInd_Lt_On.phys = getValue(this);
    _EL_TurnInd_Rq_AR_SpontanFlag = 1;
}
/*@@end*/

/*@@envVar:HMI_TurnInd_RL_On_Rq:*/
on EnvVar HMI_TurnInd_RL_On_Rq
{
    _mEL_TurnInd_Rq_AR.TurnInd_RL_On_Rq.phys = getValue(this);
    _EL_TurnInd_Rq_AR_SpontanFlag = 1;
}
/*@@end*/

/*@@envVar:HMI_TurnInd_RR_On_Rq:*/
on EnvVar HMI_TurnInd_RR_On_Rq
{
    _mEL_TurnInd_Rq_AR.TurnInd_RR_On_Rq.phys = getValue(this);
    _EL_TurnInd_Rq_AR_SpontanFlag = 1;
}
/*@@end*/

/*@@envVar:HMI_TurnInd_Rt_On:*/
on EnvVar HMI_TurnInd_Rt_On
{
    _mEL_TurnInd_Rq_AR.TurnInd_Rt_On.phys = getValue(this);
    _EL_TurnInd_Rq_AR_SpontanFlag = 1;
}
/*@@end*/

/*@@envVar:HMI_TurnLmpOnDur:*/
on EnvVar HMI_TurnLmpOnDur
{
    _mEL_TurnInd_Rq_AR.TurnLmpOnDur.phys = getValue(this);
    _EL_TurnInd_Rq_AR_SpontanFlag = 1;
}
/*@@end*/

/*@@caplFunc:Eng_Rs_EngCtrl_AR_check_output():*/
Eng_Rs_EngCtrl_AR_check_output()
{
    if( !getValue( HMI__STMSG_Eng_Rs_EngCtrl_AR ) )
    {
        // Botschaft Eng_Rs_EngCtrl_AR ID: 177 --- Sendeart 0 cyclicX --- 
        _Eng_Rs_EngCtrl_AR_Cnt--;
        if( _Eng_Rs_EngCtrl_AR_Cnt < 1 )
        {
            // Nachricht wg. abgelaufenem Zyklus ausgeben
            Eng_Rs_EngCtrl_AR_output();
            // Zyklus-Zähler zurücksetzen
            _Eng_Rs_EngCtrl_AR_Cnt = _Eng_Rs_EngCtrl_AR_CycleCount;
        }
    }
}
/*@@end*/

/*@@caplFunc:Eng_Rs_EngCtrl_AR_init():*/
Eng_Rs_EngCtrl_AR_init()
{   /* Botschaft Eng_Rs_EngCtrl_AR ID: 177 --- Sendeart 0 cyclicX --- 
BA_ "ApplMessage" BO_ 177 0;
BA_ "NmAsrMessage" BO_ 177 0;
BA_ "GenMsgMinAcceptLength" BO_ 177 8;
BA_ "GenMsgILSupport" BO_ 177 1;
BA_ "DiagState" BO_ 177 0;
BA_ "DiagRequest" BO_ 177 0;
BA_ "DiagResponse" BO_ 177 0;
BA_ "GenMsgStartValue" BO_ 177 "0";
BA_ "GenMsgStartDelayTime" BO_ 177 0;
BA_ "GenMsgCycleTime" BO_ 177 10;
BA_ "GenMsgSendType" BO_ 177 0;
    */
    _Eng_Rs_EngCtrl_AR_Timebase =         c_tDBKomTimer_5ms;
    _Eng_Rs_EngCtrl_AR_CycleCount =     10 / _Eng_Rs_EngCtrl_AR_Timebase;
    _Eng_Rs_EngCtrl_AR_StartDelay =      0 / _Eng_Rs_EngCtrl_AR_Timebase;
    _Eng_Rs_EngCtrl_AR_Cnt = _Eng_Rs_EngCtrl_AR_StartDelay;

    putValue( HMI__STMSGSD_Eng_Rs_EngCtrl_AR, _Eng_Rs_EngCtrl_AR_StartDelay * _Eng_Rs_EngCtrl_AR_Timebase );

    _mEng_Rs_EngCtrl_AR.AddPwrCnsmr_On_Rq.phys = getValue( HMI_AddPwrCnsmr_On_Rq );
    _mEng_Rs_EngCtrl_AR.CRC_Eng_Rs_EngCtrl.phys = getValue( HMI_CRC_Eng_Rs_EngCtrl );
    _mEng_Rs_EngCtrl_AR.EngRPM.phys = getValue( HMI_EngRPM );
    _mEng_Rs_EngCtrl_AR.EngRPM_Sens_LHOM.phys = getValue( HMI_EngRPM_Sens_LHOM );
    _mEng_Rs_EngCtrl_AR.EngRun_Stat.phys = getValue( HMI_EngRun_Stat );
    _mEng_Rs_EngCtrl_AR.EngStyle.phys = getValue( HMI_EngStyle );
    _mEng_Rs_EngCtrl_AR.EngTrq.phys = getValue( HMI_EngTrq );
    _mEng_Rs_EngCtrl_AR.EngTrqLmtd_Misfire.phys = getValue( HMI_EngTrqLmtd_Misfire );
    _mEng_Rs_EngCtrl_AR.EngTrqMaxCorrFctr.phys = getValue( HMI_EngTrqMaxCorrFctr );
    _mEng_Rs_EngCtrl_AR.OFC_Stat_PT.phys = getValue( HMI_OFC_Stat_PT );
    _mEng_Rs_EngCtrl_AR.Rsrv2_Eng_Rs_EngCtrl.phys = getValue( HMI_Rsrv2_Eng_Rs_EngCtrl );
    _mEng_Rs_EngCtrl_AR.SQC_Eng_Rs_EngCtrl.phys = getValue( HMI_SQC_Eng_Rs_EngCtrl );
}
/*@@end*/

/*@@caplFunc:Eng_Rs_EngCtrl_AR_output():*/
void Eng_Rs_EngCtrl_AR_output(void)
{
    byte crc;
    byte SQC_help;

    if( !getValue( HMI_SQC_Eng_Rs_EngCtrl_Auto ) )
    {
        // berechne message counter
        SQC_help = getValue( HMI_SQC_Eng_Rs_EngCtrl );
        if( SQC_help >= 15 ) SQC_help = 0;
        else SQC_help++;
        putValue( HMI_SQC_Eng_Rs_EngCtrl, SQC_help );
        _mEng_Rs_EngCtrl_AR.SQC_Eng_Rs_EngCtrl = SQC_help;
    }
    else
          _mEng_Rs_EngCtrl_AR.SQC_Eng_Rs_EngCtrl = getValue( HMI_SQC_Eng_Rs_EngCtrl );

    if( !getValue( HMI_CRC_Eng_Rs_EngCtrl_Profile_02 ) )
    {
        if( !getValue( HMI_CRC_Eng_Rs_EngCtrl_Auto ) )
        {   // CRC according Profile_02 ( W213 )
            // berechne crc
            crc = 0xFF;
            // crc = crctable_profile02[crc ^ _mEng_Rs_EngCtrl_AR.byte( 0 )];  CRC
            crc = crctable_profile02[crc ^ _mEng_Rs_EngCtrl_AR.byte( 1 )];
            crc = crctable_profile02[crc ^ _mEng_Rs_EngCtrl_AR.byte( 2 )];
            crc = crctable_profile02[crc ^ _mEng_Rs_EngCtrl_AR.byte( 3 )];
            crc = crctable_profile02[crc ^ _mEng_Rs_EngCtrl_AR.byte( 4 )];
            crc = crctable_profile02[crc ^ _mEng_Rs_EngCtrl_AR.byte( 5 )];
            crc = crctable_profile02[crc ^ _mEng_Rs_EngCtrl_AR.byte( 6 )];
            crc = crctable_profile02[crc ^ _mEng_Rs_EngCtrl_AR.byte( 7 )];
            crc = crctable_profile02[crc ^ _Eng_Rs_EngCtrl_AR_CRC_Offset[ _mEng_Rs_EngCtrl_AR.SQC_Eng_Rs_EngCtrl ] ]; // load offset
            crc = (crc ^ 0xFF);
            if( getValue(  HMI_CRC_Eng_Rs_EngCtrl_Invalid ) )
                crc++;
            _mEng_Rs_EngCtrl_AR.CRC_Eng_Rs_EngCtrl = crc;
            putValue( HMI_CRC_Eng_Rs_EngCtrl, crc );
        }
        else
            _mEng_Rs_EngCtrl_AR.CRC_Eng_Rs_EngCtrl = getValue( HMI_CRC_Eng_Rs_EngCtrl );
    }
    else
    {
        if( !getValue( HMI_CRC_Eng_Rs_EngCtrl_Auto ) )
        {   // CRC according to SAE1850 ( W222 )
            // berechne crc
            crc = 0xFF;
//            crc = crctable[crc ^ _mEng_Rs_EngCtrl_AR.byte( 0 )];  CRC
            crc = crctable[crc ^ _mEng_Rs_EngCtrl_AR.byte( 1 )];
            crc = crctable[crc ^ _mEng_Rs_EngCtrl_AR.byte( 2 )];
            crc = crctable[crc ^ _mEng_Rs_EngCtrl_AR.byte( 3 )];
            crc = crctable[crc ^ _mEng_Rs_EngCtrl_AR.byte( 4 )];
            crc = crctable[crc ^ _mEng_Rs_EngCtrl_AR.byte( 5 )];
            crc = crctable[crc ^ _mEng_Rs_EngCtrl_AR.byte( 6 )];
            crc = crctable[crc ^ _mEng_Rs_EngCtrl_AR.byte( 7 )];
            crc = (crc ^ 0xFF);
            if( getValue(  HMI_CRC_Eng_Rs_EngCtrl_Invalid ) )
                crc++;
            _mEng_Rs_EngCtrl_AR.CRC_Eng_Rs_EngCtrl = crc;
            putValue( HMI_CRC_Eng_Rs_EngCtrl, crc );
        }
        else
            _mEng_Rs_EngCtrl_AR.CRC_Eng_Rs_EngCtrl = getValue( HMI_CRC_Eng_Rs_EngCtrl );
    }
    output( _mEng_Rs_EngCtrl_AR );
}
/*@@end*/

/*@@caplFunc:Eng_Rs_EngCtrl_AR_saveEnvVars(dword):*/
Eng_Rs_EngCtrl_AR_saveEnvVars( dword hFile )
{
    filePutString("\n// Knoten EIS: Eng_Rs_EngCtrl_AR\n", 31, hFile );
    snprintf( buffer, elcount( buffer ), "0.0000 HMI__STMSG_Eng_Rs_EngCtrl_AR := %X\n", getValue( HMI__STMSG_Eng_Rs_EngCtrl_AR ) );        filePutString ( buffer, elcount( buffer ), hFile );
    snprintf( buffer, elcount( buffer ), "0.0000 HMI__STMSGT_Eng_Rs_EngCtrl_AR := %X\n", getValue( HMI__STMSGT_Eng_Rs_EngCtrl_AR ) );        filePutString ( buffer, elcount( buffer ), hFile );
    snprintf( buffer, elcount( buffer ), "0.0000 HMI_AddPwrCnsmr_On_Rq := %X\n", getValue( HMI_AddPwrCnsmr_On_Rq ) );        filePutString ( buffer, elcount( buffer ), hFile );
    snprintf( buffer, elcount( buffer ), "0.0000 HMI_CRC_Eng_Rs_EngCtrl := %X\n", getValue( HMI_CRC_Eng_Rs_EngCtrl ) );        filePutString ( buffer, elcount( buffer ), hFile );
    snprintf( buffer, elcount( buffer ), "0.0000 HMI_CRC_Eng_Rs_EngCtrl_Auto := %X\n", getValue( HMI_CRC_Eng_Rs_EngCtrl_Auto ) );        filePutString ( buffer, elcount( buffer ), hFile );
    snprintf( buffer, elcount( buffer ), "0.0000 HMI_EngRPM := %X\n", getValue( HMI_EngRPM ) );        filePutString ( buffer, elcount( buffer ), hFile );
    snprintf( buffer, elcount( buffer ), "0.0000 HMI_EngRPM_Sens_LHOM := %X\n", getValue( HMI_EngRPM_Sens_LHOM ) );        filePutString ( buffer, elcount( buffer ), hFile );
    snprintf( buffer, elcount( buffer ), "0.0000 HMI_EngRun_Stat := %X\n", getValue( HMI_EngRun_Stat ) );        filePutString ( buffer, elcount( buffer ), hFile );
    snprintf( buffer, elcount( buffer ), "0.0000 HMI_EngStyle := %X\n", getValue( HMI_EngStyle ) );        filePutString ( buffer, elcount( buffer ), hFile );
    snprintf( buffer, elcount( buffer ), "0.0000 HMI_EngTrq := %X\n", getValue( HMI_EngTrq ) );        filePutString ( buffer, elcount( buffer ), hFile );
    snprintf( buffer, elcount( buffer ), "0.0000 HMI_EngTrqLmtd_Misfire := %X\n", getValue( HMI_EngTrqLmtd_Misfire ) );        filePutString ( buffer, elcount( buffer ), hFile );
    snprintf( buffer, elcount( buffer ), "0.0000 HMI_EngTrqMaxCorrFctr := %X\n", getValue( HMI_EngTrqMaxCorrFctr ) );        filePutString ( buffer, elcount( buffer ), hFile );
    snprintf( buffer, elcount( buffer ), "0.0000 HMI_OFC_Stat_PT := %X\n", getValue( HMI_OFC_Stat_PT ) );        filePutString ( buffer, elcount( buffer ), hFile );
    snprintf( buffer, elcount( buffer ), "0.0000 HMI_Rsrv2_Eng_Rs_EngCtrl := %X\n", getValue( HMI_Rsrv2_Eng_Rs_EngCtrl ) );        filePutString ( buffer, elcount( buffer ), hFile );
    snprintf( buffer, elcount( buffer ), "0.0000 HMI_SQC_Eng_Rs_EngCtrl := %X\n", getValue( HMI_SQC_Eng_Rs_EngCtrl ) );        filePutString ( buffer, elcount( buffer ), hFile );
    snprintf( buffer, elcount( buffer ), "0.0000 HMI_SQC_Eng_Rs_EngCtrl_Auto := %X\n", getValue( HMI_SQC_Eng_Rs_EngCtrl_Auto ) );        filePutString ( buffer, elcount( buffer ), hFile );
}
/*@@end*/

/*@@timer:_tEng_Rs_EngCtrl_AR:*/
on timer _tEng_Rs_EngCtrl_AR
{
    putValue( HMI__STMSG_Eng_Rs_EngCtrl_AR, 0 );
}
/*@@end*/

/*@@envVar:HMI__STMSG_Eng_Rs_EngCtrl_AR:*/
on EnvVar HMI__STMSG_Eng_Rs_EngCtrl_AR
{
    long tDelay;
    if( getValue( this ) == 2 )
    {
        tDelay = getValue( HMI__STMSGT_Eng_Rs_EngCtrl_AR );
        if( tDelay > 0)    
            setTimer( _tEng_Rs_EngCtrl_AR, tDelay );
        else
            putValue( HMI__STMSG_Eng_Rs_EngCtrl_AR, 0 );
    }
}
/*@@end*/

/*@@envVar:HMI_AddPwrCnsmr_On_Rq:*/
on EnvVar HMI_AddPwrCnsmr_On_Rq
{
    _mEng_Rs_EngCtrl_AR.AddPwrCnsmr_On_Rq.phys = getValue(this);
}
/*@@end*/

/*@@envVar:HMI_EngRPM:*/
on EnvVar HMI_EngRPM
{
    _mEng_Rs_EngCtrl_AR.EngRPM.phys = getValue(this);
}
/*@@end*/

/*@@envVar:HMI_EngRPM_Sens_LHOM:*/
on EnvVar HMI_EngRPM_Sens_LHOM
{
    _mEng_Rs_EngCtrl_AR.EngRPM_Sens_LHOM.phys = getValue(this);
}
/*@@end*/

/*@@envVar:HMI_EngRun_Stat:*/
on EnvVar HMI_EngRun_Stat
{
    _mEng_Rs_EngCtrl_AR.EngRun_Stat.phys = getValue(this);
}
/*@@end*/

/*@@envVar:HMI_EngStyle:*/
on EnvVar HMI_EngStyle
{
    _mEng_Rs_EngCtrl_AR.EngStyle.phys = getValue(this);
}
/*@@end*/

/*@@envVar:HMI_EngTrq:*/
on EnvVar HMI_EngTrq
{
    _mEng_Rs_EngCtrl_AR.EngTrq.phys = getValue(this);
}
/*@@end*/

/*@@envVar:HMI_EngTrqLmtd_Misfire:*/
on EnvVar HMI_EngTrqLmtd_Misfire
{
    _mEng_Rs_EngCtrl_AR.EngTrqLmtd_Misfire.phys = getValue(this);
}
/*@@end*/

/*@@envVar:HMI_EngTrqMaxCorrFctr:*/
on EnvVar HMI_EngTrqMaxCorrFctr
{
    _mEng_Rs_EngCtrl_AR.EngTrqMaxCorrFctr.phys = getValue(this);
}
/*@@end*/

/*@@envVar:HMI_OFC_Stat_PT:*/
on EnvVar HMI_OFC_Stat_PT
{
    _mEng_Rs_EngCtrl_AR.OFC_Stat_PT.phys = getValue(this);
}
/*@@end*/

/*@@envVar:HMI_Rsrv2_Eng_Rs_EngCtrl:*/
on EnvVar HMI_Rsrv2_Eng_Rs_EngCtrl
{
    _mEng_Rs_EngCtrl_AR.Rsrv2_Eng_Rs_EngCtrl.phys = getValue(this);
}
/*@@end*/

/*@@caplFunc:Eng_Rs2_AR_check_output():*/
Eng_Rs2_AR_check_output()
{
    if( !getValue( HMI__STMSG_Eng_Rs2_AR ) )
    {
        // Botschaft Eng_Rs2_AR ID: 119 --- Sendeart 0 cyclicX --- 
        _Eng_Rs2_AR_Cnt--;
        if( _Eng_Rs2_AR_Cnt < 1 )
        {
            Eng_Rs2_AR_output();  // Nachricht wg. abgelaufenem Zyklus ausgeben
            _Eng_Rs2_AR_Cnt = _Eng_Rs2_AR_CycleCount;  // Zyklus-Zähler zurücksetzen
        }
    }
}
/*@@end*/

/*@@caplFunc:Eng_Rs2_AR_init():*/
Eng_Rs2_AR_init()
{   /* Botschaft Eng_Rs2_AR ID: 119 --- Sendeart 0 cyclicX --- 
BA_ "ApplMessage" BO_ 119 0;
BA_ "NmAsrMessage" BO_ 119 0;
BA_ "GenMsgMinAcceptLength" BO_ 119 8;
BA_ "GenMsgILSupport" BO_ 119 1;
BA_ "DiagState" BO_ 119 0;
BA_ "DiagRequest" BO_ 119 0;
BA_ "DiagResponse" BO_ 119 0;
BA_ "GenMsgStartValue" BO_ 119 "0";
BA_ "GenMsgStartDelayTime" BO_ 119 0;
BA_ "GenMsgCycleTime" BO_ 119 20;
BA_ "GenMsgSendType" BO_ 119 0;
    */
    _Eng_Rs2_AR_Timebase =          c_tDBKomTimer_20ms;
    _Eng_Rs2_AR_CycleCount =       20 / _Eng_Rs2_AR_Timebase;
    _Eng_Rs2_AR_StartDelay =        0 / _Eng_Rs2_AR_Timebase;
    _Eng_Rs2_AR_Cnt = _Eng_Rs2_AR_StartDelay;

    putValue( HMI__STMSGSD_Eng_Rs2_AR, _Eng_Rs2_AR_StartDelay * _Eng_Rs2_AR_Timebase );

    _mEng_Rs2_AR.EngTrqMax.phys = getValue( HMI_EngTrqMax );
    _mEng_Rs2_AR.EngTrqMin.phys = getValue( HMI_EngTrqMin );
    _mEng_Rs2_AR.EngTrqStatic.phys = getValue( HMI_EngTrqStatic );
    _mEng_Rs2_AR.Rsrv1_Eng_Rs2.phys = getValue( HMI_Rsrv1_Eng_Rs2 );
    _mEng_Rs2_AR.Rsrv2_Eng_Rs2.phys = getValue( HMI_Rsrv2_Eng_Rs2 );
    _mEng_Rs2_AR.Rsrv3_Eng_Rs2.phys = getValue( HMI_Rsrv3_Eng_Rs2 );
    _mEng_Rs2_AR.Rsrv4_Eng_Rs2.phys = getValue( HMI_Rsrv4_Eng_Rs2 );
}
/*@@end*/

/*@@caplFunc:Eng_Rs2_AR_output():*/
void Eng_Rs2_AR_output(void)
{
    byte crc;
    byte SQC_help;

    if( !getValue( HMI_SQC_Eng_Rs2_Auto ) )
    {
        // berechne message counter
        SQC_help = getValue( HMI_SQC_Eng_Rs2 );
        if( SQC_help >= 15 ) SQC_help = 0;
        else SQC_help++;
        putValue( HMI_SQC_Eng_Rs2, SQC_help );
        _mEng_Rs2_AR.SQC_Eng_Rs2 = SQC_help;
    }
    else
          _mEng_Rs2_AR.SQC_Eng_Rs2 = getValue( HMI_SQC_Eng_Rs2 );

    if( getValue( HMI_CRC_Eng_Rs2_Profile_02 ) )
    {
        if( !getValue( HMI_CRC_Eng_Rs2_Auto ) )
        {   // CRC according Profile_02 ( W213 )
            // berechne crc
            crc = 0xFF;
//            crc = crctable_profile02[crc ^ _mEng_Rs2_AR.byte( 0 )];  CRC
            crc = crctable_profile02[crc ^ _mEng_Rs2_AR.byte( 1 )];
            crc = crctable_profile02[crc ^ _mEng_Rs2_AR.byte( 2 )];
            crc = crctable_profile02[crc ^ _mEng_Rs2_AR.byte( 3 )];
            crc = crctable_profile02[crc ^ _mEng_Rs2_AR.byte( 4 )];
            crc = crctable_profile02[crc ^ _mEng_Rs2_AR.byte( 5 )];
            crc = crctable_profile02[crc ^ _mEng_Rs2_AR.byte( 6 )];
            crc = crctable_profile02[crc ^ _mEng_Rs2_AR.byte( 7 )];
            crc = crctable_profile02[crc ^ _Eng_Rs2_AR_CRC_Offset[ _mEng_Rs2_AR.SQC_Eng_Rs2 ] ]; // load offset
            crc = (crc ^ 0xFF);
            if( getValue(  HMI_CRC_Eng_Rs2_Invalid ) )
                crc++;
            _mEng_Rs2_AR.CRC_Eng_Rs2 = crc;
            putValue( HMI_CRC_Eng_Rs2, crc );
        }
        else
            _mEng_Rs2_AR.CRC_Eng_Rs2 = getValue( HMI_CRC_Eng_Rs2 );
    }
    else
    {
        if( !getValue( HMI_CRC_Eng_Rs2_Auto ) )
        {   // CRC according to SAE1850 ( W222 )
            // berechne crc
            crc = 0xFF;
//            crc = crctable[crc ^ _mEng_Rs2_AR.byte( 0 )];  CRC
            crc = crctable[crc ^ _mEng_Rs2_AR.byte( 1 )];
            crc = crctable[crc ^ _mEng_Rs2_AR.byte( 2 )];
            crc = crctable[crc ^ _mEng_Rs2_AR.byte( 3 )];
            crc = crctable[crc ^ _mEng_Rs2_AR.byte( 4 )];
            crc = crctable[crc ^ _mEng_Rs2_AR.byte( 5 )];
            crc = crctable[crc ^ _mEng_Rs2_AR.byte( 6 )];
            crc = crctable[crc ^ _mEng_Rs2_AR.byte( 7 )];
            crc = (crc ^ 0xFF);
            if( getValue(  HMI_CRC_Eng_Rs2_Invalid ) )
                crc++;
            _mEng_Rs2_AR.CRC_Eng_Rs2 = crc;
            putValue( HMI_CRC_Eng_Rs2, crc );
        }
        else
            _mEng_Rs2_AR.CRC_Eng_Rs2 = getValue( HMI_CRC_Eng_Rs2 );
    }
    output( _mEng_Rs2_AR );
}
/*@@end*/

/*@@caplFunc:Eng_Rs2_AR_saveEnvVars(dword):*/
Eng_Rs2_AR_saveEnvVars( dword hFile )
{
    filePutString("\n// Knoten EIS: Eng_Rs2_AR\n", 24, hFile );
    snprintf( buffer, elcount( buffer ), "0.0000 HMI__STMSG_Eng_Rs2_AR := %X\n", getValue( HMI__STMSG_Eng_Rs2_AR ) );        filePutString ( buffer, elcount( buffer ), hFile );
    snprintf( buffer, elcount( buffer ), "0.0000 HMI__STMSGT_Eng_Rs2_AR := %X\n", getValue( HMI__STMSGT_Eng_Rs2_AR ) );        filePutString ( buffer, elcount( buffer ), hFile );
    snprintf( buffer, elcount( buffer ), "0.0000 HMI_CRC_Eng_Rs2 := %X\n", getValue( HMI_CRC_Eng_Rs2 ) );        filePutString ( buffer, elcount( buffer ), hFile );
    snprintf( buffer, elcount( buffer ), "0.0000 HMI_CRC_Eng_Rs2_Auto := %X\n", getValue( HMI_CRC_Eng_Rs2_Auto ) );        filePutString ( buffer, elcount( buffer ), hFile );
    snprintf( buffer, elcount( buffer ), "0.0000 HMI_EngTrqMax := %X\n", getValue( HMI_EngTrqMax ) );        filePutString ( buffer, elcount( buffer ), hFile );
    snprintf( buffer, elcount( buffer ), "0.0000 HMI_EngTrqMin := %X\n", getValue( HMI_EngTrqMin ) );        filePutString ( buffer, elcount( buffer ), hFile );
    snprintf( buffer, elcount( buffer ), "0.0000 HMI_EngTrqStatic := %X\n", getValue( HMI_EngTrqStatic ) );        filePutString ( buffer, elcount( buffer ), hFile );
    snprintf( buffer, elcount( buffer ), "0.0000 HMI_Rsrv1_Eng_Rs2 := %X\n", getValue( HMI_Rsrv1_Eng_Rs2 ) );        filePutString ( buffer, elcount( buffer ), hFile );
    snprintf( buffer, elcount( buffer ), "0.0000 HMI_Rsrv2_Eng_Rs2 := %X\n", getValue( HMI_Rsrv2_Eng_Rs2 ) );        filePutString ( buffer, elcount( buffer ), hFile );
    snprintf( buffer, elcount( buffer ), "0.0000 HMI_Rsrv3_Eng_Rs2 := %X\n", getValue( HMI_Rsrv3_Eng_Rs2 ) );        filePutString ( buffer, elcount( buffer ), hFile );
    snprintf( buffer, elcount( buffer ), "0.0000 HMI_Rsrv4_Eng_Rs2 := %X\n", getValue( HMI_Rsrv4_Eng_Rs2 ) );        filePutString ( buffer, elcount( buffer ), hFile );
    snprintf( buffer, elcount( buffer ), "0.0000 HMI_SQC_Eng_Rs2 := %X\n", getValue( HMI_SQC_Eng_Rs2 ) );        filePutString ( buffer, elcount( buffer ), hFile );
    snprintf( buffer, elcount( buffer ), "0.0000 HMI_SQC_Eng_Rs2_Auto := %X\n", getValue( HMI_SQC_Eng_Rs2_Auto ) );        filePutString ( buffer, elcount( buffer ), hFile );
}
/*@@end*/

/*@@timer:_tEng_Rs2_AR:*/
on timer _tEng_Rs2_AR
{
    putValue( HMI__STMSG_Eng_Rs2_AR, 0 );
}
/*@@end*/

/*@@envVar:HMI__STMSG_Eng_Rs2_AR:*/
on EnvVar HMI__STMSG_Eng_Rs2_AR
{
    long tDelay;
    if( getValue( this ) == 2 )
    {
        tDelay = getValue( HMI__STMSGT_Eng_Rs2_AR );
        if( tDelay > 0)    
            setTimer( _tEng_Rs2_AR, tDelay );
        else
            putValue( HMI__STMSG_Eng_Rs2_AR, 0 );
    }
}
/*@@end*/

/*@@envVar:HMI_EngTrqMax:*/
on EnvVar HMI_EngTrqMax
{
    _mEng_Rs2_AR.EngTrqMax.phys = getValue(this);
}
/*@@end*/

/*@@envVar:HMI_EngTrqMin:*/
on EnvVar HMI_EngTrqMin
{
    _mEng_Rs2_AR.EngTrqMin.phys = getValue(this);
}
/*@@end*/

/*@@envVar:HMI_EngTrqStatic:*/
on EnvVar HMI_EngTrqStatic
{
    _mEng_Rs2_AR.EngTrqStatic.phys = getValue(this);
}
/*@@end*/

/*@@envVar:HMI_Rsrv1_Eng_Rs2:*/
on EnvVar HMI_Rsrv1_Eng_Rs2
{
    _mEng_Rs2_AR.Rsrv1_Eng_Rs2.phys = getValue(this);
}
/*@@end*/

/*@@envVar:HMI_Rsrv2_Eng_Rs2:*/
on EnvVar HMI_Rsrv2_Eng_Rs2
{
    _mEng_Rs2_AR.Rsrv2_Eng_Rs2.phys = getValue(this);
}
/*@@end*/

/*@@envVar:HMI_Rsrv3_Eng_Rs2:*/
on EnvVar HMI_Rsrv3_Eng_Rs2
{
    _mEng_Rs2_AR.Rsrv3_Eng_Rs2.phys = getValue(this);
}
/*@@end*/

/*@@envVar:HMI_Rsrv4_Eng_Rs2:*/
on EnvVar HMI_Rsrv4_Eng_Rs2
{
    _mEng_Rs2_AR.Rsrv4_Eng_Rs2.phys = getValue(this);
}
/*@@end*/

/*@@caplFunc:EngCtrl_Disp_Rq_AR_check_output():*/
EngCtrl_Disp_Rq_AR_check_output()
{
    if( !getValue( HMI__STMSG_EngCtrl_Disp_Rq_AR ) )
    {
        // Botschaft EngCtrl_Disp_Rq_AR ID: 327 --- Sendeart 0 cyclicX --- 
        _EngCtrl_Disp_Rq_AR_Cnt--;
        if( _EngCtrl_Disp_Rq_AR_Cnt < 1 )
        {
            // Nachricht wg. abgelaufenem Zyklus ausgeben
            EngCtrl_Disp_Rq_AR_output();
            // Zyklus-Zähler zurücksetzen
            _EngCtrl_Disp_Rq_AR_Cnt = _EngCtrl_Disp_Rq_AR_CycleCount;
        }
    }
}
/*@@end*/

/*@@caplFunc:EngCtrl_Disp_Rq_AR_init():*/
EngCtrl_Disp_Rq_AR_init()
{   /* Botschaft EngCtrl_Disp_Rq_AR ID: 327 --- Sendeart 0 cyclicX --- 
BA_ "ApplMessage" BO_ 327 0;
BA_ "NmAsrMessage" BO_ 327 0;
BA_ "GenMsgMinAcceptLength" BO_ 327 8;
BA_ "GenMsgILSupport" BO_ 327 1;
BA_ "DiagState" BO_ 327 0;
BA_ "DiagRequest" BO_ 327 0;
BA_ "DiagResponse" BO_ 327 0;
BA_ "GenMsgStartValue" BO_ 327 "0";
BA_ "GenMsgStartDelayTime" BO_ 327 0;
BA_ "GenMsgCycleTime" BO_ 327 100;
BA_ "GenMsgSendType" BO_ 327 0;
    */
    _EngCtrl_Disp_Rq_AR_Timebase =        c_tDBKomTimer_20ms;
    _EngCtrl_Disp_Rq_AR_CycleCount =    100 / _EngCtrl_Disp_Rq_AR_Timebase;
    _EngCtrl_Disp_Rq_AR_StartDelay =      0 / _EngCtrl_Disp_Rq_AR_Timebase;
    _EngCtrl_Disp_Rq_AR_Cnt = _EngCtrl_Disp_Rq_AR_StartDelay;

    putValue( HMI__STMSGSD_EngCtrl_Disp_Rq_AR, _EngCtrl_Disp_Rq_AR_StartDelay * _EngCtrl_Disp_Rq_AR_Timebase );

    _mEngCtrl_Disp_Rq_AR.AirStrIndLmp_On_Rq.phys = getValue( HMI_AirStrIndLmp_On_Rq );
    _mEngCtrl_Disp_Rq_AR.BoostPress_Disp_Rq.phys = getValue( HMI_BoostPress_Disp_Rq );
    _mEngCtrl_Disp_Rq_AR.DAC_StErr.phys = getValue( HMI_DAC_StErr );
    _mEngCtrl_Disp_Rq_AR.EngCoolTemp_Disp_Rq.phys = getValue( HMI_EngCoolTemp_Disp_Rq );
    _mEngCtrl_Disp_Rq_AR.EngIdleRPM_Dsr.phys = getValue( HMI_EngIdleRPM_Dsr );
    _mEngCtrl_Disp_Rq_AR.EngOilIndLmp_On_Rq.phys = getValue( HMI_EngOilIndLmp_On_Rq );
    _mEngCtrl_Disp_Rq_AR.EngOilLvl_Sens_Foam_Dtct.phys = getValue( HMI_EngOilLvl_Sens_Foam_Dtct );
    _mEngCtrl_Disp_Rq_AR.EngOilLvl_Sens_LowTemp_Dtct.phys = getValue( HMI_EngOilLvl_Sens_LowTemp_Dtct );
    _mEngCtrl_Disp_Rq_AR.EngOilLvl_V2.phys = getValue( HMI_EngOilLvl_V2 );
    _mEngCtrl_Disp_Rq_AR.EngOilPress_Disp_Rq.phys = getValue( HMI_EngOilPress_Disp_Rq );
    _mEngCtrl_Disp_Rq_AR.EngOilTemp_Above_Max.phys = getValue( HMI_EngOilTemp_Above_Max );
    _mEngCtrl_Disp_Rq_AR.MIL_On_Rq.phys = getValue( HMI_MIL_On_Rq );
    _mEngCtrl_Disp_Rq_AR.OvrRPM_Actv.phys = getValue( HMI_OvrRPM_Actv );
    _mEngCtrl_Disp_Rq_AR.ParticleFltrWarn.phys = getValue( HMI_ParticleFltrWarn );
    _mEngCtrl_Disp_Rq_AR.PreHtIndLmp_On_Rq.phys = getValue( HMI_PreHtIndLmp_On_Rq );
    _mEngCtrl_Disp_Rq_AR.TankCapIndLmp_On_Rq.phys = getValue( HMI_TankCapIndLmp_On_Rq );
    _mEngCtrl_Disp_Rq_AR.TankPressCtrlDisp_Rq.phys = getValue( HMI_TankPressCtrlDisp_Rq );
    _mEngCtrl_Disp_Rq_AR.WtrFuelIndLmp_On_Rq.phys = getValue( HMI_WtrFuelIndLmp_On_Rq );
}
/*@@end*/

/*@@caplFunc:EngCtrl_Disp_Rq_AR_output():*/
EngCtrl_Disp_Rq_AR_output(void)
{
    output( _mEngCtrl_Disp_Rq_AR );
}
/*@@end*/

/*@@caplFunc:EngCtrl_Disp_Rq_AR_saveEnvVars(dword):*/
EngCtrl_Disp_Rq_AR_saveEnvVars( dword hFile )
{
    filePutString("\n// Knoten EIS: EngCtrl_Disp_Rq_AR\n", 32, hFile );
    snprintf( buffer, elcount( buffer ), "0.0000 HMI__STMSG_EngCtrl_Disp_Rq := %X\n", getValue( HMI__STMSG_EngCtrl_Disp_Rq_AR ) );    filePutString( buffer, elcount( buffer ), hFile );
    snprintf( buffer, elcount( buffer ), "0.0000 HMI__STMSGT_EngCtrl_Disp_Rq := %X\n", getValue( HMI__STMSGT_EngCtrl_Disp_Rq_AR ) );    filePutString( buffer, elcount( buffer ), hFile );
    snprintf( buffer, elcount( buffer ), "0.0000 HMI_AirStrIndLmp_On_Rq := %X\n", getValue( HMI_AirStrIndLmp_On_Rq ) );    filePutString( buffer, elcount( buffer ), hFile );
    snprintf( buffer, elcount( buffer ), "0.0000 HMI_BoostPress_Disp_Rq := %X\n", getValue( HMI_BoostPress_Disp_Rq ) );    filePutString( buffer, elcount( buffer ), hFile );
    snprintf( buffer, elcount( buffer ), "0.0000 HMI_DAC_StErr := %X\n", getValue( HMI_DAC_StErr ) );    filePutString( buffer, elcount( buffer ), hFile );
    snprintf( buffer, elcount( buffer ), "0.0000 HMI_EngCoolTemp_Disp_Rq := %X\n", getValue( HMI_EngCoolTemp_Disp_Rq ) );    filePutString( buffer, elcount( buffer ), hFile );
    snprintf( buffer, elcount( buffer ), "0.0000 HMI_EngIdleRPM_Dsr := %X\n", getValue( HMI_EngIdleRPM_Dsr ) );    filePutString( buffer, elcount( buffer ), hFile );
    snprintf( buffer, elcount( buffer ), "0.0000 HMI_EngOilIndLmp_On_Rq := %X\n", getValue( HMI_EngOilIndLmp_On_Rq ) );    filePutString( buffer, elcount( buffer ), hFile );
    snprintf( buffer, elcount( buffer ), "0.0000 HMI_EngOilLvl_Sens_Foam_Dtct := %X\n", getValue( HMI_EngOilLvl_Sens_Foam_Dtct ) );    filePutString( buffer, elcount( buffer ), hFile );
    snprintf( buffer, elcount( buffer ), "0.0000 HMI_EngOilLvl_Sens_LowTemp_Dtct := %X\n", getValue( HMI_EngOilLvl_Sens_LowTemp_Dtct ) );    filePutString( buffer, elcount( buffer ), hFile );
    snprintf( buffer, elcount( buffer ), "0.0000 HMI_EngOilLvl_V2 := %X\n", getValue( HMI_EngOilLvl_V2 ) );    filePutString( buffer, elcount( buffer ), hFile );
    snprintf( buffer, elcount( buffer ), "0.0000 HMI_EngOilPress_Disp_Rq := %X\n", getValue( HMI_EngOilPress_Disp_Rq ) );    filePutString( buffer, elcount( buffer ), hFile );
    snprintf( buffer, elcount( buffer ), "0.0000 HMI_EngOilTemp_Above_Max := %X\n", getValue( HMI_EngOilTemp_Above_Max ) );    filePutString( buffer, elcount( buffer ), hFile );
    snprintf( buffer, elcount( buffer ), "0.0000 HMI_MIL_On_Rq := %X\n", getValue( HMI_MIL_On_Rq ) );    filePutString( buffer, elcount( buffer ), hFile );
    snprintf( buffer, elcount( buffer ), "0.0000 HMI_OvrRPM_Actv := %X\n", getValue( HMI_OvrRPM_Actv ) );    filePutString( buffer, elcount( buffer ), hFile );
    snprintf( buffer, elcount( buffer ), "0.0000 HMI_ParticleFltrWarn := %X\n", getValue( HMI_ParticleFltrWarn ) );    filePutString( buffer, elcount( buffer ), hFile );
    snprintf( buffer, elcount( buffer ), "0.0000 HMI_PreHtIndLmp_On_Rq := %X\n", getValue( HMI_PreHtIndLmp_On_Rq ) );    filePutString( buffer, elcount( buffer ), hFile );
    snprintf( buffer, elcount( buffer ), "0.0000 HMI_TankCapIndLmp_On_Rq := %X\n", getValue( HMI_TankCapIndLmp_On_Rq ) );    filePutString( buffer, elcount( buffer ), hFile );
    snprintf( buffer, elcount( buffer ), "0.0000 HMI_TankPressCtrlDisp_Rq := %X\n", getValue( HMI_TankPressCtrlDisp_Rq ) );    filePutString( buffer, elcount( buffer ), hFile );
    snprintf( buffer, elcount( buffer ), "0.0000 HMI_WtrFuelIndLmp_On_Rq := %X\n", getValue( HMI_WtrFuelIndLmp_On_Rq ) );    filePutString( buffer, elcount( buffer ), hFile );
}
/*@@end*/

/*@@timer:_tEngCtrl_Disp_Rq_AR:*/
on timer _tEngCtrl_Disp_Rq_AR
{
    putValue( HMI__STMSG_EngCtrl_Disp_Rq_AR, 0 );
}
/*@@end*/

/*@@envVar:HMI__STMSG_EngCtrl_Disp_Rq_AR:*/
on EnvVar HMI__STMSG_EngCtrl_Disp_Rq_AR
{
    long tDelay;
    if( getValue( this ) == 2 )
    {
        tDelay = getValue( HMI__STMSGT_EngCtrl_Disp_Rq_AR );
        if( tDelay > 0)    
            setTimer( _tEngCtrl_Disp_Rq_AR, tDelay );
        else
            putValue( HMI__STMSG_EngCtrl_Disp_Rq_AR, 0 );
    }
}
/*@@end*/

/*@@envVar:HMI_AirStrIndLmp_On_Rq:*/
on EnvVar HMI_AirStrIndLmp_On_Rq
{
    _mEngCtrl_Disp_Rq_AR.AirStrIndLmp_On_Rq.phys = getValue(this);
}
/*@@end*/

/*@@envVar:HMI_BoostPress_Disp_Rq:*/
on EnvVar HMI_BoostPress_Disp_Rq
{
    _mEngCtrl_Disp_Rq_AR.BoostPress_Disp_Rq.phys = getValue(this);
}
/*@@end*/

/*@@envVar:HMI_DAC_StErr:*/
on EnvVar HMI_DAC_StErr
{
    _mEngCtrl_Disp_Rq_AR.DAC_StErr.phys = getValue(this);
}
/*@@end*/

/*@@envVar:HMI_EngCoolTemp_Disp_Rq:*/
on EnvVar HMI_EngCoolTemp_Disp_Rq
{
    _mEngCtrl_Disp_Rq_AR.EngCoolTemp_Disp_Rq.phys = getValue(this);
}
/*@@end*/

/*@@envVar:HMI_EngIdleRPM_Dsr:*/
on EnvVar HMI_EngIdleRPM_Dsr
{
    _mEngCtrl_Disp_Rq_AR.EngIdleRPM_Dsr.phys = getValue(this);
}
/*@@end*/

/*@@envVar:HMI_EngOilIndLmp_On_Rq:*/
on EnvVar HMI_EngOilIndLmp_On_Rq
{
    _mEngCtrl_Disp_Rq_AR.EngOilIndLmp_On_Rq.phys = getValue(this);
}
/*@@end*/

/*@@envVar:HMI_EngOilLvl_Sens_Foam_Dtct:*/
on EnvVar HMI_EngOilLvl_Sens_Foam_Dtct
{
    _mEngCtrl_Disp_Rq_AR.EngOilLvl_Sens_Foam_Dtct.phys = getValue(this);
}
/*@@end*/

/*@@envVar:HMI_EngOilLvl_Sens_LowTemp_Dtct:*/
on EnvVar HMI_EngOilLvl_Sens_LowTemp_Dtct
{
    _mEngCtrl_Disp_Rq_AR.EngOilLvl_Sens_LowTemp_Dtct.phys = getValue(this);
}
/*@@end*/

/*@@envVar:HMI_EngOilLvl_V2:*/
on EnvVar HMI_EngOilLvl_V2
{
    _mEngCtrl_Disp_Rq_AR.EngOilLvl_V2.phys = getValue(this);
}
/*@@end*/

/*@@envVar:HMI_EngOilPress_Disp_Rq:*/
on EnvVar HMI_EngOilPress_Disp_Rq
{
    _mEngCtrl_Disp_Rq_AR.EngOilPress_Disp_Rq.phys = getValue(this);
}
/*@@end*/

/*@@envVar:HMI_EngOilTemp_Above_Max:*/
on EnvVar HMI_EngOilTemp_Above_Max
{
    _mEngCtrl_Disp_Rq_AR.EngOilTemp_Above_Max.phys = getValue(this);
}
/*@@end*/

/*@@envVar:HMI_MIL_On_Rq:*/
on EnvVar HMI_MIL_On_Rq
{
    _mEngCtrl_Disp_Rq_AR.MIL_On_Rq.phys = getValue(this);
}
/*@@end*/

/*@@envVar:HMI_OvrRPM_Actv:*/
on EnvVar HMI_OvrRPM_Actv
{
    _mEngCtrl_Disp_Rq_AR.OvrRPM_Actv.phys = getValue(this);
}
/*@@end*/

/*@@envVar:HMI_ParticleFltrWarn:*/
on EnvVar HMI_ParticleFltrWarn
{
    _mEngCtrl_Disp_Rq_AR.ParticleFltrWarn.phys = getValue(this);
}
/*@@end*/

/*@@envVar:HMI_PreHtIndLmp_On_Rq:*/
on EnvVar HMI_PreHtIndLmp_On_Rq
{
    _mEngCtrl_Disp_Rq_AR.PreHtIndLmp_On_Rq.phys = getValue(this);
}
/*@@end*/

/*@@envVar:HMI_TankCapIndLmp_On_Rq:*/
on EnvVar HMI_TankCapIndLmp_On_Rq
{
    _mEngCtrl_Disp_Rq_AR.TankCapIndLmp_On_Rq.phys = getValue(this);
}
/*@@end*/

/*@@envVar:HMI_TankPressCtrlDisp_Rq:*/
on EnvVar HMI_TankPressCtrlDisp_Rq
{
    _mEngCtrl_Disp_Rq_AR.TankPressCtrlDisp_Rq.phys = getValue(this);
}
/*@@end*/

/*@@envVar:HMI_WtrFuelIndLmp_On_Rq:*/
on EnvVar HMI_WtrFuelIndLmp_On_Rq
{
    _mEngCtrl_Disp_Rq_AR.WtrFuelIndLmp_On_Rq.phys = getValue(this);
}
/*@@end*/

/*@@caplFunc:EngCtrl_Stat_AR_check_output():*/
EngCtrl_Stat_AR_check_output()
{
    if( !getValue( HMI__STMSG_EngCtrl_Stat_AR ) )
    {
        // Botschaft EngCtrl_Stat_AR ID: 697 --- Sendeart 5 cyclicAndSpontanWithDelay --- 
        _EngCtrl_Stat_AR_Cnt--;
        if( _EngCtrl_Stat_AR_Cnt < 1 )
        {
            // Nachricht wg. abgelaufenem Zyklus ausgeben
            EngCtrl_Stat_AR_output();
            _EngCtrl_Stat_AR_Cnt = _EngCtrl_Stat_AR_CycleCount; // Zyklus-Zähler zurücksetzen
            _EngCtrl_Stat_AR_SpontanFlag = 0; // Spontan-Flag zurücksetzen
        }
        else if( _EngCtrl_Stat_AR_SpontanFlag)
        {
            // Nachricht wg. spontaner Änderung ausgeben
            EngCtrl_Stat_AR_output();
            _EngCtrl_Stat_AR_SpontanFlag = 0; // Spontan-Flag zurücksetzen
        }
    }
}
/*@@end*/

/*@@caplFunc:EngCtrl_Stat_AR_init():*/
EngCtrl_Stat_AR_init()
{   /* Botschaft EngCtrl_Stat_AR ID: 697 --- Sendeart 5 cyclicAndSpontanWithDelay --- 
BA_ "ApplMessage" BO_ 697 0;
BA_ "NmAsrMessage" BO_ 697 0;
BA_ "GenMsgMinAcceptLength" BO_ 697 8;
BA_ "GenMsgILSupport" BO_ 697 1;
BA_ "DiagState" BO_ 697 0;
BA_ "DiagRequest" BO_ 697 0;
BA_ "DiagResponse" BO_ 697 0;
BA_ "GenMsgStartValue" BO_ 697 "0";
BA_ "GenMsgDelayTime" BO_ 697 10;
BA_ "GenMsgNrOfRepetitions" BO_ 697 0;
BA_ "GenMsgCycleTime" BO_ 697 100;
BA_ "GenMsgSendType" BO_ 697 5;
    */
    _EngCtrl_Stat_AR_Timebase =           c_tDBKomTimer_20ms;
    _EngCtrl_Stat_AR_CycleCount =       100 / _EngCtrl_Stat_AR_Timebase;
    _EngCtrl_Stat_AR_StartDelay =         0 / _EngCtrl_Stat_AR_Timebase;
    _EngCtrl_Stat_AR_Cnt = _EngCtrl_Stat_AR_StartDelay;
    _EngCtrl_Stat_AR_SpontanFlag = 0;

    putValue( HMI__STMSGSD_EngCtrl_Stat_AR, _EngCtrl_Stat_AR_StartDelay * _EngCtrl_Stat_AR_Timebase );

    _mEngCtrl_Stat_AR.AirPress_Outsd.phys = getValue( HMI_AirPress_Outsd );
    _mEngCtrl_Stat_AR.CylCutoff_Stat.phys = getValue( HMI_CylCutoff_Stat );
    _mEngCtrl_Stat_AR.EngCoolTemp.phys = getValue( HMI_EngCoolTemp );
    _mEngCtrl_Stat_AR.EngOilQual.phys = getValue( HMI_EngOilQual );
    _mEngCtrl_Stat_AR.FuelCons.phys = getValue( HMI_FuelCons );
    _mEngCtrl_Stat_AR.IntkAirTemp.phys = getValue( HMI_IntkAirTemp );
    _mEngCtrl_Stat_AR.PN14_EHC_Prio_Rq.phys = getValue( HMI_PN14_EHC_Prio_Rq );
    _mEngCtrl_Stat_AR.PreHt_Stat.phys = getValue( HMI_PreHt_Stat );
}
/*@@end*/

/*@@caplFunc:EngCtrl_Stat_AR_output():*/
EngCtrl_Stat_AR_output(void)
{
    output( _mEngCtrl_Stat_AR );
}
/*@@end*/

/*@@caplFunc:EngCtrl_Stat_AR_saveEnvVars(dword):*/
EngCtrl_Stat_AR_saveEnvVars( dword hFile )
{
    filePutString("\n// Knoten EIS: EngCtrl_Stat_AR\n", 29, hFile );
    snprintf( buffer, elcount( buffer ), "0.0000 HMI__STMSG_EngCtrl_Stat := %X\n", getValue( HMI__STMSG_EngCtrl_Stat_AR ) );        filePutString( buffer, elcount( buffer ), hFile );
    snprintf( buffer, elcount( buffer ), "0.0000 HMI__STMSGT_EngCtrl_Stat := %X\n", getValue( HMI__STMSGT_EngCtrl_Stat_AR ) );        filePutString( buffer, elcount( buffer ), hFile );
    snprintf( buffer, elcount( buffer ), "0.0000 HMI_AirPress_Outsd := %X\n", getValue( HMI_AirPress_Outsd ) );        filePutString( buffer, elcount( buffer ), hFile );
    snprintf( buffer, elcount( buffer ), "0.0000 HMI_CylCutoff_Stat := %X\n", getValue( HMI_CylCutoff_Stat ) );        filePutString( buffer, elcount( buffer ), hFile );
    snprintf( buffer, elcount( buffer ), "0.0000 HMI_EngCoolTemp := %X\n", getValue( HMI_EngCoolTemp ) );        filePutString( buffer, elcount( buffer ), hFile );
    snprintf( buffer, elcount( buffer ), "0.0000 HMI_EngOilQual := %X\n", getValue( HMI_EngOilQual ) );        filePutString( buffer, elcount( buffer ), hFile );
    snprintf( buffer, elcount( buffer ), "0.0000 HMI_FuelCons := %X\n", getValue( HMI_FuelCons ) );        filePutString( buffer, elcount( buffer ), hFile );
    snprintf( buffer, elcount( buffer ), "0.0000 HMI_IntkAirTemp := %X\n", getValue( HMI_IntkAirTemp ) );        filePutString( buffer, elcount( buffer ), hFile );
    snprintf( buffer, elcount( buffer ), "0.0000 HMI_PN14_EHC_Prio_Rq := %X\n", getValue( HMI_PN14_EHC_Prio_Rq ) );        filePutString( buffer, elcount( buffer ), hFile );
    snprintf( buffer, elcount( buffer ), "0.0000 HMI_PreHt_Stat := %X\n", getValue( HMI_PreHt_Stat ) );        filePutString( buffer, elcount( buffer ), hFile );
}
/*@@end*/

/*@@timer:_tEngCtrl_Stat_AR:*/
on timer _tEngCtrl_Stat_AR
{
    putValue( HMI__STMSG_EngCtrl_Stat_AR, 0 );
}
/*@@end*/

/*@@envVar:HMI__STMSG_EngCtrl_Stat_AR:*/
on EnvVar HMI__STMSG_EngCtrl_Stat_AR
{
    long tDelay;
    if( getValue( this ) == 2 )
    {
        tDelay = getValue( HMI__STMSGT_EngCtrl_Stat_AR );
        if( tDelay > 0)    
            setTimer( _tEngCtrl_Stat_AR, tDelay );
        else
            putValue( HMI__STMSG_EngCtrl_Stat_AR, 0 );
    }
}
/*@@end*/

/*@@envVar:HMI_AirPress_Outsd:*/
on EnvVar HMI_AirPress_Outsd
{
    _mEngCtrl_Stat_AR.AirPress_Outsd.phys = getValue(this);
    _EngCtrl_Stat_AR_SpontanFlag = 1;
}
/*@@end*/

/*@@envVar:HMI_CylCutoff_Stat:*/
on EnvVar HMI_CylCutoff_Stat
{
    _mEngCtrl_Stat_AR.CylCutoff_Stat.phys = getValue(this);
    _EngCtrl_Stat_AR_SpontanFlag = 1;
}
/*@@end*/

/*@@envVar:HMI_EngCoolTemp:*/
on EnvVar HMI_EngCoolTemp
{
    _mEngCtrl_Stat_AR.EngCoolTemp.phys = getValue(this);
    _EngCtrl_Stat_AR_SpontanFlag = 1;
}
/*@@end*/

/*@@envVar:HMI_EngOilQual:*/
on EnvVar HMI_EngOilQual
{
    _mEngCtrl_Stat_AR.EngOilQual.phys = getValue(this);
    _EngCtrl_Stat_AR_SpontanFlag = 1;
}
/*@@end*/

/*@@envVar:HMI_FuelCons:*/
on EnvVar HMI_FuelCons
{
    _mEngCtrl_Stat_AR.FuelCons.phys = getValue(this);
    _EngCtrl_Stat_AR_SpontanFlag = 1;
}
/*@@end*/

/*@@envVar:HMI_IntkAirTemp:*/
on EnvVar HMI_IntkAirTemp
{
    _mEngCtrl_Stat_AR.IntkAirTemp.phys = getValue(this);
    _EngCtrl_Stat_AR_SpontanFlag = 1;
}
/*@@end*/

/*@@envVar:HMI_PN14_EHC_Prio_Rq:*/
on EnvVar HMI_PN14_EHC_Prio_Rq
{
    _mEngCtrl_Stat_AR.PN14_EHC_Prio_Rq.phys = getValue(this);
    _EngCtrl_Stat_AR_SpontanFlag = 1;
}
/*@@end*/

/*@@envVar:HMI_PreHt_Stat:*/
on EnvVar HMI_PreHt_Stat
{
    _mEngCtrl_Stat_AR.PreHt_Stat.phys = getValue(this);
    _EngCtrl_Stat_AR_SpontanFlag = 1;
}
/*@@end*/

/*@@caplFunc:EPKB_Disp_IndLmp_Rq_2_AR_check_output():*/
EPKB_Disp_IndLmp_Rq_2_AR_check_output()
{
    if( !getValue( HMI__STMSG_EPKB_Disp_IndLmp_Rq_2_AR ) )
    {
        // Botschaft EPKB_Disp_IndLmp_Rq_2_AR ID: 1041 --- Sendeart 5 cyclicAndSpontanWithDelay --- 
        _EPKB_Disp_IndLmp_Rq_2_AR_Cnt--;
        if( _EPKB_Disp_IndLmp_Rq_2_AR_Cnt < 1 )
        {
            // Nachricht wg. abgelaufenem Zyklus ausgeben
             EPKB_Disp_IndLmp_Rq_2_AR_output();
            _EPKB_Disp_IndLmp_Rq_2_AR_Cnt = _EPKB_Disp_IndLmp_Rq_2_AR_CycleCount; // Zyklus-Zähler zurücksetzen
            _EPKB_Disp_IndLmp_Rq_2_AR_SpontanFlag = 0; // Spontan-Flag zurücksetzen
        }
        else if( _EPKB_Disp_IndLmp_Rq_2_AR_SpontanFlag)
        {
            // Nachricht wg. spontaner Änderung ausgeben
            EPKB_Disp_IndLmp_Rq_2_AR_output();
            _EPKB_Disp_IndLmp_Rq_2_AR_SpontanFlag = 0; // Spontan-Flag zurücksetzen
        }
    }
}
/*@@end*/

/*@@caplFunc:EPKB_Disp_IndLmp_Rq_2_AR_init():*/
EPKB_Disp_IndLmp_Rq_2_AR_init()
{   /* Botschaft EPKB_Disp_IndLmp_Rq_2_AR ID: 1041 --- Sendeart 5 cyclicAndSpontanWithDelay --- 
BA_ "ApplMessage" BO_ 1041 0;
BA_ "NmAsrMessage" BO_ 1041 0;
BA_ "GenMsgMinAcceptLength" BO_ 1041 4;
BA_ "GenMsgILSupport" BO_ 1041 1;
BA_ "DiagState" BO_ 1041 0;
BA_ "DiagRequest" BO_ 1041 0;
BA_ "DiagResponse" BO_ 1041 0;
BA_ "GenMsgStartValue" BO_ 1041 "0";
BA_ "GenMsgStartDelayTime" BO_ 1041 0;
BA_ "GenMsgDelayTime" BO_ 1041 5;
BA_ "GenMsgNrOfRepetitions" BO_ 1041 0;
BA_ "GenMsgCycleTime" BO_ 1041 200;
BA_ "GenMsgSendType" BO_ 1041 5;
    */
    _EPKB_Disp_IndLmp_Rq_2_AR_Timebase =        c_tDBKomTimer_20ms;
    _EPKB_Disp_IndLmp_Rq_2_AR_CycleCount =    200 / _EPKB_Disp_IndLmp_Rq_2_AR_Timebase;
    _EPKB_Disp_IndLmp_Rq_2_AR_StartDelay =      0 / _EPKB_Disp_IndLmp_Rq_2_AR_Timebase;
    _EPKB_Disp_IndLmp_Rq_2_AR_Cnt = _EPKB_Disp_IndLmp_Rq_2_AR_StartDelay;
    _EPKB_Disp_IndLmp_Rq_2_AR_SpontanFlag = 0;

    putValue( HMI__STMSGSD_EPKB_Disp_IndLmp_Rq_2_AR, _EPKB_Disp_IndLmp_Rq_2_AR_StartDelay * _EPKB_Disp_IndLmp_Rq_2_AR_Timebase );

    _mEPKB_Disp_IndLmp_Rq_2_AR.BrkIndLmp_On_Rq_EPkB.phys = getValue( HMI_BrkIndLmp_On_Rq_EPkB );
    _mEPKB_Disp_IndLmp_Rq_2_AR.BrkLnServMd_MsgDisp_Rq.phys = getValue( HMI_BrkLnServMd_MsgDisp_Rq );
    _mEPKB_Disp_IndLmp_Rq_2_AR.EPKB_Msg_Disp_Rq.phys = getValue( HMI_EPKB_Msg_Disp_Rq );
    _mEPKB_Disp_IndLmp_Rq_2_AR.EPKB_Msg_Disp_TrgrRq.phys = getValue( HMI_EPKB_Msg_Disp_TrgrRq );
    _mEPKB_Disp_IndLmp_Rq_2_AR.PkBrkIndLmp_On_Rq.phys = getValue( HMI_PkBrkIndLmp_On_Rq );
    _mEPKB_Disp_IndLmp_Rq_2_AR.Rsrv1_EPKB_Disp_IndLmp_Rq.phys = getValue( HMI_Rsrv1_EPKB_Disp_IndLmp_Rq );
}
/*@@end*/

/*@@caplFunc:EPKB_Disp_IndLmp_Rq_2_AR_output():*/
void EPKB_Disp_IndLmp_Rq_2_AR_output(void)
{
    byte crc;
    byte SQC_help;
    byte dataId = 0x1F;

    if( !getValue( HMI_SQC_EPKB_Disp_IndLmp_Rq_Auto ) )
    {
        // berechne message counter
        SQC_help = getValue( HMI_SQC_EPKB_Disp_IndLmp_Rq );
        if( SQC_help >= 15 ) SQC_help = 0;
        else SQC_help++;
        putValue( HMI_SQC_EPKB_Disp_IndLmp_Rq, SQC_help );
        _mEPKB_Disp_IndLmp_Rq_2_AR.SQC_EPKB_Disp_IndLmp_Rq = SQC_help;
    }
    else
          _mEPKB_Disp_IndLmp_Rq_2_AR.SQC_EPKB_Disp_IndLmp_Rq = getValue( HMI_SQC_EPKB_Disp_IndLmp_Rq );

    if( getValue( HMI_CRC_EPKB_Disp_IndLmp_Rq_Profile_02 ) )
    {
        if( !getValue( HMI_CRC_EPKB_Disp_IndLmp_Rq_Auto ))
        {   // CRC according Profile_02 ( W213 )
            // berechne crc
            crc = 0xFF;
//            crc = crctable_profile02[ crc ^ _mEPKB_Disp_IndLmp_Rq_2_AR.byte( 0 ) ];  CRC
            crc = crctable_profile02[ crc ^ _mEPKB_Disp_IndLmp_Rq_2_AR.byte( 1 ) ];
            crc = crctable_profile02[ crc ^ _mEPKB_Disp_IndLmp_Rq_2_AR.byte( 2 ) ];
            crc = crctable_profile02[ crc ^ _mEPKB_Disp_IndLmp_Rq_2_AR.byte( 3 ) ];
            // crc = crctable_profile02[ crc ^ _mEPKB_Disp_IndLmp_Rq_2_AR.byte( 4 ) ];
            // crc = crctable_profile02[ crc ^ _mEPKB_Disp_IndLmp_Rq_2_AR.byte( 5 ) ];
            // crc = crctable_profile02[ crc ^ _mEPKB_Disp_IndLmp_Rq_2_AR.byte( 6 ) ];
            // crc = crctable_profile02[ crc ^ _mEPKB_Disp_IndLmp_Rq_2_AR.byte( 7 ) ];
            crc = crctable_profile02[ crc ^_EPKB_Disp_IndLmp_Rq_2_AR_CRC_Offset[ _mEPKB_Disp_IndLmp_Rq_2_AR.SQC_EPKB_Disp_IndLmp_Rq ] ]; // load offset
            crc = (crc ^ 0xFF);
            if( getValue(  HMI_CRC_EPKB_Disp_IndLmp_Rq_Invalid ) )
                crc++;
            _mEPKB_Disp_IndLmp_Rq_2_AR.CRC_EPKB_Disp_IndLmp_Rq = crc;
            putValue( HMI_CRC_EPKB_Disp_IndLmp_Rq, crc );
        }
        else
            _mEPKB_Disp_IndLmp_Rq_2_AR.CRC_EPKB_Disp_IndLmp_Rq = getValue( HMI_CRC_EPKB_Disp_IndLmp_Rq );
    }
    else
    {
        if( !getValue( HMI_CRC_EPKB_Disp_IndLmp_Rq_Auto ))
        {   // CRC according to SAE1850 ( W222 )
            // berechne crc
            crc = 0xFF;
//            crc = crctable[crc ^ _mEPKB_Disp_IndLmp_Rq_2_AR.byte( 0 )];  CRC
            crc = crctable[crc ^ _mEPKB_Disp_IndLmp_Rq_2_AR.byte( 1 )];
            crc = crctable[crc ^ _mEPKB_Disp_IndLmp_Rq_2_AR.byte( 2 )];
            crc = crctable[crc ^ _mEPKB_Disp_IndLmp_Rq_2_AR.byte( 3 )];
            // crc = crctable[crc ^ _mEPKB_Disp_IndLmp_Rq_2_AR.byte( 4 )];
            // crc = crctable[crc ^ _mEPKB_Disp_IndLmp_Rq_2_AR.byte( 5 )];
            // crc = crctable[crc ^ _mEPKB_Disp_IndLmp_Rq_2_AR.byte( 6 )];
            // crc = crctable[crc ^ _mEPKB_Disp_IndLmp_Rq_2_AR.byte( 7 )];
            crc = crctable[crc ^ dataId];
            crc = (crc ^ 0xFF);
            if( getValue(  HMI_CRC_EPKB_Disp_IndLmp_Rq_Invalid ) )
                crc++;
            _mEPKB_Disp_IndLmp_Rq_2_AR.CRC_EPKB_Disp_IndLmp_Rq = crc;
            putValue( HMI_CRC_EPKB_Disp_IndLmp_Rq, crc );
        }
        else
            _mEPKB_Disp_IndLmp_Rq_2_AR.CRC_EPKB_Disp_IndLmp_Rq = getValue( HMI_CRC_EPKB_Disp_IndLmp_Rq );
    }
    output( _mEPKB_Disp_IndLmp_Rq_2_AR );
}
/*@@end*/

/*@@caplFunc:EPKB_Disp_IndLmp_Rq_2_AR_saveEnvVars(dword):*/
EPKB_Disp_IndLmp_Rq_2_AR_saveEnvVars( dword hFile )
{
    filePutString("\n// Knoten EIS: EPKB_Disp_IndLmp_Rq_AR \n", 36, hFile );
    snprintf( buffer, elcount( buffer ), "0.0000 HMI__STMSG_EPKB_Disp_IndLmp_Rq_2_AR := %X\n", getValue( HMI__STMSG_EPKB_Disp_IndLmp_Rq_2_AR ) );        filePutString( buffer, elcount( buffer ), hFile );
    snprintf( buffer, elcount( buffer ), "0.0000 HMI__STMSGT_EPKB_Disp_IndLmp_Rq_2_AR := %X\n", getValue( HMI__STMSGT_EPKB_Disp_IndLmp_Rq_2_AR ) );        filePutString( buffer, elcount( buffer ), hFile );
    snprintf( buffer, elcount( buffer ), "0.0000 HMI_BrkIndLmp_On_Rq_EPkB := %X\n", getValue( HMI_BrkIndLmp_On_Rq_EPkB ) );        filePutString( buffer, elcount( buffer ), hFile );
    snprintf( buffer, elcount( buffer ), "0.0000 HMI_BrkLnServMd_MsgDisp_Rq := %X\n", getValue( HMI_BrkLnServMd_MsgDisp_Rq ) );        filePutString( buffer, elcount( buffer ), hFile );
    snprintf( buffer, elcount( buffer ), "0.0000 HMI_EPKB_Msg_Disp_Rq := %X\n", getValue( HMI_EPKB_Msg_Disp_Rq ) );        filePutString( buffer, elcount( buffer ), hFile );
    snprintf( buffer, elcount( buffer ), "0.0000 HMI_EPKB_Msg_Disp_TrgrRq := %X\n", getValue( HMI_EPKB_Msg_Disp_TrgrRq ) );        filePutString( buffer, elcount( buffer ), hFile );
    snprintf( buffer, elcount( buffer ), "0.0000 HMI_PkBrkIndLmp_On_Rq := %X\n", getValue( HMI_PkBrkIndLmp_On_Rq ) );        filePutString( buffer, elcount( buffer ), hFile );
}
/*@@end*/

/*@@timer:_tEPKB_Disp_IndLmp_Rq_2_AR:*/
on timer _tEPKB_Disp_IndLmp_Rq_2_AR
{
    putValue( HMI__STMSG_EPKB_Disp_IndLmp_Rq_2_AR, 0 );
}
/*@@end*/

/*@@envVar:HMI__STMSG_EPKB_Disp_IndLmp_Rq_2_AR:*/
on EnvVar HMI__STMSG_EPKB_Disp_IndLmp_Rq_2_AR
{
    long tDelay;
    if( getValue( this ) == 2 )
    {
        tDelay = getValue( HMI__STMSGT_EPKB_Disp_IndLmp_Rq_2_AR );
        if( tDelay > 0)    
            setTimer( _tEPKB_Disp_IndLmp_Rq_2_AR, tDelay );
        else
            putValue( HMI__STMSG_EPKB_Disp_IndLmp_Rq_2_AR, 0 );
    }
}
/*@@end*/

/*@@envVar:HMI_BrkIndLmp_On_Rq_EPkB:*/
on EnvVar HMI_BrkIndLmp_On_Rq_EPkB
{
    _mEPKB_Disp_IndLmp_Rq_2_AR.BrkIndLmp_On_Rq_EPkB.phys = getValue(this);
    _EPKB_Disp_IndLmp_Rq_2_AR_SpontanFlag = 1;
}
/*@@end*/

/*@@envVar:HMI_BrkLnServMd_MsgDisp_Rq:*/
on EnvVar HMI_BrkLnServMd_MsgDisp_Rq
{
    _mEPKB_Disp_IndLmp_Rq_2_AR.BrkLnServMd_MsgDisp_Rq.phys = getValue(this);
    _EPKB_Disp_IndLmp_Rq_2_AR_SpontanFlag = 1;
}
/*@@end*/

/*@@envVar:HMI_EPKB_Msg_Disp_Rq:*/
on EnvVar HMI_EPKB_Msg_Disp_Rq
{
    if( ( getValue( Env_Stress__StresstestMainActiv ) == 0 )   &&
        ( getValue( HMI__NM_EIS_AutomaticNM_Switching ) == 0 )    )
    {
        _SetCommRequest( cEPKBWarningNMRequest );
        setTimer( t_EPKBWarningNMCancelTimer, c_NMCancelTimer_05sec ); // 30 seconds for auto-shut-off
    }
    _mEPKB_Disp_IndLmp_Rq_2_AR.EPKB_Msg_Disp_Rq.phys = getValue(this);
    _EPKB_Disp_IndLmp_Rq_2_AR_SpontanFlag = 1;
}
/*@@end*/

/*@@envVar:HMI_EPKB_Msg_Disp_TrgrRq:*/
on EnvVar HMI_EPKB_Msg_Disp_TrgrRq
{
    if( ( getValue( Env_Stress__StresstestMainActiv ) == 0 )   &&
        ( getValue( HMI__NM_EIS_AutomaticNM_Switching ) == 0 )    )
    {
        _SetCommRequest( cEPKBWarningNMRequest );
        setTimer( t_EPKBWarningNMCancelTimer, c_NMCancelTimer_05sec ); // 5 seconds for auto-shut-off
    }
    _mEPKB_Disp_IndLmp_Rq_2_AR.EPKB_Msg_Disp_TrgrRq.phys = getValue(this);
    _EPKB_Disp_IndLmp_Rq_2_AR_SpontanFlag = 1;
}
/*@@end*/

/*@@envVar:HMI_PkBrkIndLmp_On_Rq:*/
on EnvVar HMI_PkBrkIndLmp_On_Rq
{
    _mEPKB_Disp_IndLmp_Rq_2_AR.PkBrkIndLmp_On_Rq.phys = getValue(this);
    _EPKB_Disp_IndLmp_Rq_2_AR_SpontanFlag = 1;
}
/*@@end*/

/*@@envVar:HMI_Rsrv1_EPKB_Disp_IndLmp_Rq:*/
on EnvVar HMI_Rsrv1_EPKB_Disp_IndLmp_Rq
{
    _mEPKB_Disp_IndLmp_Rq_2_AR.Rsrv1_EPKB_Disp_IndLmp_Rq.phys = getValue(this);
    _EPKB_Disp_IndLmp_Rq_2_AR_SpontanFlag = 1;
}
/*@@end*/

/*@@caplFunc:EPS_Stat_Disp_Rq_AR_check_output():*/
EPS_Stat_Disp_Rq_AR_check_output()
{
    if( !getValue( HMI__STMSG_EPS_Stat_Disp_Rq_AR ) )
    {
        // Botschaft EPS_Stat_Disp_Rq_AR ID: 1069 --- Sendeart 5 cyclicAndSpontanWithDelay --- 
        _EPS_Stat_Disp_Rq_AR_Cnt--;
        if( _EPS_Stat_Disp_Rq_AR_Cnt < 1 )
        {
            // Nachricht wg. abgelaufenem Zyklus ausgeben
            EPS_Stat_Disp_Rq_AR_output();
            _EPS_Stat_Disp_Rq_AR_Cnt = _EPS_Stat_Disp_Rq_AR_CycleCount; // Zyklus-Zähler zurücksetzen
            _EPS_Stat_Disp_Rq_AR_SpontanFlag = 0; // Spontan-Flag zurücksetzen
        }
        else if( _EPS_Stat_Disp_Rq_AR_SpontanFlag)
        {
            // Nachricht wg. spontaner Änderung ausgeben
            EPS_Stat_Disp_Rq_AR_output();
            _EPS_Stat_Disp_Rq_AR_SpontanFlag = 0; // Spontan-Flag zurücksetzen
        }
    }
}
/*@@end*/

/*@@caplFunc:EPS_Stat_Disp_Rq_AR_init():*/
EPS_Stat_Disp_Rq_AR_init()
{   /* Botschaft EPS_Stat_Disp_Rq_AR ID: 1069 --- Sendeart 5 cyclicAndSpontanWithDelay --- 
BA_ "ApplMessage" BO_ 1069 0;
BA_ "NmAsrMessage" BO_ 1069 0;
BA_ "GenMsgMinAcceptLength" BO_ 1069 8;
BA_ "GenMsgILSupport" BO_ 1069 1;
BA_ "DiagState" BO_ 1069 0;
BA_ "DiagRequest" BO_ 1069 0;
BA_ "DiagResponse" BO_ 1069 0;
BA_ "GenMsgStartValue" BO_ 1069 "0";
BA_ "GenMsgStartDelayTime" BO_ 1069 0;
BA_ "GenMsgDelayTime" BO_ 1069 5;
BA_ "GenMsgNrOfRepetitions" BO_ 1069 0;
BA_ "GenMsgCycleTime" BO_ 1069 200;
BA_ "GenMsgSendType" BO_ 1069 5;
    */
    _EPS_Stat_Disp_Rq_AR_Timebase =            c_tDBKomTimer_20ms;
    _EPS_Stat_Disp_Rq_AR_CycleCount =         200 / _EPS_Stat_Disp_Rq_AR_Timebase;
    _EPS_Stat_Disp_Rq_AR_StartDelay =           0 / _EPS_Stat_Disp_Rq_AR_Timebase;
    _EPS_Stat_Disp_Rq_AR_Cnt = _EPS_Stat_Disp_Rq_AR_StartDelay;
    _EPS_Stat_Disp_Rq_AR_SpontanFlag = 0;

    putValue( HMI__STMSGSD_EPS_Stat_Disp_Rq_AR, _EPS_Stat_Disp_Rq_AR_StartDelay * _EPS_Stat_Disp_Rq_AR_Timebase );

    _mEPS_Stat_Disp_Rq_AR.ASM_Stat_EPS.phys = getValue( HMI_ASM_Stat_EPS );
    _mEPS_Stat_Disp_Rq_AR.DPC_Md_St_Rs.phys = getValue( HMI_DPC_Md_St_Rs );
    _mEPS_Stat_Disp_Rq_AR.EPS_IndLmp_On_Rq.phys = getValue( HMI_EPS_IndLmp_On_Rq );
    _mEPS_Stat_Disp_Rq_AR.EPS_WarnDisp_Rq.phys = getValue( HMI_EPS_WarnDisp_Rq );
    _mEPS_Stat_Disp_Rq_AR.Rsrv1_EPS_CtrlLmp_Disp_Rq.phys = getValue( HMI_Rsrv1_EPS_CtrlLmp_Disp_Rq );
    _mEPS_Stat_Disp_Rq_AR.Rsrv2_EPS_CtrlLmp_Disp_Rq.phys = getValue( HMI_Rsrv2_EPS_CtrlLmp_Disp_Rq );
    _mEPS_Stat_Disp_Rq_AR.Rsrv3_EPS_CtrlLmp_Disp_Rq.phys = getValue( HMI_Rsrv3_EPS_CtrlLmp_Disp_Rq );
}
/*@@end*/

/*@@caplFunc:EPS_Stat_Disp_Rq_AR_output():*/
void EPS_Stat_Disp_Rq_AR_output(void)
{
    byte crc;
    byte SQC_help;
    byte dataId = 0x2D;

    if( !getValue( HMI_SQC_EPS_CtrlLmp_Disp_Rq_Auto ) )
    {
        // berechne message counter
        SQC_help = getValue( HMI_SQC_EPS_CtrlLmp_Disp_Rq );
        if( SQC_help >= 15 ) SQC_help = 0;
        else SQC_help++;
        putValue( HMI_SQC_EPS_CtrlLmp_Disp_Rq, SQC_help );
        _mEPS_Stat_Disp_Rq_AR.SQC_EPS_CtrlLmp_Disp_Rq = SQC_help;
    }
    else
          _mEPS_Stat_Disp_Rq_AR.SQC_EPS_CtrlLmp_Disp_Rq = getValue( HMI_SQC_EPS_CtrlLmp_Disp_Rq );

    if( getValue( HMI_CRC_EPS_CtrlLmp_Disp_Rq_Profile_02 ) )
    {
        if( !getValue( HMI_CRC_EPS_CtrlLmp_Disp_Rq_Auto ) )
        {   // CRC according Profile_02 ( W213 )
            // berechne crc
            crc = 0xFF;
            // crc = crctable_profile02[ crc ^ _mEPS_Stat_Disp_Rq_AR.byte( 0 ) ];
            // crc = crctable_profile02[ crc ^ _mEPS_Stat_Disp_Rq_AR.byte( 1 ) ];
            // crc = crctable_profile02[ crc ^ _mEPS_Stat_Disp_Rq_AR.byte( 2 ) ];  CRC
            crc = crctable_profile02[ crc ^ _mEPS_Stat_Disp_Rq_AR.byte( 3 ) ];
            crc = crctable_profile02[ crc ^ _mEPS_Stat_Disp_Rq_AR.byte( 4 ) ];
            crc = crctable_profile02[ crc ^ _mEPS_Stat_Disp_Rq_AR.byte( 5 ) ];
            // crc = crctable_profile02[ crc ^ _mEPS_Stat_Disp_Rq_AR.byte( 6 ) ];
            // crc = crctable_profile02[ crc ^ _mEPS_Stat_Disp_Rq_AR.byte( 7 ) ];
            crc = crctable_profile02[ crc ^ _EPS_Stat_Disp_Rq_AR_CRC_Offset[ _mEPS_Stat_Disp_Rq_AR.SQC_EPS_CtrlLmp_Disp_Rq ] ]; // load offset
            crc = (crc ^ 0xFF);
            if( getValue(  HMI_CRC_EPS_CtrlLmp_Disp_Rq_Invalid ) )
                crc++;
            _mEPS_Stat_Disp_Rq_AR.CRC_EPS_CtrlLmp_Disp_Rq = crc;
            putValue( HMI_CRC_EPS_CtrlLmp_Disp_Rq, crc );
        }
        else
            _mEPS_Stat_Disp_Rq_AR.CRC_EPS_CtrlLmp_Disp_Rq = getValue( HMI_CRC_EPS_CtrlLmp_Disp_Rq );
    }
    else
    {
        if( !getValue( HMI_CRC_EPS_CtrlLmp_Disp_Rq_Auto ) )
        {   // CRC according to SAE1850 ( W222 )
            // berechne crc
            crc = 0xFF;
            // crc = crctable[crc ^ _mEPS_Stat_Disp_Rq_AR.byte( 0 )];
            // crc = crctable[crc ^ _mEPS_Stat_Disp_Rq_AR.byte( 1 )];
            // crc = crctable[crc ^ _mEPS_Stat_Disp_Rq_AR.byte( 2 )];  CRC
            crc = crctable[crc ^ _mEPS_Stat_Disp_Rq_AR.byte( 3 )];
            crc = crctable[crc ^ _mEPS_Stat_Disp_Rq_AR.byte( 4 )];
            crc = crctable[crc ^ _mEPS_Stat_Disp_Rq_AR.byte( 5 )];
            // crc = crctable[crc ^ _mEPS_Stat_Disp_Rq_AR.byte( 6 )];
            // crc = crctable[crc ^ _mEPS_Stat_Disp_Rq_AR.byte( 7 )];
            crc = crctable[crc ^ dataId];
            crc = (crc ^ 0xFF);
            if( getValue(  HMI_CRC_EPS_CtrlLmp_Disp_Rq_Invalid ) )
                crc++;
            _mEPS_Stat_Disp_Rq_AR.CRC_EPS_CtrlLmp_Disp_Rq = crc;
            putValue( HMI_CRC_EPS_CtrlLmp_Disp_Rq, crc );
        }
        else
            _mEPS_Stat_Disp_Rq_AR.CRC_EPS_CtrlLmp_Disp_Rq = getValue( HMI_CRC_EPS_CtrlLmp_Disp_Rq );
    }
    output( _mEPS_Stat_Disp_Rq_AR );
}
/*@@end*/

/*@@caplFunc:EPS_Stat_Disp_Rq_AR_saveEnvVars(dword):*/
EPS_Stat_Disp_Rq_AR_saveEnvVars( dword hFile )
{
    filePutString("\n// Knoten EIS: EPS_Stat_Disp_Rq_AR\n", 28, hFile );
    snprintf( buffer, elcount( buffer ), "0.0000 HMI__STMSG_EPS_Stat_Disp_Rq_AR := %X\n", getValue( HMI__STMSG_EPS_Stat_Disp_Rq_AR ) );        filePutString( buffer, elcount( buffer ), hFile );
    snprintf( buffer, elcount( buffer ), "0.0000 HMI__STMSGT_EPS_Stat_Disp_Rq_AR := %X\n", getValue( HMI__STMSGT_EPS_Stat_Disp_Rq_AR ) );        filePutString( buffer, elcount( buffer ), hFile );
    snprintf( buffer, elcount( buffer ), "0.0000 HMI_ASM_Stat_EPS := %X\n", getValue( HMI_ASM_Stat_EPS ) );        filePutString( buffer, elcount( buffer ), hFile );
    snprintf( buffer, elcount( buffer ), "0.0000 HMI_CRC_EPS_CtrlLmp_Disp_Rq := %X\n", getValue( HMI_CRC_EPS_CtrlLmp_Disp_Rq ) );        filePutString( buffer, elcount( buffer ), hFile );
    snprintf( buffer, elcount( buffer ), "0.0000 HMI_CRC_EPS_CtrlLmp_Disp_Rq_Auto := %X\n", getValue( HMI_CRC_EPS_CtrlLmp_Disp_Rq_Auto ) );        filePutString( buffer, elcount( buffer ), hFile );
    snprintf( buffer, elcount( buffer ), "0.0000 HMI_DPC_Md_St_Rs := %X\n", getValue( HMI_DPC_Md_St_Rs ) );        filePutString( buffer, elcount( buffer ), hFile );
    snprintf( buffer, elcount( buffer ), "0.0000 HMI_EPS_IndLmp_On_Rq := %X\n", getValue( HMI_EPS_IndLmp_On_Rq ) );        filePutString( buffer, elcount( buffer ), hFile );
    snprintf( buffer, elcount( buffer ), "0.0000 HMI_EPS_WarnDisp_Rq := %X\n", getValue( HMI_EPS_WarnDisp_Rq ) );        filePutString( buffer, elcount( buffer ), hFile );
    snprintf( buffer, elcount( buffer ), "0.0000 HMI_Rsrv1_EPS_CtrlLmp_Disp_Rq := %X\n", getValue( HMI_Rsrv1_EPS_CtrlLmp_Disp_Rq ) );        filePutString( buffer, elcount( buffer ), hFile );
    snprintf( buffer, elcount( buffer ), "0.0000 HMI_Rsrv2_EPS_CtrlLmp_Disp_Rq := %X\n", getValue( HMI_Rsrv2_EPS_CtrlLmp_Disp_Rq ) );        filePutString( buffer, elcount( buffer ), hFile );
    snprintf( buffer, elcount( buffer ), "0.0000 HMI_Rsrv3_EPS_CtrlLmp_Disp_Rq := %X\n", getValue( HMI_Rsrv3_EPS_CtrlLmp_Disp_Rq ) );        filePutString( buffer, elcount( buffer ), hFile );
    snprintf( buffer, elcount( buffer ), "0.0000 HMI_SQC_EPS_CtrlLmp_Disp_Rq := %X\n", getValue( HMI_SQC_EPS_CtrlLmp_Disp_Rq ) );        filePutString( buffer, elcount( buffer ), hFile );
    snprintf( buffer, elcount( buffer ), "0.0000 HMI_SQC_EPS_CtrlLmp_Disp_Rq_Auto := %X\n", getValue( HMI_SQC_EPS_CtrlLmp_Disp_Rq_Auto ) );        filePutString( buffer, elcount( buffer ), hFile );
}
/*@@end*/

/*@@timer:_tEPS_Stat_Disp_Rq_AR:*/
on timer _tEPS_Stat_Disp_Rq_AR
{
    putValue( HMI__STMSG_EPS_Stat_Disp_Rq_AR, 0 );
}
/*@@end*/

/*@@envVar:HMI__STMSG_EPS_Stat_Disp_Rq_AR:*/
on EnvVar HMI__STMSG_EPS_Stat_Disp_Rq_AR
{
    long tDelay;
    if( getValue( this ) == 2 )
    {
        tDelay = getValue( HMI__STMSGT_EPS_Stat_Disp_Rq_AR );
        if( tDelay > 0)    
            setTimer( _tEPS_Stat_Disp_Rq_AR, tDelay );
        else
            putValue( HMI__STMSG_EPS_Stat_Disp_Rq_AR, 0 );
    }
}
/*@@end*/

/*@@envVar:HMI_ASM_Stat_EPS:*/
on EnvVar HMI_ASM_Stat_EPS
{
    _mEPS_Stat_Disp_Rq_AR.ASM_Stat_EPS.phys = getValue(this);
    _EPS_Stat_Disp_Rq_AR_SpontanFlag = 1;
}
/*@@end*/

/*@@envVar:HMI_DPC_Md_St_Rs:*/
on EnvVar HMI_DPC_Md_St_Rs
{
    _mEPS_Stat_Disp_Rq_AR.DPC_Md_St_Rs.phys = getValue(this);
    _EPS_Stat_Disp_Rq_AR_SpontanFlag = 1;
}
/*@@end*/

/*@@envVar:HMI_EPS_IndLmp_On_Rq:*/
on EnvVar HMI_EPS_IndLmp_On_Rq
{
    _mEPS_Stat_Disp_Rq_AR.EPS_IndLmp_On_Rq.phys = getValue(this);
    _EPS_Stat_Disp_Rq_AR_SpontanFlag = 1;
}
/*@@end*/

/*@@envVar:HMI_EPS_WarnDisp_Rq:*/
on EnvVar HMI_EPS_WarnDisp_Rq
{
    _mEPS_Stat_Disp_Rq_AR.EPS_WarnDisp_Rq.phys = getValue(this);
    _EPS_Stat_Disp_Rq_AR_SpontanFlag = 1;
}
/*@@end*/

/*@@envVar:HMI_Rsrv1_EPS_CtrlLmp_Disp_Rq:*/
on EnvVar HMI_Rsrv1_EPS_CtrlLmp_Disp_Rq
{
    _mEPS_Stat_Disp_Rq_AR.Rsrv1_EPS_CtrlLmp_Disp_Rq.phys = getValue(this);
    _EPS_Stat_Disp_Rq_AR_SpontanFlag = 1;
}
/*@@end*/

/*@@envVar:HMI_Rsrv2_EPS_CtrlLmp_Disp_Rq:*/
on EnvVar HMI_Rsrv2_EPS_CtrlLmp_Disp_Rq
{
    _mEPS_Stat_Disp_Rq_AR.Rsrv2_EPS_CtrlLmp_Disp_Rq.phys = getValue(this);
    _EPS_Stat_Disp_Rq_AR_SpontanFlag = 1;
}
/*@@end*/

/*@@envVar:HMI_Rsrv3_EPS_CtrlLmp_Disp_Rq:*/
on EnvVar HMI_Rsrv3_EPS_CtrlLmp_Disp_Rq
{
    _mEPS_Stat_Disp_Rq_AR.Rsrv3_EPS_CtrlLmp_Disp_Rq.phys = getValue(this);
    _EPS_Stat_Disp_Rq_AR_SpontanFlag = 1;
}
/*@@end*/

/*@@caplFunc:ESP_Disp_Rq_AR_check_output():*/
ESP_Disp_Rq_AR_check_output()
{
    if( !getValue( HMI__STMSG_ESP_Disp_Rq_AR ) )
    {
        // Botschaft ESP_Disp_Rq_AR ID: 555 --- Sendeart 5 cyclicAndSpontanWithDelay --- 
        _ESP_Disp_Rq_AR_Cnt--;
        if( _ESP_Disp_Rq_AR_Cnt < 1 )
        {
            // Nachricht wg. abgelaufenem Zyklus ausgeben
            ESP_Disp_Rq_AR_output();
            _ESP_Disp_Rq_AR_Cnt = _ESP_Disp_Rq_AR_CycleCount; // Zyklus-Zähler zurücksetzen
            _ESP_Disp_Rq_AR_SpontanFlag = 0; // Spontan-Flag zurücksetzen
        }
        else if( _ESP_Disp_Rq_AR_SpontanFlag)
        {
            // Nachricht wg. spontaner Änderung ausgeben
            ESP_Disp_Rq_AR_output();
            _ESP_Disp_Rq_AR_SpontanFlag = 0; // Spontan-Flag zurücksetzen
        }
    }
}
/*@@end*/

/*@@caplFunc:ESP_Disp_Rq_AR_init():*/
ESP_Disp_Rq_AR_init()
{   /* Botschaft ESP_Disp_Rq_AR ID: 555 --- Sendeart 5 cyclicAndSpontanWithDelay --- 
BA_ "ApplMessage" BO_ 555 0;
BA_ "NmAsrMessage" BO_ 555 0;
BA_ "GenMsgMinAcceptLength" BO_ 555 8;
BA_ "GenMsgILSupport" BO_ 555 1;
BA_ "DiagState" BO_ 555 0;
BA_ "DiagRequest" BO_ 555 0;
BA_ "DiagResponse" BO_ 555 0;
BA_ "GenMsgStartValue" BO_ 555 "0";
BA_ "GenMsgStartDelayTime" BO_ 555 0;
BA_ "GenMsgDelayTime" BO_ 555 5;
BA_ "GenMsgNrOfRepetitions" BO_ 555 0;
BA_ "GenMsgCycleTime" BO_ 555 100;
BA_ "GenMsgSendType" BO_ 555 5;
    */
    _ESP_Disp_Rq_AR_Timebase =            c_tDBKomTimer_20ms;
    _ESP_Disp_Rq_AR_CycleCount =         100 / _ESP_Disp_Rq_AR_Timebase;
    _ESP_Disp_Rq_AR_StartDelay =           0 / _ESP_Disp_Rq_AR_Timebase;
    _ESP_Disp_Rq_AR_Cnt = _ESP_Disp_Rq_AR_StartDelay;
    _ESP_Disp_Rq_AR_SpontanFlag = 0;

    putValue( HMI__STMSGSD_ESP_Disp_Rq_AR, _ESP_Disp_Rq_AR_StartDelay * _ESP_Disp_Rq_AR_Timebase );

    _mESP_Disp_Rq_AR.ABS_IndLmp_On_Rq.phys = getValue( HMI_ABS_IndLmp_On_Rq );
    _mESP_Disp_Rq_AR.BrkIndLmp_On_Rq_ESP.phys = getValue( HMI_BrkIndLmp_On_Rq_ESP );
    _mESP_Disp_Rq_AR.ESP_BrkMsg_Disp_Rq.phys = getValue( HMI_ESP_BrkMsg_Disp_Rq );
    _mESP_Disp_Rq_AR.ESP_BrkMsg_Disp_TrgRq.phys = getValue( HMI_ESP_BrkMsg_Disp_TrgRq );
    _mESP_Disp_Rq_AR.ESP_CtrlLmp_Info.phys = getValue( HMI_ESP_CtrlLmp_Info );
    _mESP_Disp_Rq_AR.ESP_Md_Disp_Rq.phys = getValue( HMI_ESP_Md_Disp_Rq );
    _mESP_Disp_Rq_AR.ESP_Md_Rq_Ack.phys = getValue( HMI_ESP_Md_Rq_Ack );
    _mESP_Disp_Rq_AR.ESP_Off_IndLmp_On_Rq.phys = getValue( HMI_ESP_Off_IndLmp_On_Rq );
    _mESP_Disp_Rq_AR.ESP_VDC_Msg_Disp_Rq.phys = getValue( HMI_ESP_VDC_Msg_Disp_Rq );
    _mESP_Disp_Rq_AR.ESP_VDC_Msg_Disp_TrgRq.phys = getValue( HMI_ESP_VDC_Msg_Disp_TrgRq );
    _mESP_Disp_Rq_AR.FTW_Msg_Disp_Rq.phys = getValue( HMI_FTW_Msg_Disp_Rq );
    _mESP_Disp_Rq_AR.FTW_Stat.phys = getValue( HMI_FTW_Stat );
    _mESP_Disp_Rq_AR.MIL_On_Rq_ESP.phys = getValue( HMI_MIL_On_Rq_ESP );
    _mESP_Disp_Rq_AR.RBS_AcustWarn_Rq.phys = getValue( HMI_RBS_AcustWarn_Rq );
    _mESP_Disp_Rq_AR.RBS_IndLmp_On_Rq.phys = getValue( HMI_RBS_IndLmp_On_Rq );
    _mESP_Disp_Rq_AR.RollTestMd_Rq_Ack.phys = getValue( HMI_RollTestMd_Rq_Ack );
    _mESP_Disp_Rq_AR.Rsrv1_ESP_Disp_Rq.phys = getValue( HMI_Rsrv1_ESP_Disp_Rq );
    _mESP_Disp_Rq_AR.SPCR_Stat.phys = getValue( HMI_SPCR_Stat );
    _mESP_Disp_Rq_AR.SPCR_StatMsg_Disp_Rq.phys = getValue( HMI_SPCR_StatMsg_Disp_Rq );
    _mESP_Disp_Rq_AR.SQC_ESP_Disp_Rq.phys = 15;
    putValue( HMI_SPCR_StatMsg_Disp_Rq, 15 );
}
/*@@end*/

/*@@caplFunc:ESP_Disp_Rq_AR_output():*/
void ESP_Disp_Rq_AR_output(void)
{
    byte crc;
    byte SQC_help;

    if( !getValue( HMI_SQC_ESP_Disp_Rq_Auto ) )
    {
        // berechne message counter
        SQC_help = getValue( HMI_SQC_ESP_Disp_Rq );
        if( SQC_help >= 15 ) SQC_help = 0;
        else SQC_help++;
        putValue( HMI_SQC_ESP_Disp_Rq, SQC_help );
        _mESP_Disp_Rq_AR.SQC_ESP_Disp_Rq = SQC_help;
    }
    else
          _mESP_Disp_Rq_AR.SQC_ESP_Disp_Rq = getValue( HMI_SQC_ESP_Disp_Rq );

    if( getValue( HMI_CRC_ESP_Disp_Rq_Profile_02 ) )
    {
        if( !getValue( HMI_CRC_ESP_Disp_Rq_Auto ) )
        {   // CRC according Profile_02 ( W213 )
            // berechne crc
            crc = 0xFF;
//          crc = crctable_profile02[ crc ^ _mESP_Disp_Rq_AR.byte( 0 ) ];   CRC
            crc = crctable_profile02[ crc ^ _mESP_Disp_Rq_AR.byte( 1 ) ];
            crc = crctable_profile02[ crc ^ _mESP_Disp_Rq_AR.byte( 2 ) ];
            crc = crctable_profile02[ crc ^ _mESP_Disp_Rq_AR.byte( 3 ) ];
            crc = crctable_profile02[ crc ^ _mESP_Disp_Rq_AR.byte( 4 ) ];
            crc = crctable_profile02[ crc ^ _mESP_Disp_Rq_AR.byte( 5 ) ];
//          crc = crctable_profile02[ crc ^ _mESP_Disp_Rq_AR.byte( 6 ) ];
//          crc = crctable_profile02[ crc ^ _mESP_Disp_Rq_AR.byte( 7 ) ];
            crc = crctable_profile02[ crc ^ _ESP_Disp_Rq_AR_CRC_Offset[ _mESP_Disp_Rq_AR.SQC_ESP_Disp_Rq ] ]; // load offset
            crc = (crc ^ 0xFF);
            if( getValue(  HMI_CRC_ESP_Disp_Rq_Invalid ) )
                crc++;
            _mESP_Disp_Rq_AR.CRC_ESP_Disp_Rq = crc;
            putValue( HMI_CRC_ESP_Disp_Rq, crc );
        }
        else
            _mESP_Disp_Rq_AR.CRC_ESP_Disp_Rq = getValue( HMI_CRC_ESP_Disp_Rq );
    }
    else
    {
        if( !getValue( HMI_CRC_ESP_Disp_Rq_Auto ) )
        {   // CRC according to SAE1850 ( W222 )
            // berechne crc
            crc = 0xFF;
//            crc = crctable[crc ^ _mESP_Disp_Rq_AR.byte( 0 )];  CRC
            crc = crctable[crc ^ _mESP_Disp_Rq_AR.byte( 1 )];
            crc = crctable[crc ^ _mESP_Disp_Rq_AR.byte( 2 )];
            crc = crctable[crc ^ _mESP_Disp_Rq_AR.byte( 3 )];
            crc = crctable[crc ^ _mESP_Disp_Rq_AR.byte( 4 )];
            crc = crctable[crc ^ _mESP_Disp_Rq_AR.byte( 5 )];
//          crc = crctable[crc ^ _mESP_Disp_Rq_AR.byte( 6 )];
//          crc = crctable[crc ^ _mESP_Disp_Rq_AR.byte( 7 )];
            crc = (crc ^ 0xFF);
            if( getValue(  HMI_CRC_ESP_Disp_Rq_Invalid ) )
                crc++;
            _mESP_Disp_Rq_AR.CRC_ESP_Disp_Rq = crc;
            putValue( HMI_CRC_ESP_Disp_Rq, crc );
        }
        else
            _mESP_Disp_Rq_AR.CRC_ESP_Disp_Rq = getValue( HMI_CRC_ESP_Disp_Rq );
    }
    output( _mESP_Disp_Rq_AR );
}
/*@@end*/

/*@@caplFunc:ESP_Disp_Rq_AR_saveEnvVars(dword):*/
ESP_Disp_Rq_AR_saveEnvVars( dword hFile )
{
    filePutString("\n// Knoten EIS: ESP_Disp_Rq_AR\n", 28, hFile );
    snprintf( buffer, elcount( buffer ), "0.0000 HMI__STMSG_ESP_Disp_Rq_AR := %X\n", getValue( HMI__STMSG_ESP_Disp_Rq_AR ) );        filePutString( buffer, elcount( buffer ), hFile );
    snprintf( buffer, elcount( buffer ), "0.0000 HMI__STMSGT_ESP_Disp_Rq_AR := %X\n", getValue( HMI__STMSGT_ESP_Disp_Rq_AR ) );        filePutString( buffer, elcount( buffer ), hFile );
    snprintf( buffer, elcount( buffer ), "0.0000 HMI_ABS_IndLmp_On_Rq := %X\n", getValue( HMI_ABS_IndLmp_On_Rq ) );        filePutString( buffer, elcount( buffer ), hFile );
    snprintf( buffer, elcount( buffer ), "0.0000 HMI_BrkIndLmp_On_Rq_ESP := %X\n", getValue( HMI_BrkIndLmp_On_Rq_ESP ) );        filePutString( buffer, elcount( buffer ), hFile );
    snprintf( buffer, elcount( buffer ), "0.0000 HMI_CRC_ESP_Disp_Rq := %X\n", getValue( HMI_CRC_ESP_Disp_Rq ) );        filePutString( buffer, elcount( buffer ), hFile );
    snprintf( buffer, elcount( buffer ), "0.0000 HMI_CRC_ESP_Disp_Rq_Auto := %X\n", getValue( HMI_CRC_ESP_Disp_Rq_Auto ) );        filePutString( buffer, elcount( buffer ), hFile );
    snprintf( buffer, elcount( buffer ), "0.0000 HMI_ESP_BrkMsg_Disp_Rq := %X\n", getValue( HMI_ESP_BrkMsg_Disp_Rq ) );        filePutString( buffer, elcount( buffer ), hFile );
    snprintf( buffer, elcount( buffer ), "0.0000 HMI_ESP_BrkMsg_Disp_TrgRq := %X\n", getValue( HMI_ESP_BrkMsg_Disp_TrgRq ) );        filePutString( buffer, elcount( buffer ), hFile );
    snprintf( buffer, elcount( buffer ), "0.0000 HMI_ESP_CtrlLmp_Info := %X\n", getValue( HMI_ESP_CtrlLmp_Info ) );        filePutString( buffer, elcount( buffer ), hFile );
    snprintf( buffer, elcount( buffer ), "0.0000 HMI_ESP_Md_Disp_Rq := %X\n", getValue( HMI_ESP_Md_Disp_Rq ) );        filePutString( buffer, elcount( buffer ), hFile );
    snprintf( buffer, elcount( buffer ), "0.0000 HMI_ESP_Md_Rq_Ack := %X\n", getValue( HMI_ESP_Md_Rq_Ack ) );        filePutString( buffer, elcount( buffer ), hFile );
    snprintf( buffer, elcount( buffer ), "0.0000 HMI_ESP_Off_IndLmp_On_Rq := %X\n", getValue( HMI_ESP_Off_IndLmp_On_Rq ) );        filePutString( buffer, elcount( buffer ), hFile );
    snprintf( buffer, elcount( buffer ), "0.0000 HMI_ESP_VDC_Msg_Disp_Rq := %X\n", getValue( HMI_ESP_VDC_Msg_Disp_Rq ) );        filePutString( buffer, elcount( buffer ), hFile );
    snprintf( buffer, elcount( buffer ), "0.0000 HMI_ESP_VDC_Msg_Disp_TrgRq := %X\n", getValue( HMI_ESP_VDC_Msg_Disp_TrgRq ) );        filePutString( buffer, elcount( buffer ), hFile );
    snprintf( buffer, elcount( buffer ), "0.0000 HMI_FTW_Msg_Disp_Rq := %X\n", getValue( HMI_FTW_Msg_Disp_Rq ) );        filePutString( buffer, elcount( buffer ), hFile );
    snprintf( buffer, elcount( buffer ), "0.0000 HMI_FTW_Stat := %X\n", getValue( HMI_FTW_Stat ) );        filePutString( buffer, elcount( buffer ), hFile );
    snprintf( buffer, elcount( buffer ), "0.0000 HMI_MIL_On_Rq_ESP := %X\n", getValue( HMI_MIL_On_Rq_ESP ) );        filePutString( buffer, elcount( buffer ), hFile );
    snprintf( buffer, elcount( buffer ), "0.0000 HMI_RBS_AcustWarn_Rq := %X\n", getValue( HMI_RBS_AcustWarn_Rq ) );        filePutString( buffer, elcount( buffer ), hFile );
    snprintf( buffer, elcount( buffer ), "0.0000 HMI_RBS_IndLmp_On_Rq := %X\n", getValue( HMI_RBS_IndLmp_On_Rq ) );        filePutString( buffer, elcount( buffer ), hFile );
    snprintf( buffer, elcount( buffer ), "0.0000 HMI_RollTestMd_Rq_Ack := %X\n", getValue( HMI_RollTestMd_Rq_Ack ) );        filePutString( buffer, elcount( buffer ), hFile );
    snprintf( buffer, elcount( buffer ), "0.0000 HMI_Rsrv1_ESP_Disp_Rq := %X\n", getValue( HMI_Rsrv1_ESP_Disp_Rq ) );        filePutString( buffer, elcount( buffer ), hFile );
    snprintf( buffer, elcount( buffer ), "0.0000 HMI_SPCR_Stat := %X\n", getValue( HMI_SPCR_Stat ) );        filePutString( buffer, elcount( buffer ), hFile );
    snprintf( buffer, elcount( buffer ), "0.0000 HMI_SPCR_StatMsg_Disp_Rq := %X\n", getValue( HMI_SPCR_StatMsg_Disp_Rq ) );        filePutString( buffer, elcount( buffer ), hFile );
    snprintf( buffer, elcount( buffer ), "0.0000 HMI_SQC_ESP_Disp_Rq := %X\n", getValue( HMI_SQC_ESP_Disp_Rq ) );        filePutString( buffer, elcount( buffer ), hFile );
    snprintf( buffer, elcount( buffer ), "0.0000 HMI_SQC_ESP_Disp_Rq_Auto := %X\n", getValue( HMI_SQC_ESP_Disp_Rq_Auto ) );        filePutString( buffer, elcount( buffer ), hFile );
}
/*@@end*/

/*@@timer:_tESP_Disp_Rq_AR:*/
on timer _tESP_Disp_Rq_AR
{
    putValue( HMI__STMSG_ESP_Disp_Rq_AR, 0 );
}
/*@@end*/

/*@@envVar:HMI__STMSG_ESP_Disp_Rq_AR:*/
on EnvVar HMI__STMSG_ESP_Disp_Rq_AR
{
    long tDelay;
    if( getValue( this ) == 2 )
    {
        tDelay = getValue( HMI__STMSGT_ESP_Disp_Rq_AR );
        if( tDelay > 0)    
            setTimer( _tESP_Disp_Rq_AR, tDelay );
        else
            putValue( HMI__STMSG_ESP_Disp_Rq_AR, 0 );
    }
}
/*@@end*/

/*@@envVar:HMI_ABS_IndLmp_On_Rq:*/
on EnvVar HMI_ABS_IndLmp_On_Rq
{
    _mESP_Disp_Rq_AR.ABS_IndLmp_On_Rq.phys = getValue(this);
    _ESP_Disp_Rq_AR_SpontanFlag = 1;
}
/*@@end*/

/*@@envVar:HMI_BrkIndLmp_On_Rq_ESP:*/
on EnvVar HMI_BrkIndLmp_On_Rq_ESP
{
    _mESP_Disp_Rq_AR.BrkIndLmp_On_Rq_ESP.phys = getValue(this);
    _ESP_Disp_Rq_AR_SpontanFlag = 1;
}
/*@@end*/

/*@@envVar:HMI_ESP_BrkMsg_Disp_Rq:*/
on EnvVar HMI_ESP_BrkMsg_Disp_Rq
{
    _mESP_Disp_Rq_AR.ESP_BrkMsg_Disp_Rq.phys = getValue(this);
    _ESP_Disp_Rq_AR_SpontanFlag = 1;
}
/*@@end*/

/*@@envVar:HMI_ESP_BrkMsg_Disp_TrgRq:*/
on EnvVar HMI_ESP_BrkMsg_Disp_TrgRq
{
    _mESP_Disp_Rq_AR.ESP_BrkMsg_Disp_TrgRq.phys = getValue(this);
    _ESP_Disp_Rq_AR_SpontanFlag = 1;
}
/*@@end*/

/*@@envVar:HMI_ESP_CtrlLmp_Info:*/
on EnvVar HMI_ESP_CtrlLmp_Info
{
    _mESP_Disp_Rq_AR.ESP_CtrlLmp_Info.phys = getValue(this);
    _ESP_Disp_Rq_AR_SpontanFlag = 1;
}
/*@@end*/

/*@@envVar:HMI_ESP_Md_Disp_Rq:*/
on EnvVar HMI_ESP_Md_Disp_Rq
{
    _mESP_Disp_Rq_AR.ESP_Md_Disp_Rq.phys = getValue(this);
    _ESP_Disp_Rq_AR_SpontanFlag = 1;
}
/*@@end*/

/*@@envVar:HMI_ESP_Md_Rq_Ack:*/
on EnvVar HMI_ESP_Md_Rq_Ack
{
    _mESP_Disp_Rq_AR.ESP_Md_Rq_Ack.phys = getValue(this);
    _ESP_Disp_Rq_AR_SpontanFlag = 1;
}
/*@@end*/

/*@@envVar:HMI_ESP_Off_IndLmp_On_Rq:*/
on EnvVar HMI_ESP_Off_IndLmp_On_Rq
{
    _mESP_Disp_Rq_AR.ESP_Off_IndLmp_On_Rq.phys = getValue(this);
    _ESP_Disp_Rq_AR_SpontanFlag = 1;
}
/*@@end*/

/*@@envVar:HMI_ESP_VDC_Msg_Disp_Rq:*/
on EnvVar HMI_ESP_VDC_Msg_Disp_Rq
{
    _mESP_Disp_Rq_AR.ESP_VDC_Msg_Disp_Rq.phys = getValue(this);
    _ESP_Disp_Rq_AR_SpontanFlag = 1;
}
/*@@end*/

/*@@envVar:HMI_ESP_VDC_Msg_Disp_TrgRq:*/
on EnvVar HMI_ESP_VDC_Msg_Disp_TrgRq
{
    _mESP_Disp_Rq_AR.ESP_VDC_Msg_Disp_TrgRq.phys = getValue(this);
    _ESP_Disp_Rq_AR_SpontanFlag = 1;
}
/*@@end*/

/*@@envVar:HMI_FTW_Msg_Disp_Rq:*/
on EnvVar HMI_FTW_Msg_Disp_Rq
{
    _mESP_Disp_Rq_AR.FTW_Msg_Disp_Rq.phys = getValue(this);
    _ESP_Disp_Rq_AR_SpontanFlag = 1;
}
/*@@end*/

/*@@envVar:HMI_FTW_Stat:*/
on EnvVar HMI_FTW_Stat
{
    _mESP_Disp_Rq_AR.FTW_Stat.phys = getValue(this);
    _ESP_Disp_Rq_AR_SpontanFlag = 1;
}
/*@@end*/

/*@@envVar:HMI_MIL_On_Rq_ESP:*/
on EnvVar HMI_MIL_On_Rq_ESP
{
    _mESP_Disp_Rq_AR.MIL_On_Rq_ESP.phys = getValue(this);
    _ESP_Disp_Rq_AR_SpontanFlag = 1;
}
/*@@end*/

/*@@envVar:HMI_RBS_AcustWarn_Rq:*/
on EnvVar HMI_RBS_AcustWarn_Rq
{
    _mESP_Disp_Rq_AR.RBS_AcustWarn_Rq.phys = getValue(this);
    _ESP_Disp_Rq_AR_SpontanFlag = 1;
}
/*@@end*/

/*@@envVar:HMI_RBS_IndLmp_On_Rq:*/
on EnvVar HMI_RBS_IndLmp_On_Rq
{
    _mESP_Disp_Rq_AR.RBS_IndLmp_On_Rq.phys = getValue(this);
    _ESP_Disp_Rq_AR_SpontanFlag = 1;
}
/*@@end*/

/*@@envVar:HMI_RollTestMd_Rq_Ack:*/
on EnvVar HMI_RollTestMd_Rq_Ack
{
    _mESP_Disp_Rq_AR.RollTestMd_Rq_Ack.phys = getValue(this);
    _ESP_Disp_Rq_AR_SpontanFlag = 1;
}
/*@@end*/

/*@@envVar:HMI_Rsrv1_ESP_Disp_Rq:*/
on EnvVar HMI_Rsrv1_ESP_Disp_Rq
{
    _mESP_Disp_Rq_AR.Rsrv1_ESP_Disp_Rq.phys = getValue(this);
    _ESP_Disp_Rq_AR_SpontanFlag = 1;
}
/*@@end*/

/*@@envVar:HMI_SPCR_Stat:*/
on EnvVar HMI_SPCR_Stat
{
    _mESP_Disp_Rq_AR.SPCR_Stat.phys = getValue(this);
    _ESP_Disp_Rq_AR_SpontanFlag = 1;
}
/*@@end*/

/*@@envVar:HMI_SPCR_StatMsg_Disp_Rq:*/
on EnvVar HMI_SPCR_StatMsg_Disp_Rq
{
    if( ( getValue( Env_Stress__StresstestMainActiv ) == 0 )   &&
        ( getValue( HMI__NM_EIS_AutomaticNM_Switching ) == 0 )    )
    {
        _SetCommRequest( cWakeWarningNMRequest );
        setTimer( t_WakeWarningNMCancelTimer, c_NMCancelTimer_05sec ); // 30 seconds for auto-shut-off
    }
    _mESP_Disp_Rq_AR.SPCR_StatMsg_Disp_Rq.phys = getValue(this);
    _ESP_Disp_Rq_AR_SpontanFlag = 1;
}
/*@@end*/

/*@@caplFunc:ESP_Disp_Rq2_AR_check_output():*/
ESP_Disp_Rq2_AR_check_output()
{
    if( !getValue( HMI__STMSG_ESP_Disp_Rq2_AR ) )
    {
        // Botschaft ESP_Disp_Rq2_AR ID: 1177 --- Sendeart 5 cyclicAndSpontanWithDelay --- 
        _ESP_Disp_Rq2_AR_Cnt--;
        if( _ESP_Disp_Rq2_AR_Cnt < 1 )
        {
            // Nachricht wg. abgelaufenem Zyklus ausgeben
            ESP_Disp_Rq2_AR_output();
            _ESP_Disp_Rq2_AR_Cnt = _ESP_Disp_Rq2_AR_CycleCount; // Zyklus-Zähler zurücksetzen
            _ESP_Disp_Rq2_AR_SpontanFlag = 0; // Spontan-Flag zurücksetzen
        }
        else if( _ESP_Disp_Rq2_AR_SpontanFlag)
        {
            // Nachricht wg. spontaner Änderung ausgeben
            ESP_Disp_Rq2_AR_output();
            _ESP_Disp_Rq2_AR_SpontanFlag = 0; // Spontan-Flag zurücksetzen
        }
    }
}
/*@@end*/

/*@@caplFunc:ESP_Disp_Rq2_AR_init():*/
ESP_Disp_Rq2_AR_init()
{   /* Botschaft ESP_Disp_Rq2_AR ID: 1177 --- Sendeart 5 cyclicAndSpontanWithDelay --- 
BA_ "ApplMessage" BO_ 1177 0;
BA_ "NmAsrMessage" BO_ 1177 0;
BA_ "GenMsgMinAcceptLength" BO_ 1177 8;
BA_ "GenMsgILSupport" BO_ 1177 1;
BA_ "DiagState" BO_ 1177 0;
BA_ "DiagRequest" BO_ 1177 0;
BA_ "DiagResponse" BO_ 1177 0;
BA_ "GenMsgStartValue" BO_ 1177 "0";
BA_ "GenMsgStartDelayTime" BO_ 1177 0;
BA_ "GenMsgDelayTime" BO_ 1177 20;
BA_ "GenMsgNrOfRepetitions" BO_ 1177 0;
BA_ "GenMsgCycleTime" BO_ 1177 100;
BA_ "GenMsgSendType" BO_ 1177 5;
    */
    _ESP_Disp_Rq2_AR_Timebase =            c_tDBKomTimer_20ms;
    _ESP_Disp_Rq2_AR_CycleCount =         100 / _ESP_Disp_Rq2_AR_Timebase;
    _ESP_Disp_Rq2_AR_StartDelay =           0 / _ESP_Disp_Rq2_AR_Timebase;
    _ESP_Disp_Rq2_AR_Cnt = _ESP_Disp_Rq2_AR_StartDelay;
    _ESP_Disp_Rq2_AR_SpontanFlag = 0;

    putValue( HMI__STMSGSD_ESP_Disp_Rq2_AR, _ESP_Disp_Rq2_AR_StartDelay * _ESP_Disp_Rq2_AR_Timebase );

    _mESP_Disp_Rq2_AR.ABS_Actv_Stat_EDR.phys = getValue( HMI_ABS_Actv_Stat_EDR );
    _mESP_Disp_Rq2_AR.CRC_DSR_Disp_Rq.phys = getValue( HMI_CRC_DSR_Disp_Rq );
    _mESP_Disp_Rq2_AR.DrowDtct_Actv.phys = getValue( HMI_DrowDtct_Actv );
    _mESP_Disp_Rq2_AR.DrowDtct_DrvTmHour_Disp_Rq.phys = getValue( HMI_DrowDtct_DrvTmHour_Disp_Rq );
    _mESP_Disp_Rq2_AR.DrowDtct_DrvTmMinute_Disp_Rq.phys = getValue( HMI_DrowDtct_DrvTmMinute_Disp_Rq );
    _mESP_Disp_Rq2_AR.DrowDtctIndLmp_On_Rq.phys = getValue( HMI_DrowDtctIndLmp_On_Rq );
    _mESP_Disp_Rq2_AR.DrowLvl_Disp_Rq.phys = getValue( HMI_DrowLvl_Disp_Rq );
    _mESP_Disp_Rq2_AR.DrowLvlDisp_Md_Rq.phys = getValue( HMI_DrowLvlDisp_Md_Rq );
    _mESP_Disp_Rq2_AR.DrowWarn_Rq.phys = getValue( HMI_DrowWarn_Rq );
    _mESP_Disp_Rq2_AR.DSR_Disp_Rq1.phys = getValue( HMI_DSR_Disp_Rq1 );
    _mESP_Disp_Rq2_AR.DSR_Disp_Rq2.phys = getValue( HMI_DSR_Disp_Rq2 );
    _mESP_Disp_Rq2_AR.DSR_Disp_TrgrRq.phys = getValue( HMI_DSR_Disp_TrgrRq );
    _mESP_Disp_Rq2_AR.DSR_SpdUnit_Rs.phys = getValue( HMI_DSR_SpdUnit_Rs );
    _mESP_Disp_Rq2_AR.DSR_Sw_LED_On_Rq.phys = getValue( HMI_DSR_Sw_LED_On_Rq );
    _mESP_Disp_Rq2_AR.ESP_Actv_Stat_EDR.phys = getValue( HMI_ESP_Actv_Stat_EDR );
    _mESP_Disp_Rq2_AR.ESP_LastMd_Disp_Rq.phys = getValue( HMI_ESP_LastMd_Disp_Rq );
    _mESP_Disp_Rq2_AR.RoofLuggMd_MenuSubs_Rq.phys = getValue( HMI_RoofLuggMd_MenuSubs_Rq );
    putValue( HMI_SQC_DSR_Disp_Rq, 15 );
    _mESP_Disp_Rq2_AR.SQC_DSR_Disp_Rq.phys = getValue( HMI_SQC_DSR_Disp_Rq );
}
/*@@end*/

/*@@caplFunc:ESP_Disp_Rq2_AR_output():*/
void ESP_Disp_Rq2_AR_output(void)
{
    byte crc;
    byte SQC_help;

    if( !getValue( HMI_SQC_DSR_Disp_Rq_Auto ) )
    {
        // berechne message counter
        SQC_help = getValue( HMI_SQC_DSR_Disp_Rq );
        if( SQC_help >= 15 ) SQC_help = 0;
        else SQC_help++;
        putValue( HMI_SQC_DSR_Disp_Rq, SQC_help );
        _mESP_Disp_Rq2_AR.SQC_DSR_Disp_Rq = SQC_help;
    }
    else
          _mESP_Disp_Rq2_AR.SQC_DSR_Disp_Rq = getValue( HMI_SQC_DSR_Disp_Rq );

    if( getValue( HMI_CRC_DSR_Disp_Rq_Profile_02 ) )
    {
        if( !getValue( HMI_CRC_DSR_Disp_Rq_Auto ) )
        {   // CRC according Profile_02 ( W213 )
            // berechne crc
            crc = 0xFF;
//          crc = crctable_profile02[crc ^ _mESP_Disp_Rq2_AR.byte( 0 )];
//          crc = crctable_profile02[crc ^ _mESP_Disp_Rq2_AR.byte( 1 )];
//          crc = crctable_profile02[crc ^ _mESP_Disp_Rq2_AR.byte( 2 )];
//          crc = crctable_profile02[crc ^ _mESP_Disp_Rq2_AR.byte( 3 )];
//          crc = crctable_profile02[crc ^ _mESP_Disp_Rq2_AR.byte( 4 )]; // CRC
            crc = crctable_profile02[crc ^ _mESP_Disp_Rq2_AR.byte( 5 )];
            crc = crctable_profile02[crc ^ _mESP_Disp_Rq2_AR.byte( 6 )];
//          crc = crctable_profile02[crc ^ _mESP_Disp_Rq2_AR.byte( 7 )];
            crc = crctable_profile02[ crc ^ _ESP_Disp_Rq2_AR_CRC_Offset[ _mESP_Disp_Rq2_AR.SQC_DSR_Disp_Rq ] ]; // load offset
            crc = (crc ^ 0xFF);
            if( getValue(  HMI_CRC_DSR_Disp_Rq_Invalid ) )
                crc++;
            _mESP_Disp_Rq2_AR.CRC_DSR_Disp_Rq = crc;
            putValue( HMI_CRC_DSR_Disp_Rq, crc );
        }
        else
            _mESP_Disp_Rq2_AR.CRC_DSR_Disp_Rq = getValue( HMI_CRC_DSR_Disp_Rq );
    }
    else
    {
        if( !getValue( HMI_CRC_DSR_Disp_Rq_Auto ) )
        {   // CRC according to SAE1850 ( W222 )
            // berechne crc
            crc = 0xFF;
//          crc = crctable[crc ^ _mESP_Disp_Rq2_AR.byte( 0 )];
//          crc = crctable[crc ^ _mESP_Disp_Rq2_AR.byte( 1 )];
//          crc = crctable[crc ^ _mESP_Disp_Rq2_AR.byte( 2 )];
//          crc = crctable[crc ^ _mESP_Disp_Rq2_AR.byte( 3 )];
//          crc = crctable[crc ^ _mESP_Disp_Rq2_AR.byte( 4 )]; // CRC
            crc = crctable[crc ^ _mESP_Disp_Rq2_AR.byte( 5 )];
            crc = crctable[crc ^ _mESP_Disp_Rq2_AR.byte( 6 )];
//          crc = crctable[crc ^ _mESP_Disp_Rq2_AR.byte( 7 )];
            crc = (crc ^ 0xFF);
            if( getValue(  HMI_CRC_DSR_Disp_Rq_Invalid ) )
                crc++;
            _mESP_Disp_Rq2_AR.CRC_DSR_Disp_Rq = crc;
            putValue( HMI_CRC_DSR_Disp_Rq, crc );
        }
        else
            _mESP_Disp_Rq2_AR.CRC_DSR_Disp_Rq = getValue( HMI_CRC_DSR_Disp_Rq );
    }
    output( _mESP_Disp_Rq2_AR );
}
/*@@end*/

/*@@caplFunc:ESP_Disp_Rq2_AR_saveEnvVars(dword):*/
ESP_Disp_Rq2_AR_saveEnvVars( dword hFile )
{
    filePutString("\n// Knoten EIS: ESP_Disp_Rq2_AR\n", 28, hFile );
    snprintf( buffer, elcount( buffer ), "0.0000 HMI__STMSG_ESP_Disp_Rq2_AR := %X\n", getValue( HMI__STMSG_ESP_Disp_Rq2_AR ) );    filePutString( buffer, elcount( buffer ), hFile );
    snprintf( buffer, elcount( buffer ), "0.0000 HMI__STMSGT_ESP_Disp_Rq2_AR := %X\n", getValue( HMI__STMSGT_ESP_Disp_Rq2_AR ) );    filePutString( buffer, elcount( buffer ), hFile );
    snprintf( buffer, elcount( buffer ), "0.0000 HMI_ABS_Actv_Stat_EDR := %X\n", getValue( HMI_ABS_Actv_Stat_EDR ) );    filePutString( buffer, elcount( buffer ), hFile );
    snprintf( buffer, elcount( buffer ), "0.0000 HMI_CRC_DSR_Disp_Rq := %X\n", getValue( HMI_CRC_DSR_Disp_Rq ) );    filePutString( buffer, elcount( buffer ), hFile );
    snprintf( buffer, elcount( buffer ), "0.0000 HMI_CRC_DSR_Disp_Rq_Auto := %X\n", getValue( HMI_CRC_DSR_Disp_Rq_Auto ) );    filePutString( buffer, elcount( buffer ), hFile );
    snprintf( buffer, elcount( buffer ), "0.0000 HMI_DrowDtct_Actv := %X\n", getValue( HMI_DrowDtct_Actv ) );    filePutString( buffer, elcount( buffer ), hFile );
    snprintf( buffer, elcount( buffer ), "0.0000 HMI_DrowDtct_DrvTmHour_Disp_Rq := %X\n", getValue( HMI_DrowDtct_DrvTmHour_Disp_Rq ) );    filePutString( buffer, elcount( buffer ), hFile );
    snprintf( buffer, elcount( buffer ), "0.0000 HMI_DrowDtct_DrvTmMinute_Disp_Rq := %X\n", getValue( HMI_DrowDtct_DrvTmMinute_Disp_Rq ) );    filePutString( buffer, elcount( buffer ), hFile );
    snprintf( buffer, elcount( buffer ), "0.0000 HMI_DrowDtctIndLmp_On_Rq := %X\n", getValue( HMI_DrowDtctIndLmp_On_Rq ) );    filePutString( buffer, elcount( buffer ), hFile );
    snprintf( buffer, elcount( buffer ), "0.0000 HMI_DrowLvl_Disp_Rq := %X\n", getValue( HMI_DrowLvl_Disp_Rq ) );    filePutString( buffer, elcount( buffer ), hFile );
    snprintf( buffer, elcount( buffer ), "0.0000 HMI_DrowLvlDisp_Md_Rq := %X\n", getValue( HMI_DrowLvlDisp_Md_Rq ) );    filePutString( buffer, elcount( buffer ), hFile );
    snprintf( buffer, elcount( buffer ), "0.0000 HMI_DrowWarn_Rq := %X\n", getValue( HMI_DrowWarn_Rq ) );    filePutString( buffer, elcount( buffer ), hFile );
    snprintf( buffer, elcount( buffer ), "0.0000 HMI_DSR_Disp_Rq1 := %X\n", getValue( HMI_DSR_Disp_Rq1 ) );    filePutString( buffer, elcount( buffer ), hFile );
    snprintf( buffer, elcount( buffer ), "0.0000 HMI_DSR_Disp_Rq2 := %X\n", getValue( HMI_DSR_Disp_Rq2 ) );    filePutString( buffer, elcount( buffer ), hFile );
    snprintf( buffer, elcount( buffer ), "0.0000 HMI_DSR_Disp_TrgrRq := %X\n", getValue( HMI_DSR_Disp_TrgrRq ) );    filePutString( buffer, elcount( buffer ), hFile );
    snprintf( buffer, elcount( buffer ), "0.0000 HMI_DSR_SpdUnit_Rs := %X\n", getValue( HMI_DSR_SpdUnit_Rs ) );    filePutString( buffer, elcount( buffer ), hFile );
    snprintf( buffer, elcount( buffer ), "0.0000 HMI_DSR_Sw_LED_On_Rq := %X\n", getValue( HMI_DSR_Sw_LED_On_Rq ) );    filePutString( buffer, elcount( buffer ), hFile );
    snprintf( buffer, elcount( buffer ), "0.0000 HMI_ESP_Actv_Stat_EDR := %X\n", getValue( HMI_ESP_Actv_Stat_EDR ) );    filePutString( buffer, elcount( buffer ), hFile );
    snprintf( buffer, elcount( buffer ), "0.0000 HMI_ESP_LastMd_Disp_Rq := %X\n", getValue( HMI_ESP_LastMd_Disp_Rq ) );    filePutString( buffer, elcount( buffer ), hFile );
    snprintf( buffer, elcount( buffer ), "0.0000 HMI_RoofLuggMd_MenuSubs_Rq := %X\n", getValue( HMI_RoofLuggMd_MenuSubs_Rq ) );    filePutString( buffer, elcount( buffer ), hFile );
    snprintf( buffer, elcount( buffer ), "0.0000 HMI_SQC_DSR_Disp_Rq := %X\n", getValue( HMI_SQC_DSR_Disp_Rq ) );    filePutString( buffer, elcount( buffer ), hFile );
    snprintf( buffer, elcount( buffer ), "0.0000 HMI_SQC_DSR_Disp_Rq_Auto := %X\n", getValue( HMI_SQC_DSR_Disp_Rq_Auto ) );    filePutString( buffer, elcount( buffer ), hFile );
}
/*@@end*/

/*@@timer:_tESP_Disp_Rq2_AR:*/
on timer _tESP_Disp_Rq2_AR
{
    putValue( HMI__STMSG_ESP_Disp_Rq2_AR, 0 );
}
/*@@end*/

/*@@envVar:HMI__STMSG_ESP_Disp_Rq2_AR:*/
on EnvVar HMI__STMSG_ESP_Disp_Rq2_AR
{
    long tDelay;
    if( getValue( this ) == 2 )
    {
        tDelay = getValue( HMI__STMSGT_ESP_Disp_Rq2_AR );
        if( tDelay > 0)    
            setTimer( _tESP_Disp_Rq2_AR, tDelay );
        else
            putValue( HMI__STMSG_ESP_Disp_Rq2_AR, 0 );
    }
}
/*@@end*/

/*@@envVar:HMI_ABS_Actv_Stat_EDR:*/
on EnvVar HMI_ABS_Actv_Stat_EDR
{
    _mESP_Disp_Rq2_AR.ABS_Actv_Stat_EDR.phys = getValue(this);
    _ESP_Disp_Rq2_AR_SpontanFlag = 1;
}
/*@@end*/

/*@@envVar:HMI_DrowDtct_Actv:*/
on EnvVar HMI_DrowDtct_Actv
{
    _mESP_Disp_Rq2_AR.DrowDtct_Actv.phys = getValue(this);
    _ESP_Disp_Rq2_AR_SpontanFlag = 1;
}
/*@@end*/

/*@@envVar:HMI_DrowDtct_DrvTmHour_Disp_Rq:*/
on EnvVar HMI_DrowDtct_DrvTmHour_Disp_Rq
{
    _mESP_Disp_Rq2_AR.DrowDtct_DrvTmHour_Disp_Rq.phys = getValue(this);
    _ESP_Disp_Rq2_AR_SpontanFlag = 1;
}
/*@@end*/

/*@@envVar:HMI_DrowDtct_DrvTmMinute_Disp_Rq:*/
on EnvVar HMI_DrowDtct_DrvTmMinute_Disp_Rq
{
    _mESP_Disp_Rq2_AR.DrowDtct_DrvTmMinute_Disp_Rq.phys = getValue(this);
    _ESP_Disp_Rq2_AR_SpontanFlag = 1;
}
/*@@end*/

/*@@envVar:HMI_DrowDtctIndLmp_On_Rq:*/
on EnvVar HMI_DrowDtctIndLmp_On_Rq
{
    _mESP_Disp_Rq2_AR.DrowDtctIndLmp_On_Rq.phys = getValue(this);
    _ESP_Disp_Rq2_AR_SpontanFlag = 1;
}
/*@@end*/

/*@@envVar:HMI_DrowLvl_Disp_Rq:*/
on EnvVar HMI_DrowLvl_Disp_Rq
{
    _mESP_Disp_Rq2_AR.DrowLvl_Disp_Rq.phys = getValue(this);
    _ESP_Disp_Rq2_AR_SpontanFlag = 1;
}
/*@@end*/

/*@@envVar:HMI_DrowLvlDisp_Md_Rq:*/
on EnvVar HMI_DrowLvlDisp_Md_Rq
{
    _mESP_Disp_Rq2_AR.DrowLvlDisp_Md_Rq.phys = getValue(this);
    _ESP_Disp_Rq2_AR_SpontanFlag = 1;
}
/*@@end*/

/*@@envVar:HMI_DrowWarn_Rq:*/
on EnvVar HMI_DrowWarn_Rq
{
    _mESP_Disp_Rq2_AR.DrowWarn_Rq.phys = getValue(this);
    _ESP_Disp_Rq2_AR_SpontanFlag = 1;
}
/*@@end*/

/*@@envVar:HMI_DSR_Disp_Rq1:*/
on EnvVar HMI_DSR_Disp_Rq1
{
    _mESP_Disp_Rq2_AR.DSR_Disp_Rq1.phys = getValue(this);
    _ESP_Disp_Rq2_AR_SpontanFlag = 1;
}
/*@@end*/

/*@@envVar:HMI_DSR_Disp_Rq2:*/
on EnvVar HMI_DSR_Disp_Rq2
{
    _mESP_Disp_Rq2_AR.DSR_Disp_Rq2.phys = getValue(this);
    _ESP_Disp_Rq2_AR_SpontanFlag = 1;
}
/*@@end*/

/*@@envVar:HMI_DSR_Disp_TrgrRq:*/
on EnvVar HMI_DSR_Disp_TrgrRq
{
    _mESP_Disp_Rq2_AR.DSR_Disp_TrgrRq.phys = getValue(this);
    _ESP_Disp_Rq2_AR_SpontanFlag = 1;
}
/*@@end*/

/*@@envVar:HMI_DSR_SpdUnit_Rs:*/
on EnvVar HMI_DSR_SpdUnit_Rs
{
    _mESP_Disp_Rq2_AR.DSR_SpdUnit_Rs.phys = getValue(this);
    _ESP_Disp_Rq2_AR_SpontanFlag = 1;
}
/*@@end*/

/*@@envVar:HMI_DSR_Sw_LED_On_Rq:*/
on EnvVar HMI_DSR_Sw_LED_On_Rq
{
    _mESP_Disp_Rq2_AR.DSR_Sw_LED_On_Rq.phys = getValue(this);
    _ESP_Disp_Rq2_AR_SpontanFlag = 1;
}
/*@@end*/

/*@@envVar:HMI_ESP_Actv_Stat_EDR:*/
on EnvVar HMI_ESP_Actv_Stat_EDR
{
    _mESP_Disp_Rq2_AR.ESP_Actv_Stat_EDR.phys = getValue(this);
    _ESP_Disp_Rq2_AR_SpontanFlag = 1;
}
/*@@end*/

/*@@envVar:HMI_ESP_LastMd_Disp_Rq:*/
on EnvVar HMI_ESP_LastMd_Disp_Rq
{
    _mESP_Disp_Rq2_AR.ESP_LastMd_Disp_Rq.phys = getValue(this);
    _ESP_Disp_Rq2_AR_SpontanFlag = 1;
}
/*@@end*/

/*@@envVar:HMI_RoofLuggMd_MenuSubs_Rq:*/
on EnvVar HMI_RoofLuggMd_MenuSubs_Rq
{
    _mESP_Disp_Rq2_AR.RoofLuggMd_MenuSubs_Rq.phys = getValue(this);
    _ESP_Disp_Rq2_AR_SpontanFlag = 1;
}
/*@@end*/

/*@@caplFunc:ESP_Disp_Rq3_AR_check_output():*/
ESP_Disp_Rq3_AR_check_output()
{
    if( !getValue( HMI__STMSG_ESP_Disp_Rq3_AR ) )
    {
        // Botschaft ESP_Disp_Rq3_AR ID: 920 --- Sendeart 0 cyclicX --- 
        _ESP_Disp_Rq3_AR_Cnt--;
        if( _ESP_Disp_Rq3_AR_Cnt < 1 )
        {
            // Nachricht wg. abgelaufenem Zyklus ausgeben
            ESP_Disp_Rq3_AR_output();
            // Zyklus-Zähler zurücksetzen
            _ESP_Disp_Rq3_AR_Cnt = _ESP_Disp_Rq3_AR_CycleCount;
        }
    }
}
/*@@end*/

/*@@caplFunc:ESP_Disp_Rq3_AR_init():*/
ESP_Disp_Rq3_AR_init()
{   /* Botschaft ESP_Disp_Rq3_AR ID: 920 --- Sendeart 0 cyclicX --- 
BA_ "ApplMessage" BO_ 920 0;
BA_ "NmAsrMessage" BO_ 920 0;
BA_ "GenMsgMinAcceptLength" BO_ 920 8;
BA_ "GenMsgILSupport" BO_ 920 1;
BA_ "DiagState" BO_ 920 0;
BA_ "DiagRequest" BO_ 920 0;
BA_ "DiagResponse" BO_ 920 0;
BA_ "GenMsgStartValue" BO_ 920 "0";
BA_ "GenMsgCycleTime" BO_ 920 200;
BA_ "GenMsgSendType" BO_ 920 0;
    */
    _ESP_Disp_Rq3_AR_Timebase =            c_tDBKomTimer_20ms;
    _ESP_Disp_Rq3_AR_CycleCount =         200 / _ESP_Disp_Rq3_AR_Timebase;
    _ESP_Disp_Rq3_AR_StartDelay =           0 / _ESP_Disp_Rq3_AR_Timebase;
    _ESP_Disp_Rq3_AR_Cnt = _ESP_Disp_Rq3_AR_StartDelay;

    putValue( HMI__STMSGSD_ESP_Disp_Rq3_AR, _ESP_Disp_Rq3_AR_StartDelay * _ESP_Disp_Rq3_AR_Timebase );

    _mESP_Disp_Rq3_AR.DrowDtct_Md_Stat.phys = getValue( HMI_DrowDtct_Md_Stat );
    _mESP_Disp_Rq3_AR.Incl_X_Graph.phys = getValue( HMI_Incl_X_Graph );
    _mESP_Disp_Rq3_AR.Incl_X_Num.phys = getValue( HMI_Incl_X_Num );
    _mESP_Disp_Rq3_AR.Incl_Y_Graph.phys = getValue( HMI_Incl_Y_Graph );
    _mESP_Disp_Rq3_AR.Incl_Y_Num.phys = getValue( HMI_Incl_Y_Num );
}
/*@@end*/

/*@@caplFunc:ESP_Disp_Rq3_AR_output():*/
ESP_Disp_Rq3_AR_output(void)
{
    output( _mESP_Disp_Rq3_AR );
}
/*@@end*/

/*@@caplFunc:ESP_Disp_Rq3_AR_saveEnvVars(dword):*/
ESP_Disp_Rq3_AR_saveEnvVars( dword hFile )
{
    filePutString("\n// Knoten EIS: ESP_Disp_Rq3_AR\n", 33, hFile );
    snprintf( buffer, elcount( buffer ), "0.0000 HMI__STMSG_ESP_Disp_Rq3_AR := %X\n", getValue( HMI__STMSG_ESP_Disp_Rq3_AR ) );    filePutString( buffer, elcount( buffer ), hFile );
    snprintf( buffer, elcount( buffer ), "0.0000 HMI__STMSGT_ESP_Disp_Rq3_AR := %X\n", getValue( HMI__STMSGT_ESP_Disp_Rq3_AR ) );    filePutString( buffer, elcount( buffer ), hFile );
    snprintf( buffer, elcount( buffer ), "0.0000 HMI_DrowDtct_Md_Stat := %X\n", getValue( HMI_DrowDtct_Md_Stat ) );    filePutString( buffer, elcount( buffer ), hFile );
    snprintf( buffer, elcount( buffer ), "0.0000 HMI_Incl_X_Graph := %X\n", getValue( HMI_Incl_X_Graph ) );    filePutString( buffer, elcount( buffer ), hFile );
    snprintf( buffer, elcount( buffer ), "0.0000 HMI_Incl_X_Num := %X\n", getValue( HMI_Incl_X_Num ) );    filePutString( buffer, elcount( buffer ), hFile );
    snprintf( buffer, elcount( buffer ), "0.0000 HMI_Incl_Y_Graph := %X\n", getValue( HMI_Incl_Y_Graph ) );    filePutString( buffer, elcount( buffer ), hFile );
    snprintf( buffer, elcount( buffer ), "0.0000 HMI_Incl_Y_Num := %X\n", getValue( HMI_Incl_Y_Num ) );    filePutString( buffer, elcount( buffer ), hFile );
}
/*@@end*/

/*@@timer:_tESP_Disp_Rq3_AR:*/
on timer _tESP_Disp_Rq3_AR
{
    putValue( HMI__STMSG_ESP_Disp_Rq3_AR, 0 );
}
/*@@end*/

/*@@envVar:HMI__STMSG_ESP_Disp_Rq3_AR:*/
on EnvVar HMI__STMSG_ESP_Disp_Rq3_AR
{
    long tDelay;
    if( getValue( this ) == 2 )
    {
        tDelay = getValue( HMI__STMSGT_ESP_Disp_Rq3_AR );
        if( tDelay > 0)    
            setTimer( _tESP_Disp_Rq3_AR, tDelay );
        else
            putValue( HMI__STMSG_ESP_Disp_Rq3_AR, 0 );
    }
}
/*@@end*/

/*@@envVar:HMI_DrowDtct_Md_Stat:*/
on EnvVar HMI_DrowDtct_Md_Stat
{
    _mESP_Disp_Rq3_AR.DrowDtct_Md_Stat.phys = getValue(this);
}
/*@@end*/

/*@@envVar:HMI_Incl_X_Graph:*/
on EnvVar HMI_Incl_X_Graph
{
    _mESP_Disp_Rq3_AR.Incl_X_Graph.phys = getValue(this);
}
/*@@end*/

/*@@envVar:HMI_Incl_X_Num:*/
on EnvVar HMI_Incl_X_Num
{
    _mESP_Disp_Rq3_AR.Incl_X_Num.phys = getValue(this);
}
/*@@end*/

/*@@envVar:HMI_Incl_Y_Graph:*/
on EnvVar HMI_Incl_Y_Graph
{
    _mESP_Disp_Rq3_AR.Incl_Y_Graph.phys = getValue(this);
}
/*@@end*/

/*@@envVar:HMI_Incl_Y_Num:*/
on EnvVar HMI_Incl_Y_Num
{
    _mESP_Disp_Rq3_AR.Incl_Y_Num.phys = getValue(this);
}
/*@@end*/

/*@@caplFunc:ESP_Disp_Rq_AMG_AR_check_output():*/
ESP_Disp_Rq_AMG_AR_check_output()
{
    if( !getValue( HMI__STMSG_ESP_Disp_Rq3_AR ) )
    {
        // Botschaft ESP_Disp_Rq_AMG_AR ID: 365 --- Sendeart 0 cyclicX --- 
        _ESP_Disp_Rq_AMG_AR_Cnt--;
        if( _ESP_Disp_Rq_AMG_AR_Cnt < 1 )
        {
            // Nachricht wg. abgelaufenem Zyklus ausgeben
            ESP_Disp_Rq_AMG_AR_output();
            // Zyklus-Zähler zurücksetzen
            _ESP_Disp_Rq_AMG_AR_Cnt = _ESP_Disp_Rq_AMG_AR_CycleCount;
        }
    }
}
/*@@end*/

/*@@caplFunc:ESP_Disp_Rq_AMG_AR_init():*/
ESP_Disp_Rq_AMG_AR_init()
{   /* Botschaft ESP_Disp_Rq_AMG_AR ID: 365 --- Sendeart 0 cyclicX --- 
BA_ "ApplMessage" BO_ 365 0;
BA_ "NmAsrMessage" BO_ 365 0;
BA_ "GenMsgMinAcceptLength" BO_ 365 2;
BA_ "GenMsgILSupport" BO_ 365 1;
BA_ "DiagState" BO_ 365 0;
BA_ "DiagRequest" BO_ 365 0;
BA_ "DiagResponse" BO_ 365 0;
BA_ "GenMsgStartValue" BO_ 365 "0";
BA_ "GenMsgStartDelayTime" BO_ 365 35;
BA_ "GenMsgCycleTime" BO_ 365 40;
BA_ "GenMsgSendType" BO_ 365 0;
    */
    _ESP_Disp_Rq_AMG_AR_Timebase =            c_tDBKomTimer_20ms;
    _ESP_Disp_Rq_AMG_AR_CycleCount =          40 / _ESP_Disp_Rq_AMG_AR_Timebase;
    _ESP_Disp_Rq_AMG_AR_StartDelay =          35 / _ESP_Disp_Rq_AMG_AR_Timebase;
    _ESP_Disp_Rq_AMG_AR_Cnt = _ESP_Disp_Rq_AMG_AR_StartDelay;

    putValue( HMI__STMSGSD_ESP_Disp_Rq_AMG_AR, _ESP_Disp_Rq_AMG_AR_StartDelay * _ESP_Disp_Rq_AMG_AR_Timebase );

    _mESP_Disp_Rq_AMG_AR.VehAccel_Y_V3.phys = getValue( HMI_VehAccel_Y_V3 );
}
/*@@end*/

/*@@caplFunc:ESP_Disp_Rq_AMG_AR_output():*/
ESP_Disp_Rq_AMG_AR_output(void)
{
    output( _mESP_Disp_Rq_AMG_AR );
}
/*@@end*/

/*@@caplFunc:ESP_Disp_Rq_AMG_AR_saveEnvVars(dword):*/
ESP_Disp_Rq_AMG_AR_saveEnvVars( dword hFile )
{
    filePutString("\n// Knoten EIS: ESP_Disp_Rq_AMG_AR\n", 33, hFile );
    snprintf( buffer, elcount( buffer ), "0.0000 HMI__STMSG_ESP_Disp_Rq_AMG_AR := %X\n", getValue( HMI__STMSG_ESP_Disp_Rq_AMG_AR ) );    filePutString( buffer, elcount( buffer ), hFile );
    snprintf( buffer, elcount( buffer ), "0.0000 HMI__STMSGT_ESP_Disp_Rq_AMG_AR := %X\n", getValue( HMI__STMSGT_ESP_Disp_Rq_AMG_AR ) );    filePutString( buffer, elcount( buffer ), hFile );
    snprintf( buffer, elcount( buffer ), "0.0000 HMI_VehAccel_Y_V3 := %X\n", getValue( HMI_VehAccel_Y_V3 ) );    filePutString( buffer, elcount( buffer ), hFile );
}
/*@@end*/

/*@@timer:_tESP_Disp_Rq_AMG_AR:*/
on timer _tESP_Disp_Rq_AMG_AR
{
    putValue( HMI__STMSG_ESP_Disp_Rq_AMG_AR, 0 );
}
/*@@end*/

/*@@envVar:HMI__STMSG_ESP_Disp_Rq_AMG_AR:*/
on EnvVar HMI__STMSG_ESP_Disp_Rq_AMG_AR
{
    long tDelay;
    if( getValue( this ) == 2 )
    {
        tDelay = getValue( HMI__STMSGT_ESP_Disp_Rq_AMG_AR );
        if( tDelay > 0)    
            setTimer( _tESP_Disp_Rq_AMG_AR, tDelay );
        else
            putValue( HMI__STMSG_ESP_Disp_Rq_AMG_AR, 0 );
    }
}
/*@@end*/

/*@@envVar:HMI_VehAccel_Y_V3:*/
on EnvVar HMI_VehAccel_Y_V3
{
    _mESP_Disp_Rq_AMG_AR.VehAccel_Y_V3.phys = getValue(this);
}
/*@@end*/

/*@@caplFunc:EVC_CfgBit_01_32_AR_check_output():*/
EVC_CfgBit_01_32_AR_check_output()
{
    if( !getValue( HMI__STMSG_EVC_CfgBit_01_32_AR ) )
    {
        // Botschaft EVC_CfgBit_01_32_AR ID: 753 --- Sendeart 0 cyclicX --- 
        _EVC_CfgBit_01_32_AR_Cnt--;
        if( _EVC_CfgBit_01_32_AR_Cnt < 1 )
        {
            // Nachricht wg. abgelaufenem Zyklus ausgeben
            EVC_CfgBit_01_32_AR_output();
            // Zyklus-Zähler zurücksetzen
            _EVC_CfgBit_01_32_AR_Cnt = _EVC_CfgBit_01_32_AR_CycleCount;
        }
    }
}
/*@@end*/

/*@@caplFunc:EVC_CfgBit_01_32_AR_init():*/
EVC_CfgBit_01_32_AR_init()
{   /* Botschaft EVC_CfgBit_01_32_AR ID: 753 --- Sendeart 0 cyclicX --- 
BA_ "ApplMessage" BO_ 753 0;
BA_ "NmAsrMessage" BO_ 753 0;
BA_ "GenMsgMinAcceptLength" BO_ 753 8;
BA_ "GenMsgILSupport" BO_ 753 1;
BA_ "DiagState" BO_ 753 0;
BA_ "DiagRequest" BO_ 753 0;
BA_ "DiagResponse" BO_ 753 0;
BA_ "GenMsgStartValue" BO_ 753 "0";
BA_ "GenMsgStartDelayTime" BO_ 753 225;
BA_ "GenMsgCycleTime" BO_ 753 1000;
BA_ "GenMsgSendType" BO_ 753 0;
    */
    _EVC_CfgBit_01_32_AR_Timebase =        c_tDBKomTimer_20ms;
    _EVC_CfgBit_01_32_AR_CycleCount =    1000 / _EVC_CfgBit_01_32_AR_Timebase;
    _EVC_CfgBit_01_32_AR_StartDelay =     225 / _EVC_CfgBit_01_32_AR_Timebase;
    _EVC_CfgBit_01_32_AR_Cnt = _EVC_CfgBit_01_32_AR_StartDelay;

    putValue( HMI__STMSGSD_EVC_CfgBit_01_32_AR, _EVC_CfgBit_01_32_AR_StartDelay * _EVC_CfgBit_01_32_AR_Timebase );

    _mEVC_CfgBit_01_32_AR.EVC_01_Ver_USA_Avl.phys = getValue( HMI_EVC_01_Ver_USA_Avl );
    _mEVC_CfgBit_01_32_AR.EVC_02_Ver_Mexico_Avl.phys = getValue( HMI_EVC_02_Ver_Mexico_Avl );
    _mEVC_CfgBit_01_32_AR.EVC_03_Ver_Japan_Avl.phys = getValue( HMI_EVC_03_Ver_Japan_Avl );
    _mEVC_CfgBit_01_32_AR.EVC_04_Ver_GulfStates_Avl.phys = getValue( HMI_EVC_04_Ver_GulfStates_Avl );
    _mEVC_CfgBit_01_32_AR.EVC_05_Ver_Australia_Avl.phys = getValue( HMI_EVC_05_Ver_Australia_Avl );
    _mEVC_CfgBit_01_32_AR.EVC_06_Ver_China_Avl.phys = getValue( HMI_EVC_06_Ver_China_Avl );
    _mEVC_CfgBit_01_32_AR.EVC_07_Ver_S_Korea_Avl.phys = getValue( HMI_EVC_07_Ver_S_Korea_Avl );
    _mEVC_CfgBit_01_32_AR.EVC_08_Ver_Canada_Avl.phys = getValue( HMI_EVC_08_Ver_Canada_Avl );
    _mEVC_CfgBit_01_32_AR.EVC_09_FullHyb_Avl.phys = getValue( HMI_EVC_09_FullHyb_Avl );
    _mEVC_CfgBit_01_32_AR.EVC_0A_Hyb_20kW_Avl.phys = getValue( HMI_EVC_0A_Hyb_20kW_Avl );
    _mEVC_CfgBit_01_32_AR.EVC_0B_PlugInHyb_80kW_Avl.phys = getValue( HMI_EVC_0B_PlugInHyb_80kW_Avl );
    _mEVC_CfgBit_01_32_AR.EVC_0C_AllWheelDr_Avl.phys = getValue( HMI_EVC_0C_AllWheelDr_Avl );
    _mEVC_CfgBit_01_32_AR.EVC_0D_4x2Drive_Avl.phys = getValue( HMI_EVC_0D_4x2Drive_Avl );
    _mEVC_CfgBit_01_32_AR.EVC_0E_Presf_Avl.phys = getValue( HMI_EVC_0E_Presf_Avl );
    _mEVC_CfgBit_01_32_AR.EVC_0F_TrlrHtch_Avl.phys = getValue( HMI_EVC_0F_TrlrHtch_Avl );
    _mEVC_CfgBit_01_32_AR.EVC_10_KG_Avl.phys = getValue( HMI_EVC_10_KG_Avl );
    _mEVC_CfgBit_01_32_AR.EVC_11_AutTrunkLid_Avl.phys = getValue( HMI_EVC_11_AutTrunkLid_Avl );
    _mEVC_CfgBit_01_32_AR.EVC_12_AutRearDr_Avl.phys = getValue( HMI_EVC_12_AutRearDr_Avl );
    _mEVC_CfgBit_01_32_AR.EVC_13_PwrCls_Avl.phys = getValue( HMI_EVC_13_PwrCls_Avl );
    _mEVC_CfgBit_01_32_AR.EVC_14_RainSens_Avl.phys = getValue( HMI_EVC_14_RainSens_Avl );
    _mEVC_CfgBit_01_32_AR.EVC_15_DRLt_Avl.phys = getValue( HMI_EVC_15_DRLt_Avl );
    _mEVC_CfgBit_01_32_AR.EVC_16_FogLmp_Avl.phys = getValue( HMI_EVC_16_FogLmp_Avl );
    _mEVC_CfgBit_01_32_AR.EVC_17_IL_Pk_Avl.phys = getValue( HMI_EVC_17_IL_Pk_Avl );
    _mEVC_CfgBit_01_32_AR.EVC_18_AmbLgt_Avl.phys = getValue( HMI_EVC_18_AmbLgt_Avl );
    _mEVC_CfgBit_01_32_AR.EVC_19_ElDrPosnSel_Avl.phys = getValue( HMI_EVC_19_ElDrPosnSel_Avl );
    _mEVC_CfgBit_01_32_AR.EVC_1A_IntSfProt_Avl.phys = getValue( HMI_EVC_1A_IntSfProt_Avl );
    _mEVC_CfgBit_01_32_AR.EVC_1B_VTA_Avl.phys = getValue( HMI_EVC_1B_VTA_Avl );
    _mEVC_CfgBit_01_32_AR.EVC_1C_HghVTP_Avl.phys = getValue( HMI_EVC_1C_HghVTP_Avl );
    _mEVC_CfgBit_01_32_AR.EVC_1D_SecurityVer_Avl.phys = getValue( HMI_EVC_1D_SecurityVer_Avl );
    _mEVC_CfgBit_01_32_AR.EVC_1E_GuardLvl_B4_Avl.phys = getValue( HMI_EVC_1E_GuardLvl_B4_Avl );
    _mEVC_CfgBit_01_32_AR.EVC_1F_GuardLvl_B6_Avl.phys = getValue( HMI_EVC_1F_GuardLvl_B6_Avl );
    _mEVC_CfgBit_01_32_AR.EVC_20_GuardLvl_B7_Avl.phys = getValue( HMI_EVC_20_GuardLvl_B7_Avl );
    _mEVC_CfgBit_01_32_AR.EVC_21_Pullman_Avl.phys = getValue( HMI_EVC_21_Pullman_Avl );
    _mEVC_CfgBit_01_32_AR.EVC_22_SpecClos_Avl.phys = getValue( HMI_EVC_22_SpecClos_Avl );
    _mEVC_CfgBit_01_32_AR.EVC_23_PASS_Avl.phys = getValue( HMI_EVC_23_PASS_Avl );
    _mEVC_CfgBit_01_32_AR.EVC_24_ICH_Avl.phys = getValue( HMI_EVC_24_ICH_Avl );
    _mEVC_CfgBit_01_32_AR.EVC_25_HVAC_R_Avl.phys = getValue( HMI_EVC_25_HVAC_R_Avl );
    _mEVC_CfgBit_01_32_AR.EVC_26_SSA_Avl.phys = getValue( HMI_EVC_26_SSA_Avl );
    _mEVC_CfgBit_01_32_AR.EVC_27_HandsFreeAcc_Avl.phys = getValue( HMI_EVC_27_HandsFreeAcc_Avl );
    _mEVC_CfgBit_01_32_AR.EVC_28_PlugInHyb_50kW_Avl.phys = getValue( HMI_EVC_28_PlugInHyb_50kW_Avl );
    _mEVC_CfgBit_01_32_AR.EVC_29_Hyb_30kW_Avl.phys = getValue( HMI_EVC_29_Hyb_30kW_Avl );
    _mEVC_CfgBit_01_32_AR.EVC_2A_SeatElAdj_F_OprtnR_Avl.phys = getValue( HMI_EVC_2A_SeatElAdj_F_OprtnR_Avl );
    _mEVC_CfgBit_01_32_AR.EVC_2B_DSI_Sel_Avl.phys = getValue( HMI_EVC_2B_DSI_Sel_Avl );
    _mEVC_CfgBit_01_32_AR.EVC_2C_WC_VEDA_Avl.phys = getValue( HMI_EVC_2C_WC_VEDA_Avl );
    _mEVC_CfgBit_01_32_AR.EVC_2D_AutoSpdCtrl_Avl.phys = getValue( HMI_EVC_2D_AutoSpdCtrl_Avl );
    _mEVC_CfgBit_01_32_AR.EVC_2E_AddEquip_Avl.phys = getValue( HMI_EVC_2E_AddEquip_Avl );
    _mEVC_CfgBit_01_32_AR.EVC_2F_AddEquip_Avl.phys = getValue( HMI_EVC_2F_AddEquip_Avl );
    _mEVC_CfgBit_01_32_AR.EVC_30_AddEquip_Avl.phys = getValue( HMI_EVC_30_AddEquip_Avl );
    _mEVC_CfgBit_01_32_AR.EVC_31_AddEquip_Avl.phys = getValue( HMI_EVC_31_AddEquip_Avl );
    _mEVC_CfgBit_01_32_AR.EVC_32_AddEquip_Avl.phys = getValue( HMI_EVC_32_AddEquip_Avl );
    _mEVC_CfgBit_01_32_AR.EVC_CfgBit_01_32_Stat.phys = getValue( HMI_EVC_CfgBit_01_32_Stat );
}
/*@@end*/

/*@@caplFunc:EVC_CfgBit_01_32_AR_output():*/
void EVC_CfgBit_01_32_AR_output(void)
{
    byte crc;
    byte SQC_help;

    if( !getValue( HMI_SQC_EVC_CfgBit_01_32_Auto ) )
    {
        // berechne message counter
        SQC_help = getValue( HMI_SQC_EVC_CfgBit_01_32 );
        if( SQC_help >= 15 ) SQC_help = 0;
        else SQC_help++;
        putValue( HMI_SQC_EVC_CfgBit_01_32, SQC_help );
        _mEVC_CfgBit_01_32_AR.SQC_EVC_CfgBit_01_32 = SQC_help;
    }
    else
          _mEVC_CfgBit_01_32_AR.SQC_EVC_CfgBit_01_32 = getValue( HMI_SQC_EVC_CfgBit_01_32 );

    if( getValue( HMI_CRC_EVC_CfgBit_01_32_Profile_02 ) )
    {
        if( !getValue( HMI_CRC_EVC_CfgBit_01_32_Auto ) )
        {   // CRC according to SAE1850 ( W222 )
            // berechne crc
            crc = 0xFF;
//          crc = crctable_profile02[ crc ^ _mXXX.byte( 0 ) ];
            crc = crctable_profile02[ crc ^ _mEVC_CfgBit_01_32_AR.byte( 1 ) ];
            crc = crctable_profile02[ crc ^ _mEVC_CfgBit_01_32_AR.byte( 2 ) ];
            crc = crctable_profile02[ crc ^ _mEVC_CfgBit_01_32_AR.byte( 3 ) ];
            crc = crctable_profile02[ crc ^ _mEVC_CfgBit_01_32_AR.byte( 4 ) ];
            crc = crctable_profile02[ crc ^ _mEVC_CfgBit_01_32_AR.byte( 5 ) ];
            crc = crctable_profile02[ crc ^ _mEVC_CfgBit_01_32_AR.byte( 6 ) ];
            crc = crctable_profile02[ crc ^ _mEVC_CfgBit_01_32_AR.byte( 7 ) ];
            crc = crctable_profile02[ crc ^ _EVC_CfgBit_01_32_AR_CRC_Offset[ _mEVC_CfgBit_01_32_AR.SQC_EVC_CfgBit_01_32 ] ]; // load offset
            crc = (crc ^ 0xFF);
            if( getValue(  HMI_CRC_EVC_CfgBit_01_32_Invalid ) )
                crc++;
            _mEVC_CfgBit_01_32_AR.CRC_EVC_CfgBit_01_32 = crc;
            putValue( HMI_CRC_EVC_CfgBit_01_32, crc );
        }
        else
            _mEVC_CfgBit_01_32_AR.CRC_EVC_CfgBit_01_32 = getValue( HMI_CRC_EVC_CfgBit_01_32);
    }
    else
    {
        if( !getValue( HMI_CRC_EVC_CfgBit_01_32_Auto ) )
        {   // CRC according to SAE1850 ( W222 )
            // berechne crc
            crc = 0xFF;
            crc = crctable[crc ^ _mEVC_CfgBit_01_32_AR.byte( 1 )];
            crc = crctable[crc ^ _mEVC_CfgBit_01_32_AR.byte( 2 )];
            crc = crctable[crc ^ _mEVC_CfgBit_01_32_AR.byte( 3 )];
            crc = crctable[crc ^ _mEVC_CfgBit_01_32_AR.byte( 4 )];
            crc = crctable[crc ^ _mEVC_CfgBit_01_32_AR.byte( 5 )];
            crc = crctable[crc ^ _mEVC_CfgBit_01_32_AR.byte( 6 )];
            crc = crctable[crc ^ _mEVC_CfgBit_01_32_AR.byte( 7 )];
            crc = (crc ^ 0xFF);
            if( getValue(  HMI_CRC_EVC_CfgBit_01_32_Invalid ) )
                crc++;
            _mEVC_CfgBit_01_32_AR.CRC_EVC_CfgBit_01_32 = crc;
            putValue( HMI_CRC_EVC_CfgBit_01_32, crc );
        }
        else
            _mEVC_CfgBit_01_32_AR.CRC_EVC_CfgBit_01_32 = getValue( HMI_CRC_EVC_CfgBit_01_32);
    }
    output( _mEVC_CfgBit_01_32_AR );
}
/*@@end*/

/*@@caplFunc:EVC_CfgBit_01_32_AR_saveEnvVars(dword):*/
EVC_CfgBit_01_32_AR_saveEnvVars( dword hFile )
{
    filePutString("\n// Knoten EIS: EVC_CfgBit_01_32_AR\n", 33, hFile );
    snprintf( buffer, elcount( buffer ), "0.0000 HMI__STMSG_EVC_CfgBit_01_32_AR := %X\n", getValue( HMI__STMSG_EVC_CfgBit_01_32_AR ) );    filePutString( buffer, elcount( buffer ), hFile );
    snprintf( buffer, elcount( buffer ), "0.0000 HMI__STMSGT_EVC_CfgBit_01_32_AR := %X\n", getValue( HMI__STMSGT_EVC_CfgBit_01_32_AR ) );    filePutString( buffer, elcount( buffer ), hFile );
    snprintf( buffer, elcount( buffer ), "0.0000 HMI_CRC_EVC_CfgBit_01_32 := %X\n", getValue( HMI_CRC_EVC_CfgBit_01_32 ) );    filePutString( buffer, elcount( buffer ), hFile );
    snprintf( buffer, elcount( buffer ), "0.0000 HMI_CRC_EVC_CfgBit_01_32_Auto := %X\n", getValue( HMI_CRC_EVC_CfgBit_01_32_Auto ) );    filePutString( buffer, elcount( buffer ), hFile );
    snprintf( buffer, elcount( buffer ), "0.0000 HMI_EVC_01_Ver_USA_Avl := %X\n", getValue( HMI_EVC_01_Ver_USA_Avl ) );    filePutString( buffer, elcount( buffer ), hFile );
    snprintf( buffer, elcount( buffer ), "0.0000 HMI_EVC_02_Ver_Mexico_Avl := %X\n", getValue( HMI_EVC_02_Ver_Mexico_Avl ) );    filePutString( buffer, elcount( buffer ), hFile );
    snprintf( buffer, elcount( buffer ), "0.0000 HMI_EVC_03_Ver_Japan_Avl := %X\n", getValue( HMI_EVC_03_Ver_Japan_Avl ) );    filePutString( buffer, elcount( buffer ), hFile );
    snprintf( buffer, elcount( buffer ), "0.0000 HMI_EVC_04_Ver_GulfStates_Avl := %X\n", getValue( HMI_EVC_04_Ver_GulfStates_Avl ) );    filePutString( buffer, elcount( buffer ), hFile );
    snprintf( buffer, elcount( buffer ), "0.0000 HMI_EVC_05_Ver_Australia_Avl := %X\n", getValue( HMI_EVC_05_Ver_Australia_Avl ) );    filePutString( buffer, elcount( buffer ), hFile );
    snprintf( buffer, elcount( buffer ), "0.0000 HMI_EVC_06_Ver_China_Avl := %X\n", getValue( HMI_EVC_06_Ver_China_Avl ) );    filePutString( buffer, elcount( buffer ), hFile );
    snprintf( buffer, elcount( buffer ), "0.0000 HMI_EVC_07_Ver_S_Korea_Avl := %X\n", getValue( HMI_EVC_07_Ver_S_Korea_Avl ) );    filePutString( buffer, elcount( buffer ), hFile );
    snprintf( buffer, elcount( buffer ), "0.0000 HMI_EVC_08_Ver_Canada_Avl := %X\n", getValue( HMI_EVC_08_Ver_Canada_Avl ) );    filePutString( buffer, elcount( buffer ), hFile );
    snprintf( buffer, elcount( buffer ), "0.0000 HMI_EVC_09_FullHyb_Avl := %X\n", getValue( HMI_EVC_09_FullHyb_Avl ) );    filePutString( buffer, elcount( buffer ), hFile );
    snprintf( buffer, elcount( buffer ), "0.0000 HMI_EVC_0A_Hyb_20kW_Avl := %X\n", getValue( HMI_EVC_0A_Hyb_20kW_Avl ) );    filePutString( buffer, elcount( buffer ), hFile );
    snprintf( buffer, elcount( buffer ), "0.0000 HMI_EVC_0B_PlugInHyb_80kW_Avl := %X\n", getValue( HMI_EVC_0B_PlugInHyb_80kW_Avl ) );    filePutString( buffer, elcount( buffer ), hFile );
    snprintf( buffer, elcount( buffer ), "0.0000 HMI_EVC_0C_AllWheelDr_Avl := %X\n", getValue( HMI_EVC_0C_AllWheelDr_Avl ) );    filePutString( buffer, elcount( buffer ), hFile );
    snprintf( buffer, elcount( buffer ), "0.0000 HMI_EVC_0D_4x2Drive_Avl := %X\n", getValue( HMI_EVC_0D_4x2Drive_Avl ) );    filePutString( buffer, elcount( buffer ), hFile );
    snprintf( buffer, elcount( buffer ), "0.0000 HMI_EVC_0E_Presf_Avl := %X\n", getValue( HMI_EVC_0E_Presf_Avl ) );    filePutString( buffer, elcount( buffer ), hFile );
    snprintf( buffer, elcount( buffer ), "0.0000 HMI_EVC_0F_TrlrHtch_Avl := %X\n", getValue( HMI_EVC_0F_TrlrHtch_Avl ) );    filePutString( buffer, elcount( buffer ), hFile );
    snprintf( buffer, elcount( buffer ), "0.0000 HMI_EVC_10_KG_Avl := %X\n", getValue( HMI_EVC_10_KG_Avl ) );    filePutString( buffer, elcount( buffer ), hFile );
    snprintf( buffer, elcount( buffer ), "0.0000 HMI_EVC_11_AutTrunkLid_Avl := %X\n", getValue( HMI_EVC_11_AutTrunkLid_Avl ) );    filePutString( buffer, elcount( buffer ), hFile );
    snprintf( buffer, elcount( buffer ), "0.0000 HMI_EVC_12_AutRearDr_Avl := %X\n", getValue( HMI_EVC_12_AutRearDr_Avl ) );    filePutString( buffer, elcount( buffer ), hFile );
    snprintf( buffer, elcount( buffer ), "0.0000 HMI_EVC_13_PwrCls_Avl := %X\n", getValue( HMI_EVC_13_PwrCls_Avl ) );    filePutString( buffer, elcount( buffer ), hFile );
    snprintf( buffer, elcount( buffer ), "0.0000 HMI_EVC_14_RainSens_Avl := %X\n", getValue( HMI_EVC_14_RainSens_Avl ) );    filePutString( buffer, elcount( buffer ), hFile );
    snprintf( buffer, elcount( buffer ), "0.0000 HMI_EVC_15_DRLt_Avl := %X\n", getValue( HMI_EVC_15_DRLt_Avl ) );    filePutString( buffer, elcount( buffer ), hFile );
    snprintf( buffer, elcount( buffer ), "0.0000 HMI_EVC_16_FogLmp_Avl := %X\n", getValue( HMI_EVC_16_FogLmp_Avl ) );    filePutString( buffer, elcount( buffer ), hFile );
    snprintf( buffer, elcount( buffer ), "0.0000 HMI_EVC_17_IL_Pk_Avl := %X\n", getValue( HMI_EVC_17_IL_Pk_Avl ) );    filePutString( buffer, elcount( buffer ), hFile );
    snprintf( buffer, elcount( buffer ), "0.0000 HMI_EVC_18_AmbLgt_Avl := %X\n", getValue( HMI_EVC_18_AmbLgt_Avl ) );    filePutString( buffer, elcount( buffer ), hFile );
    snprintf( buffer, elcount( buffer ), "0.0000 HMI_EVC_19_ElDrPosnSel_Avl := %X\n", getValue( HMI_EVC_19_ElDrPosnSel_Avl ) );    filePutString( buffer, elcount( buffer ), hFile );
    snprintf( buffer, elcount( buffer ), "0.0000 HMI_EVC_1A_IntSfProt_Avl := %X\n", getValue( HMI_EVC_1A_IntSfProt_Avl ) );    filePutString( buffer, elcount( buffer ), hFile );
    snprintf( buffer, elcount( buffer ), "0.0000 HMI_EVC_1B_VTA_Avl := %X\n", getValue( HMI_EVC_1B_VTA_Avl ) );    filePutString( buffer, elcount( buffer ), hFile );
    snprintf( buffer, elcount( buffer ), "0.0000 HMI_EVC_1C_HghVTP_Avl := %X\n", getValue( HMI_EVC_1C_HghVTP_Avl ) );    filePutString( buffer, elcount( buffer ), hFile );
    snprintf( buffer, elcount( buffer ), "0.0000 HMI_EVC_1D_SecurityVer_Avl := %X\n", getValue( HMI_EVC_1D_SecurityVer_Avl ) );    filePutString( buffer, elcount( buffer ), hFile );
    snprintf( buffer, elcount( buffer ), "0.0000 HMI_EVC_1E_GuardLvl_B4_Avl := %X\n", getValue( HMI_EVC_1E_GuardLvl_B4_Avl ) );    filePutString( buffer, elcount( buffer ), hFile );
    snprintf( buffer, elcount( buffer ), "0.0000 HMI_EVC_1F_GuardLvl_B6_Avl := %X\n", getValue( HMI_EVC_1F_GuardLvl_B6_Avl ) );    filePutString( buffer, elcount( buffer ), hFile );
    snprintf( buffer, elcount( buffer ), "0.0000 HMI_EVC_20_GuardLvl_B7_Avl := %X\n", getValue( HMI_EVC_20_GuardLvl_B7_Avl ) );    filePutString( buffer, elcount( buffer ), hFile );
    snprintf( buffer, elcount( buffer ), "0.0000 HMI_EVC_21_Pullman_Avl := %X\n", getValue( HMI_EVC_21_Pullman_Avl ) );    filePutString( buffer, elcount( buffer ), hFile );
    snprintf( buffer, elcount( buffer ), "0.0000 HMI_EVC_22_SpecClos_Avl := %X\n", getValue( HMI_EVC_22_SpecClos_Avl ) );    filePutString( buffer, elcount( buffer ), hFile );
    snprintf( buffer, elcount( buffer ), "0.0000 HMI_EVC_23_PASS_Avl := %X\n", getValue( HMI_EVC_23_PASS_Avl ) );    filePutString( buffer, elcount( buffer ), hFile );
    snprintf( buffer, elcount( buffer ), "0.0000 HMI_EVC_24_ICH_Avl := %X\n", getValue( HMI_EVC_24_ICH_Avl ) );    filePutString( buffer, elcount( buffer ), hFile );
    snprintf( buffer, elcount( buffer ), "0.0000 HMI_EVC_25_HVAC_R_Avl := %X\n", getValue( HMI_EVC_25_HVAC_R_Avl ) );    filePutString( buffer, elcount( buffer ), hFile );
    snprintf( buffer, elcount( buffer ), "0.0000 HMI_EVC_26_SSA_Avl := %X\n", getValue( HMI_EVC_26_SSA_Avl ) );    filePutString( buffer, elcount( buffer ), hFile );
    snprintf( buffer, elcount( buffer ), "0.0000 HMI_EVC_27_HandsFreeAcc_Avl := %X\n", getValue( HMI_EVC_27_HandsFreeAcc_Avl ) );    filePutString( buffer, elcount( buffer ), hFile );
    snprintf( buffer, elcount( buffer ), "0.0000 HMI_EVC_28_PlugInHyb_50kW_Avl := %X\n", getValue( HMI_EVC_28_PlugInHyb_50kW_Avl ) );    filePutString( buffer, elcount( buffer ), hFile );
    snprintf( buffer, elcount( buffer ), "0.0000 HMI_EVC_29_Hyb_30kW_Avl := %X\n", getValue( HMI_EVC_29_Hyb_30kW_Avl ) );    filePutString( buffer, elcount( buffer ), hFile );
    snprintf( buffer, elcount( buffer ), "0.0000 HMI_EVC_2A_SeatElAdj_F_OprtnR_Avl := %X\n", getValue( HMI_EVC_2A_SeatElAdj_F_OprtnR_Avl ) );    filePutString( buffer, elcount( buffer ), hFile );
    snprintf( buffer, elcount( buffer ), "0.0000 HMI_EVC_2B_DSI_Sel_Avl := %X\n", getValue( HMI_EVC_2B_DSI_Sel_Avl ) );    filePutString( buffer, elcount( buffer ), hFile );
    snprintf( buffer, elcount( buffer ), "0.0000 HMI_EVC_2C_WC_VEDA_Avl := %X\n", getValue( HMI_EVC_2C_WC_VEDA_Avl ) );    filePutString( buffer, elcount( buffer ), hFile );
    snprintf( buffer, elcount( buffer ), "0.0000 HMI_EVC_2D_AutoSpdCtrl_Avl := %X\n", getValue( HMI_EVC_2D_AutoSpdCtrl_Avl ) );    filePutString( buffer, elcount( buffer ), hFile );
    snprintf( buffer, elcount( buffer ), "0.0000 HMI_EVC_2E_AddEquip_Avl := %X\n", getValue( HMI_EVC_2E_AddEquip_Avl ) );    filePutString( buffer, elcount( buffer ), hFile );
    snprintf( buffer, elcount( buffer ), "0.0000 HMI_EVC_2F_AddEquip_Avl := %X\n", getValue( HMI_EVC_2F_AddEquip_Avl ) );    filePutString( buffer, elcount( buffer ), hFile );
    snprintf( buffer, elcount( buffer ), "0.0000 HMI_EVC_30_AddEquip_Avl := %X\n", getValue( HMI_EVC_30_AddEquip_Avl ) );    filePutString( buffer, elcount( buffer ), hFile );
    snprintf( buffer, elcount( buffer ), "0.0000 HMI_EVC_31_AddEquip_Avl := %X\n", getValue( HMI_EVC_31_AddEquip_Avl ) );    filePutString( buffer, elcount( buffer ), hFile );
    snprintf( buffer, elcount( buffer ), "0.0000 HMI_EVC_32_AddEquip_Avl := %X\n", getValue( HMI_EVC_32_AddEquip_Avl ) );    filePutString( buffer, elcount( buffer ), hFile );
    snprintf( buffer, elcount( buffer ), "0.0000 HMI_EVC_CfgBit_01_32_Stat := %X\n", getValue( HMI_EVC_CfgBit_01_32_Stat ) );    filePutString( buffer, elcount( buffer ), hFile );
    snprintf( buffer, elcount( buffer ), "0.0000 HMI_SQC_EVC_CfgBit_01_32 := %X\n", getValue( HMI_SQC_EVC_CfgBit_01_32 ) );    filePutString( buffer, elcount( buffer ), hFile );
    snprintf( buffer, elcount( buffer ), "0.0000 HMI_SQC_EVC_CfgBit_01_32_Auto := %X\n", getValue( HMI_SQC_EVC_CfgBit_01_32_Auto ) );    filePutString( buffer, elcount( buffer ), hFile );
}
/*@@end*/

/*@@timer:_tEVC_CfgBit_01_32_AR:*/
on timer _tEVC_CfgBit_01_32_AR
{
    putValue( HMI__STMSG_EVC_CfgBit_01_32_AR, 0 );
}
/*@@end*/

/*@@envVar:HMI__STMSG_EVC_CfgBit_01_32_AR:*/
on EnvVar HMI__STMSG_EVC_CfgBit_01_32_AR
{
    long tDelay;
    if( getValue( this ) == 2 )
    {
        tDelay = getValue( HMI__STMSGT_EVC_CfgBit_01_32_AR );
        if( tDelay > 0)    
            setTimer( _tEVC_CfgBit_01_32_AR, tDelay );
        else
            putValue( HMI__STMSG_EVC_CfgBit_01_32_AR, 0 );
    }
}
/*@@end*/

/*@@envVar:HMI_EVC_01_Ver_USA_Avl:*/
on EnvVar HMI_EVC_01_Ver_USA_Avl
{
    _mEVC_CfgBit_01_32_AR.EVC_01_Ver_USA_Avl.phys = getValue(this);
}
/*@@end*/

/*@@envVar:HMI_EVC_02_Ver_Mexico_Avl:*/
on EnvVar HMI_EVC_02_Ver_Mexico_Avl
{
    _mEVC_CfgBit_01_32_AR.EVC_02_Ver_Mexico_Avl.phys = getValue(this);
}
/*@@end*/

/*@@envVar:HMI_EVC_03_Ver_Japan_Avl:*/
on EnvVar HMI_EVC_03_Ver_Japan_Avl
{
    _mEVC_CfgBit_01_32_AR.EVC_03_Ver_Japan_Avl.phys = getValue(this);
}
/*@@end*/

/*@@envVar:HMI_EVC_04_Ver_GulfStates_Avl:*/
on EnvVar HMI_EVC_04_Ver_GulfStates_Avl
{
    _mEVC_CfgBit_01_32_AR.EVC_04_Ver_GulfStates_Avl.phys = getValue(this);
}
/*@@end*/

/*@@envVar:HMI_EVC_05_Ver_Australia_Avl:*/
on EnvVar HMI_EVC_05_Ver_Australia_Avl
{
    _mEVC_CfgBit_01_32_AR.EVC_05_Ver_Australia_Avl.phys = getValue(this);
}
/*@@end*/

/*@@envVar:HMI_EVC_06_Ver_China_Avl:*/
on EnvVar HMI_EVC_06_Ver_China_Avl
{
    _mEVC_CfgBit_01_32_AR.EVC_06_Ver_China_Avl.phys = getValue(this);
}
/*@@end*/

/*@@envVar:HMI_EVC_07_Ver_S_Korea_Avl:*/
on EnvVar HMI_EVC_07_Ver_S_Korea_Avl
{
    _mEVC_CfgBit_01_32_AR.EVC_07_Ver_S_Korea_Avl.phys = getValue(this);
}
/*@@end*/

/*@@envVar:HMI_EVC_08_Ver_Canada_Avl:*/
on EnvVar HMI_EVC_08_Ver_Canada_Avl
{
    _mEVC_CfgBit_01_32_AR.EVC_08_Ver_Canada_Avl.phys = getValue(this);
}
/*@@end*/

/*@@envVar:HMI_EVC_09_FullHyb_Avl:*/
on EnvVar HMI_EVC_09_FullHyb_Avl
{
    _mEVC_CfgBit_01_32_AR.EVC_09_FullHyb_Avl.phys = getValue(this);
}
/*@@end*/

/*@@envVar:HMI_EVC_0A_Hyb_20kW_Avl:*/
on EnvVar HMI_EVC_0A_Hyb_20kW_Avl
{
    _mEVC_CfgBit_01_32_AR.EVC_0A_Hyb_20kW_Avl.phys = getValue(this);
}
/*@@end*/

/*@@envVar:HMI_EVC_0B_PlugInHyb_80kW_Avl:*/
on EnvVar HMI_EVC_0B_PlugInHyb_80kW_Avl
{
    _mEVC_CfgBit_01_32_AR.EVC_0B_PlugInHyb_80kW_Avl.phys = getValue(this);
}
/*@@end*/

/*@@envVar:HMI_EVC_0C_AllWheelDr_Avl:*/
on EnvVar HMI_EVC_0C_AllWheelDr_Avl
{
    _mEVC_CfgBit_01_32_AR.EVC_0C_AllWheelDr_Avl.phys = getValue(this);
}
/*@@end*/

/*@@envVar:HMI_EVC_0D_4x2Drive_Avl:*/
on EnvVar HMI_EVC_0D_4x2Drive_Avl
{
    _mEVC_CfgBit_01_32_AR.EVC_0D_4x2Drive_Avl.phys = getValue(this);
}
/*@@end*/

/*@@envVar:HMI_EVC_0E_Presf_Avl:*/
on EnvVar HMI_EVC_0E_Presf_Avl
{
    _mEVC_CfgBit_01_32_AR.EVC_0E_Presf_Avl.phys = getValue(this);
}
/*@@end*/

/*@@envVar:HMI_EVC_0F_TrlrHtch_Avl:*/
on EnvVar HMI_EVC_0F_TrlrHtch_Avl
{
    _mEVC_CfgBit_01_32_AR.EVC_0F_TrlrHtch_Avl.phys = getValue(this);
}
/*@@end*/

/*@@envVar:HMI_EVC_10_KG_Avl:*/
on EnvVar HMI_EVC_10_KG_Avl
{
    _mEVC_CfgBit_01_32_AR.EVC_10_KG_Avl.phys = getValue(this);
}
/*@@end*/

/*@@envVar:HMI_EVC_11_AutTrunkLid_Avl:*/
on EnvVar HMI_EVC_11_AutTrunkLid_Avl
{
    _mEVC_CfgBit_01_32_AR.EVC_11_AutTrunkLid_Avl.phys = getValue(this);
}
/*@@end*/

/*@@envVar:HMI_EVC_12_AutRearDr_Avl:*/
on EnvVar HMI_EVC_12_AutRearDr_Avl
{
    _mEVC_CfgBit_01_32_AR.EVC_12_AutRearDr_Avl.phys = getValue(this);
}
/*@@end*/

/*@@envVar:HMI_EVC_13_PwrCls_Avl:*/
on EnvVar HMI_EVC_13_PwrCls_Avl
{
    _mEVC_CfgBit_01_32_AR.EVC_13_PwrCls_Avl.phys = getValue(this);
}
/*@@end*/

/*@@envVar:HMI_EVC_14_RainSens_Avl:*/
on EnvVar HMI_EVC_14_RainSens_Avl
{
    _mEVC_CfgBit_01_32_AR.EVC_14_RainSens_Avl.phys = getValue(this);
}
/*@@end*/

/*@@envVar:HMI_EVC_15_DRLt_Avl:*/
on EnvVar HMI_EVC_15_DRLt_Avl
{
    _mEVC_CfgBit_01_32_AR.EVC_15_DRLt_Avl.phys = getValue(this);
}
/*@@end*/

/*@@envVar:HMI_EVC_16_FogLmp_Avl:*/
on EnvVar HMI_EVC_16_FogLmp_Avl
{
    _mEVC_CfgBit_01_32_AR.EVC_16_FogLmp_Avl.phys = getValue(this);
}
/*@@end*/

/*@@envVar:HMI_EVC_17_IL_Pk_Avl:*/
on EnvVar HMI_EVC_17_IL_Pk_Avl
{
    _mEVC_CfgBit_01_32_AR.EVC_17_IL_Pk_Avl.phys = getValue(this);
}
/*@@end*/

/*@@envVar:HMI_EVC_18_AmbLgt_Avl:*/
on EnvVar HMI_EVC_18_AmbLgt_Avl
{
    _mEVC_CfgBit_01_32_AR.EVC_18_AmbLgt_Avl.phys = getValue(this);
}
/*@@end*/

/*@@envVar:HMI_EVC_19_ElDrPosnSel_Avl:*/
on EnvVar HMI_EVC_19_ElDrPosnSel_Avl
{
    _mEVC_CfgBit_01_32_AR.EVC_19_ElDrPosnSel_Avl.phys = getValue(this);
}
/*@@end*/

/*@@envVar:HMI_EVC_1A_IntSfProt_Avl:*/
on EnvVar HMI_EVC_1A_IntSfProt_Avl
{
    _mEVC_CfgBit_01_32_AR.EVC_1A_IntSfProt_Avl.phys = getValue(this);
}
/*@@end*/

/*@@envVar:HMI_EVC_1B_VTA_Avl:*/
on EnvVar HMI_EVC_1B_VTA_Avl
{
    _mEVC_CfgBit_01_32_AR.EVC_1B_VTA_Avl.phys = getValue(this);
}
/*@@end*/

/*@@envVar:HMI_EVC_1C_HghVTP_Avl:*/
on EnvVar HMI_EVC_1C_HghVTP_Avl
{
    _mEVC_CfgBit_01_32_AR.EVC_1C_HghVTP_Avl.phys = getValue(this);
}
/*@@end*/

/*@@envVar:HMI_EVC_1D_SecurityVer_Avl:*/
on EnvVar HMI_EVC_1D_SecurityVer_Avl
{
    _mEVC_CfgBit_01_32_AR.EVC_1D_SecurityVer_Avl.phys = getValue(this);
}
/*@@end*/

/*@@envVar:HMI_EVC_1E_GuardLvl_B4_Avl:*/
on EnvVar HMI_EVC_1E_GuardLvl_B4_Avl
{
    _mEVC_CfgBit_01_32_AR.EVC_1E_GuardLvl_B4_Avl.phys = getValue(this);
}
/*@@end*/

/*@@envVar:HMI_EVC_1F_GuardLvl_B6_Avl:*/
on EnvVar HMI_EVC_1F_GuardLvl_B6_Avl
{
    _mEVC_CfgBit_01_32_AR.EVC_1F_GuardLvl_B6_Avl.phys = getValue(this);
}
/*@@end*/

/*@@envVar:HMI_EVC_20_GuardLvl_B7_Avl:*/
on EnvVar HMI_EVC_20_GuardLvl_B7_Avl
{
    _mEVC_CfgBit_01_32_AR.EVC_20_GuardLvl_B7_Avl.phys = getValue(this);
}
/*@@end*/

/*@@envVar:HMI_EVC_21_Pullman_Avl:*/
on EnvVar HMI_EVC_21_Pullman_Avl
{
    _mEVC_CfgBit_01_32_AR.EVC_21_Pullman_Avl.phys = getValue(this);
}
/*@@end*/

/*@@envVar:HMI_EVC_22_SpecClos_Avl:*/
on EnvVar HMI_EVC_22_SpecClos_Avl
{
    _mEVC_CfgBit_01_32_AR.EVC_22_SpecClos_Avl.phys = getValue(this);
}
/*@@end*/

/*@@envVar:HMI_EVC_23_PASS_Avl:*/
on EnvVar HMI_EVC_23_PASS_Avl
{
    _mEVC_CfgBit_01_32_AR.EVC_23_PASS_Avl.phys = getValue(this);
}
/*@@end*/

/*@@envVar:HMI_EVC_24_ICH_Avl:*/
on EnvVar HMI_EVC_24_ICH_Avl
{
    _mEVC_CfgBit_01_32_AR.EVC_24_ICH_Avl.phys = getValue(this);
}
/*@@end*/

/*@@envVar:HMI_EVC_25_HVAC_R_Avl:*/
on EnvVar HMI_EVC_25_HVAC_R_Avl
{
    _mEVC_CfgBit_01_32_AR.EVC_25_HVAC_R_Avl.phys = getValue(this);
}
/*@@end*/

/*@@envVar:HMI_EVC_26_SSA_Avl:*/
on EnvVar HMI_EVC_26_SSA_Avl
{
    _mEVC_CfgBit_01_32_AR.EVC_26_SSA_Avl.phys = getValue(this);
}
/*@@end*/

/*@@envVar:HMI_EVC_27_HandsFreeAcc_Avl:*/
on EnvVar HMI_EVC_27_HandsFreeAcc_Avl
{
    _mEVC_CfgBit_01_32_AR.EVC_27_HandsFreeAcc_Avl.phys = getValue(this);
}
/*@@end*/

/*@@envVar:HMI_EVC_28_PlugInHyb_50kW_Avl:*/
on EnvVar HMI_EVC_28_PlugInHyb_50kW_Avl
{
    _mEVC_CfgBit_01_32_AR.EVC_28_PlugInHyb_50kW_Avl.phys = getValue(this);
}
/*@@end*/

/*@@envVar:HMI_EVC_29_Hyb_30kW_Avl:*/
on EnvVar HMI_EVC_29_Hyb_30kW_Avl
{
    _mEVC_CfgBit_01_32_AR.EVC_29_Hyb_30kW_Avl.phys = getValue(this);
}
/*@@end*/

/*@@envVar:HMI_EVC_2A_SeatElAdj_F_OprtnR_Avl:*/
on EnvVar HMI_EVC_2A_SeatElAdj_F_OprtnR_Avl
{
    _mEVC_CfgBit_01_32_AR.EVC_2A_SeatElAdj_F_OprtnR_Avl.phys = getValue(this);
}
/*@@end*/

/*@@envVar:HMI_EVC_2B_DSI_Sel_Avl:*/
on EnvVar HMI_EVC_2B_DSI_Sel_Avl
{
    _mEVC_CfgBit_01_32_AR.EVC_2B_DSI_Sel_Avl.phys = getValue(this);
}
/*@@end*/

/*@@envVar:HMI_EVC_2C_WC_VEDA_Avl:*/
on EnvVar HMI_EVC_2C_WC_VEDA_Avl
{
    _mEVC_CfgBit_01_32_AR.EVC_2C_WC_VEDA_Avl.phys = getValue(this);
}
/*@@end*/

/*@@envVar:HMI_EVC_2D_AutoSpdCtrl_Avl:*/
on EnvVar HMI_EVC_2D_AutoSpdCtrl_Avl
{
    _mEVC_CfgBit_01_32_AR.EVC_2D_AutoSpdCtrl_Avl.phys = getValue(this);
}
/*@@end*/

/*@@envVar:HMI_EVC_2E_AddEquip_Avl:*/
on EnvVar HMI_EVC_2E_AddEquip_Avl
{
    _mEVC_CfgBit_01_32_AR.EVC_2E_AddEquip_Avl.phys = getValue(this);
}
/*@@end*/

/*@@envVar:HMI_EVC_2F_AddEquip_Avl:*/
on EnvVar HMI_EVC_2F_AddEquip_Avl
{
    _mEVC_CfgBit_01_32_AR.EVC_2F_AddEquip_Avl.phys = getValue(this);
}
/*@@end*/

/*@@envVar:HMI_EVC_30_AddEquip_Avl:*/
on EnvVar HMI_EVC_30_AddEquip_Avl
{
    _mEVC_CfgBit_01_32_AR.EVC_30_AddEquip_Avl.phys = getValue(this);
}
/*@@end*/

/*@@envVar:HMI_EVC_31_AddEquip_Avl:*/
on EnvVar HMI_EVC_31_AddEquip_Avl
{
    _mEVC_CfgBit_01_32_AR.EVC_31_AddEquip_Avl.phys = getValue(this);
}
/*@@end*/

/*@@envVar:HMI_EVC_32_AddEquip_Avl:*/
on EnvVar HMI_EVC_32_AddEquip_Avl
{
    _mEVC_CfgBit_01_32_AR.EVC_32_AddEquip_Avl.phys = getValue(this);
}
/*@@end*/

/*@@envVar:HMI_EVC_CfgBit_01_32_Stat:*/
on EnvVar HMI_EVC_CfgBit_01_32_Stat
{
    _mEVC_CfgBit_01_32_AR.EVC_CfgBit_01_32_Stat.phys = getValue(this);
}
/*@@end*/

/*@@caplFunc:EVC_CfgBit_33_64_AR_check_output():*/
EVC_CfgBit_33_64_AR_check_output()
{
    if( !getValue( HMI__STMSG_EVC_CfgBit_33_64_AR ) )
    {
        // Botschaft EVC_CfgBit_33_64_AR ID: 755 --- Sendeart 0 cyclicX --- 
        _EVC_CfgBit_33_64_AR_Cnt--;
        if( _EVC_CfgBit_33_64_AR_Cnt < 1 )
        {
            // Nachricht wg. abgelaufenem Zyklus ausgeben
            EVC_CfgBit_33_64_AR_output();
            // Zyklus-Zähler zurücksetzen
            _EVC_CfgBit_33_64_AR_Cnt = _EVC_CfgBit_33_64_AR_CycleCount;
        }
    }
}
/*@@end*/

/*@@caplFunc:EVC_CfgBit_33_64_AR_init():*/
EVC_CfgBit_33_64_AR_init()
{   /* Botschaft EVC_CfgBit_33_64_AR ID: 755 --- Sendeart 0 cyclicX --- 
BA_ "ApplMessage" BO_ 755 0;
BA_ "NmAsrMessage" BO_ 755 0;
BA_ "GenMsgMinAcceptLength" BO_ 755 8;
BA_ "GenMsgILSupport" BO_ 755 1;
BA_ "DiagState" BO_ 755 0;
BA_ "DiagRequest" BO_ 755 0;
BA_ "DiagResponse" BO_ 755 0;
BA_ "GenMsgStartValue" BO_ 755 "0";
BA_ "GenMsgStartDelayTime" BO_ 755 185;
BA_ "GenMsgCycleTime" BO_ 755 1000;
BA_ "GenMsgSendType" BO_ 755 0;
    */
    _EVC_CfgBit_33_64_AR_Timebase =        c_tDBKomTimer_20ms;
    _EVC_CfgBit_33_64_AR_CycleCount =    1000 / _EVC_CfgBit_33_64_AR_Timebase;
    _EVC_CfgBit_33_64_AR_StartDelay =     185 / _EVC_CfgBit_33_64_AR_Timebase;
    _EVC_CfgBit_33_64_AR_Cnt = _EVC_CfgBit_33_64_AR_StartDelay;

    putValue( HMI__STMSGSD_EVC_CfgBit_33_64_AR, _EVC_CfgBit_33_64_AR_StartDelay * _EVC_CfgBit_33_64_AR_Timebase );

    _mEVC_CfgBit_33_64_AR.EVC_33_EmgOpn_F_Avl.phys = getValue( HMI_EVC_33_EmgOpn_F_Avl );
    _mEVC_CfgBit_33_64_AR.EVC_34_Curtain_F_Avl.phys = getValue( HMI_EVC_34_Curtain_F_Avl );
    _mEVC_CfgBit_33_64_AR.EVC_35_EmgOpn_Inact.phys = getValue( HMI_EVC_35_EmgOpn_Inact );
    _mEVC_CfgBit_33_64_AR.EVC_36_SpecVehPW_FL_Avl.phys = getValue( HMI_EVC_36_SpecVehPW_FL_Avl );
    _mEVC_CfgBit_33_64_AR.EVC_37_SpecVehPW_FR_Avl.phys = getValue( HMI_EVC_37_SpecVehPW_FR_Avl );
    _mEVC_CfgBit_33_64_AR.EVC_38_SpecVehPW_RL_Avl.phys = getValue( HMI_EVC_38_SpecVehPW_RL_Avl );
    _mEVC_CfgBit_33_64_AR.EVC_39_SpecVehPW_RR_Avl.phys = getValue( HMI_EVC_39_SpecVehPW_RR_Avl );
    _mEVC_CfgBit_33_64_AR.EVC_3A_RB_F_Avl.phys = getValue( HMI_EVC_3A_RB_F_Avl );
    _mEVC_CfgBit_33_64_AR.EVC_3B_RB_R_Avl.phys = getValue( HMI_EVC_3B_RB_R_Avl );
    _mEVC_CfgBit_33_64_AR.EVC_3C_SeatDrvDyn_Ft_Avl.phys = getValue( HMI_EVC_3C_SeatDrvDyn_Ft_Avl );
    _mEVC_CfgBit_33_64_AR.EVC_3D_ComfHdRst_Ft_Avl.phys = getValue( HMI_EVC_3D_ComfHdRst_Ft_Avl );
    _mEVC_CfgBit_33_64_AR.EVC_3E_SeatMultiCont_Ft_Avl.phys = getValue( HMI_EVC_3E_SeatMultiCont_Ft_Avl );
    _mEVC_CfgBit_33_64_AR.EVC_3F_SeatHt_Ft_Avl.phys = getValue( HMI_EVC_3F_SeatHt_Ft_Avl );
    _mEVC_CfgBit_33_64_AR.EVC_40_SeatClim_Ft_Avl.phys = getValue( HMI_EVC_40_SeatClim_Ft_Avl );
    _mEVC_CfgBit_33_64_AR.EVC_41_SeatMem_LHD_Avl.phys = getValue( HMI_EVC_41_SeatMem_LHD_Avl );
    _mEVC_CfgBit_33_64_AR.EVC_42_SeatMem_RHD_Avl.phys = getValue( HMI_EVC_42_SeatMem_RHD_Avl );
    _mEVC_CfgBit_33_64_AR.EVC_43_SeatMemPk_Avl.phys = getValue( HMI_EVC_43_SeatMemPk_Avl );
    _mEVC_CfgBit_33_64_AR.EVC_44_ReclSeat_Avl.phys = getValue( HMI_EVC_44_ReclSeat_Avl );
    _mEVC_CfgBit_33_64_AR.EVC_45_SeatMultiCont_R_Avl.phys = getValue( HMI_EVC_45_SeatMultiCont_R_Avl );
    _mEVC_CfgBit_33_64_AR.EVC_46_SeatBkRstAdj_R_Avl.phys = getValue( HMI_EVC_46_SeatBkRstAdj_R_Avl );
    _mEVC_CfgBit_33_64_AR.EVC_47_SeatHt_R_Avl.phys = getValue( HMI_EVC_47_SeatHt_R_Avl );
    _mEVC_CfgBit_33_64_AR.EVC_48_SeatClim_R_Avl.phys = getValue( HMI_EVC_48_SeatClim_R_Avl );
    _mEVC_CfgBit_33_64_AR.EVC_49_WShWashHt_Avl.phys = getValue( HMI_EVC_49_WShWashHt_Avl );
    _mEVC_CfgBit_33_64_AR.EVC_4A_TaxiPwrSup_Avl.phys = getValue( HMI_EVC_4A_TaxiPwrSup_Avl );
    _mEVC_CfgBit_33_64_AR.EVC_4B_TaxiRoofLmpCon_Avl.phys = getValue( HMI_EVC_4B_TaxiRoofLmpCon_Avl );
    _mEVC_CfgBit_33_64_AR.EVC_4C_TaxiEmgAlm_Avl.phys = getValue( HMI_EVC_4C_TaxiEmgAlm_Avl );
    _mEVC_CfgBit_33_64_AR.EVC_4D_RadioHdFree_Avl.phys = getValue( HMI_EVC_4D_RadioHdFree_Avl );
    _mEVC_CfgBit_33_64_AR.EVC_4E_GAS_Avl.phys = getValue( HMI_EVC_4E_GAS_Avl );
    _mEVC_CfgBit_33_64_AR.EVC_4F_CtrlU_MultiFunc_Avl.phys = getValue( HMI_EVC_4F_CtrlU_MultiFunc_Avl );
    _mEVC_CfgBit_33_64_AR.EVC_50_TaxInMirr_Avl.phys = getValue( HMI_EVC_50_TaxInMirr_Avl );
    _mEVC_CfgBit_33_64_AR.EVC_51_DistRecInMirr_Avl.phys = getValue( HMI_EVC_51_DistRecInMirr_Avl );
    _mEVC_CfgBit_33_64_AR.EVC_52_PreInstRad_Avl.phys = getValue( HMI_EVC_52_PreInstRad_Avl );
    _mEVC_CfgBit_33_64_AR.EVC_53_VehHandi_Avl.phys = getValue( HMI_EVC_53_VehHandi_Avl );
    _mEVC_CfgBit_33_64_AR.EVC_54_PanelHt_Ft_Avl.phys = getValue( HMI_EVC_54_PanelHt_Ft_Avl );
    _mEVC_CfgBit_33_64_AR.EVC_55_SeatComfHt_Ft_Avl.phys = getValue( HMI_EVC_55_SeatComfHt_Ft_Avl );
    _mEVC_CfgBit_33_64_AR.EVC_56_SeatComfHt_R_Avl.phys = getValue( HMI_EVC_56_SeatComfHt_R_Avl );
    _mEVC_CfgBit_33_64_AR.EVC_57_IntFoldHdRst_Ft_Avl.phys = getValue( HMI_EVC_57_IntFoldHdRst_Ft_Avl );
    _mEVC_CfgBit_33_64_AR.EVC_58_SeatInd_R_Avl.phys = getValue( HMI_EVC_58_SeatInd_R_Avl );
    _mEVC_CfgBit_33_64_AR.EVC_59_SeatChauffPos_P_Avl.phys = getValue( HMI_EVC_59_SeatChauffPos_P_Avl );
    _mEVC_CfgBit_33_64_AR.EVC_5A_SeatMContMass_Ft_Avl.phys = getValue( HMI_EVC_5A_SeatMContMass_Ft_Avl );
    _mEVC_CfgBit_33_64_AR.EVC_5B_PanelHt_R_Avl.phys = getValue( HMI_EVC_5B_PanelHt_R_Avl );
    _mEVC_CfgBit_33_64_AR.EVC_5C_Airscarf_Ft_Avl.phys = getValue( HMI_EVC_5C_Airscarf_Ft_Avl );
    _mEVC_CfgBit_33_64_AR.EVC_5D_SeatLimit_P_Avl.phys = getValue( HMI_EVC_5D_SeatLimit_P_Avl );
    _mEVC_CfgBit_33_64_AR.EVC_5E_TaxiRoofLmp_Avl.phys = getValue( HMI_EVC_5E_TaxiRoofLmp_Avl );
    _mEVC_CfgBit_33_64_AR.EVC_5F_SeatElAdj_LHD_Avl.phys = getValue( HMI_EVC_5F_SeatElAdj_LHD_Avl );
    _mEVC_CfgBit_33_64_AR.EVC_60_SeatElAdj_RHD_Avl.phys = getValue( HMI_EVC_60_SeatElAdj_RHD_Avl );
    _mEVC_CfgBit_33_64_AR.EVC_61_AMGPerfSusp_Avl.phys = getValue( HMI_EVC_61_AMGPerfSusp_Avl );
    _mEVC_CfgBit_33_64_AR.EVC_62_ShiftExhstSys_Avl.phys = getValue( HMI_EVC_62_ShiftExhstSys_Avl );
    _mEVC_CfgBit_33_64_AR.EVC_63_ActvLDA_MPC_Avl.phys = getValue( HMI_EVC_63_ActvLDA_MPC_Avl );
    _mEVC_CfgBit_33_64_AR.EVC_64_EAS_Avl.phys = getValue( HMI_EVC_64_EAS_Avl );
    _mEVC_CfgBit_33_64_AR.EVC_CfgBit_33_64_Stat.phys = getValue( HMI_EVC_CfgBit_33_64_Stat );
}
/*@@end*/

/*@@caplFunc:EVC_CfgBit_33_64_AR_output():*/
void EVC_CfgBit_33_64_AR_output(void)
{
    byte crc;
    byte SQC_help;

    if( !getValue( HMI_SQC_EVC_CfgBit_33_64_Auto ) )
    {
        // berechne message counter
        SQC_help = getValue( HMI_SQC_EVC_CfgBit_33_64 );
        if( SQC_help >= 15 ) SQC_help = 0;
        else SQC_help++;
        putValue( HMI_SQC_EVC_CfgBit_33_64, SQC_help );
        _mEVC_CfgBit_33_64_AR.SQC_EVC_CfgBit_33_64 = SQC_help;
    }
    else
          _mEVC_CfgBit_33_64_AR.SQC_EVC_CfgBit_33_64 = getValue( HMI_SQC_EVC_CfgBit_33_64 );

    if( getValue( HMI_CRC_EVC_CfgBit_33_64_Profile_02 ) )
    {
        if( !getValue( HMI_CRC_EVC_CfgBit_33_64_Auto ) )
        {   // CRC according Profile_02 ( W213 )
            // berechne crc
            crc = 0xFF;
//          crc = crctable_profile02[ crc ^ _mEVC_CfgBit_33_64_AR.byte( 0 ) ];
            crc = crctable_profile02[ crc ^ _mEVC_CfgBit_33_64_AR.byte( 1 ) ];
            crc = crctable_profile02[ crc ^ _mEVC_CfgBit_33_64_AR.byte( 2 ) ];
            crc = crctable_profile02[ crc ^ _mEVC_CfgBit_33_64_AR.byte( 3 ) ];
            crc = crctable_profile02[ crc ^ _mEVC_CfgBit_33_64_AR.byte( 4 ) ];
            crc = crctable_profile02[ crc ^ _mEVC_CfgBit_33_64_AR.byte( 5 ) ];
//          crc = crctable_profile02[ crc ^ _mEVC_CfgBit_33_64_AR.byte( 6 ) ];
//          crc = crctable_profile02[ crc ^ _mEVC_CfgBit_33_64_AR.byte( 7 ) ];
            crc = crctable_profile02[ crc ^ _EVC_CfgBit_33_64_AR_CRC_Offset[ _mEVC_CfgBit_33_64_AR.SQC_EVC_CfgBit_33_64 ] ]; // load offset
            crc = (crc ^ 0xFF);
            if( getValue(  HMI_CRC_EVC_CfgBit_33_64_Invalid ) )
                crc++;
            _mEVC_CfgBit_33_64_AR.CRC_EVC_CfgBit_33_64 = crc;
            putValue( HMI_CRC_EVC_CfgBit_33_64, crc );
        }
        else
            _mEVC_CfgBit_33_64_AR.CRC_EVC_CfgBit_33_64 = getValue( HMI_CRC_EVC_CfgBit_33_64 );
    }
    else
    {
        if( !getValue( HMI_CRC_EVC_CfgBit_33_64_Auto ) )
        {   // CRC according to SAE1850 ( W222 )
            // berechne crc
            crc = 0xFF;
            crc = crctable[crc ^ _mEVC_CfgBit_33_64_AR.byte( 1 )];
            crc = crctable[crc ^ _mEVC_CfgBit_33_64_AR.byte( 2 )];
            crc = crctable[crc ^ _mEVC_CfgBit_33_64_AR.byte( 3 )];
            crc = crctable[crc ^ _mEVC_CfgBit_33_64_AR.byte( 4 )];
            crc = crctable[crc ^ _mEVC_CfgBit_33_64_AR.byte( 5 )];
            crc = crctable[crc ^ _mEVC_CfgBit_33_64_AR.byte( 6 )];
            crc = crctable[crc ^ _mEVC_CfgBit_33_64_AR.byte( 7 )];
            crc = (crc ^ 0xFF);
            if( getValue(  HMI_CRC_EVC_CfgBit_33_64_Invalid ) )
                crc++;
            _mEVC_CfgBit_33_64_AR.CRC_EVC_CfgBit_33_64 = crc;
            putValue( HMI_CRC_EVC_CfgBit_33_64, crc );
        }
        else
            _mEVC_CfgBit_33_64_AR.CRC_EVC_CfgBit_33_64 = getValue( HMI_CRC_EVC_CfgBit_33_64 );
    }
    output( _mEVC_CfgBit_33_64_AR );
}
/*@@end*/

/*@@caplFunc:EVC_CfgBit_33_64_AR_saveEnvVars(dword):*/
EVC_CfgBit_33_64_AR_saveEnvVars( dword hFile )
{
    filePutString("\n// Knoten EIS: EVC_CfgBit_33_64_AR\n", 33, hFile );
    snprintf( buffer, elcount( buffer ), "0.0000 HMI__STMSG_EVC_CfgBit_33_64 := %X\n", getValue( HMI__STMSG_EVC_CfgBit_33_64_AR ) );    filePutString( buffer, elcount( buffer ), hFile );
    snprintf( buffer, elcount( buffer ), "0.0000 HMI__STMSGT_EVC_CfgBit_33_64 := %X\n", getValue( HMI__STMSGT_EVC_CfgBit_33_64_AR ) );    filePutString( buffer, elcount( buffer ), hFile );
    snprintf( buffer, elcount( buffer ), "0.0000 HMI_CRC_EVC_CfgBit_33_64 := %X\n", getValue( HMI_CRC_EVC_CfgBit_33_64 ) );    filePutString( buffer, elcount( buffer ), hFile );
    snprintf( buffer, elcount( buffer ), "0.0000 HMI_CRC_EVC_CfgBit_33_64_Auto := %X\n", getValue( HMI_CRC_EVC_CfgBit_33_64_Auto ) );    filePutString( buffer, elcount( buffer ), hFile );
    snprintf( buffer, elcount( buffer ), "0.0000 HMI_EVC_33_EmgOpn_F_Avl := %X\n", getValue( HMI_EVC_33_EmgOpn_F_Avl ) );    filePutString( buffer, elcount( buffer ), hFile );
    snprintf( buffer, elcount( buffer ), "0.0000 HMI_EVC_34_Curtain_F_Avl := %X\n", getValue( HMI_EVC_34_Curtain_F_Avl ) );    filePutString( buffer, elcount( buffer ), hFile );
    snprintf( buffer, elcount( buffer ), "0.0000 HMI_EVC_35_EmgOpn_Inact := %X\n", getValue( HMI_EVC_35_EmgOpn_Inact ) );    filePutString( buffer, elcount( buffer ), hFile );
    snprintf( buffer, elcount( buffer ), "0.0000 HMI_EVC_36_SpecVehPW_FL_Avl := %X\n", getValue( HMI_EVC_36_SpecVehPW_FL_Avl ) );    filePutString( buffer, elcount( buffer ), hFile );
    snprintf( buffer, elcount( buffer ), "0.0000 HMI_EVC_37_SpecVehPW_FR_Avl := %X\n", getValue( HMI_EVC_37_SpecVehPW_FR_Avl ) );    filePutString( buffer, elcount( buffer ), hFile );
    snprintf( buffer, elcount( buffer ), "0.0000 HMI_EVC_38_SpecVehPW_RL_Avl := %X\n", getValue( HMI_EVC_38_SpecVehPW_RL_Avl ) );    filePutString( buffer, elcount( buffer ), hFile );
    snprintf( buffer, elcount( buffer ), "0.0000 HMI_EVC_39_SpecVehPW_RR_Avl := %X\n", getValue( HMI_EVC_39_SpecVehPW_RR_Avl ) );    filePutString( buffer, elcount( buffer ), hFile );
    snprintf( buffer, elcount( buffer ), "0.0000 HMI_EVC_3A_RB_F_Avl := %X\n", getValue( HMI_EVC_3A_RB_F_Avl ) );    filePutString( buffer, elcount( buffer ), hFile );
    snprintf( buffer, elcount( buffer ), "0.0000 HMI_EVC_3B_RB_R_Avl := %X\n", getValue( HMI_EVC_3B_RB_R_Avl ) );    filePutString( buffer, elcount( buffer ), hFile );
    snprintf( buffer, elcount( buffer ), "0.0000 HMI_EVC_3C_SeatDrvDyn_Ft_Avl := %X\n", getValue( HMI_EVC_3C_SeatDrvDyn_Ft_Avl ) );    filePutString( buffer, elcount( buffer ), hFile );
    snprintf( buffer, elcount( buffer ), "0.0000 HMI_EVC_3D_ComfHdRst_Ft_Avl := %X\n", getValue( HMI_EVC_3D_ComfHdRst_Ft_Avl ) );    filePutString( buffer, elcount( buffer ), hFile );
    snprintf( buffer, elcount( buffer ), "0.0000 HMI_EVC_3E_SeatMultiCont_Ft_Avl := %X\n", getValue( HMI_EVC_3E_SeatMultiCont_Ft_Avl ) );    filePutString( buffer, elcount( buffer ), hFile );
    snprintf( buffer, elcount( buffer ), "0.0000 HMI_EVC_3F_SeatHt_Ft_Avl := %X\n", getValue( HMI_EVC_3F_SeatHt_Ft_Avl ) );    filePutString( buffer, elcount( buffer ), hFile );
    snprintf( buffer, elcount( buffer ), "0.0000 HMI_EVC_40_SeatClim_Ft_Avl := %X\n", getValue( HMI_EVC_40_SeatClim_Ft_Avl ) );    filePutString( buffer, elcount( buffer ), hFile );
    snprintf( buffer, elcount( buffer ), "0.0000 HMI_EVC_41_SeatMem_LHD_Avl := %X\n", getValue( HMI_EVC_41_SeatMem_LHD_Avl ) );    filePutString( buffer, elcount( buffer ), hFile );
    snprintf( buffer, elcount( buffer ), "0.0000 HMI_EVC_42_SeatMem_RHD_Avl := %X\n", getValue( HMI_EVC_42_SeatMem_RHD_Avl ) );    filePutString( buffer, elcount( buffer ), hFile );
    snprintf( buffer, elcount( buffer ), "0.0000 HMI_EVC_43_SeatMemPk_Avl := %X\n", getValue( HMI_EVC_43_SeatMemPk_Avl ) );    filePutString( buffer, elcount( buffer ), hFile );
    snprintf( buffer, elcount( buffer ), "0.0000 HMI_EVC_44_ReclSeat_Avl := %X\n", getValue( HMI_EVC_44_ReclSeat_Avl ) );    filePutString( buffer, elcount( buffer ), hFile );
    snprintf( buffer, elcount( buffer ), "0.0000 HMI_EVC_45_SeatMultiCont_R_Avl := %X\n", getValue( HMI_EVC_45_SeatMultiCont_R_Avl ) );    filePutString( buffer, elcount( buffer ), hFile );
    snprintf( buffer, elcount( buffer ), "0.0000 HMI_EVC_46_SeatBkRstAdj_R_Avl := %X\n", getValue( HMI_EVC_46_SeatBkRstAdj_R_Avl ) );    filePutString( buffer, elcount( buffer ), hFile );
    snprintf( buffer, elcount( buffer ), "0.0000 HMI_EVC_47_SeatHt_R_Avl := %X\n", getValue( HMI_EVC_47_SeatHt_R_Avl ) );    filePutString( buffer, elcount( buffer ), hFile );
    snprintf( buffer, elcount( buffer ), "0.0000 HMI_EVC_48_SeatClim_R_Avl := %X\n", getValue( HMI_EVC_48_SeatClim_R_Avl ) );    filePutString( buffer, elcount( buffer ), hFile );
    snprintf( buffer, elcount( buffer ), "0.0000 HMI_EVC_49_WShWashHt_Avl := %X\n", getValue( HMI_EVC_49_WShWashHt_Avl ) );    filePutString( buffer, elcount( buffer ), hFile );
    snprintf( buffer, elcount( buffer ), "0.0000 HMI_EVC_4A_TaxiPwrSup_Avl := %X\n", getValue( HMI_EVC_4A_TaxiPwrSup_Avl ) );    filePutString( buffer, elcount( buffer ), hFile );
    snprintf( buffer, elcount( buffer ), "0.0000 HMI_EVC_4B_TaxiRoofLmpCon_Avl := %X\n", getValue( HMI_EVC_4B_TaxiRoofLmpCon_Avl ) );    filePutString( buffer, elcount( buffer ), hFile );
    snprintf( buffer, elcount( buffer ), "0.0000 HMI_EVC_4C_TaxiEmgAlm_Avl := %X\n", getValue( HMI_EVC_4C_TaxiEmgAlm_Avl ) );    filePutString( buffer, elcount( buffer ), hFile );
    snprintf( buffer, elcount( buffer ), "0.0000 HMI_EVC_4D_RadioHdFree_Avl := %X\n", getValue( HMI_EVC_4D_RadioHdFree_Avl ) );    filePutString( buffer, elcount( buffer ), hFile );
    snprintf( buffer, elcount( buffer ), "0.0000 HMI_EVC_4E_GAS_Avl := %X\n", getValue( HMI_EVC_4E_GAS_Avl ) );    filePutString( buffer, elcount( buffer ), hFile );
    snprintf( buffer, elcount( buffer ), "0.0000 HMI_EVC_4F_CtrlU_MultiFunc_Avl := %X\n", getValue( HMI_EVC_4F_CtrlU_MultiFunc_Avl ) );    filePutString( buffer, elcount( buffer ), hFile );
    snprintf( buffer, elcount( buffer ), "0.0000 HMI_EVC_50_TaxInMirr_Avl := %X\n", getValue( HMI_EVC_50_TaxInMirr_Avl ) );    filePutString( buffer, elcount( buffer ), hFile );
    snprintf( buffer, elcount( buffer ), "0.0000 HMI_EVC_51_DistRecInMirr_Avl := %X\n", getValue( HMI_EVC_51_DistRecInMirr_Avl ) );    filePutString( buffer, elcount( buffer ), hFile );
    snprintf( buffer, elcount( buffer ), "0.0000 HMI_EVC_52_PreInstRad_Avl := %X\n", getValue( HMI_EVC_52_PreInstRad_Avl ) );    filePutString( buffer, elcount( buffer ), hFile );
    snprintf( buffer, elcount( buffer ), "0.0000 HMI_EVC_53_VehHandi_Avl := %X\n", getValue( HMI_EVC_53_VehHandi_Avl ) );    filePutString( buffer, elcount( buffer ), hFile );
    snprintf( buffer, elcount( buffer ), "0.0000 HMI_EVC_54_PanelHt_Ft_Avl := %X\n", getValue( HMI_EVC_54_PanelHt_Ft_Avl ) );    filePutString( buffer, elcount( buffer ), hFile );
    snprintf( buffer, elcount( buffer ), "0.0000 HMI_EVC_55_SeatComfHt_Ft_Avl := %X\n", getValue( HMI_EVC_55_SeatComfHt_Ft_Avl ) );    filePutString( buffer, elcount( buffer ), hFile );
    snprintf( buffer, elcount( buffer ), "0.0000 HMI_EVC_56_SeatComfHt_R_Avl := %X\n", getValue( HMI_EVC_56_SeatComfHt_R_Avl ) );    filePutString( buffer, elcount( buffer ), hFile );
    snprintf( buffer, elcount( buffer ), "0.0000 HMI_EVC_57_IntFoldHdRst_Ft_Avl := %X\n", getValue( HMI_EVC_57_IntFoldHdRst_Ft_Avl ) );    filePutString( buffer, elcount( buffer ), hFile );
    snprintf( buffer, elcount( buffer ), "0.0000 HMI_EVC_58_SeatInd_R_Avl := %X\n", getValue( HMI_EVC_58_SeatInd_R_Avl ) );    filePutString( buffer, elcount( buffer ), hFile );
    snprintf( buffer, elcount( buffer ), "0.0000 HMI_EVC_59_SeatChauffPos_P_Avl := %X\n", getValue( HMI_EVC_59_SeatChauffPos_P_Avl ) );    filePutString( buffer, elcount( buffer ), hFile );
    snprintf( buffer, elcount( buffer ), "0.0000 HMI_EVC_5A_SeatMContMass_Ft_Avl := %X\n", getValue( HMI_EVC_5A_SeatMContMass_Ft_Avl ) );    filePutString( buffer, elcount( buffer ), hFile );
    snprintf( buffer, elcount( buffer ), "0.0000 HMI_EVC_EVC_5B_PanelHt_R_Avl_Avl := %X\n", getValue( HMI_EVC_5B_PanelHt_R_Avl ) );    filePutString( buffer, elcount( buffer ), hFile );
    snprintf( buffer, elcount( buffer ), "0.0000 HMI_EVC_5C_Airscarf_Ft_Avl := %X\n", getValue( HMI_EVC_5C_Airscarf_Ft_Avl ) );    filePutString( buffer, elcount( buffer ), hFile );
    snprintf( buffer, elcount( buffer ), "0.0000 HMI_EVC_5D_SeatLimit_P_Avl := %X\n", getValue( HMI_EVC_5D_SeatLimit_P_Avl ) );    filePutString( buffer, elcount( buffer ), hFile );
    snprintf( buffer, elcount( buffer ), "0.0000 HMI_EVC_5E_TaxiRoofLmp_Avl := %X\n", getValue( HMI_EVC_5E_TaxiRoofLmp_Avl ) );    filePutString( buffer, elcount( buffer ), hFile );
    snprintf( buffer, elcount( buffer ), "0.0000 HMI_EVC_5F_SeatElAdj_LHD_Avl := %X\n", getValue( HMI_EVC_5F_SeatElAdj_LHD_Avl ) );    filePutString( buffer, elcount( buffer ), hFile );
    snprintf( buffer, elcount( buffer ), "0.0000 HMI_EVC_60_SeatElAdj_RHD_Avl := %X\n", getValue( HMI_EVC_60_SeatElAdj_RHD_Avl ) );    filePutString( buffer, elcount( buffer ), hFile );
    snprintf( buffer, elcount( buffer ), "0.0000 HMI_EVC_61_AMGPerfSusp_Avl := %X\n", getValue( HMI_EVC_61_AMGPerfSusp_Avl ) );    filePutString( buffer, elcount( buffer ), hFile );
    snprintf( buffer, elcount( buffer ), "0.0000 HMI_EVC_62_ShiftExhstSys_Avl := %X\n", getValue( HMI_EVC_62_ShiftExhstSys_Avl ) );    filePutString( buffer, elcount( buffer ), hFile );
    snprintf( buffer, elcount( buffer ), "0.0000 HMI_EVC_63_ActvLDA_MPC_Avl := %X\n", getValue( HMI_EVC_63_ActvLDA_MPC_Avl ) );    filePutString( buffer, elcount( buffer ), hFile );
    snprintf( buffer, elcount( buffer ), "0.0000 HMI_EVC_64_EAS_Avl := %X\n", getValue( HMI_EVC_64_EAS_Avl ) );    filePutString( buffer, elcount( buffer ), hFile );
    snprintf( buffer, elcount( buffer ), "0.0000 HMI_EVC_CfgBit_33_64_Stat := %X\n", getValue( HMI_EVC_CfgBit_33_64_Stat ) );    filePutString( buffer, elcount( buffer ), hFile );
    snprintf( buffer, elcount( buffer ), "0.0000 HMI_SQC_EVC_CfgBit_33_64 := %X\n", getValue( HMI_SQC_EVC_CfgBit_33_64 ) );    filePutString( buffer, elcount( buffer ), hFile );
    snprintf( buffer, elcount( buffer ), "0.0000 HMI_SQC_EVC_CfgBit_33_64_Auto := %X\n", getValue( HMI_SQC_EVC_CfgBit_33_64_Auto ) );    filePutString( buffer, elcount( buffer ), hFile );
}
/*@@end*/

/*@@timer:_tEVC_CfgBit_33_64_AR:*/
on timer _tEVC_CfgBit_33_64_AR
{
    putValue( HMI__STMSG_EVC_CfgBit_33_64_AR, 0 );
}
/*@@end*/

/*@@envVar:HMI__STMSG_EVC_CfgBit_33_64_AR:*/
on EnvVar HMI__STMSG_EVC_CfgBit_33_64_AR
{
    long tDelay;
    if( getValue( this ) == 2 )
    {
        tDelay = getValue( HMI__STMSGT_EVC_CfgBit_33_64_AR );
        if( tDelay > 0)    
            setTimer( _tEVC_CfgBit_33_64_AR, tDelay );
        else
            putValue( HMI__STMSG_EVC_CfgBit_33_64_AR, 0 );
    }
}
/*@@end*/

/*@@envVar:HMI_EVC_33_EmgOpn_F_Avl:*/
on EnvVar HMI_EVC_33_EmgOpn_F_Avl
{
    _mEVC_CfgBit_33_64_AR.EVC_33_EmgOpn_F_Avl.phys = getValue(this);
}
/*@@end*/

/*@@envVar:HMI_EVC_34_Curtain_F_Avl:*/
on EnvVar HMI_EVC_34_Curtain_F_Avl
{
    _mEVC_CfgBit_33_64_AR.EVC_34_Curtain_F_Avl.phys = getValue(this);
}
/*@@end*/

/*@@envVar:HMI_EVC_35_EmgOpn_Inact:*/
on EnvVar HMI_EVC_35_EmgOpn_Inact
{
    _mEVC_CfgBit_33_64_AR.EVC_35_EmgOpn_Inact.phys = getValue(this);
}
/*@@end*/

/*@@envVar:HMI_EVC_36_SpecVehPW_FL_Avl:*/
on EnvVar HMI_EVC_36_SpecVehPW_FL_Avl
{
    _mEVC_CfgBit_33_64_AR.EVC_36_SpecVehPW_FL_Avl.phys = getValue(this);
}
/*@@end*/

/*@@envVar:HMI_EVC_37_SpecVehPW_FR_Avl:*/
on EnvVar HMI_EVC_37_SpecVehPW_FR_Avl
{
    _mEVC_CfgBit_33_64_AR.EVC_37_SpecVehPW_FR_Avl.phys = getValue(this);
}
/*@@end*/

/*@@envVar:HMI_EVC_38_SpecVehPW_RL_Avl:*/
on EnvVar HMI_EVC_38_SpecVehPW_RL_Avl
{
    _mEVC_CfgBit_33_64_AR.EVC_38_SpecVehPW_RL_Avl.phys = getValue(this);
}
/*@@end*/

/*@@envVar:HMI_EVC_39_SpecVehPW_RR_Avl:*/
on EnvVar HMI_EVC_39_SpecVehPW_RR_Avl
{
    _mEVC_CfgBit_33_64_AR.EVC_39_SpecVehPW_RR_Avl.phys = getValue(this);
}
/*@@end*/

/*@@envVar:HMI_EVC_3A_RB_F_Avl:*/
on EnvVar HMI_EVC_3A_RB_F_Avl
{
    _mEVC_CfgBit_33_64_AR.EVC_3A_RB_F_Avl.phys = getValue(this);
}
/*@@end*/

/*@@envVar:HMI_EVC_3B_RB_R_Avl:*/
on EnvVar HMI_EVC_3B_RB_R_Avl
{
    _mEVC_CfgBit_33_64_AR.EVC_3B_RB_R_Avl.phys = getValue(this);
}
/*@@end*/

/*@@envVar:HMI_EVC_3C_SeatDrvDyn_Ft_Avl:*/
on EnvVar HMI_EVC_3C_SeatDrvDyn_Ft_Avl
{
    _mEVC_CfgBit_33_64_AR.EVC_3C_SeatDrvDyn_Ft_Avl.phys = getValue(this);
}
/*@@end*/

/*@@envVar:HMI_EVC_3D_ComfHdRst_Ft_Avl:*/
on EnvVar HMI_EVC_3D_ComfHdRst_Ft_Avl
{
    _mEVC_CfgBit_33_64_AR.EVC_3D_ComfHdRst_Ft_Avl.phys = getValue(this);
}
/*@@end*/

/*@@envVar:HMI_EVC_3E_SeatMultiCont_Ft_Avl:*/
on EnvVar HMI_EVC_3E_SeatMultiCont_Ft_Avl
{
    _mEVC_CfgBit_33_64_AR.EVC_3E_SeatMultiCont_Ft_Avl.phys = getValue(this);
}
/*@@end*/

/*@@envVar:HMI_EVC_3F_SeatHt_Ft_Avl:*/
on EnvVar HMI_EVC_3F_SeatHt_Ft_Avl
{
    _mEVC_CfgBit_33_64_AR.EVC_3F_SeatHt_Ft_Avl.phys = getValue(this);
}
/*@@end*/

/*@@envVar:HMI_EVC_40_SeatClim_Ft_Avl:*/
on EnvVar HMI_EVC_40_SeatClim_Ft_Avl
{
    _mEVC_CfgBit_33_64_AR.EVC_40_SeatClim_Ft_Avl.phys = getValue(this);
}
/*@@end*/

/*@@envVar:HMI_EVC_41_SeatMem_LHD_Avl:*/
on EnvVar HMI_EVC_41_SeatMem_LHD_Avl
{
    _mEVC_CfgBit_33_64_AR.EVC_41_SeatMem_LHD_Avl.phys = getValue(this);
}
/*@@end*/

/*@@envVar:HMI_EVC_42_SeatMem_RHD_Avl:*/
on EnvVar HMI_EVC_42_SeatMem_RHD_Avl
{
    _mEVC_CfgBit_33_64_AR.EVC_42_SeatMem_RHD_Avl.phys = getValue(this);
}
/*@@end*/

/*@@envVar:HMI_EVC_43_SeatMemPk_Avl:*/
on EnvVar HMI_EVC_43_SeatMemPk_Avl
{
    _mEVC_CfgBit_33_64_AR.EVC_43_SeatMemPk_Avl.phys = getValue(this);
}
/*@@end*/

/*@@envVar:HMI_EVC_44_ReclSeat_Avl:*/
on EnvVar HMI_EVC_44_ReclSeat_Avl
{
    _mEVC_CfgBit_33_64_AR.EVC_44_ReclSeat_Avl.phys = getValue(this);
}
/*@@end*/

/*@@envVar:HMI_EVC_45_SeatMultiCont_R_Avl:*/
on EnvVar HMI_EVC_45_SeatMultiCont_R_Avl
{
    _mEVC_CfgBit_33_64_AR.EVC_45_SeatMultiCont_R_Avl.phys = getValue(this);
}
/*@@end*/

/*@@envVar:HMI_EVC_46_SeatBkRstAdj_R_Avl:*/
on EnvVar HMI_EVC_46_SeatBkRstAdj_R_Avl
{
    _mEVC_CfgBit_33_64_AR.EVC_46_SeatBkRstAdj_R_Avl.phys = getValue(this);
}
/*@@end*/

/*@@envVar:HMI_EVC_47_SeatHt_R_Avl:*/
on EnvVar HMI_EVC_47_SeatHt_R_Avl
{
    _mEVC_CfgBit_33_64_AR.EVC_47_SeatHt_R_Avl.phys = getValue(this);
}
/*@@end*/

/*@@envVar:HMI_EVC_48_SeatClim_R_Avl:*/
on EnvVar HMI_EVC_48_SeatClim_R_Avl
{
    _mEVC_CfgBit_33_64_AR.EVC_48_SeatClim_R_Avl.phys = getValue(this);
}
/*@@end*/

/*@@envVar:HMI_EVC_49_WShWashHt_Avl:*/
on EnvVar HMI_EVC_49_WShWashHt_Avl
{
    _mEVC_CfgBit_33_64_AR.EVC_49_WShWashHt_Avl.phys = getValue(this);
}
/*@@end*/

/*@@envVar:HMI_EVC_4A_TaxiPwrSup_Avl:*/
on EnvVar HMI_EVC_4A_TaxiPwrSup_Avl
{
    _mEVC_CfgBit_33_64_AR.EVC_4A_TaxiPwrSup_Avl.phys = getValue(this);
}
/*@@end*/

/*@@envVar:HMI_EVC_4B_TaxiRoofLmpCon_Avl:*/
on EnvVar HMI_EVC_4B_TaxiRoofLmpCon_Avl
{
    _mEVC_CfgBit_33_64_AR.EVC_4B_TaxiRoofLmpCon_Avl.phys = getValue(this);
}
/*@@end*/

/*@@envVar:HMI_EVC_4C_TaxiEmgAlm_Avl:*/
on EnvVar HMI_EVC_4C_TaxiEmgAlm_Avl
{
    _mEVC_CfgBit_33_64_AR.EVC_4C_TaxiEmgAlm_Avl.phys = getValue(this);
}
/*@@end*/

/*@@envVar:HMI_EVC_4D_RadioHdFree_Avl:*/
on EnvVar HMI_EVC_4D_RadioHdFree_Avl
{
    _mEVC_CfgBit_33_64_AR.EVC_4D_RadioHdFree_Avl.phys = getValue(this);
}
/*@@end*/

/*@@envVar:HMI_EVC_4E_GAS_Avl:*/
on EnvVar HMI_EVC_4E_GAS_Avl
{
    _mEVC_CfgBit_33_64_AR.EVC_4E_GAS_Avl.phys = getValue(this);
}
/*@@end*/

/*@@envVar:HMI_EVC_4F_CtrlU_MultiFunc_Avl:*/
on EnvVar HMI_EVC_4F_CtrlU_MultiFunc_Avl
{
    _mEVC_CfgBit_33_64_AR.EVC_4F_CtrlU_MultiFunc_Avl.phys = getValue(this);
}
/*@@end*/

/*@@envVar:HMI_EVC_50_TaxInMirr_Avl:*/
on EnvVar HMI_EVC_50_TaxInMirr_Avl
{
    _mEVC_CfgBit_33_64_AR.EVC_50_TaxInMirr_Avl.phys = getValue(this);
}
/*@@end*/

/*@@envVar:HMI_EVC_51_DistRecInMirr_Avl:*/
on EnvVar HMI_EVC_51_DistRecInMirr_Avl
{
    _mEVC_CfgBit_33_64_AR.EVC_51_DistRecInMirr_Avl.phys = getValue(this);
}
/*@@end*/

/*@@envVar:HMI_EVC_52_PreInstRad_Avl:*/
on EnvVar HMI_EVC_52_PreInstRad_Avl
{
    _mEVC_CfgBit_33_64_AR.EVC_52_PreInstRad_Avl.phys = getValue(this);
}
/*@@end*/

/*@@envVar:HMI_EVC_53_VehHandi_Avl:*/
on EnvVar HMI_EVC_53_VehHandi_Avl
{
    _mEVC_CfgBit_33_64_AR.EVC_53_VehHandi_Avl.phys = getValue(this);
}
/*@@end*/

/*@@envVar:HMI_EVC_54_PanelHt_Ft_Avl:*/
on EnvVar HMI_EVC_54_PanelHt_Ft_Avl
{
    _mEVC_CfgBit_33_64_AR.EVC_54_PanelHt_Ft_Avl.phys = getValue(this);
}
/*@@end*/

/*@@envVar:HMI_EVC_55_SeatComfHt_Ft_Avl:*/
on EnvVar HMI_EVC_55_SeatComfHt_Ft_Avl
{
    _mEVC_CfgBit_33_64_AR.EVC_55_SeatComfHt_Ft_Avl.phys = getValue(this);
}
/*@@end*/

/*@@envVar:HMI_EVC_56_SeatComfHt_R_Avl:*/
on EnvVar HMI_EVC_56_SeatComfHt_R_Avl
{
    _mEVC_CfgBit_33_64_AR.EVC_56_SeatComfHt_R_Avl.phys = getValue(this);
}
/*@@end*/

/*@@envVar:HMI_EVC_57_IntFoldHdRst_Ft_Avl:*/
on EnvVar HMI_EVC_57_IntFoldHdRst_Ft_Avl
{
    _mEVC_CfgBit_33_64_AR.EVC_57_IntFoldHdRst_Ft_Avl.phys = getValue(this);
}
/*@@end*/

/*@@envVar:HMI_EVC_58_SeatInd_R_Avl:*/
on EnvVar HMI_EVC_58_SeatInd_R_Avl
{
    _mEVC_CfgBit_33_64_AR.EVC_58_SeatInd_R_Avl.phys = getValue(this);
}
/*@@end*/

/*@@envVar:HMI_EVC_59_SeatChauffPos_P_Avl:*/
on EnvVar HMI_EVC_59_SeatChauffPos_P_Avl
{
    _mEVC_CfgBit_33_64_AR.EVC_59_SeatChauffPos_P_Avl.phys = getValue(this);
}
/*@@end*/

/*@@envVar:HMI_EVC_5A_SeatMContMass_Ft_Avl:*/
on EnvVar HMI_EVC_5A_SeatMContMass_Ft_Avl
{
    _mEVC_CfgBit_33_64_AR.EVC_5A_SeatMContMass_Ft_Avl.phys = getValue(this);
}
/*@@end*/

/*@@envVar:HMI_EVC_5B_PanelHt_R_Avl:*/
on EnvVar HMI_EVC_5B_PanelHt_R_Avl
{
    _mEVC_CfgBit_33_64_AR.EVC_5B_PanelHt_R_Avl.phys = getValue(this);
}
/*@@end*/

/*@@envVar:HMI_EVC_5C_Airscarf_Ft_Avl:*/
on EnvVar HMI_EVC_5C_Airscarf_Ft_Avl
{
    _mEVC_CfgBit_33_64_AR.EVC_5C_Airscarf_Ft_Avl.phys = getValue(this);
}
/*@@end*/

/*@@envVar:HMI_EVC_5D_SeatLimit_P_Avl:*/
on EnvVar HMI_EVC_5D_SeatLimit_P_Avl
{
    _mEVC_CfgBit_33_64_AR.EVC_5D_SeatLimit_P_Avl.phys = getValue(this);
}
/*@@end*/

/*@@envVar:HMI_EVC_5E_TaxiRoofLmp_Avl:*/
on EnvVar HMI_EVC_5E_TaxiRoofLmp_Avl
{
    _mEVC_CfgBit_33_64_AR.EVC_5E_TaxiRoofLmp_Avl.phys = getValue(this);
}
/*@@end*/

/*@@envVar:HMI_EVC_5F_SeatElAdj_LHD_Avl:*/
on EnvVar HMI_EVC_5F_SeatElAdj_LHD_Avl
{
    _mEVC_CfgBit_33_64_AR.EVC_5F_SeatElAdj_LHD_Avl.phys = getValue(this);
}
/*@@end*/

/*@@envVar:HMI_EVC_60_SeatElAdj_RHD_Avl:*/
on EnvVar HMI_EVC_60_SeatElAdj_RHD_Avl
{
    _mEVC_CfgBit_33_64_AR.EVC_60_SeatElAdj_RHD_Avl.phys = getValue(this);
}
/*@@end*/

/*@@envVar:HMI_EVC_61_AMGPerfSusp_Avl:*/
on EnvVar HMI_EVC_61_AMGPerfSusp_Avl
{
    _mEVC_CfgBit_33_64_AR.EVC_61_AMGPerfSusp_Avl.phys = getValue(this);
}
/*@@end*/

/*@@envVar:HMI_EVC_62_ShiftExhstSys_Avl:*/
on EnvVar HMI_EVC_62_ShiftExhstSys_Avl
{
    _mEVC_CfgBit_33_64_AR.EVC_62_ShiftExhstSys_Avl.phys = getValue(this);
}
/*@@end*/

/*@@envVar:HMI_EVC_63_ActvLDA_MPC_Avl:*/
on EnvVar HMI_EVC_63_ActvLDA_MPC_Avl
{
    _mEVC_CfgBit_33_64_AR.EVC_63_ActvLDA_MPC_Avl.phys = getValue(this);
}
/*@@end*/

/*@@envVar:HMI_EVC_64_EAS_Avl:*/
on EnvVar HMI_EVC_64_EAS_Avl
{
    _mEVC_CfgBit_33_64_AR.EVC_64_EAS_Avl.phys = getValue(this);
}
/*@@end*/

/*@@envVar:HMI_EVC_CfgBit_33_64_Stat:*/
on EnvVar HMI_EVC_CfgBit_33_64_Stat
{
    _mEVC_CfgBit_33_64_AR.EVC_CfgBit_33_64_Stat.phys = getValue(this);
}
/*@@end*/

/*@@caplFunc:EVC_CfgBit_65_96_AR_check_output():*/
EVC_CfgBit_65_96_AR_check_output()
{
    if( !getValue( HMI__STMSG_EVC_CfgBit_65_96_AR ) )
    {
        // Botschaft EVC_CfgBit_65_96_AR ID: 757 --- Sendeart 0 cyclicX --- 
        _EVC_CfgBit_65_96_AR_Cnt--;
        if( _EVC_CfgBit_65_96_AR_Cnt < 1 )
        {
            // Nachricht wg. abgelaufenem Zyklus ausgeben
            EVC_CfgBit_65_96_AR_output();
            // Zyklus-Zähler zurücksetzen
            _EVC_CfgBit_65_96_AR_Cnt = _EVC_CfgBit_65_96_AR_CycleCount;
        }
    }
}
/*@@end*/

/*@@caplFunc:EVC_CfgBit_65_96_AR_init():*/
EVC_CfgBit_65_96_AR_init()
{   /* Botschaft EVC_CfgBit_65_96_AR ID: 757 --- Sendeart 0 cyclicX --- 
BA_ "ApplMessage" BO_ 757 0;
BA_ "NmAsrMessage" BO_ 757 0;
BA_ "GenMsgMinAcceptLength" BO_ 757 8;
BA_ "GenMsgILSupport" BO_ 757 1;
BA_ "DiagState" BO_ 757 0;
BA_ "DiagRequest" BO_ 757 0;
BA_ "DiagResponse" BO_ 757 0;
BA_ "GenMsgStartValue" BO_ 757 "0";
BA_ "GenMsgStartDelayTime" BO_ 757 145;
BA_ "GenMsgCycleTime" BO_ 757 1000;
BA_ "GenMsgSendType" BO_ 757 0;
    */
    _EVC_CfgBit_65_96_AR_Timebase =        c_tDBKomTimer_20ms;
    _EVC_CfgBit_65_96_AR_CycleCount =    1000 / _EVC_CfgBit_65_96_AR_Timebase;
    _EVC_CfgBit_65_96_AR_StartDelay =     145 / _EVC_CfgBit_65_96_AR_Timebase;
    _EVC_CfgBit_65_96_AR_Cnt = _EVC_CfgBit_65_96_AR_StartDelay;

    putValue( HMI__STMSGSD_EVC_CfgBit_65_96_AR, _EVC_CfgBit_65_96_AR_StartDelay * _EVC_CfgBit_65_96_AR_Timebase );

    _mEVC_CfgBit_65_96_AR.EVC_65_CruiseCtrl_Avl.phys = getValue( HMI_EVC_65_CruiseCtrl_Avl );
    _mEVC_CfgBit_65_96_AR.EVC_66_OffRoadPk_Avl.phys = getValue( HMI_EVC_66_OffRoadPk_Avl );
    _mEVC_CfgBit_65_96_AR.EVC_67_CMS_Avl.phys = getValue( HMI_EVC_67_CMS_Avl );
    _mEVC_CfgBit_65_96_AR.EVC_68_CMS_R_Avl.phys = getValue( HMI_EVC_68_CMS_R_Avl );
    _mEVC_CfgBit_65_96_AR.EVC_69_BrkEngg_PP_Avl.phys = getValue( HMI_EVC_69_BrkEngg_PP_Avl );
    _mEVC_CfgBit_65_96_AR.EVC_6A_BasExtd_Avl.phys = getValue( HMI_EVC_6A_BasExtd_Avl );
    _mEVC_CfgBit_65_96_AR.EVC_6B_MirrFld_Avl.phys = getValue( HMI_EVC_6B_MirrFld_Avl );
    _mEVC_CfgBit_65_96_AR.EVC_6C_BSM_Avl.phys = getValue( HMI_EVC_6C_BSM_Avl );
    _mEVC_CfgBit_65_96_AR.EVC_6D_ActvBSM_Avl.phys = getValue( HMI_EVC_6D_ActvBSM_Avl );
    _mEVC_CfgBit_65_96_AR.EVC_6E_TurnAss_Avl.phys = getValue( HMI_EVC_6E_TurnAss_Avl );
    _mEVC_CfgBit_65_96_AR.EVC_6F_ADTR_Avl.phys = getValue( HMI_EVC_6F_ADTR_Avl );
    _mEVC_CfgBit_65_96_AR.EVC_70_DTR_Pro_Avl.phys = getValue( HMI_EVC_70_DTR_Pro_Avl );
    _mEVC_CfgBit_65_96_AR.EVC_71_ALS_Avl.phys = getValue( HMI_EVC_71_ALS_Avl );
    _mEVC_CfgBit_65_96_AR.EVC_72_ActvLDA_Avl.phys = getValue( HMI_EVC_72_ActvLDA_Avl );
    _mEVC_CfgBit_65_96_AR.EVC_73_FCW_Avl.phys = getValue( HMI_EVC_73_FCW_Avl );
    _mEVC_CfgBit_65_96_AR.EVC_74_LaneRec_Avl.phys = getValue( HMI_EVC_74_LaneRec_Avl );
    _mEVC_CfgBit_65_96_AR.EVC_75_NV_Avl.phys = getValue( HMI_EVC_75_NV_Avl );
    _mEVC_CfgBit_65_96_AR.EVC_76_RoadSignDtct_Avl.phys = getValue( HMI_EVC_76_RoadSignDtct_Avl );
    _mEVC_CfgBit_65_96_AR.EVC_77_RVC_Avl.phys = getValue( HMI_EVC_77_RVC_Avl );
    _mEVC_CfgBit_65_96_AR.EVC_78_SurrView_Avl.phys = getValue( HMI_EVC_78_SurrView_Avl );
    _mEVC_CfgBit_65_96_AR.EVC_79_PTS_Avl.phys = getValue( HMI_EVC_79_PTS_Avl );
    _mEVC_CfgBit_65_96_AR.EVC_7A_APG_Avl.phys = getValue( HMI_EVC_7A_APG_Avl );
    _mEVC_CfgBit_65_96_AR.EVC_7B_ActPKAS_Avl .phys = getValue( HMI_EVC_7B_ActPKAS_Avl  );
    _mEVC_CfgBit_65_96_AR.EVC_7C_IHC_Avl.phys = getValue( HMI_EVC_7C_IHC_Avl );
    _mEVC_CfgBit_65_96_AR.EVC_7D_IHC_Plus_Avl.phys = getValue( HMI_EVC_7D_IHC_Plus_Avl );
    _mEVC_CfgBit_65_96_AR.EVC_7E_BasPlusQ_Avl.phys = getValue( HMI_EVC_7E_BasPlusQ_Avl );
    _mEVC_CfgBit_65_96_AR.EVC_7F_ECO_St_Avl.phys = getValue( HMI_EVC_7F_ECO_St_Avl );
    _mEVC_CfgBit_65_96_AR.EVC_80_PSTS_Avl.phys = getValue( HMI_EVC_80_PSTS_Avl );
    _mEVC_CfgBit_65_96_AR.EVC_81_ABC_Avl.phys = getValue( HMI_EVC_81_ABC_Avl );
    _mEVC_CfgBit_65_96_AR.EVC_82_SteelAirSusp_Avl.phys = getValue( HMI_EVC_82_SteelAirSusp_Avl );
    _mEVC_CfgBit_65_96_AR.EVC_83_AirSemiActv_Susp_Avl.phys = getValue( HMI_EVC_83_AirSemiActv_Susp_Avl );
    _mEVC_CfgBit_65_96_AR.EVC_84_SportSusp_Avl.phys = getValue( HMI_EVC_84_SportSusp_Avl );
    _mEVC_CfgBit_65_96_AR.EVC_85_SportPk_AMG_Avl.phys = getValue( HMI_EVC_85_SportPk_AMG_Avl );
    _mEVC_CfgBit_65_96_AR.EVC_86_SportPk_Avl.phys = getValue( HMI_EVC_86_SportPk_Avl );
    _mEVC_CfgBit_65_96_AR.EVC_87_SportPk_Ext_Avl.phys = getValue( HMI_EVC_87_SportPk_Ext_Avl );
    _mEVC_CfgBit_65_96_AR.EVC_88_DualView_Avl.phys = getValue( HMI_EVC_88_DualView_Avl );
    _mEVC_CfgBit_65_96_AR.EVC_89_Entertain_R_Avl.phys = getValue( HMI_EVC_89_Entertain_R_Avl );
    _mEVC_CfgBit_65_96_AR.EVC_8A_DigTV_Avl.phys = getValue( HMI_EVC_8A_DigTV_Avl );
    _mEVC_CfgBit_65_96_AR.EVC_8B_DAB_Tun_Avl.phys = getValue( HMI_EVC_8B_DAB_Tun_Avl );
    _mEVC_CfgBit_65_96_AR.EVC_8C_MTUS_Avl.phys = getValue( HMI_EVC_8C_MTUS_Avl );
    _mEVC_CfgBit_65_96_AR.EVC_8D_UCI_Avl.phys = getValue( HMI_EVC_8D_UCI_Avl );
    _mEVC_CfgBit_65_96_AR.EVC_8E_SndSys_Avl.phys = getValue( HMI_EVC_8E_SndSys_Avl );
    _mEVC_CfgBit_65_96_AR.EVC_8F_WShViewWin_Avl.phys = getValue( HMI_EVC_8F_WShViewWin_Avl );
    _mEVC_CfgBit_65_96_AR.EVC_90_WSh_Clr_Avl.phys = getValue( HMI_EVC_90_WSh_Clr_Avl );
    _mEVC_CfgBit_65_96_AR.EVC_91_WSh_Ht_Avl.phys = getValue( HMI_EVC_91_WSh_Ht_Avl );
    _mEVC_CfgBit_65_96_AR.EVC_92_WShBL_Prot_Avl.phys = getValue( HMI_EVC_92_WShBL_Prot_Avl );
    _mEVC_CfgBit_65_96_AR.EVC_93_WSh_Ht_Lcut_Avl.phys = getValue( HMI_EVC_93_WSh_Ht_Lcut_Avl );
    _mEVC_CfgBit_65_96_AR.EVC_94_OptPack_Clas_Avl.phys = getValue( HMI_EVC_94_OptPack_Clas_Avl );
    _mEVC_CfgBit_65_96_AR.EVC_95_OptPack_Avan_Avl.phys = getValue( HMI_EVC_95_OptPack_Avan_Avl );
    _mEVC_CfgBit_65_96_AR.EVC_96_OptPack_Eleg_Avl.phys = getValue( HMI_EVC_96_OptPack_Eleg_Avl );
    _mEVC_CfgBit_65_96_AR.EVC_CfgBit_65_96_Stat.phys = getValue( HMI_EVC_CfgBit_65_96_Stat );
}
/*@@end*/

/*@@caplFunc:EVC_CfgBit_65_96_AR_output():*/
void EVC_CfgBit_65_96_AR_output(void)
{
    byte crc;
    byte SQC_help;

    if( !getValue( HMI_SQC_EVC_CfgBit_65_96_Auto ) )
    {
        // berechne message counter
        SQC_help = getValue( HMI_SQC_EVC_CfgBit_65_96 );
        if( SQC_help >= 15 ) SQC_help = 0;
        else SQC_help++;
        putValue( HMI_SQC_EVC_CfgBit_65_96, SQC_help );
        _mEVC_CfgBit_65_96_AR.SQC_EVC_CfgBit_65_96 = SQC_help;
    }
    else
          _mEVC_CfgBit_65_96_AR.SQC_EVC_CfgBit_65_96 = getValue( HMI_SQC_EVC_CfgBit_65_96 );

    if( getValue( HMI_CRC_EVC_CfgBit_65_96_Profile_02 ) )
    {
         if( !getValue( HMI_CRC_EVC_CfgBit_65_96_Auto ) )
        {   // CRC according to SAE1850 ( W222 )
            // berechne crc
            crc = 0xFF;
//          crc = crctable_profile02[ crc ^ _mXXX.byte( 0 ) ];
            crc = crctable_profile02[ crc ^ _mEVC_CfgBit_65_96_AR.byte( 1 ) ];
            crc = crctable_profile02[ crc ^ _mEVC_CfgBit_65_96_AR.byte( 2 ) ];
            crc = crctable_profile02[ crc ^ _mEVC_CfgBit_65_96_AR.byte( 3 ) ];
            crc = crctable_profile02[ crc ^ _mEVC_CfgBit_65_96_AR.byte( 4 ) ];
            crc = crctable_profile02[ crc ^ _mEVC_CfgBit_65_96_AR.byte( 5 ) ];
            crc = crctable_profile02[ crc ^ _mEVC_CfgBit_65_96_AR.byte( 6 ) ];
            crc = crctable_profile02[ crc ^ _mEVC_CfgBit_65_96_AR.byte( 7 ) ];
            crc = crctable_profile02[ crc ^ _EVC_CfgBit_65_96_AR_CRC_Offset[ _mEVC_CfgBit_65_96_AR.SQC_EVC_CfgBit_65_96 ] ]; // load offset
            crc = (crc ^ 0xFF);
            if( getValue(  HMI_CRC_EVC_CfgBit_65_96_Invalid ) )
                crc++;
            _mEVC_CfgBit_65_96_AR.CRC_EVC_CfgBit_65_96 = crc;
            putValue( HMI_CRC_EVC_CfgBit_65_96, crc );
        }
        else
            _mEVC_CfgBit_65_96_AR.CRC_EVC_CfgBit_65_96 = getValue( HMI_CRC_EVC_CfgBit_65_96);
    }
    else
    {
         if( !getValue( HMI_CRC_EVC_CfgBit_65_96_Auto ) )
        {   // CRC according to SAE1850 ( W222 )
            // berechne crc
            crc = 0xFF;
            crc = crctable[ crc ^ _mEVC_CfgBit_65_96_AR.byte( 1 ) ];
            crc = crctable[ crc ^ _mEVC_CfgBit_65_96_AR.byte( 2 ) ];
            crc = crctable[ crc ^ _mEVC_CfgBit_65_96_AR.byte( 3 ) ];
            crc = crctable[ crc ^ _mEVC_CfgBit_65_96_AR.byte( 4 ) ];
            crc = crctable[ crc ^ _mEVC_CfgBit_65_96_AR.byte( 5 ) ];
            crc = crctable[ crc ^ _mEVC_CfgBit_65_96_AR.byte( 6 ) ];
            crc = crctable[ crc ^ _mEVC_CfgBit_65_96_AR.byte( 7 ) ];
            crc = (crc ^ 0xFF);
            if( getValue(  HMI_CRC_EVC_CfgBit_65_96_Invalid ) )
                crc++;
            _mEVC_CfgBit_65_96_AR.CRC_EVC_CfgBit_65_96 = crc;
            putValue( HMI_CRC_EVC_CfgBit_65_96, crc );
        }
        else
            _mEVC_CfgBit_65_96_AR.CRC_EVC_CfgBit_65_96 = getValue( HMI_CRC_EVC_CfgBit_65_96);
    }
    output( _mEVC_CfgBit_65_96_AR );
}
/*@@end*/

/*@@caplFunc:EVC_CfgBit_65_96_AR_saveEnvVars(dword):*/
EVC_CfgBit_65_96_AR_saveEnvVars( dword hFile )
{
    filePutString("\n// Knoten EIS: EVC_CfgBit_65_96_AR\n", 33, hFile );
    snprintf( buffer, elcount( buffer ), "0.0000 HMI__STMSG_EVC_CfgBit_65_96 := %X\n", getValue( HMI__STMSG_EVC_CfgBit_65_96_AR ) );    filePutString( buffer, elcount( buffer ), hFile );
    snprintf( buffer, elcount( buffer ), "0.0000 HMI__STMSGT_EVC_CfgBit_65_96 := %X\n", getValue( HMI__STMSGT_EVC_CfgBit_65_96_AR ) );    filePutString( buffer, elcount( buffer ), hFile );
    snprintf( buffer, elcount( buffer ), "0.0000 HMI_CRC_EVC_CfgBit_65_96 := %X\n", getValue( HMI_CRC_EVC_CfgBit_65_96 ) );    filePutString( buffer, elcount( buffer ), hFile );
    snprintf( buffer, elcount( buffer ), "0.0000 HMI_CRC_EVC_CfgBit_65_96_Auto := %X\n", getValue( HMI_CRC_EVC_CfgBit_65_96_Auto ) );    filePutString( buffer, elcount( buffer ), hFile );
    snprintf( buffer, elcount( buffer ), "0.0000 HMI_EVC_65_CruiseCtrl_Avl := %X\n", getValue( HMI_EVC_65_CruiseCtrl_Avl ) );    filePutString( buffer, elcount( buffer ), hFile );
    snprintf( buffer, elcount( buffer ), "0.0000 HMI_EVC_66_OffRoadPk_Avl := %X\n", getValue( HMI_EVC_66_OffRoadPk_Avl ) );    filePutString( buffer, elcount( buffer ), hFile );
    snprintf( buffer, elcount( buffer ), "0.0000 HMI_EVC_67_CMS_Avl := %X\n", getValue( HMI_EVC_67_CMS_Avl ) );    filePutString( buffer, elcount( buffer ), hFile );
    snprintf( buffer, elcount( buffer ), "0.0000 HMI_EVC_68_CMS_R_Avl := %X\n", getValue( HMI_EVC_68_CMS_R_Avl ) );    filePutString( buffer, elcount( buffer ), hFile );
    snprintf( buffer, elcount( buffer ), "0.0000 HMI_EVC_69_BrkEngg_PP_Avl := %X\n", getValue( HMI_EVC_69_BrkEngg_PP_Avl ) );    filePutString( buffer, elcount( buffer ), hFile );
    snprintf( buffer, elcount( buffer ), "0.0000 HMI_EVC_6A_BasExtd_Avl := %X\n", getValue( HMI_EVC_6A_BasExtd_Avl ) );    filePutString( buffer, elcount( buffer ), hFile );
    snprintf( buffer, elcount( buffer ), "0.0000 HMI_EVC_6B_MirrFld_Avl := %X\n", getValue( HMI_EVC_6B_MirrFld_Avl ) );    filePutString( buffer, elcount( buffer ), hFile );
    snprintf( buffer, elcount( buffer ), "0.0000 HMI_EVC_6C_BSM_Avl := %X\n", getValue( HMI_EVC_6C_BSM_Avl ) );    filePutString( buffer, elcount( buffer ), hFile );
    snprintf( buffer, elcount( buffer ), "0.0000 HMI_EVC_6D_ActvBSM_Avl := %X\n", getValue( HMI_EVC_6D_ActvBSM_Avl ) );    filePutString( buffer, elcount( buffer ), hFile );
    snprintf( buffer, elcount( buffer ), "0.0000 HMI_EVC_6E_TurnAss_Avl := %X\n", getValue( HMI_EVC_6E_TurnAss_Avl ) );    filePutString( buffer, elcount( buffer ), hFile );
    snprintf( buffer, elcount( buffer ), "0.0000 HMI_EVC_6F_ADTR_Avl := %X\n", getValue( HMI_EVC_6F_ADTR_Avl ) );    filePutString( buffer, elcount( buffer ), hFile );
    snprintf( buffer, elcount( buffer ), "0.0000 HMI_EVC_70_DTR_Pro_Avl := %X\n", getValue( HMI_EVC_70_DTR_Pro_Avl ) );    filePutString( buffer, elcount( buffer ), hFile );
    snprintf( buffer, elcount( buffer ), "0.0000 HMI_EVC_71_ALS_Avl := %X\n", getValue( HMI_EVC_71_ALS_Avl ) );    filePutString( buffer, elcount( buffer ), hFile );
    snprintf( buffer, elcount( buffer ), "0.0000 HMI_EVC_72_ActvLDA_Avl := %X\n", getValue( HMI_EVC_72_ActvLDA_Avl ) );    filePutString( buffer, elcount( buffer ), hFile );
    snprintf( buffer, elcount( buffer ), "0.0000 HMI_EVC_73_FCW_Avl := %X\n", getValue( HMI_EVC_73_FCW_Avl ) );    filePutString( buffer, elcount( buffer ), hFile );
    snprintf( buffer, elcount( buffer ), "0.0000 HMI_EVC_74_LaneRec_Avl := %X\n", getValue( HMI_EVC_74_LaneRec_Avl ) );    filePutString( buffer, elcount( buffer ), hFile );
    snprintf( buffer, elcount( buffer ), "0.0000 HMI_EVC_75_NV_Avl := %X\n", getValue( HMI_EVC_75_NV_Avl ) );    filePutString( buffer, elcount( buffer ), hFile );
    snprintf( buffer, elcount( buffer ), "0.0000 HMI_EVC_76_RoadSignDtct_Avl := %X\n", getValue( HMI_EVC_76_RoadSignDtct_Avl ) );    filePutString( buffer, elcount( buffer ), hFile );
    snprintf( buffer, elcount( buffer ), "0.0000 HMI_EVC_77_RVC_Avl := %X\n", getValue( HMI_EVC_77_RVC_Avl ) );    filePutString( buffer, elcount( buffer ), hFile );
    snprintf( buffer, elcount( buffer ), "0.0000 HMI_EVC_78_SurrView_Avl := %X\n", getValue( HMI_EVC_78_SurrView_Avl ) );    filePutString( buffer, elcount( buffer ), hFile );
    snprintf( buffer, elcount( buffer ), "0.0000 HMI_EVC_79_PTS_Avl := %X\n", getValue( HMI_EVC_79_PTS_Avl ) );    filePutString( buffer, elcount( buffer ), hFile );
    snprintf( buffer, elcount( buffer ), "0.0000 HMI_EVC_7A_APG_Avl := %X\n", getValue( HMI_EVC_7A_APG_Avl ) );    filePutString( buffer, elcount( buffer ), hFile );
    snprintf( buffer, elcount( buffer ), "0.0000 HMI_EVC_7B_ActPKAS_Avl  := %X\n", getValue( HMI_EVC_7B_ActPKAS_Avl  ) );    filePutString( buffer, elcount( buffer ), hFile );
    snprintf( buffer, elcount( buffer ), "0.0000 HMI_EVC_7C_IHC_Avl := %X\n", getValue( HMI_EVC_7C_IHC_Avl ) );    filePutString( buffer, elcount( buffer ), hFile );
    snprintf( buffer, elcount( buffer ), "0.0000 HMI_EVC_7D_IHC_Plus_Avl := %X\n", getValue( HMI_EVC_7D_IHC_Plus_Avl ) );    filePutString( buffer, elcount( buffer ), hFile );
    snprintf( buffer, elcount( buffer ), "0.0000 HMI_EVC_7E_BasPlusQ_Avl := %X\n", getValue( HMI_EVC_7E_BasPlusQ_Avl ) );    filePutString( buffer, elcount( buffer ), hFile );
    snprintf( buffer, elcount( buffer ), "0.0000 HMI_EVC_7F_ECO_St_Avl := %X\n", getValue( HMI_EVC_7F_ECO_St_Avl ) );    filePutString( buffer, elcount( buffer ), hFile );
    snprintf( buffer, elcount( buffer ), "0.0000 HMI_EVC_80_PSTS_Avl := %X\n", getValue( HMI_EVC_80_PSTS_Avl ) );    filePutString( buffer, elcount( buffer ), hFile );
    snprintf( buffer, elcount( buffer ), "0.0000 HMI_EVC_81_ABC_Avl := %X\n", getValue( HMI_EVC_81_ABC_Avl ) );    filePutString( buffer, elcount( buffer ), hFile );
    snprintf( buffer, elcount( buffer ), "0.0000 HMI_EVC_82_SteelAirSusp_Avl := %X\n", getValue( HMI_EVC_82_SteelAirSusp_Avl ) );    filePutString( buffer, elcount( buffer ), hFile );
    snprintf( buffer, elcount( buffer ), "0.0000 HMI_EVC_83_AirSemiActv_Susp_Avl := %X\n", getValue( HMI_EVC_83_AirSemiActv_Susp_Avl ) );    filePutString( buffer, elcount( buffer ), hFile );
    snprintf( buffer, elcount( buffer ), "0.0000 HMI_EVC_84_SportSusp_Avl := %X\n", getValue( HMI_EVC_84_SportSusp_Avl ) );    filePutString( buffer, elcount( buffer ), hFile );
    snprintf( buffer, elcount( buffer ), "0.0000 HMI_EVC_85_SportPk_AMG_Avl := %X\n", getValue( HMI_EVC_85_SportPk_AMG_Avl ) );    filePutString( buffer, elcount( buffer ), hFile );
    snprintf( buffer, elcount( buffer ), "0.0000 HMI_EVC_86_SportPk_Avl := %X\n", getValue( HMI_EVC_86_SportPk_Avl ) );    filePutString( buffer, elcount( buffer ), hFile );
    snprintf( buffer, elcount( buffer ), "0.0000 HMI_EVC_87_SportPk_Ext_Avl := %X\n", getValue( HMI_EVC_87_SportPk_Ext_Avl ) );    filePutString( buffer, elcount( buffer ), hFile );
    snprintf( buffer, elcount( buffer ), "0.0000 HMI_EVC_88_DualView_Avl := %X\n", getValue( HMI_EVC_88_DualView_Avl ) );    filePutString( buffer, elcount( buffer ), hFile );
    snprintf( buffer, elcount( buffer ), "0.0000 HMI_EVC_89_Entertain_R_Avl := %X\n", getValue( HMI_EVC_89_Entertain_R_Avl ) );    filePutString( buffer, elcount( buffer ), hFile );
    snprintf( buffer, elcount( buffer ), "0.0000 HMI_EVC_8A_DigTV_Avl := %X\n", getValue( HMI_EVC_8A_DigTV_Avl ) );    filePutString( buffer, elcount( buffer ), hFile );
    snprintf( buffer, elcount( buffer ), "0.0000 HMI_EVC_8B_DAB_Tun_Avl := %X\n", getValue( HMI_EVC_8B_DAB_Tun_Avl ) );    filePutString( buffer, elcount( buffer ), hFile );
    snprintf( buffer, elcount( buffer ), "0.0000 HMI_EVC_8C_MTUS_Avl := %X\n", getValue( HMI_EVC_8C_MTUS_Avl ) );    filePutString( buffer, elcount( buffer ), hFile );
    snprintf( buffer, elcount( buffer ), "0.0000 HMI_EVC_8D_UCI_Avl := %X\n", getValue( HMI_EVC_8D_UCI_Avl ) );    filePutString( buffer, elcount( buffer ), hFile );
    snprintf( buffer, elcount( buffer ), "0.0000 HMI_EVC_8E_SndSys_Avl := %X\n", getValue( HMI_EVC_8E_SndSys_Avl ) );    filePutString( buffer, elcount( buffer ), hFile );
    snprintf( buffer, elcount( buffer ), "0.0000 HMI_EVC_8F_WShViewWin_Avl := %X\n", getValue( HMI_EVC_8F_WShViewWin_Avl ) );    filePutString( buffer, elcount( buffer ), hFile );
    snprintf( buffer, elcount( buffer ), "0.0000 HMI_EVC_90_WSh_Clr_Avl := %X\n", getValue( HMI_EVC_90_WSh_Clr_Avl ) );    filePutString( buffer, elcount( buffer ), hFile );
    snprintf( buffer, elcount( buffer ), "0.0000 HMI_EVC_91_WSh_Ht_Avl := %X\n", getValue( HMI_EVC_91_WSh_Ht_Avl ) );    filePutString( buffer, elcount( buffer ), hFile );
    snprintf( buffer, elcount( buffer ), "0.0000 HMI_EVC_92_WShBL_Prot_Avl := %X\n", getValue( HMI_EVC_92_WShBL_Prot_Avl ) );    filePutString( buffer, elcount( buffer ), hFile );
    snprintf( buffer, elcount( buffer ), "0.0000 HMI_EVC_93_WSh_Ht_Lcut_Avl := %X\n", getValue( HMI_EVC_93_WSh_Ht_Lcut_Avl ) );    filePutString( buffer, elcount( buffer ), hFile );
    snprintf( buffer, elcount( buffer ), "0.0000 HMI_EVC_94_OptPack_Clas_Avl := %X\n", getValue( HMI_EVC_94_OptPack_Clas_Avl ) );    filePutString( buffer, elcount( buffer ), hFile );
    snprintf( buffer, elcount( buffer ), "0.0000 HMI_EVC_95_OptPack_Avan_Avl := %X\n", getValue( HMI_EVC_95_OptPack_Avan_Avl ) );    filePutString( buffer, elcount( buffer ), hFile );
    snprintf( buffer, elcount( buffer ), "0.0000 HMI_EVC_96_OptPack_Eleg_Avl := %X\n", getValue( HMI_EVC_96_OptPack_Eleg_Avl ) );    filePutString( buffer, elcount( buffer ), hFile );
    snprintf( buffer, elcount( buffer ), "0.0000 HMI_EVC_CfgBit_65_96_Stat := %X\n", getValue( HMI_EVC_CfgBit_65_96_Stat ) );    filePutString( buffer, elcount( buffer ), hFile );
    snprintf( buffer, elcount( buffer ), "0.0000 HMI_SQC_EVC_CfgBit_65_96 := %X\n", getValue( HMI_SQC_EVC_CfgBit_65_96 ) );    filePutString( buffer, elcount( buffer ), hFile );
    snprintf( buffer, elcount( buffer ), "0.0000 HMI_SQC_EVC_CfgBit_65_96_Auto := %X\n", getValue( HMI_SQC_EVC_CfgBit_65_96_Auto ) );    filePutString( buffer, elcount( buffer ), hFile );
}
/*@@end*/

/*@@timer:_tEVC_CfgBit_65_96_AR:*/
on timer _tEVC_CfgBit_65_96_AR
{
    putValue( HMI__STMSG_EVC_CfgBit_65_96_AR, 0 );
}
/*@@end*/

/*@@envVar:HMI__STMSG_EVC_CfgBit_65_96_AR:*/
on EnvVar HMI__STMSG_EVC_CfgBit_65_96_AR
{
    long tDelay;
    if( getValue( this ) == 2 )
    {
        tDelay = getValue( HMI__STMSGT_EVC_CfgBit_65_96_AR );
        if( tDelay > 0)    
            setTimer( _tEVC_CfgBit_65_96_AR, tDelay );
        else
            putValue( HMI__STMSG_EVC_CfgBit_65_96_AR, 0 );
    }
}
/*@@end*/

/*@@envVar:HMI_EVC_65_CruiseCtrl_Avl:*/
on EnvVar HMI_EVC_65_CruiseCtrl_Avl
{
    _mEVC_CfgBit_65_96_AR.EVC_65_CruiseCtrl_Avl.phys = getValue(this);
}
/*@@end*/

/*@@envVar:HMI_EVC_66_OffRoadPk_Avl:*/
on EnvVar HMI_EVC_66_OffRoadPk_Avl
{
    _mEVC_CfgBit_65_96_AR.EVC_66_OffRoadPk_Avl.phys = getValue(this);
}
/*@@end*/

/*@@envVar:HMI_EVC_67_CMS_Avl:*/
on EnvVar HMI_EVC_67_CMS_Avl
{
    _mEVC_CfgBit_65_96_AR.EVC_67_CMS_Avl.phys = getValue(this);
}
/*@@end*/

/*@@envVar:HMI_EVC_68_CMS_R_Avl:*/
on EnvVar HMI_EVC_68_CMS_R_Avl
{
    _mEVC_CfgBit_65_96_AR.EVC_68_CMS_R_Avl.phys = getValue(this);
}
/*@@end*/

/*@@envVar:HMI_EVC_69_BrkEngg_PP_Avl:*/
on EnvVar HMI_EVC_69_BrkEngg_PP_Avl
{
    _mEVC_CfgBit_65_96_AR.EVC_69_BrkEngg_PP_Avl.phys = getValue(this);
}
/*@@end*/

/*@@envVar:HMI_EVC_6A_BasExtd_Avl:*/
on EnvVar HMI_EVC_6A_BasExtd_Avl
{
    _mEVC_CfgBit_65_96_AR.EVC_6A_BasExtd_Avl.phys = getValue(this);
}
/*@@end*/

/*@@envVar:HMI_EVC_6B_MirrFld_Avl:*/
on EnvVar HMI_EVC_6B_MirrFld_Avl
{
    _mEVC_CfgBit_65_96_AR.EVC_6B_MirrFld_Avl.phys = getValue(this);
}
/*@@end*/

/*@@envVar:HMI_EVC_6C_BSM_Avl:*/
on EnvVar HMI_EVC_6C_BSM_Avl
{
    _mEVC_CfgBit_65_96_AR.EVC_6C_BSM_Avl.phys = getValue(this);
}
/*@@end*/

/*@@envVar:HMI_EVC_6D_ActvBSM_Avl:*/
on EnvVar HMI_EVC_6D_ActvBSM_Avl
{
    _mEVC_CfgBit_65_96_AR.EVC_6D_ActvBSM_Avl.phys = getValue(this);
}
/*@@end*/

/*@@envVar:HMI_EVC_6E_TurnAss_Avl:*/
on EnvVar HMI_EVC_6E_TurnAss_Avl
{
    _mEVC_CfgBit_65_96_AR.EVC_6E_TurnAss_Avl.phys = getValue(this);
}
/*@@end*/

/*@@envVar:HMI_EVC_6F_ADTR_Avl:*/
on EnvVar HMI_EVC_6F_ADTR_Avl
{
    _mEVC_CfgBit_65_96_AR.EVC_6F_ADTR_Avl.phys = getValue(this);
}
/*@@end*/

/*@@envVar:HMI_EVC_70_DTR_Pro_Avl:*/
on EnvVar HMI_EVC_70_DTR_Pro_Avl
{
    _mEVC_CfgBit_65_96_AR.EVC_70_DTR_Pro_Avl.phys = getValue(this);
}
/*@@end*/

/*@@envVar:HMI_EVC_71_ALS_Avl:*/
on EnvVar HMI_EVC_71_ALS_Avl
{
    _mEVC_CfgBit_65_96_AR.EVC_71_ALS_Avl.phys = getValue(this);
}
/*@@end*/

/*@@envVar:HMI_EVC_72_ActvLDA_Avl:*/
on EnvVar HMI_EVC_72_ActvLDA_Avl
{
    _mEVC_CfgBit_65_96_AR.EVC_72_ActvLDA_Avl.phys = getValue(this);
}
/*@@end*/

/*@@envVar:HMI_EVC_73_FCW_Avl:*/
on EnvVar HMI_EVC_73_FCW_Avl
{
    _mEVC_CfgBit_65_96_AR.EVC_73_FCW_Avl.phys = getValue(this);
}
/*@@end*/

/*@@envVar:HMI_EVC_74_LaneRec_Avl:*/
on EnvVar HMI_EVC_74_LaneRec_Avl
{
    _mEVC_CfgBit_65_96_AR.EVC_74_LaneRec_Avl.phys = getValue(this);
}
/*@@end*/

/*@@envVar:HMI_EVC_75_NV_Avl:*/
on EnvVar HMI_EVC_75_NV_Avl
{
    _mEVC_CfgBit_65_96_AR.EVC_75_NV_Avl.phys = getValue(this);
}
/*@@end*/

/*@@envVar:HMI_EVC_76_RoadSignDtct_Avl:*/
on EnvVar HMI_EVC_76_RoadSignDtct_Avl
{
    _mEVC_CfgBit_65_96_AR.EVC_76_RoadSignDtct_Avl.phys = getValue(this);
}
/*@@end*/

/*@@envVar:HMI_EVC_77_RVC_Avl:*/
on EnvVar HMI_EVC_77_RVC_Avl
{
    _mEVC_CfgBit_65_96_AR.EVC_77_RVC_Avl.phys = getValue(this);
}
/*@@end*/

/*@@envVar:HMI_EVC_78_SurrView_Avl:*/
on EnvVar HMI_EVC_78_SurrView_Avl
{
    _mEVC_CfgBit_65_96_AR.EVC_78_SurrView_Avl.phys = getValue(this);
}
/*@@end*/

/*@@envVar:HMI_EVC_79_PTS_Avl:*/
on EnvVar HMI_EVC_79_PTS_Avl
{
    _mEVC_CfgBit_65_96_AR.EVC_79_PTS_Avl.phys = getValue(this);
}
/*@@end*/

/*@@envVar:HMI_EVC_7A_APG_Avl:*/
on EnvVar HMI_EVC_7A_APG_Avl
{
    _mEVC_CfgBit_65_96_AR.EVC_7A_APG_Avl.phys = getValue(this);
}
/*@@end*/

/*@@envVar:HMI_EVC_7B_ActPKAS_Avl:*/
on EnvVar HMI_EVC_7B_ActPKAS_Avl
{
    _mEVC_CfgBit_65_96_AR.EVC_7B_ActPKAS_Avl.phys = getValue(this);
}
/*@@end*/

/*@@envVar:HMI_EVC_7C_IHC_Avl:*/
on EnvVar HMI_EVC_7C_IHC_Avl
{
    _mEVC_CfgBit_65_96_AR.EVC_7C_IHC_Avl.phys = getValue(this);
}
/*@@end*/

/*@@envVar:HMI_EVC_7D_IHC_Plus_Avl:*/
on EnvVar HMI_EVC_7D_IHC_Plus_Avl
{
    _mEVC_CfgBit_65_96_AR.EVC_7D_IHC_Plus_Avl.phys = getValue(this);
}
/*@@end*/

/*@@envVar:HMI_EVC_7E_BasPlusQ_Avl:*/
on EnvVar HMI_EVC_7E_BasPlusQ_Avl
{
    _mEVC_CfgBit_65_96_AR.EVC_7E_BasPlusQ_Avl.phys = getValue(this);
}
/*@@end*/

/*@@envVar:HMI_EVC_7F_ECO_St_Avl:*/
on EnvVar HMI_EVC_7F_ECO_St_Avl
{
    _mEVC_CfgBit_65_96_AR.EVC_7F_ECO_St_Avl.phys = getValue(this);
}
/*@@end*/

/*@@envVar:HMI_EVC_80_PSTS_Avl:*/
on EnvVar HMI_EVC_80_PSTS_Avl
{
    _mEVC_CfgBit_65_96_AR.EVC_80_PSTS_Avl.phys = getValue(this);
}
/*@@end*/

/*@@envVar:HMI_EVC_81_ABC_Avl:*/
on EnvVar HMI_EVC_81_ABC_Avl
{
    _mEVC_CfgBit_65_96_AR.EVC_81_ABC_Avl.phys = getValue(this);
}
/*@@end*/

/*@@envVar:HMI_EVC_82_SteelAirSusp_Avl:*/
on EnvVar HMI_EVC_82_SteelAirSusp_Avl
{
    _mEVC_CfgBit_65_96_AR.EVC_82_SteelAirSusp_Avl.phys = getValue(this);
}
/*@@end*/

/*@@envVar:HMI_EVC_83_AirSemiActv_Susp_Avl:*/
on EnvVar HMI_EVC_83_AirSemiActv_Susp_Avl
{
    _mEVC_CfgBit_65_96_AR.EVC_83_AirSemiActv_Susp_Avl.phys = getValue(this);
}
/*@@end*/

/*@@envVar:HMI_EVC_84_SportSusp_Avl:*/
on EnvVar HMI_EVC_84_SportSusp_Avl
{
    _mEVC_CfgBit_65_96_AR.EVC_84_SportSusp_Avl.phys = getValue(this);
}
/*@@end*/

/*@@envVar:HMI_EVC_85_SportPk_AMG_Avl:*/
on EnvVar HMI_EVC_85_SportPk_AMG_Avl
{
    _mEVC_CfgBit_65_96_AR.EVC_85_SportPk_AMG_Avl.phys = getValue(this);
}
/*@@end*/

/*@@envVar:HMI_EVC_86_SportPk_Avl:*/
on EnvVar HMI_EVC_86_SportPk_Avl
{
    _mEVC_CfgBit_65_96_AR.EVC_86_SportPk_Avl.phys = getValue(this);
}
/*@@end*/

/*@@envVar:HMI_EVC_87_SportPk_Ext_Avl:*/
on EnvVar HMI_EVC_87_SportPk_Ext_Avl
{
    _mEVC_CfgBit_65_96_AR.EVC_87_SportPk_Ext_Avl.phys = getValue(this);
}
/*@@end*/

/*@@envVar:HMI_EVC_88_DualView_Avl:*/
on EnvVar HMI_EVC_88_DualView_Avl
{
    _mEVC_CfgBit_65_96_AR.EVC_88_DualView_Avl.phys = getValue(this);
}
/*@@end*/

/*@@envVar:HMI_EVC_89_Entertain_R_Avl:*/
on EnvVar HMI_EVC_89_Entertain_R_Avl
{
    _mEVC_CfgBit_65_96_AR.EVC_89_Entertain_R_Avl.phys = getValue(this);
}
/*@@end*/

/*@@envVar:HMI_EVC_8A_DigTV_Avl:*/
on EnvVar HMI_EVC_8A_DigTV_Avl
{
    _mEVC_CfgBit_65_96_AR.EVC_8A_DigTV_Avl.phys = getValue(this);
}
/*@@end*/

/*@@envVar:HMI_EVC_8B_DAB_Tun_Avl:*/
on EnvVar HMI_EVC_8B_DAB_Tun_Avl
{
    _mEVC_CfgBit_65_96_AR.EVC_8B_DAB_Tun_Avl.phys = getValue(this);
}
/*@@end*/

/*@@envVar:HMI_EVC_8C_MTUS_Avl:*/
on EnvVar HMI_EVC_8C_MTUS_Avl
{
    _mEVC_CfgBit_65_96_AR.EVC_8C_MTUS_Avl.phys = getValue(this);
}
/*@@end*/

/*@@envVar:HMI_EVC_8D_UCI_Avl:*/
on EnvVar HMI_EVC_8D_UCI_Avl
{
    _mEVC_CfgBit_65_96_AR.EVC_8D_UCI_Avl.phys = getValue(this);
}
/*@@end*/

/*@@envVar:HMI_EVC_8E_SndSys_Avl:*/
on EnvVar HMI_EVC_8E_SndSys_Avl
{
    _mEVC_CfgBit_65_96_AR.EVC_8E_SndSys_Avl.phys = getValue(this);
}
/*@@end*/

/*@@envVar:HMI_EVC_8F_WShViewWin_Avl:*/
on EnvVar HMI_EVC_8F_WShViewWin_Avl
{
    _mEVC_CfgBit_65_96_AR.EVC_8F_WShViewWin_Avl.phys = getValue(this);
}
/*@@end*/

/*@@envVar:HMI_EVC_90_WSh_Clr_Avl:*/
on EnvVar HMI_EVC_90_WSh_Clr_Avl
{
    _mEVC_CfgBit_65_96_AR.EVC_90_WSh_Clr_Avl.phys = getValue(this);
}
/*@@end*/

/*@@envVar:HMI_EVC_91_WSh_Ht_Avl:*/
on EnvVar HMI_EVC_91_WSh_Ht_Avl
{
    _mEVC_CfgBit_65_96_AR.EVC_91_WSh_Ht_Avl.phys = getValue(this);
}
/*@@end*/

/*@@envVar:HMI_EVC_92_WShBL_Prot_Avl:*/
on EnvVar HMI_EVC_92_WShBL_Prot_Avl
{
    _mEVC_CfgBit_65_96_AR.EVC_92_WShBL_Prot_Avl.phys = getValue(this);
}
/*@@end*/

/*@@envVar:HMI_EVC_93_WSh_Ht_Lcut_Avl:*/
on EnvVar HMI_EVC_93_WSh_Ht_Lcut_Avl
{
    _mEVC_CfgBit_65_96_AR.EVC_93_WSh_Ht_Lcut_Avl.phys = getValue(this);
}
/*@@end*/

/*@@envVar:HMI_EVC_94_OptPack_Clas_Avl:*/
on EnvVar HMI_EVC_94_OptPack_Clas_Avl
{
    _mEVC_CfgBit_65_96_AR.EVC_94_OptPack_Clas_Avl.phys = getValue(this);
}
/*@@end*/

/*@@envVar:HMI_EVC_95_OptPack_Avan_Avl:*/
on EnvVar HMI_EVC_95_OptPack_Avan_Avl
{
    _mEVC_CfgBit_65_96_AR.EVC_95_OptPack_Avan_Avl.phys = getValue(this);
}
/*@@end*/

/*@@envVar:HMI_EVC_96_OptPack_Eleg_Avl:*/
on EnvVar HMI_EVC_96_OptPack_Eleg_Avl
{
    _mEVC_CfgBit_65_96_AR.EVC_96_OptPack_Eleg_Avl.phys = getValue(this);
}
/*@@end*/

/*@@envVar:HMI_EVC_CfgBit_65_96_Stat:*/
on EnvVar HMI_EVC_CfgBit_65_96_Stat
{
    _mEVC_CfgBit_65_96_AR.EVC_CfgBit_65_96_Stat.phys = getValue(this);
}
/*@@end*/

/*@@caplFunc:EVC_CfgBit_97_C8_AR_check_output():*/
EVC_CfgBit_97_C8_AR_check_output()
{
    if( !getValue( HMI__STMSG_EVC_CfgBit_97_C8_AR ) )
    {
        // Botschaft EVC_CfgBit_97_C8_AR ID: 910 --- Sendeart 0 cyclicX --- 
        _EVC_CfgBit_97_C8_AR_Cnt--;
        if( _EVC_CfgBit_97_C8_AR_Cnt < 1 )
        {
            // Nachricht wg. abgelaufenem Zyklus ausgeben
            EVC_CfgBit_97_C8_AR_output();
            // Zyklus-Zähler zurücksetzen
            _EVC_CfgBit_97_C8_AR_Cnt = _EVC_CfgBit_97_C8_AR_CycleCount;
        }
    }
}
/*@@end*/

/*@@caplFunc:EVC_CfgBit_97_C8_AR_init():*/
EVC_CfgBit_97_C8_AR_init()
{   /* Botschaft EVC_CfgBit_97_C8_AR ID: 910 --- Sendeart 0 cyclicX --- 
BA_ "ApplMessage" BO_ 910 0;
BA_ "NmAsrMessage" BO_ 910 0;
BA_ "GenMsgMinAcceptLength" BO_ 910 8;
BA_ "GenMsgILSupport" BO_ 910 1;
BA_ "DiagState" BO_ 910 0;
BA_ "DiagRequest" BO_ 910 0;
BA_ "DiagResponse" BO_ 910 0;
BA_ "GenMsgStartValue" BO_ 910 "0";
BA_ "GenMsgStartDelayTime" BO_ 910 245;
BA_ "GenMsgCycleTime" BO_ 910 1000;
BA_ "GenMsgSendType" BO_ 910 0;
    */
    _EVC_CfgBit_97_C8_AR_Timebase =        c_tDBKomTimer_20ms;
    _EVC_CfgBit_97_C8_AR_CycleCount =    1000 / _EVC_CfgBit_97_C8_AR_Timebase;
    _EVC_CfgBit_97_C8_AR_StartDelay =     245 / _EVC_CfgBit_97_C8_AR_Timebase;
    _EVC_CfgBit_97_C8_AR_Cnt = _EVC_CfgBit_97_C8_AR_StartDelay;

    putValue( HMI__STMSGSD_EVC_CfgBit_97_C8_AR, _EVC_CfgBit_97_C8_AR_StartDelay * _EVC_CfgBit_97_C8_AR_Timebase );

    _mEVC_CfgBit_97_C8_AR.EVC_97_ConvStWhlOp_AssSys_Avl.phys = getValue( HMI_EVC_97_ConvStWhlOp_AssSys_Avl );
    _mEVC_CfgBit_97_C8_AR.EVC_98_AMG_PerfSeat_Avl.phys = getValue( HMI_EVC_98_AMG_PerfSeat_Avl );
    _mEVC_CfgBit_97_C8_AR.EVC_99_RemPark_Avl.phys = getValue( HMI_EVC_99_RemPark_Avl );
    _mEVC_CfgBit_97_C8_AR.EVC_9A_PresfImpls_Sd_Avl.phys = getValue( HMI_EVC_9A_PresfImpls_Sd_Avl );
    _mEVC_CfgBit_97_C8_AR.EVC_9B_ADSPlus_Avl.phys = getValue( HMI_EVC_9B_ADSPlus_Avl );
    _mEVC_CfgBit_97_C8_AR.EVC_9C_PullmanGuard_Avl.phys = getValue( HMI_EVC_9C_PullmanGuard_Avl );
    _mEVC_CfgBit_97_C8_AR.EVC_9D_Allroad_Avl.phys = getValue( HMI_EVC_9D_Allroad_Avl );
    _mEVC_CfgBit_97_C8_AR.EVC_9E_AddEquip_Avl.phys = getValue( HMI_EVC_9E_AddEquip_Avl );
    _mEVC_CfgBit_97_C8_AR.EVC_9F_AddEquip_Avl.phys = getValue( HMI_EVC_9F_AddEquip_Avl );
    _mEVC_CfgBit_97_C8_AR.EVC_A0_AddEquip_Avl.phys = getValue( HMI_EVC_A0_AddEquip_Avl );
    _mEVC_CfgBit_97_C8_AR.EVC_A1_AddEquip_Avl.phys = getValue( HMI_EVC_A1_AddEquip_Avl );
    _mEVC_CfgBit_97_C8_AR.EVC_A2_AddEquip_Avl.phys = getValue( HMI_EVC_A2_AddEquip_Avl );
    _mEVC_CfgBit_97_C8_AR.EVC_A3_AddEquip_Avl.phys = getValue( HMI_EVC_A3_AddEquip_Avl );
    _mEVC_CfgBit_97_C8_AR.EVC_A4_AddEquip_Avl.phys = getValue( HMI_EVC_A4_AddEquip_Avl );
    _mEVC_CfgBit_97_C8_AR.EVC_A5_AddEquip_Avl.phys = getValue( HMI_EVC_A5_AddEquip_Avl );
    _mEVC_CfgBit_97_C8_AR.EVC_A6_AddEquip_Avl.phys = getValue( HMI_EVC_A6_AddEquip_Avl );
    _mEVC_CfgBit_97_C8_AR.EVC_A7_AddEquip_Avl.phys = getValue( HMI_EVC_A7_AddEquip_Avl );
    _mEVC_CfgBit_97_C8_AR.EVC_A8_AddEquip_Avl.phys = getValue( HMI_EVC_A8_AddEquip_Avl );
    _mEVC_CfgBit_97_C8_AR.EVC_A9_AddEquip_Avl.phys = getValue( HMI_EVC_A9_AddEquip_Avl );
    _mEVC_CfgBit_97_C8_AR.EVC_AA_AddEquip_Avl.phys = getValue( HMI_EVC_AA_AddEquip_Avl );
    _mEVC_CfgBit_97_C8_AR.EVC_AB_AddEquip_Avl.phys = getValue( HMI_EVC_AB_AddEquip_Avl );
    _mEVC_CfgBit_97_C8_AR.EVC_AC_AddEquip_Avl.phys = getValue( HMI_EVC_AC_AddEquip_Avl );
    _mEVC_CfgBit_97_C8_AR.EVC_AD_AddEquip_Avl.phys = getValue( HMI_EVC_AD_AddEquip_Avl );
    _mEVC_CfgBit_97_C8_AR.EVC_AE_AddEquip_Avl.phys = getValue( HMI_EVC_AE_AddEquip_Avl );
    _mEVC_CfgBit_97_C8_AR.EVC_AF_AddEquip_Avl.phys = getValue( HMI_EVC_AF_AddEquip_Avl );
    _mEVC_CfgBit_97_C8_AR.EVC_B0_AddEquip_Avl.phys = getValue( HMI_EVC_B0_AddEquip_Avl );
    _mEVC_CfgBit_97_C8_AR.EVC_B1_AddEquip_Avl.phys = getValue( HMI_EVC_B1_AddEquip_Avl );
    _mEVC_CfgBit_97_C8_AR.EVC_B2_AddEquip_Avl.phys = getValue( HMI_EVC_B2_AddEquip_Avl );
    _mEVC_CfgBit_97_C8_AR.EVC_B3_AddEquip_Avl.phys = getValue( HMI_EVC_B3_AddEquip_Avl );
    _mEVC_CfgBit_97_C8_AR.EVC_B4_AddEquip_Avl.phys = getValue( HMI_EVC_B4_AddEquip_Avl );
    _mEVC_CfgBit_97_C8_AR.EVC_B5_AddEquip_Avl.phys = getValue( HMI_EVC_B5_AddEquip_Avl );
    _mEVC_CfgBit_97_C8_AR.EVC_B6_AddEquip_Avl.phys = getValue( HMI_EVC_B6_AddEquip_Avl );
    _mEVC_CfgBit_97_C8_AR.EVC_B7_AddEquip_Avl.phys = getValue( HMI_EVC_B7_AddEquip_Avl );
    _mEVC_CfgBit_97_C8_AR.EVC_B8_AddEquip_Avl.phys = getValue( HMI_EVC_B8_AddEquip_Avl );
    _mEVC_CfgBit_97_C8_AR.EVC_B9_AddEquip_Avl.phys = getValue( HMI_EVC_B9_AddEquip_Avl );
    _mEVC_CfgBit_97_C8_AR.EVC_BA_AddEquip_Avl.phys = getValue( HMI_EVC_BA_AddEquip_Avl );
    _mEVC_CfgBit_97_C8_AR.EVC_BB_AddEquip_Avl.phys = getValue( HMI_EVC_BB_AddEquip_Avl );
    _mEVC_CfgBit_97_C8_AR.EVC_BC_AddEquip_Avl.phys = getValue( HMI_EVC_BC_AddEquip_Avl );
    _mEVC_CfgBit_97_C8_AR.EVC_BD_AddEquip_Avl.phys = getValue( HMI_EVC_BD_AddEquip_Avl );
    _mEVC_CfgBit_97_C8_AR.EVC_BE_AddEquip_Avl.phys = getValue( HMI_EVC_BE_AddEquip_Avl );
    _mEVC_CfgBit_97_C8_AR.EVC_BF_AEJx0_2_Avl.phys = getValue( HMI_EVC_BF_AEJx0_2_Avl );
    _mEVC_CfgBit_97_C8_AR.EVC_C0_AEJx1_2_Avl.phys = getValue( HMI_EVC_C0_AEJx1_2_Avl );
    _mEVC_CfgBit_97_C8_AR.EVC_C1_AEJx2_2_Avl.phys = getValue( HMI_EVC_C1_AEJx2_2_Avl );
    _mEVC_CfgBit_97_C8_AR.EVC_C2_AEJx3_2_Avl.phys = getValue( HMI_EVC_C2_AEJx3_2_Avl );
    _mEVC_CfgBit_97_C8_AR.EVC_C3_AEJx4_2_Avl.phys = getValue( HMI_EVC_C3_AEJx4_2_Avl );
    _mEVC_CfgBit_97_C8_AR.EVC_C4_AEJx5_2_Avl.phys = getValue( HMI_EVC_C4_AEJx5_2_Avl );
    _mEVC_CfgBit_97_C8_AR.EVC_C5_AEJx6_2_Avl.phys = getValue( HMI_EVC_C5_AEJx6_2_Avl );
    _mEVC_CfgBit_97_C8_AR.EVC_C6_AEJx7_2_Avl.phys = getValue( HMI_EVC_C6_AEJx7_2_Avl );
    _mEVC_CfgBit_97_C8_AR.EVC_C7_AEJx8_2_Avl.phys = getValue( HMI_EVC_C7_AEJx8_2_Avl );
    _mEVC_CfgBit_97_C8_AR.EVC_C8_AEJx9_2_Avl.phys = getValue( HMI_EVC_C8_AEJx9_2_Avl );
    _mEVC_CfgBit_97_C8_AR.EVC_CfgBit_97_C8_Stat.phys = getValue( HMI_EVC_CfgBit_97_C8_Stat );
}
/*@@end*/

/*@@caplFunc:EVC_CfgBit_97_C8_AR_output():*/
void EVC_CfgBit_97_C8_AR_output(void)
{
    byte crc;
    byte SQC_help;

    if( !getValue( HMI_SQC_EVC_CfgBit_97_C8_Auto ) )
    {
        // berechne message counter
        SQC_help = getValue( HMI_SQC_EVC_CfgBit_97_C8 );
        if( SQC_help >= 15 ) SQC_help = 0;
        else SQC_help++;
        putValue( HMI_SQC_EVC_CfgBit_97_C8, SQC_help );
        _mEVC_CfgBit_97_C8_AR.SQC_EVC_CfgBit_97_C8 = SQC_help;
    }
    else
          _mEVC_CfgBit_97_C8_AR.SQC_EVC_CfgBit_97_C8 = getValue( HMI_SQC_EVC_CfgBit_97_C8 );

    if( getValue( HMI_CRC_EVC_CfgBit_97_C8_Profile_02 ) )
    {
         if( !getValue( HMI_CRC_EVC_CfgBit_97_C8_Auto ) )
        {   // CRC according to SAE1850 ( W222 )
            // berechne crc
            crc = 0xFF;
//          crc = crctable_profile02[ crc ^ _mEVC_CfgBit_97_C8_AR.byte( 0 ) ];  // CRC
            crc = crctable_profile02[ crc ^ _mEVC_CfgBit_97_C8_AR.byte( 1 ) ];
            crc = crctable_profile02[ crc ^ _mEVC_CfgBit_97_C8_AR.byte( 2 ) ];
            crc = crctable_profile02[ crc ^ _mEVC_CfgBit_97_C8_AR.byte( 3 ) ];
            crc = crctable_profile02[ crc ^ _mEVC_CfgBit_97_C8_AR.byte( 4 ) ];
            crc = crctable_profile02[ crc ^ _mEVC_CfgBit_97_C8_AR.byte( 5 ) ];
            crc = crctable_profile02[ crc ^ _mEVC_CfgBit_97_C8_AR.byte( 6 ) ];
            crc = crctable_profile02[ crc ^ _mEVC_CfgBit_97_C8_AR.byte( 7 ) ];
            crc = crctable_profile02[ crc ^ _EVC_CfgBit_65_96_AR_CRC_Offset[ _mEVC_CfgBit_97_C8_AR.SQC_EVC_CfgBit_97_C8 ] ]; // load offset
            crc = (crc ^ 0xFF);
            if( getValue(  HMI_CRC_EVC_CfgBit_97_C8_Invalid ) )
                crc++;
            _mEVC_CfgBit_97_C8_AR.CRC_EVC_CfgBit_97_C8 = crc;
            putValue( HMI_CRC_EVC_CfgBit_97_C8, crc );
        }
        else
            _mEVC_CfgBit_97_C8_AR.CRC_EVC_CfgBit_97_C8 = getValue( HMI_CRC_EVC_CfgBit_97_C8 );
    }
    else
    {
         if( !getValue( HMI_CRC_EVC_CfgBit_97_C8_Auto ) )
        {   // CRC according to SAE1850 ( W222 )
            // berechne crc
            crc = 0xFF;
            crc = crctable[ crc ^ _mEVC_CfgBit_97_C8_AR.byte( 1 ) ];
            crc = crctable[ crc ^ _mEVC_CfgBit_97_C8_AR.byte( 2 ) ];
            crc = crctable[ crc ^ _mEVC_CfgBit_97_C8_AR.byte( 3 ) ];
            crc = crctable[ crc ^ _mEVC_CfgBit_97_C8_AR.byte( 4 ) ];
            crc = crctable[ crc ^ _mEVC_CfgBit_97_C8_AR.byte( 5 ) ];
            crc = crctable[ crc ^ _mEVC_CfgBit_97_C8_AR.byte( 6 ) ];
            crc = crctable[ crc ^ _mEVC_CfgBit_97_C8_AR.byte( 7 ) ];
            crc = (crc ^ 0xFF);
            if( getValue(  HMI_CRC_EVC_CfgBit_97_C8_Invalid ) )
                crc++;
            _mEVC_CfgBit_97_C8_AR.CRC_EVC_CfgBit_97_C8 = crc;
            putValue( HMI_CRC_EVC_CfgBit_97_C8, crc );
        }
        else
            _mEVC_CfgBit_97_C8_AR.CRC_EVC_CfgBit_97_C8 = getValue( HMI_CRC_EVC_CfgBit_97_C8 );
    }
    output( _mEVC_CfgBit_97_C8_AR );
}
/*@@end*/

/*@@caplFunc:EVC_CfgBit_97_C8_AR_saveEnvVars(dword):*/
EVC_CfgBit_97_C8_AR_saveEnvVars( dword hFile )
{
    filePutString("\n// Knoten EIS: EVC_CfgBit_97_C8_AR\n", 33, hFile );
    snprintf( buffer, elcount( buffer ), "0.0000 HMI__STMSG_EVC_CfgBit_97_C8 := %X\n", getValue( HMI__STMSG_EVC_CfgBit_97_C8_AR ) );    filePutString( buffer, elcount( buffer ), hFile );
    snprintf( buffer, elcount( buffer ), "0.0000 HMI__STMSGT_EVC_CfgBit_97_C8 := %X\n", getValue( HMI__STMSGT_EVC_CfgBit_97_C8_AR ) );    filePutString( buffer, elcount( buffer ), hFile );
    snprintf( buffer, elcount( buffer ), "0.0000 HMI_CRC_EVC_CfgBit_97_C8 := %X\n", getValue( HMI_CRC_EVC_CfgBit_97_C8 ) );    filePutString( buffer, elcount( buffer ), hFile );
    snprintf( buffer, elcount( buffer ), "0.0000 HMI_CRC_EVC_CfgBit_97_C8_Auto := %X\n", getValue( HMI_CRC_EVC_CfgBit_97_C8_Auto ) );    filePutString( buffer, elcount( buffer ), hFile );
    snprintf( buffer, elcount( buffer ), "0.0000 HMI_EVC_97_ConvStWhlOp_AssSys_Avl := %X\n", getValue( HMI_EVC_97_ConvStWhlOp_AssSys_Avl ) );    filePutString( buffer, elcount( buffer ), hFile );
    snprintf( buffer, elcount( buffer ), "0.0000 HMI_EVC_98_AMG_PerfSeat_Avl := %X\n", getValue( HMI_EVC_98_AMG_PerfSeat_Avl ) );    filePutString( buffer, elcount( buffer ), hFile );
    snprintf( buffer, elcount( buffer ), "0.0000 HMI_EVC_99_RemPark_Avl := %X\n", getValue( HMI_EVC_99_RemPark_Avl ) );    filePutString( buffer, elcount( buffer ), hFile );
    snprintf( buffer, elcount( buffer ), "0.0000 HMI_EVC_9A_PresfImpls_Sd_Avl := %X\n", getValue( HMI_EVC_9A_PresfImpls_Sd_Avl ) );    filePutString( buffer, elcount( buffer ), hFile );
    snprintf( buffer, elcount( buffer ), "0.0000 HMI_EVC_9B_ADSPlus_Avl := %X\n", getValue( HMI_EVC_9B_ADSPlus_Avl ) );    filePutString( buffer, elcount( buffer ), hFile );
    snprintf( buffer, elcount( buffer ), "0.0000 HMI_EVC_9C_PullmanGuard_Avl := %X\n", getValue( HMI_EVC_9C_PullmanGuard_Avl ) );    filePutString( buffer, elcount( buffer ), hFile );
    snprintf( buffer, elcount( buffer ), "0.0000 HMI_EVC_9D_Allroad_Avl := %X\n", getValue( HMI_EVC_9D_Allroad_Avl ) );    filePutString( buffer, elcount( buffer ), hFile );
    snprintf( buffer, elcount( buffer ), "0.0000 HMI_EVC_9E_AddEquip_Avl := %X\n", getValue( HMI_EVC_9E_AddEquip_Avl ) );    filePutString( buffer, elcount( buffer ), hFile );
    snprintf( buffer, elcount( buffer ), "0.0000 HMI_EVC_9F_AddEquip_Avl := %X\n", getValue( HMI_EVC_9F_AddEquip_Avl ) );    filePutString( buffer, elcount( buffer ), hFile );
    snprintf( buffer, elcount( buffer ), "0.0000 HMI_EVC_A0_AddEquip_Avl := %X\n", getValue( HMI_EVC_A0_AddEquip_Avl ) );    filePutString( buffer, elcount( buffer ), hFile );
    snprintf( buffer, elcount( buffer ), "0.0000 HMI_EVC_A1_AddEquip_Avl := %X\n", getValue( HMI_EVC_A1_AddEquip_Avl ) );    filePutString( buffer, elcount( buffer ), hFile );
    snprintf( buffer, elcount( buffer ), "0.0000 HMI_EVC_A2_AddEquip_Avl := %X\n", getValue( HMI_EVC_A2_AddEquip_Avl ) );    filePutString( buffer, elcount( buffer ), hFile );
    snprintf( buffer, elcount( buffer ), "0.0000 HMI_EVC_A3_AddEquip_Avl := %X\n", getValue( HMI_EVC_A3_AddEquip_Avl ) );    filePutString( buffer, elcount( buffer ), hFile );
    snprintf( buffer, elcount( buffer ), "0.0000 HMI_EVC_A4_AddEquip_Avl := %X\n", getValue( HMI_EVC_A4_AddEquip_Avl ) );    filePutString( buffer, elcount( buffer ), hFile );
    snprintf( buffer, elcount( buffer ), "0.0000 HMI_EVC_A5_AddEquip_Avl := %X\n", getValue( HMI_EVC_A5_AddEquip_Avl ) );    filePutString( buffer, elcount( buffer ), hFile );
    snprintf( buffer, elcount( buffer ), "0.0000 HMI_EVC_A6_AddEquip_Avl := %X\n", getValue( HMI_EVC_A6_AddEquip_Avl ) );    filePutString( buffer, elcount( buffer ), hFile );
    snprintf( buffer, elcount( buffer ), "0.0000 HMI_EVC_A7_AddEquip_Avl := %X\n", getValue( HMI_EVC_A7_AddEquip_Avl ) );    filePutString( buffer, elcount( buffer ), hFile );
    snprintf( buffer, elcount( buffer ), "0.0000 HMI_EVC_A8_AddEquip_Avl := %X\n", getValue( HMI_EVC_A8_AddEquip_Avl ) );    filePutString( buffer, elcount( buffer ), hFile );
    snprintf( buffer, elcount( buffer ), "0.0000 HMI_EVC_A9_AddEquip_Avl := %X\n", getValue( HMI_EVC_A9_AddEquip_Avl ) );    filePutString( buffer, elcount( buffer ), hFile );
    snprintf( buffer, elcount( buffer ), "0.0000 HMI_EVC_AA_AddEquip_Avl := %X\n", getValue( HMI_EVC_AA_AddEquip_Avl ) );    filePutString( buffer, elcount( buffer ), hFile );
    snprintf( buffer, elcount( buffer ), "0.0000 HMI_EVC_AB_AddEquip_Avl := %X\n", getValue( HMI_EVC_AB_AddEquip_Avl ) );    filePutString( buffer, elcount( buffer ), hFile );
    snprintf( buffer, elcount( buffer ), "0.0000 HMI_EVC_AC_AddEquip_Avl := %X\n", getValue( HMI_EVC_AC_AddEquip_Avl ) );    filePutString( buffer, elcount( buffer ), hFile );
    snprintf( buffer, elcount( buffer ), "0.0000 HMI_EVC_AD_AddEquip_Avl := %X\n", getValue( HMI_EVC_AD_AddEquip_Avl ) );    filePutString( buffer, elcount( buffer ), hFile );
    snprintf( buffer, elcount( buffer ), "0.0000 HMI_EVC_AE_AddEquip_Avl := %X\n", getValue( HMI_EVC_AE_AddEquip_Avl ) );    filePutString( buffer, elcount( buffer ), hFile );
    snprintf( buffer, elcount( buffer ), "0.0000 HMI_EVC_AF_AddEquip_Avl := %X\n", getValue( HMI_EVC_AF_AddEquip_Avl ) );    filePutString( buffer, elcount( buffer ), hFile );
    snprintf( buffer, elcount( buffer ), "0.0000 HMI_EVC_B0_AddEquip_Avl := %X\n", getValue( HMI_EVC_B0_AddEquip_Avl ) );    filePutString( buffer, elcount( buffer ), hFile );
    snprintf( buffer, elcount( buffer ), "0.0000 HMI_EVC_B1_AddEquip_Avl := %X\n", getValue( HMI_EVC_B1_AddEquip_Avl ) );    filePutString( buffer, elcount( buffer ), hFile );
    snprintf( buffer, elcount( buffer ), "0.0000 HMI_EVC_B2_AddEquip_Avl := %X\n", getValue( HMI_EVC_B2_AddEquip_Avl ) );    filePutString( buffer, elcount( buffer ), hFile );
    snprintf( buffer, elcount( buffer ), "0.0000 HMI_EVC_B3_AddEquip_Avl := %X\n", getValue( HMI_EVC_B3_AddEquip_Avl ) );    filePutString( buffer, elcount( buffer ), hFile );
    snprintf( buffer, elcount( buffer ), "0.0000 HMI_EVC_B4_AddEquip_Avl := %X\n", getValue( HMI_EVC_B4_AddEquip_Avl ) );    filePutString( buffer, elcount( buffer ), hFile );
    snprintf( buffer, elcount( buffer ), "0.0000 HMI_EVC_B5_AddEquip_Avl := %X\n", getValue( HMI_EVC_B5_AddEquip_Avl ) );    filePutString( buffer, elcount( buffer ), hFile );
    snprintf( buffer, elcount( buffer ), "0.0000 HMI_EVC_B6_AddEquip_Avl := %X\n", getValue( HMI_EVC_B6_AddEquip_Avl ) );    filePutString( buffer, elcount( buffer ), hFile );
    snprintf( buffer, elcount( buffer ), "0.0000 HMI_EVC_B7_AddEquip_Avl := %X\n", getValue( HMI_EVC_B7_AddEquip_Avl ) );    filePutString( buffer, elcount( buffer ), hFile );
    snprintf( buffer, elcount( buffer ), "0.0000 HMI_EVC_B8_AddEquip_Avl := %X\n", getValue( HMI_EVC_B8_AddEquip_Avl ) );    filePutString( buffer, elcount( buffer ), hFile );
    snprintf( buffer, elcount( buffer ), "0.0000 HMI_EVC_B9_AddEquip_Avl := %X\n", getValue( HMI_EVC_B9_AddEquip_Avl ) );    filePutString( buffer, elcount( buffer ), hFile );
    snprintf( buffer, elcount( buffer ), "0.0000 HMI_EVC_BA_AddEquip_Avl := %X\n", getValue( HMI_EVC_BA_AddEquip_Avl ) );    filePutString( buffer, elcount( buffer ), hFile );
    snprintf( buffer, elcount( buffer ), "0.0000 HMI_EVC_BB_AddEquip_Avl := %X\n", getValue( HMI_EVC_BB_AddEquip_Avl ) );    filePutString( buffer, elcount( buffer ), hFile );
    snprintf( buffer, elcount( buffer ), "0.0000 HMI_EVC_BC_AddEquip_Avl := %X\n", getValue( HMI_EVC_BC_AddEquip_Avl ) );    filePutString( buffer, elcount( buffer ), hFile );
    snprintf( buffer, elcount( buffer ), "0.0000 HMI_EVC_BD_AddEquip_Avl := %X\n", getValue( HMI_EVC_BD_AddEquip_Avl ) );    filePutString( buffer, elcount( buffer ), hFile );
    snprintf( buffer, elcount( buffer ), "0.0000 HMI_EVC_BE_AddEquip_Avl := %X\n", getValue( HMI_EVC_BE_AddEquip_Avl ) );    filePutString( buffer, elcount( buffer ), hFile );
    snprintf( buffer, elcount( buffer ), "0.0000 HMI_EVC_BF_AEJx0_2_Avl := %X\n", getValue( HMI_EVC_BF_AEJx0_2_Avl ) );    filePutString( buffer, elcount( buffer ), hFile );
    snprintf( buffer, elcount( buffer ), "0.0000 HMI_EVC_C0_AEJx1_2_Avl := %X\n", getValue( HMI_EVC_C0_AEJx1_2_Avl ) );    filePutString( buffer, elcount( buffer ), hFile );
    snprintf( buffer, elcount( buffer ), "0.0000 HMI_EVC_C1_AEJx2_2_Avl := %X\n", getValue( HMI_EVC_C1_AEJx2_2_Avl ) );    filePutString( buffer, elcount( buffer ), hFile );
    snprintf( buffer, elcount( buffer ), "0.0000 HMI_EVC_C2_AEJx3_2_Avl := %X\n", getValue( HMI_EVC_C2_AEJx3_2_Avl ) );    filePutString( buffer, elcount( buffer ), hFile );
    snprintf( buffer, elcount( buffer ), "0.0000 HMI_EVC_C3_AEJx4_2_Avl := %X\n", getValue( HMI_EVC_C3_AEJx4_2_Avl ) );    filePutString( buffer, elcount( buffer ), hFile );
    snprintf( buffer, elcount( buffer ), "0.0000 HMI_EVC_C4_AEJx5_2_Avl := %X\n", getValue( HMI_EVC_C4_AEJx5_2_Avl ) );    filePutString( buffer, elcount( buffer ), hFile );
    snprintf( buffer, elcount( buffer ), "0.0000 HMI_EVC_C5_AEJx6_2_Avl := %X\n", getValue( HMI_EVC_C5_AEJx6_2_Avl ) );    filePutString( buffer, elcount( buffer ), hFile );
    snprintf( buffer, elcount( buffer ), "0.0000 HMI_EVC_C6_AEJx7_2_Avl := %X\n", getValue( HMI_EVC_C6_AEJx7_2_Avl ) );    filePutString( buffer, elcount( buffer ), hFile );
    snprintf( buffer, elcount( buffer ), "0.0000 HMI_EVC_C7_AEJx8_2_Avl := %X\n", getValue( HMI_EVC_C7_AEJx8_2_Avl ) );    filePutString( buffer, elcount( buffer ), hFile );
    snprintf( buffer, elcount( buffer ), "0.0000 HMI_EVC_C8_AEJx9_2_Avl := %X\n", getValue( HMI_EVC_C8_AEJx9_2_Avl ) );    filePutString( buffer, elcount( buffer ), hFile );
    snprintf( buffer, elcount( buffer ), "0.0000 HMI_EVC_CfgBit_97_C8_Stat := %X\n", getValue( HMI_EVC_CfgBit_97_C8_Stat ) );    filePutString( buffer, elcount( buffer ), hFile );
    snprintf( buffer, elcount( buffer ), "0.0000 HMI_SQC_EVC_CfgBit_97_C8 := %X\n", getValue( HMI_SQC_EVC_CfgBit_97_C8 ) );    filePutString( buffer, elcount( buffer ), hFile );
    snprintf( buffer, elcount( buffer ), "0.0000 HMI_SQC_EVC_CfgBit_97_C8_Auto := %X\n", getValue( HMI_SQC_EVC_CfgBit_97_C8_Auto ) );    filePutString( buffer, elcount( buffer ), hFile );
}
/*@@end*/

/*@@timer:_tEVC_CfgBit_97_C8_AR:*/
on timer _tEVC_CfgBit_97_C8_AR
{
    putValue( HMI__STMSG_EVC_CfgBit_97_C8_AR, 0 );
}
/*@@end*/

/*@@envVar:HMI__STMSG_EVC_CfgBit_97_C8_AR:*/
on EnvVar HMI__STMSG_EVC_CfgBit_97_C8_AR
{
    long tDelay;
    if( getValue( this ) == 2 )
    {
        tDelay = getValue( HMI__STMSGT_EVC_CfgBit_97_C8_AR );
        if( tDelay > 0)    
            setTimer( _tEVC_CfgBit_97_C8_AR, tDelay );
        else
            putValue( HMI__STMSG_EVC_CfgBit_97_C8_AR, 0 );
    }
}
/*@@end*/

/*@@envVar:HMI_EVC_97_ConvStWhlOp_AssSys_Avl:*/
on EnvVar HMI_EVC_97_ConvStWhlOp_AssSys_Avl
{
    _mEVC_CfgBit_97_C8_AR.EVC_97_ConvStWhlOp_AssSys_Avl.phys = getValue(this);
}
/*@@end*/

/*@@envVar:HMI_EVC_98_AMG_PerfSeat_Avl:*/
on EnvVar HMI_EVC_98_AMG_PerfSeat_Avl
{
    _mEVC_CfgBit_97_C8_AR.EVC_98_AMG_PerfSeat_Avl.phys = getValue(this);
}
/*@@end*/

/*@@envVar:HMI_EVC_99_RemPark_Avl:*/
on EnvVar HMI_EVC_99_RemPark_Avl
{
    _mEVC_CfgBit_97_C8_AR.EVC_99_RemPark_Avl.phys = getValue(this);
}
/*@@end*/

/*@@envVar:HMI_EVC_9A_PresfImpls_Sd_Avl:*/
on EnvVar HMI_EVC_9A_PresfImpls_Sd_Avl
{
    _mEVC_CfgBit_97_C8_AR.EVC_9A_PresfImpls_Sd_Avl.phys = getValue(this);
}
/*@@end*/

/*@@envVar:HMI_EVC_9B_ADSPlus_Avl:*/
on EnvVar HMI_EVC_9B_ADSPlus_Avl
{
    _mEVC_CfgBit_97_C8_AR.EVC_9B_ADSPlus_Avl.phys = getValue(this);
}
/*@@end*/

/*@@envVar:HMI_EVC_9C_PullmanGuard_Avl:*/
on EnvVar HMI_EVC_9C_PullmanGuard_Avl
{
    _mEVC_CfgBit_97_C8_AR.EVC_9C_PullmanGuard_Avl.phys = getValue(this);
}
/*@@end*/

/*@@envVar:HMI_EVC_9D_Allroad_Avl:*/
on EnvVar HMI_EVC_9D_Allroad_Avl
{
    _mEVC_CfgBit_97_C8_AR.EVC_9D_Allroad_Avl.phys = getValue(this);
}
/*@@end*/

/*@@envVar:HMI_EVC_9E_AddEquip_Avl:*/
on EnvVar HMI_EVC_9E_AddEquip_Avl
{
    _mEVC_CfgBit_97_C8_AR.EVC_9E_AddEquip_Avl.phys = getValue(this);
}
/*@@end*/

/*@@envVar:HMI_EVC_9F_AddEquip_Avl:*/
on EnvVar HMI_EVC_9F_AddEquip_Avl
{
    _mEVC_CfgBit_97_C8_AR.EVC_9F_AddEquip_Avl.phys = getValue(this);
}
/*@@end*/

/*@@envVar:HMI_EVC_A0_AddEquip_Avl:*/
on EnvVar HMI_EVC_A0_AddEquip_Avl
{
    _mEVC_CfgBit_97_C8_AR.EVC_A0_AddEquip_Avl.phys = getValue(this);
}
/*@@end*/

/*@@envVar:HMI_EVC_A1_AddEquip_Avl:*/
on EnvVar HMI_EVC_A1_AddEquip_Avl
{
    _mEVC_CfgBit_97_C8_AR.EVC_A1_AddEquip_Avl.phys = getValue(this);
}
/*@@end*/

/*@@envVar:HMI_EVC_A2_AddEquip_Avl:*/
on EnvVar HMI_EVC_A2_AddEquip_Avl
{
    _mEVC_CfgBit_97_C8_AR.EVC_A2_AddEquip_Avl.phys = getValue(this);
}
/*@@end*/

/*@@envVar:HMI_EVC_A3_AddEquip_Avl:*/
on EnvVar HMI_EVC_A3_AddEquip_Avl
{
    _mEVC_CfgBit_97_C8_AR.EVC_A3_AddEquip_Avl.phys = getValue(this);
}
/*@@end*/

/*@@envVar:HMI_EVC_A4_AddEquip_Avl:*/
on EnvVar HMI_EVC_A4_AddEquip_Avl
{
    _mEVC_CfgBit_97_C8_AR.EVC_A4_AddEquip_Avl.phys = getValue(this);
}
/*@@end*/

/*@@envVar:HMI_EVC_A5_AddEquip_Avl:*/
on EnvVar HMI_EVC_A5_AddEquip_Avl
{
    _mEVC_CfgBit_97_C8_AR.EVC_A5_AddEquip_Avl.phys = getValue(this);
}
/*@@end*/

/*@@envVar:HMI_EVC_A6_AddEquip_Avl:*/
on EnvVar HMI_EVC_A6_AddEquip_Avl
{
    _mEVC_CfgBit_97_C8_AR.EVC_A6_AddEquip_Avl.phys = getValue(this);
}
/*@@end*/

/*@@envVar:HMI_EVC_A7_AddEquip_Avl:*/
on EnvVar HMI_EVC_A7_AddEquip_Avl
{
    _mEVC_CfgBit_97_C8_AR.EVC_A7_AddEquip_Avl.phys = getValue(this);
}
/*@@end*/

/*@@envVar:HMI_EVC_A8_AddEquip_Avl:*/
on EnvVar HMI_EVC_A8_AddEquip_Avl
{
    _mEVC_CfgBit_97_C8_AR.EVC_A8_AddEquip_Avl.phys = getValue(this);
}
/*@@end*/

/*@@envVar:HMI_EVC_A9_AddEquip_Avl:*/
on EnvVar HMI_EVC_A9_AddEquip_Avl
{
    _mEVC_CfgBit_97_C8_AR.EVC_A9_AddEquip_Avl.phys = getValue(this);
}
/*@@end*/

/*@@envVar:HMI_EVC_AA_AddEquip_Avl:*/
on EnvVar HMI_EVC_AA_AddEquip_Avl
{
    _mEVC_CfgBit_97_C8_AR.EVC_AA_AddEquip_Avl.phys = getValue(this);
}
/*@@end*/

/*@@envVar:HMI_EVC_AB_AddEquip_Avl:*/
on EnvVar HMI_EVC_AB_AddEquip_Avl
{
    _mEVC_CfgBit_97_C8_AR.EVC_AB_AddEquip_Avl.phys = getValue(this);
}
/*@@end*/

/*@@envVar:HMI_EVC_AC_AddEquip_Avl:*/
on EnvVar HMI_EVC_AC_AddEquip_Avl
{
    _mEVC_CfgBit_97_C8_AR.EVC_AC_AddEquip_Avl.phys = getValue(this);
}
/*@@end*/

/*@@envVar:HMI_EVC_AD_AddEquip_Avl:*/
on EnvVar HMI_EVC_AD_AddEquip_Avl
{
    _mEVC_CfgBit_97_C8_AR.EVC_AD_AddEquip_Avl.phys = getValue(this);
}
/*@@end*/

/*@@envVar:HMI_EVC_AE_AddEquip_Avl:*/
on EnvVar HMI_EVC_AE_AddEquip_Avl
{
    _mEVC_CfgBit_97_C8_AR.EVC_AE_AddEquip_Avl.phys = getValue(this);
}
/*@@end*/

/*@@envVar:HMI_EVC_AF_AddEquip_Avl:*/
on EnvVar HMI_EVC_AF_AddEquip_Avl
{
    _mEVC_CfgBit_97_C8_AR.EVC_AF_AddEquip_Avl.phys = getValue(this);
}
/*@@end*/

/*@@envVar:HMI_EVC_B0_AddEquip_Avl:*/
on EnvVar HMI_EVC_B0_AddEquip_Avl
{
    _mEVC_CfgBit_97_C8_AR.EVC_B0_AddEquip_Avl.phys = getValue(this);
}
/*@@end*/

/*@@envVar:HMI_EVC_B1_AddEquip_Avl:*/
on EnvVar HMI_EVC_B1_AddEquip_Avl
{
    _mEVC_CfgBit_97_C8_AR.EVC_B1_AddEquip_Avl.phys = getValue(this);
}
/*@@end*/

/*@@envVar:HMI_EVC_B2_AddEquip_Avl:*/
on EnvVar HMI_EVC_B2_AddEquip_Avl
{
    _mEVC_CfgBit_97_C8_AR.EVC_B2_AddEquip_Avl.phys = getValue(this);
}
/*@@end*/

/*@@envVar:HMI_EVC_B3_AddEquip_Avl:*/
on EnvVar HMI_EVC_B3_AddEquip_Avl
{
    _mEVC_CfgBit_97_C8_AR.EVC_B3_AddEquip_Avl.phys = getValue(this);
}
/*@@end*/

/*@@envVar:HMI_EVC_B4_AddEquip_Avl:*/
on EnvVar HMI_EVC_B4_AddEquip_Avl
{
    _mEVC_CfgBit_97_C8_AR.EVC_B4_AddEquip_Avl.phys = getValue(this);
}
/*@@end*/

/*@@envVar:HMI_EVC_B5_AddEquip_Avl:*/
on EnvVar HMI_EVC_B5_AddEquip_Avl
{
    _mEVC_CfgBit_97_C8_AR.EVC_B5_AddEquip_Avl.phys = getValue(this);
}
/*@@end*/

/*@@envVar:HMI_EVC_B6_AddEquip_Avl:*/
on EnvVar HMI_EVC_B6_AddEquip_Avl
{
    _mEVC_CfgBit_97_C8_AR.EVC_B6_AddEquip_Avl.phys = getValue(this);
}
/*@@end*/

/*@@envVar:HMI_EVC_B7_AddEquip_Avl:*/
on EnvVar HMI_EVC_B7_AddEquip_Avl
{
    _mEVC_CfgBit_97_C8_AR.EVC_B7_AddEquip_Avl.phys = getValue(this);
}
/*@@end*/

/*@@envVar:HMI_EVC_B8_AddEquip_Avl:*/
on EnvVar HMI_EVC_B8_AddEquip_Avl
{
    _mEVC_CfgBit_97_C8_AR.EVC_B8_AddEquip_Avl.phys = getValue(this);
}
/*@@end*/

/*@@envVar:HMI_EVC_B9_AddEquip_Avl:*/
on EnvVar HMI_EVC_B9_AddEquip_Avl
{
    _mEVC_CfgBit_97_C8_AR.EVC_B9_AddEquip_Avl.phys = getValue(this);
}
/*@@end*/

/*@@envVar:HMI_EVC_BA_AddEquip_Avl:*/
on EnvVar HMI_EVC_BA_AddEquip_Avl
{
    _mEVC_CfgBit_97_C8_AR.EVC_BA_AddEquip_Avl.phys = getValue(this);
}
/*@@end*/

/*@@envVar:HMI_EVC_BB_AddEquip_Avl:*/
on EnvVar HMI_EVC_BB_AddEquip_Avl
{
    _mEVC_CfgBit_97_C8_AR.EVC_BB_AddEquip_Avl.phys = getValue(this);
}
/*@@end*/

/*@@envVar:HMI_EVC_BC_AddEquip_Avl:*/
on EnvVar HMI_EVC_BC_AddEquip_Avl
{
    _mEVC_CfgBit_97_C8_AR.EVC_BC_AddEquip_Avl.phys = getValue(this);
}
/*@@end*/

/*@@envVar:HMI_EVC_BD_AddEquip_Avl:*/
on EnvVar HMI_EVC_BD_AddEquip_Avl
{
    _mEVC_CfgBit_97_C8_AR.EVC_BD_AddEquip_Avl.phys = getValue(this);
}
/*@@end*/

/*@@envVar:HMI_EVC_BE_AddEquip_Avl:*/
on EnvVar HMI_EVC_BE_AddEquip_Avl
{
    _mEVC_CfgBit_97_C8_AR.EVC_BE_AddEquip_Avl.phys = getValue(this);
}
/*@@end*/

/*@@envVar:HMI_EVC_BF_AEJx0_2_Avl:*/
on EnvVar HMI_EVC_BF_AEJx0_2_Avl
{
    _mEVC_CfgBit_97_C8_AR.EVC_BF_AEJx0_2_Avl.phys = getValue(this);
}
/*@@end*/

/*@@envVar:HMI_EVC_C0_AEJx1_2_Avl:*/
on EnvVar HMI_EVC_C0_AEJx1_2_Avl
{
    _mEVC_CfgBit_97_C8_AR.EVC_C0_AEJx1_2_Avl.phys = getValue(this);
}
/*@@end*/

/*@@envVar:HMI_EVC_C1_AEJx2_2_Avl:*/
on EnvVar HMI_EVC_C1_AEJx2_2_Avl
{
    _mEVC_CfgBit_97_C8_AR.EVC_C1_AEJx2_2_Avl.phys = getValue(this);
}
/*@@end*/

/*@@envVar:HMI_EVC_C2_AEJx3_2_Avl:*/
on EnvVar HMI_EVC_C2_AEJx3_2_Avl
{
    _mEVC_CfgBit_97_C8_AR.EVC_C2_AEJx3_2_Avl.phys = getValue(this);
}
/*@@end*/

/*@@envVar:HMI_EVC_C3_AEJx4_2_Avl:*/
on EnvVar HMI_EVC_C3_AEJx4_2_Avl
{
    _mEVC_CfgBit_97_C8_AR.EVC_C3_AEJx4_2_Avl.phys = getValue(this);
}
/*@@end*/

/*@@envVar:HMI_EVC_C4_AEJx5_2_Avl:*/
on EnvVar HMI_EVC_C4_AEJx5_2_Avl
{
    _mEVC_CfgBit_97_C8_AR.EVC_C4_AEJx5_2_Avl.phys = getValue(this);
}
/*@@end*/

/*@@envVar:HMI_EVC_C5_AEJx6_2_Avl:*/
on EnvVar HMI_EVC_C5_AEJx6_2_Avl
{
    _mEVC_CfgBit_97_C8_AR.EVC_C5_AEJx6_2_Avl.phys = getValue(this);
}
/*@@end*/

/*@@envVar:HMI_EVC_C6_AEJx7_2_Avl:*/
on EnvVar HMI_EVC_C6_AEJx7_2_Avl
{
    _mEVC_CfgBit_97_C8_AR.EVC_C6_AEJx7_2_Avl.phys = getValue(this);
}
/*@@end*/

/*@@envVar:HMI_EVC_C7_AEJx8_2_Avl:*/
on EnvVar HMI_EVC_C7_AEJx8_2_Avl
{
    _mEVC_CfgBit_97_C8_AR.EVC_C7_AEJx8_2_Avl.phys = getValue(this);
}
/*@@end*/

/*@@envVar:HMI_EVC_C8_AEJx9_2_Avl:*/
on EnvVar HMI_EVC_C8_AEJx9_2_Avl
{
    _mEVC_CfgBit_97_C8_AR.EVC_C8_AEJx9_2_Avl.phys = getValue(this);
}
/*@@end*/

/*@@envVar:HMI_EVC_CfgBit_97_C8_Stat:*/
on EnvVar HMI_EVC_CfgBit_97_C8_Stat
{
    _mEVC_CfgBit_97_C8_AR.EVC_CfgBit_97_C8_Stat.phys = getValue(this);
}
/*@@end*/

/*@@caplFunc:EVC_CfgList_01_0C_AR_check_output():*/
EVC_CfgList_01_0C_AR_check_output()
{
    if( !getValue( HMI__STMSG_EVC_CfgList_01_0C_AR ) )
    {
        // Botschaft EVC_CfgList_01_0C_AR ID: 759 --- Sendeart 0 cyclicX --- 
        _EVC_CfgList_01_0C_AR_Cnt--;
        if( _EVC_CfgList_01_0C_AR_Cnt < 1 )
        {
            // Nachricht wg. abgelaufenem Zyklus ausgeben
            EVC_CfgList_01_0C_AR_output();
            // Zyklus-Zähler zurücksetzen
            _EVC_CfgList_01_0C_AR_Cnt = _EVC_CfgList_01_0C_AR_CycleCount;
        }
    }
}
/*@@end*/

/*@@caplFunc:EVC_CfgList_01_0C_AR_init():*/
EVC_CfgList_01_0C_AR_init()
{   /* Botschaft EVC_CfgList_01_0C_AR ID: 759 --- Sendeart 0 cyclicX --- 
BA_ "ApplMessage" BO_ 759 0;
BA_ "NmAsrMessage" BO_ 759 0;
BA_ "GenMsgMinAcceptLength" BO_ 759 8;
BA_ "GenMsgILSupport" BO_ 759 1;
BA_ "DiagState" BO_ 759 0;
BA_ "DiagRequest" BO_ 759 0;
BA_ "DiagResponse" BO_ 759 0;
BA_ "GenMsgStartValue" BO_ 759 "0";
BA_ "GenMsgStartDelayTime" BO_ 759 295;
BA_ "GenMsgCycleTime" BO_ 759 1000;
BA_ "GenMsgSendType" BO_ 759 0;
    */
    _EVC_CfgList_01_0C_AR_Timebase =      c_tDBKomTimer_20ms;
    _EVC_CfgList_01_0C_AR_CycleCount =   1000 / _EVC_CfgList_01_0C_AR_Timebase;
    _EVC_CfgList_01_0C_AR_StartDelay =    295 / _EVC_CfgList_01_0C_AR_Timebase;
    _EVC_CfgList_01_0C_AR_Cnt = _EVC_CfgList_01_0C_AR_StartDelay;

    putValue( HMI__STMSGSD_EVC_CfgList_01_0C_AR, _EVC_CfgList_01_0C_AR_StartDelay * _EVC_CfgList_01_0C_AR_Timebase );

    _mEVC_CfgList_01_0C_AR.EVC_CfgList_01_0C_Stat.phys = getValue( HMI_EVC_CfgList_01_0C_Stat );
    _mEVC_CfgList_01_0C_AR.EVC_List01_StStyle.phys = getValue( HMI_EVC_List01_StStyle );
    _mEVC_CfgList_01_0C_AR.EVC_List02_BodyStyle.phys = getValue( HMI_EVC_List02_BodyStyle );
    _mEVC_CfgList_01_0C_AR.EVC_List03_RoofStyle.phys = getValue( HMI_EVC_List03_RoofStyle );
    _mEVC_CfgList_01_0C_AR.EVC_List04_HL_Style.phys = getValue( HMI_EVC_List04_HL_Style );
    _mEVC_CfgList_01_0C_AR.EVC_List05_TxStyle.phys = getValue( HMI_EVC_List05_TxStyle );
    _mEVC_CfgList_01_0C_AR.EVC_List06_VehLineYear.phys = getValue( HMI_EVC_List06_VehLineYear );
    _mEVC_CfgList_01_0C_AR.EVC_List07_HVAC_Style.phys = getValue( HMI_EVC_List07_HVAC_Style );
    _mEVC_CfgList_01_0C_AR.EVC_List08_Country.phys = getValue( HMI_EVC_List08_Country );
    _mEVC_CfgList_01_0C_AR.EVC_List09_HU_Style.phys = getValue( HMI_EVC_List09_HU_Style );
    _mEVC_CfgList_01_0C_AR.EVC_List0A_TPM_Style.phys = getValue( HMI_EVC_List0A_TPM_Style );
    _mEVC_CfgList_01_0C_AR.EVC_List0B_AddEquip.phys = getValue( HMI_EVC_List0B_AddEquip );
    _mEVC_CfgList_01_0C_AR.EVC_List0C_VehLine.phys = getValue( HMI_EVC_List0C_VehLine );
    //putValue ( HMI_SQC_EVC_CfgList_01_0C_Auto, 1 );
}
/*@@end*/

/*@@caplFunc:EVC_CfgList_01_0C_AR_output():*/
void EVC_CfgList_01_0C_AR_output( void )
{
    byte crc;
    byte SQC_help;

    if( !getValue( HMI_SQC_EVC_CfgList_01_0C_Auto ) )
    {
        // berechne message counter
        SQC_help = getValue( HMI_SQC_EVC_CfgList_01_0C );
        if( SQC_help >= 15 ) SQC_help = 0;
        else SQC_help++;
        putValue( HMI_SQC_EVC_CfgList_01_0C, SQC_help );
        _mEVC_CfgList_01_0C_AR.SQC_EVC_CfgList_01_0C = SQC_help;
    }
    else
        _mEVC_CfgList_01_0C_AR.SQC_EVC_CfgList_01_0C = getValue( HMI_SQC_EVC_CfgList_01_0C );

    if( getValue( HMI_CRC_EVC_CfgList_01_0C_Profile_02 ) )
    {
        if( !getValue( HMI_CRC_EVC_CfgList_01_0C_Auto ) )
        {   // CRC according Profile_02 ( W213 )
            // berechne crc
            crc = 0xFF;
//          crc = crctable_profile02[ crc ^ _mXXX.byte( 0 ) ];
            crc = crctable_profile02[ crc ^ _mEVC_CfgList_01_0C_AR.byte( 1 ) ];
            crc = crctable_profile02[ crc ^ _mEVC_CfgList_01_0C_AR.byte( 2 ) ];
            crc = crctable_profile02[ crc ^ _mEVC_CfgList_01_0C_AR.byte( 3 ) ];
            crc = crctable_profile02[ crc ^ _mEVC_CfgList_01_0C_AR.byte( 4 ) ];
            crc = crctable_profile02[ crc ^ _mEVC_CfgList_01_0C_AR.byte( 5 ) ];
            crc = crctable_profile02[ crc ^ _mEVC_CfgList_01_0C_AR.byte( 6 ) ];
            crc = crctable_profile02[ crc ^ _mEVC_CfgList_01_0C_AR.byte( 7 ) ];
            crc = crctable_profile02[ crc ^ _EVC_CfgList_01_0C_AR_CRC_Offset[ _mEVC_CfgList_01_0C_AR.SQC_EVC_CfgList_01_0C ] ]; // load offset
            crc = (crc ^ 0xFF);
            if( getValue(  HMI_CRC_EVC_CfgList_01_0C_Invalid ) )
                crc++;
            _mEVC_CfgList_01_0C_AR.CRC_EVC_CfgList_01_0C = crc;
            putValue( HMI_CRC_EVC_CfgList_01_0C, crc );
        }
        else
            _mEVC_CfgList_01_0C_AR.CRC_EVC_CfgList_01_0C = getValue( HMI_CRC_EVC_CfgList_01_0C );
    }
    else
    {
        if( !getValue( HMI_CRC_EVC_CfgList_01_0C_Auto ) )
        {   // CRC according to SAE1850 ( W222 )
            // berechne crc
            crc = 0xFF;
            crc = crctable[crc ^ _mEVC_CfgList_01_0C_AR.byte( 1 )];
            crc = crctable[crc ^ _mEVC_CfgList_01_0C_AR.byte( 2 )];
            crc = crctable[crc ^ _mEVC_CfgList_01_0C_AR.byte( 3 )];
            crc = crctable[crc ^ _mEVC_CfgList_01_0C_AR.byte( 4 )];
            crc = crctable[crc ^ _mEVC_CfgList_01_0C_AR.byte( 5 )];
            crc = crctable[crc ^ _mEVC_CfgList_01_0C_AR.byte( 6 )];
            crc = crctable[crc ^ _mEVC_CfgList_01_0C_AR.byte( 7 )];
            crc = (crc ^ 0xFF);
            if( getValue(  HMI_CRC_EVC_CfgList_01_0C_Invalid ) )
                crc++;
            _mEVC_CfgList_01_0C_AR.CRC_EVC_CfgList_01_0C = crc;
            putValue( HMI_CRC_EVC_CfgList_01_0C, crc );
        }
        else
            _mEVC_CfgList_01_0C_AR.CRC_EVC_CfgList_01_0C = getValue( HMI_CRC_EVC_CfgList_01_0C );
    }
    output( _mEVC_CfgList_01_0C_AR );
}
/*@@end*/

/*@@caplFunc:EVC_CfgList_01_0C_AR_saveEnvVars(dword):*/
EVC_CfgList_01_0C_AR_saveEnvVars( dword hFile )
{
    filePutString("\n// Knoten EIS: EVC_CfgList_01_0C_AR\n", 34, hFile );
    snprintf( buffer, elcount( buffer ), "0.0000 HMI__STMSG_EVC_CfgList_01_0B := %X\n", getValue( HMI__STMSG_EVC_CfgList_01_0C_AR ) );        filePutString ( buffer, elcount( buffer ), hFile );
    snprintf( buffer, elcount( buffer ), "0.0000 HMI__STMSGT_EVC_CfgList_01_0B := %X\n", getValue( HMI__STMSGT_EVC_CfgList_01_0C_AR ) );        filePutString ( buffer, elcount( buffer ), hFile );
    snprintf( buffer, elcount( buffer ), "0.0000 HMI_CRC_EVC_CfgList_01_0C := %X\n", getValue( HMI_CRC_EVC_CfgList_01_0C ) );        filePutString ( buffer, elcount( buffer ), hFile );
    snprintf( buffer, elcount( buffer ), "0.0000 HMI_CRC_EVC_CfgList_01_0C_Auto := %X\n", getValue( HMI_CRC_EVC_CfgList_01_0C_Auto ) );        filePutString ( buffer, elcount( buffer ), hFile );
    snprintf( buffer, elcount( buffer ), "0.0000 HMI_EVC_CfgList_01_0C_Stat := %X\n", getValue( HMI_EVC_CfgList_01_0C_Stat ) );        filePutString ( buffer, elcount( buffer ), hFile );
    snprintf( buffer, elcount( buffer ), "0.0000 HMI_EVC_List01_StStyle := %X\n", getValue( HMI_EVC_List01_StStyle ) );        filePutString ( buffer, elcount( buffer ), hFile );
    snprintf( buffer, elcount( buffer ), "0.0000 HMI_EVC_List02_BodyStyle := %X\n", getValue( HMI_EVC_List02_BodyStyle ) );        filePutString ( buffer, elcount( buffer ), hFile );
    snprintf( buffer, elcount( buffer ), "0.0000 HMI_EVC_List03_RoofStyle := %X\n", getValue( HMI_EVC_List03_RoofStyle ) );        filePutString ( buffer, elcount( buffer ), hFile );
    snprintf( buffer, elcount( buffer ), "0.0000 HMI_EVC_List04_HL_Style := %X\n", getValue( HMI_EVC_List04_HL_Style ) );        filePutString ( buffer, elcount( buffer ), hFile );
    snprintf( buffer, elcount( buffer ), "0.0000 HMI_EVC_List05_TxStyle := %X\n", getValue( HMI_EVC_List05_TxStyle ) );        filePutString ( buffer, elcount( buffer ), hFile );
    snprintf( buffer, elcount( buffer ), "0.0000 HMI_EVC_List06_VehLineYear := %X\n", getValue( HMI_EVC_List06_VehLineYear ) );        filePutString ( buffer, elcount( buffer ), hFile );
    snprintf( buffer, elcount( buffer ), "0.0000 HMI_EVC_List07_HVAC_Style := %X\n", getValue( HMI_EVC_List07_HVAC_Style ) );        filePutString ( buffer, elcount( buffer ), hFile );
    snprintf( buffer, elcount( buffer ), "0.0000 HMI_EVC_List08_Country := %X\n", getValue( HMI_EVC_List08_Country ) );        filePutString ( buffer, elcount( buffer ), hFile );
    snprintf( buffer, elcount( buffer ), "0.0000 HMI_EVC_List09_HU_Style := %X\n", getValue( HMI_EVC_List09_HU_Style ) );        filePutString ( buffer, elcount( buffer ), hFile );
    snprintf( buffer, elcount( buffer ), "0.0000 HMI_EVC_List0A_TPM_Style := %X\n", getValue( HMI_EVC_List0A_TPM_Style ) );        filePutString ( buffer, elcount( buffer ), hFile );
    snprintf( buffer, elcount( buffer ), "0.0000 HMI_EVC_List0B_AddEquip := %X\n", getValue( HMI_EVC_List0B_AddEquip ) );        filePutString ( buffer, elcount( buffer ), hFile );
    snprintf( buffer, elcount( buffer ), "0.0000 HMI_EVC_List0C_VehLine := %X\n", getValue( HMI_EVC_List0C_VehLine ) );        filePutString ( buffer, elcount( buffer ), hFile );
    snprintf( buffer, elcount( buffer ), "0.0000 HMI_SQC_EVC_CfgList_01_0C := %X\n", getValue( HMI_SQC_EVC_CfgList_01_0C ) );        filePutString ( buffer, elcount( buffer ), hFile );
    snprintf( buffer, elcount( buffer ), "0.0000 HMI_SQC_EVC_CfgList_01_0C_Auto := %X\n", getValue( HMI_SQC_EVC_CfgList_01_0C_Auto ) );        filePutString ( buffer, elcount( buffer ), hFile );
}
/*@@end*/

/*@@timer:_tEVC_CfgList_01_0C_AR:*/
on timer _tEVC_CfgList_01_0C_AR
{
    putValue( HMI__STMSG_EVC_CfgList_01_0C_AR, 0 );
}
/*@@end*/

/*@@envVar:HMI__STMSG_EVC_CfgList_01_0C_AR:*/
on EnvVar HMI__STMSG_EVC_CfgList_01_0C_AR
{
    long tDelay;
    if( getValue( this ) == 2 )
    {
        tDelay = getValue( HMI__STMSGT_EVC_CfgList_01_0C_AR );
        if( tDelay > 0 )    
            setTimer( _tEVC_CfgList_01_0C_AR, tDelay );
        else
            putValue( HMI__STMSG_EVC_CfgList_01_0C_AR, 0 );
    }
}
/*@@end*/

/*@@envVar:HMI_EVC_CfgList_01_0C_Stat:*/
on EnvVar HMI_EVC_CfgList_01_0C_Stat
{
    _mEVC_CfgList_01_0C_AR.EVC_CfgList_01_0C_Stat.phys = getValue(this);
}
/*@@end*/

/*@@envVar:HMI_EVC_List01_StStyle:*/
on EnvVar HMI_EVC_List01_StStyle
{
    _mEVC_CfgList_01_0C_AR.EVC_List01_StStyle.phys = getValue(this);
}
/*@@end*/

/*@@envVar:HMI_EVC_List02_BodyStyle:*/
on EnvVar HMI_EVC_List02_BodyStyle
{
    _mEVC_CfgList_01_0C_AR.EVC_List02_BodyStyle.phys = getValue(this);
}
/*@@end*/

/*@@envVar:HMI_EVC_List03_RoofStyle:*/
on EnvVar HMI_EVC_List03_RoofStyle
{
    _mEVC_CfgList_01_0C_AR.EVC_List03_RoofStyle.phys = getValue(this);
}
/*@@end*/

/*@@envVar:HMI_EVC_List04_HL_Style:*/
on EnvVar HMI_EVC_List04_HL_Style
{
    _mEVC_CfgList_01_0C_AR.EVC_List04_HL_Style.phys = getValue(this);
}
/*@@end*/

/*@@envVar:HMI_EVC_List05_TxStyle:*/
on EnvVar HMI_EVC_List05_TxStyle
{
    _mEVC_CfgList_01_0C_AR.EVC_List05_TxStyle.phys = getValue(this);
}
/*@@end*/

/*@@envVar:HMI_EVC_List06_VehLineYear:*/
on EnvVar HMI_EVC_List06_VehLineYear
{
    _mEVC_CfgList_01_0C_AR.EVC_List06_VehLineYear.phys = getValue(this);
}
/*@@end*/

/*@@envVar:HMI_EVC_List07_HVAC_Style:*/
on EnvVar HMI_EVC_List07_HVAC_Style
{
    _mEVC_CfgList_01_0C_AR.EVC_List07_HVAC_Style.phys = getValue(this);
}
/*@@end*/

/*@@envVar:HMI_EVC_List08_Country:*/
on EnvVar HMI_EVC_List08_Country
{
    _mEVC_CfgList_01_0C_AR.EVC_List08_Country.phys = getValue(this);
}
/*@@end*/

/*@@envVar:HMI_EVC_List09_HU_Style:*/
on EnvVar HMI_EVC_List09_HU_Style
{
    _mEVC_CfgList_01_0C_AR.EVC_List09_HU_Style.phys = getValue(this);
}
/*@@end*/

/*@@envVar:HMI_EVC_List0A_TPM_Style:*/
on EnvVar HMI_EVC_List0A_TPM_Style
{
    _mEVC_CfgList_01_0C_AR.EVC_List0A_TPM_Style.phys = getValue(this);
}
/*@@end*/

/*@@envVar:HMI_EVC_List0B_AddEquip:*/
on EnvVar HMI_EVC_List0B_AddEquip
{
    _mEVC_CfgList_01_0C_AR.EVC_List0B_AddEquip.phys = getValue(this);
}
/*@@end*/

/*@@envVar:HMI_EVC_List0C_VehLine:*/
on EnvVar HMI_EVC_List0C_VehLine
{
    _mEVC_CfgList_01_0C_AR.EVC_List0C_VehLine.phys = getValue(this);
}
/*@@end*/

/*@@caplFunc:FBL_CFG_Star2_AR_check_output():*/
FBL_CFG_Star2_AR_check_output()
{
    if( !getValue( HMI__STMSG_FBL_CFG_Star2_AR ) )
    {
        // Botschaft FBL_CFG_Star2_AR ID:104 --- Sendeart 0 cyclicX --- 
        _FBL_CFG_Star2_AR_Cnt--;
        if( _FBL_CFG_Star2_AR_Cnt < 1 )
        {
            FBL_CFG_Star2_AR_output(); // Nachricht wg. abgelaufenem Zyklus ausgeben
            _FBL_CFG_Star2_AR_Cnt = _FBL_CFG_Star2_AR_CycleCount; // Zyklus-Zähler zurücksetzen
        }
    }
}
/*@@end*/

/*@@caplFunc:FBL_CFG_Star2_AR_init():*/
FBL_CFG_Star2_AR_init()
{   /* Botschaft FBL_CFG_Star2_AR ID: 104 --- Sendeart 0 cyclicX --- 
BA_ "ApplMessage" BO_ 104 0;
BA_ "NmAsrMessage" BO_ 104 0;
BA_ "GenMsgMinAcceptLength" BO_ 104 1;
BA_ "GenMsgILSupport" BO_ 104 1;
BA_ "DiagState" BO_ 104 0;
BA_ "DiagRequest" BO_ 104 0;
BA_ "DiagResponse" BO_ 104 0;
BA_ "GenMsgStartValue" BO_ 104 "0";
BA_ "GenMsgStartDelayTime" BO_ 104 15;
BA_ "GenMsgCycleTime" BO_ 104 200;
BA_ "GenMsgSendType" BO_ 104 0;
    */
    _FBL_CFG_Star2_AR_Timebase =           c_tDBKomTimer_20ms;
    _FBL_CFG_Star2_AR_CycleCount =        200 / _FBL_CFG_Star2_AR_Timebase;
    _FBL_CFG_Star2_AR_StartDelay =         15 / _FBL_CFG_Star2_AR_Timebase;
    _FBL_CFG_Star2_AR_Cnt = _FBL_CFG_Star2_AR_StartDelay;
    
    putValue( HMI__STMSGSD_FBL_CFG_Star2_AR, _FBL_CFG_Star2_AR_StartDelay * _FBL_CFG_Star2_AR_Timebase );

    _mFBL_CFG_Star2_AR.Platform_Stat_Star2.phys = getValue( HMI_Platform_Stat_Star2 );
}
/*@@end*/

/*@@caplFunc:FBL_CFG_Star2_AR_output():*/
FBL_CFG_Star2_AR_output(void)
{
    output( _mFBL_CFG_Star2_AR );
}
/*@@end*/

/*@@caplFunc:FBL_CFG_Star2_AR_saveEnvVars(dword):*/
FBL_CFG_Star2_AR_saveEnvVars( dword hFile )
{
    filePutString("\n// Knoten EIS: FBL_CFG_Star2_AR\n", 26, hFile );
    snprintf( buffer, elcount( buffer ), "0.0000 HMI__STMSG_FBL_CFG_Star2_AR := %X\n", getValue( HMI__STMSG_FBL_CFG_Star2_AR ) );    filePutString( buffer, elcount( buffer ), hFile );
    snprintf( buffer, elcount( buffer ), "0.0000 HMI__STMSGT_FBL_CFG_Star2_AR := %X\n", getValue( HMI__STMSGT_FBL_CFG_Star2_AR ) );    filePutString( buffer, elcount( buffer ), hFile );
    snprintf( buffer, elcount( buffer ), "0.0000 HMI_Platform_Stat_Star2 := %X\n", getValue( HMI_Platform_Stat_Star2 ) );    filePutString( buffer, elcount( buffer ), hFile );
}
/*@@end*/

/*@@timer:_tFBL_CFG_Star2_AR:*/
on timer _tFBL_CFG_Star2_AR
{
    putValue( HMI__STMSG_FBL_CFG_Star2_AR, 0 );
}
/*@@end*/

/*@@envVar:HMI__STMSG_FBL_CFG_Star2_AR:*/
on EnvVar HMI__STMSG_FBL_CFG_Star2_AR
{
    long tDelay;
    if( getValue( this ) == 2 )
    {
        tDelay = getValue( HMI__STMSGT_FBL_CFG_Star2_AR );
        if( tDelay > 0)    
            setTimer( _tFBL_CFG_Star2_AR, tDelay );
        else
            putValue( HMI__STMSG_FBL_CFG_Star2_AR, 0 );
    }
}
/*@@end*/

/*@@envVar:HMI_Platform_Stat_Star2:*/
on EnvVar HMI_Platform_Stat_Star2
{

   _mFBL_CFG_Star2_AR.Platform_Stat_Star2.phys = getValue(this);
}
/*@@end*/

/*@@caplFunc:FCW_Disp_Rq_AR_check_output():*/
FCW_Disp_Rq_AR_check_output()
{
    if( !getValue( HMI__STMSG_FCW_Disp_Rq_AR ) )
    {
        // Botschaft FCW_Disp_Rq_AR ID: 1173 --- Sendeart 5 cyclicAndSpontanWithDelay --- 
        if( _FCW_Disp_Rq_AR_DelayCnt > 0) _FCW_Disp_Rq_AR_DelayCnt--; // Mindestsendeabstand
        _FCW_Disp_Rq_AR_Cnt--;
        if( _FCW_Disp_Rq_AR_Cnt < 1 )
        {
            if( _FCW_Disp_Rq_AR_DelayCnt < 1 )
            {
                FCW_Disp_Rq_AR_output(); // Nachricht wg. abgelaufenem Zyklus ausgeben (Mindestsendeabstand eingehalten)
                _FCW_Disp_Rq_AR_SpontanFlag = 0; // Spontan-Flag zurücksetzen
                _FCW_Disp_Rq_AR_DelayCnt = _FCW_Disp_Rq_AR_MinDelay;
            }
            else
            {
                // Spontanflag setzen damit nach Ablauf Mindestsendeabstand gesendet wird
                 _FCW_Disp_Rq_AR_SpontanFlag = 1;
            }
            _FCW_Disp_Rq_AR_Cnt = _FCW_Disp_Rq_AR_CycleCount; // Zyklus-Zähler zurücksetzen
        }
        else if( _FCW_Disp_Rq_AR_SpontanFlag)
        {
            if( _FCW_Disp_Rq_AR_DelayCnt < 1 )
            {
                FCW_Disp_Rq_AR_output(); // Nachricht wg. spontaner Änderung ausgeben (Mindestsendeabstand eingehalten)
                _FCW_Disp_Rq_AR_SpontanFlag = 0; // Spontan-Flag zurücksetzen
                _FCW_Disp_Rq_AR_DelayCnt = _FCW_Disp_Rq_AR_MinDelay;
            }
        }
    }
}
/*@@end*/

/*@@caplFunc:FCW_Disp_Rq_AR_init():*/
FCW_Disp_Rq_AR_init()
{   /* Botschaft FCW_Disp_Rq_AR ID: 1173 --- Sendeart 5 cyclicAndSpontanWithDelay --- 
BA_ "ApplMessage" BO_ 1173 0;
BA_ "NmAsrMessage" BO_ 1173 0;
BA_ "GenMsgMinAcceptLength" BO_ 1173 8;
BA_ "GenMsgILSupport" BO_ 1173 1;
BA_ "DiagState" BO_ 1173 0;
BA_ "DiagRequest" BO_ 1173 0;
BA_ "DiagResponse" BO_ 1173 0;
BA_ "GenMsgStartValue" BO_ 1173 "0";
BA_ "GenMsgStartDelayTime" BO_ 1173 0;
BA_ "GenMsgDelayTime" BO_ 1173 5;
BA_ "GenMsgNrOfRepetitions" BO_ 1173 0;
BA_ "GenMsgCycleTime" BO_ 1173 200;
BA_ "GenMsgSendType" BO_ 1173 5;
    */
    _FCW_Disp_Rq_AR_Timebase =             c_tDBKomTimer_20ms;
    _FCW_Disp_Rq_AR_CycleCount =          200 / _FCW_Disp_Rq_AR_Timebase;
    _FCW_Disp_Rq_AR_StartDelay =            0 / _FCW_Disp_Rq_AR_Timebase;
    _FCW_Disp_Rq_AR_MinDelay =              5 / _FCW_Disp_Rq_AR_Timebase;
    _FCW_Disp_Rq_AR_Cnt = _FCW_Disp_Rq_AR_StartDelay;
    _FCW_Disp_Rq_AR_SpontanFlag = 0;
    _FCW_Disp_Rq_AR_DelayCnt = 0;

    putValue( HMI__STMSGSD_FCW_Disp_Rq_AR, _FCW_Disp_Rq_AR_StartDelay * _FCW_Disp_Rq_AR_Timebase );

    _mFCW_Disp_Rq_AR.FCW_AcustWarn_Rq.phys = getValue( HMI_FCW_AcustWarn_Rq );
    _mFCW_Disp_Rq_AR.FCW_IndLmp_On_Rq.phys = getValue( HMI_FCW_IndLmp_On_Rq );
    _mFCW_Disp_Rq_AR.FCW_MsgDisp_Rq.phys = getValue( HMI_FCW_MsgDisp_Rq );
    _mFCW_Disp_Rq_AR.FCW_ObjIntrstDist.phys = getValue( HMI_FCW_ObjIntrstDist );
    _mFCW_Disp_Rq_AR.FCW_ObjIntrstDist_SPEEDO1.phys = getValue( HMI_FCW_ObjIntrstDist_SPEEDO1 );
    _mFCW_Disp_Rq_AR.FCW_ObjIntrstDist_SPEEDO2.phys = getValue( HMI_FCW_ObjIntrstDist_SPEEDO2 );
    _mFCW_Disp_Rq_AR.FCW_Stat.phys = getValue( HMI_FCW_Stat );
    _mFCW_Disp_Rq_AR.PN14_ElecPwr_Rq_AS.phys = getValue( HMI_PN14_ElecPwr_Rq_AS );
}
/*@@end*/

/*@@caplFunc:FCW_Disp_Rq_AR_output():*/
FCW_Disp_Rq_AR_output(void)
{
    output( _mFCW_Disp_Rq_AR );
}
/*@@end*/

/*@@caplFunc:FCW_Disp_Rq_AR_saveEnvVars(dword):*/
FCW_Disp_Rq_AR_saveEnvVars( dword hFile )
{
    filePutString("\n// Knoten EIS: FCW_Disp_Rq_AR\n", 26, hFile );
    snprintf( buffer, elcount( buffer ), "0.0000 HMI__STMSG_FCW_Disp_Rq_AR := %X\n", getValue( HMI__STMSG_FCW_Disp_Rq_AR ) );    filePutString( buffer, elcount( buffer ), hFile );
    snprintf( buffer, elcount( buffer ), "0.0000 HMI__STMSGT_FCW_Disp_Rq_AR := %X\n", getValue( HMI__STMSGT_FCW_Disp_Rq_AR ) );    filePutString( buffer, elcount( buffer ), hFile );
    snprintf( buffer, elcount( buffer ), "0.0000 HMI_FCW_AcustWarn_Rq := %X\n", getValue( HMI_FCW_AcustWarn_Rq ) );    filePutString( buffer, elcount( buffer ), hFile );
    snprintf( buffer, elcount( buffer ), "0.0000 HMI_FCW_IndLmp_On_Rq := %X\n", getValue( HMI_FCW_IndLmp_On_Rq ) );    filePutString( buffer, elcount( buffer ), hFile );
    snprintf( buffer, elcount( buffer ), "0.0000 HMI_FCW_MsgDisp_Rq := %X\n", getValue( HMI_FCW_MsgDisp_Rq ) );    filePutString( buffer, elcount( buffer ), hFile );
    snprintf( buffer, elcount( buffer ), "0.0000 HMI_FCW_ObjIntrstDist := %X\n", getValue( HMI_FCW_ObjIntrstDist ) );    filePutString( buffer, elcount( buffer ), hFile );
    snprintf( buffer, elcount( buffer ), "0.0000 HMI_FCW_ObjIntrstDist_SPEEDO1 := %X\n", getValue( HMI_FCW_ObjIntrstDist_SPEEDO1 ) );    filePutString( buffer, elcount( buffer ), hFile );
    snprintf( buffer, elcount( buffer ), "0.0000 HMI_FCW_ObjIntrstDist_SPEEDO2 := %X\n", getValue( HMI_FCW_ObjIntrstDist_SPEEDO2 ) );    filePutString( buffer, elcount( buffer ), hFile );
    snprintf( buffer, elcount( buffer ), "0.0000 HMI_FCW_Stat := %X\n", getValue( HMI_FCW_Stat ) );    filePutString( buffer, elcount( buffer ), hFile );
    snprintf( buffer, elcount( buffer ), "0.0000 HMI_PN14_ElecPwr_Rq_AS := %X\n", getValue( HMI_PN14_ElecPwr_Rq_AS ) );    filePutString( buffer, elcount( buffer ), hFile );
}
/*@@end*/

/*@@timer:_tFCW_Disp_Rq_AR:*/
on timer _tFCW_Disp_Rq_AR
{
    putValue( HMI__STMSG_FCW_Disp_Rq_AR, 0 );
}
/*@@end*/

/*@@envVar:HMI__STMSG_FCW_Disp_Rq_AR:*/
on EnvVar HMI__STMSG_FCW_Disp_Rq_AR
{
    long tDelay;
    if( getValue( this ) == 2 )
    {
        tDelay = getValue( HMI__STMSGT_FCW_Disp_Rq_AR );
        if( tDelay > 0)    
            setTimer( _tFCW_Disp_Rq_AR, tDelay );
        else
            putValue( HMI__STMSG_FCW_Disp_Rq_AR, 0 );
    }
}
/*@@end*/

/*@@envVar:HMI_FCW_AcustWarn_Rq:*/
on EnvVar HMI_FCW_AcustWarn_Rq
{
    _mFCW_Disp_Rq_AR.FCW_AcustWarn_Rq.phys = getValue(this);
    _FCW_Disp_Rq_AR_SpontanFlag = 1;
}
/*@@end*/

/*@@envVar:HMI_FCW_IndLmp_On_Rq:*/
on EnvVar HMI_FCW_IndLmp_On_Rq
{
    _mFCW_Disp_Rq_AR.FCW_IndLmp_On_Rq.phys = getValue(this);
    _FCW_Disp_Rq_AR_SpontanFlag = 1;
}
/*@@end*/

/*@@envVar:HMI_FCW_MsgDisp_Rq:*/
on EnvVar HMI_FCW_MsgDisp_Rq
{
    _mFCW_Disp_Rq_AR.FCW_MsgDisp_Rq.phys = getValue(this);
    _FCW_Disp_Rq_AR_SpontanFlag = 1;
}
/*@@end*/

/*@@envVar:HMI_FCW_ObjIntrstDist:*/
on EnvVar HMI_FCW_ObjIntrstDist
{
    _mFCW_Disp_Rq_AR.FCW_ObjIntrstDist.phys = getValue(this);
    _FCW_Disp_Rq_AR_SpontanFlag = 1;
}
/*@@end*/

/*@@envVar:HMI_FCW_ObjIntrstDist_SPEEDO1:*/
on EnvVar HMI_FCW_ObjIntrstDist_SPEEDO1
{
    _mFCW_Disp_Rq_AR.FCW_ObjIntrstDist_SPEEDO1.phys = getValue(this);
    _FCW_Disp_Rq_AR_SpontanFlag = 1;
}
/*@@end*/

/*@@envVar:HMI_FCW_ObjIntrstDist_SPEEDO2:*/
on EnvVar HMI_FCW_ObjIntrstDist_SPEEDO2
{
    _mFCW_Disp_Rq_AR.FCW_ObjIntrstDist_SPEEDO2.phys = getValue(this);
    _FCW_Disp_Rq_AR_SpontanFlag = 1;
}
/*@@end*/

/*@@envVar:HMI_FCW_Stat:*/
on EnvVar HMI_FCW_Stat
{
    _mFCW_Disp_Rq_AR.FCW_Stat.phys = getValue(this);
    _FCW_Disp_Rq_AR_SpontanFlag = 1;
}
/*@@end*/

/*@@envVar:HMI_PN14_ElecPwr_Rq_AS:*/
on EnvVar HMI_PN14_ElecPwr_Rq_AS
{
    _mFCW_Disp_Rq_AR.PN14_ElecPwr_Rq_AS.phys = getValue(this);
    _FCW_Disp_Rq_AR_SpontanFlag = 1;
}
/*@@end*/

/*@@caplFunc:FuelLvl_Stat_AR_check_output():*/
FuelLvl_Stat_AR_check_output()
{
    if( !getValue( HMI__STMSG_FuelLvl_Stat_AR ) )
    {
        // Botschaft FuelLvl_Stat_AR ID: 766 --- Sendeart 0 cyclicX --- 
        _FuelLvl_Stat_AR_Cnt--;
        if( _FuelLvl_Stat_AR_Cnt < 1 )
        {
            FuelLvl_Stat_AR_output(); // Nachricht wg. abgelaufenem Zyklus ausgeben
            _FuelLvl_Stat_AR_Cnt = _FuelLvl_Stat_AR_CycleCount; // Zyklus-Zähler zurücksetzen
        }
    }
}
/*@@end*/

/*@@caplFunc:FuelLvl_Stat_AR_init():*/
FuelLvl_Stat_AR_init()
{   /* Botschaft FuelLvl_Stat_AR ID: 766 --- Sendeart 0 cyclicX --- 
BA_ "ApplMessage" BO_ 766 0;
BA_ "NmAsrMessage" BO_ 766 0;
BA_ "GenMsgMinAcceptLength" BO_ 766 8;
BA_ "GenMsgILSupport" BO_ 766 1;
BA_ "DiagState" BO_ 766 0;
BA_ "DiagRequest" BO_ 766 0;
BA_ "DiagResponse" BO_ 766 0;
BA_ "GenMsgStartValue" BO_ 766 "0";
BA_ "GenMsgCycleTime" BO_ 766 1000;
BA_ "GenMsgSendType" BO_ 766 0;
    */
    _FuelLvl_Stat_AR_Timebase =          c_tDBKomTimer_20ms;
    _FuelLvl_Stat_AR_CycleCount =     1000 / _FuelLvl_Stat_AR_Timebase;
    _FuelLvl_Stat_AR_StartDelay =        0 / _FuelLvl_Stat_AR_Timebase;
    _FuelLvl_Stat_AR_Cnt = _FuelLvl_Stat_AR_StartDelay;

    putValue( HMI__STMSGSD_FuelLvl_Stat_AR, _FuelLvl_Stat_AR_StartDelay * _FuelLvl_Stat_AR_Timebase );

    putValue( HMI_TankLvl, 50 ); // Tank halb voll
    _mFuelLvl_Stat_AR.FSCM_FuelRefillEvent_Dtct.phys = getValue( HMI_FSCM_FuelRefillEvent_Dtct );
    _mFuelLvl_Stat_AR.FSCM_TankLvl_Min_50.phys = getValue( HMI_FSCM_TankLvl_Min_50 );
    _mFuelLvl_Stat_AR.Fuel_Lvl_Critic.phys = getValue( HMI_Fuel_Lvl_Critic );
    _mFuelLvl_Stat_AR.FuelTemp.phys = getValue( HMI_FuelTemp );
    _mFuelLvl_Stat_AR.MIL_On_Rq_FSCM.phys = getValue( HMI_MIL_On_Rq_FSCM );
    _mFuelLvl_Stat_AR.TankLvl.phys = getValue( HMI_TankLvl );
    _mFuelLvl_Stat_AR.TankLvl_Disp_V2.phys = getValue( HMI_TankLvl_Disp_V2 );
    _mFuelLvl_Stat_AR.TankLvl_Max.phys = getValue( HMI_TankLvl_Max );
    _mFuelLvl_Stat_AR.TankLvl_Min.phys = getValue( HMI_TankLvl_Min );
}
/*@@end*/

/*@@caplFunc:FuelLvl_Stat_AR_output():*/
FuelLvl_Stat_AR_output(void)
{
    output( _mFuelLvl_Stat_AR );
}
/*@@end*/

/*@@caplFunc:FuelLvl_Stat_AR_saveEnvVars(dword):*/
FuelLvl_Stat_AR_saveEnvVars( dword hFile )
{
    filePutString("\n// Knoten EIS: FuelLvl_Stat_AR\n", 26, hFile );
    snprintf( buffer, elcount( buffer ), "0.0000 HMI__STMSG_FuelLvl_Stat_AR := %X\n", getValue( HMI__STMSG_FuelLvl_Stat_AR ) );    filePutString( buffer, elcount( buffer ), hFile );
    snprintf( buffer, elcount( buffer ), "0.0000 HMI__STMSGT_FuelLvl_Stat_AR := %X\n", getValue( HMI__STMSGT_FuelLvl_Stat_AR ) );    filePutString( buffer, elcount( buffer ), hFile );
    snprintf( buffer, elcount( buffer ), "0.0000 HMI_FSCM_FuelRefillEvent_Dtct := %X\n", getValue( HMI_FSCM_FuelRefillEvent_Dtct ) );    filePutString( buffer, elcount( buffer ), hFile );
    snprintf( buffer, elcount( buffer ), "0.0000 HMI_FSCM_TankLvl_Min_50 := %X\n", getValue( HMI_FSCM_TankLvl_Min_50 ) );    filePutString( buffer, elcount( buffer ), hFile );
    snprintf( buffer, elcount( buffer ), "0.0000 HMI_Fuel_Lvl_Critic := %X\n", getValue( HMI_Fuel_Lvl_Critic ) );    filePutString( buffer, elcount( buffer ), hFile );
    snprintf( buffer, elcount( buffer ), "0.0000 HMI_FuelTemp := %X\n", getValue( HMI_FuelTemp ) );    filePutString( buffer, elcount( buffer ), hFile );
    snprintf( buffer, elcount( buffer ), "0.0000 HMI_MIL_On_Rq_FSCM := %X\n", getValue( HMI_MIL_On_Rq_FSCM ) );    filePutString( buffer, elcount( buffer ), hFile );
    snprintf( buffer, elcount( buffer ), "0.0000 HMI_TankLvl := %X\n", getValue( HMI_TankLvl ) );    filePutString( buffer, elcount( buffer ), hFile );
    snprintf( buffer, elcount( buffer ), "0.0000 HMI_TankLvl_Disp_V2 := %X\n", getValue( HMI_TankLvl_Disp_V2 ) );    filePutString( buffer, elcount( buffer ), hFile );
    snprintf( buffer, elcount( buffer ), "0.0000 HMI_TankLvl_Max := %X\n", getValue( HMI_TankLvl_Max ) );    filePutString( buffer, elcount( buffer ), hFile );
    snprintf( buffer, elcount( buffer ), "0.0000 HMI_TankLvl_Min := %X\n", getValue( HMI_TankLvl_Min ) );    filePutString( buffer, elcount( buffer ), hFile );
}
/*@@end*/

/*@@timer:_tFuelLvl_Stat_AR:*/
on timer _tFuelLvl_Stat_AR
{
    putValue( HMI__STMSG_FuelLvl_Stat_AR, 0 );
}
/*@@end*/

/*@@envVar:HMI__STMSG_FuelLvl_Stat_AR:*/
on EnvVar HMI__STMSG_FuelLvl_Stat_AR
{
    long tDelay;
    if( getValue( this ) == 2 )
    {
        tDelay = getValue( HMI__STMSGT_FuelLvl_Stat_AR );
        if( tDelay > 0)    
            setTimer( _tFuelLvl_Stat_AR, tDelay );
        else
            putValue( HMI__STMSG_FuelLvl_Stat_AR, 0 );
    }
}
/*@@end*/

/*@@envVar:HMI_FSCM_FuelRefillEvent_Dtct:*/
on EnvVar HMI_FSCM_FuelRefillEvent_Dtct
{
    _mFuelLvl_Stat_AR.FSCM_FuelRefillEvent_Dtct.phys = getValue(this);
}
/*@@end*/

/*@@envVar:HMI_FSCM_TankLvl_Min_50:*/
on EnvVar HMI_FSCM_TankLvl_Min_50
{
    _mFuelLvl_Stat_AR.FSCM_TankLvl_Min_50.phys = getValue(this);
}
/*@@end*/

/*@@envVar:HMI_Fuel_Lvl_Critic:*/
on EnvVar HMI_Fuel_Lvl_Critic
{
    _mFuelLvl_Stat_AR.Fuel_Lvl_Critic.phys = getValue(this);
}
/*@@end*/

/*@@envVar:HMI_FuelTemp:*/
on EnvVar HMI_FuelTemp
{
    _mFuelLvl_Stat_AR.FuelTemp.phys = getValue(this);
}
/*@@end*/

/*@@envVar:HMI_MIL_On_Rq_FSCM:*/
on EnvVar HMI_MIL_On_Rq_FSCM
{
    _mFuelLvl_Stat_AR.MIL_On_Rq_FSCM.phys = getValue(this);
}
/*@@end*/

/*@@envVar:HMI_TankLvl:*/
on EnvVar HMI_TankLvl
{
    _mFuelLvl_Stat_AR.TankLvl.phys = getValue(this);
}
/*@@end*/

/*@@envVar:HMI_TankLvl_Disp_V2:*/
on EnvVar HMI_TankLvl_Disp_V2
{
    _mFuelLvl_Stat_AR.TankLvl_Disp_V2.phys = getValue(this);
}
/*@@end*/

/*@@envVar:HMI_TankLvl_Max:*/
on EnvVar HMI_TankLvl_Max
{
    _mFuelLvl_Stat_AR.TankLvl_Max.phys = getValue(this);
}
/*@@end*/

/*@@envVar:HMI_TankLvl_Min:*/
on EnvVar HMI_TankLvl_Min
{
    _mFuelLvl_Stat_AR.TankLvl_Min.phys = getValue(this);
}
/*@@end*/

/*@@caplFunc:Fuel_Stat2_AR_check_output():*/
Fuel_Stat2_AR_check_output()
{
    if( !getValue( HMI__STMSG_Fuel_Stat2_AR ) )
    {
        // Botschaft Fuel_Stat2_AR --- Sendeart 0 cyclicX
        _Fuel_Stat2_AR_Cnt--;
        if( _Fuel_Stat2_AR_Cnt < 1 )
        {
            Fuel_Stat2_AR_output(); // Nachricht wg. abgelaufenem Zyklus ausgeben
            _Fuel_Stat2_AR_Cnt = _Fuel_Stat2_AR_CycleCount; // Zyklus-Zähler zurücksetzen
        }
    }
}
/*@@end*/

/*@@caplFunc:Fuel_Stat2_AR_init():*/
Fuel_Stat2_AR_init()
{   /* Botschaft Fuel_Stat2_AR ID: 1190 --- Sendeart 0 cyclicX --- 
BA_ "ApplMessage" BO_ 1190 0;
BA_ "NmAsrMessage" BO_ 1190 0;
BA_ "GenMsgMinAcceptLength" BO_ 1190 8;
BA_ "GenMsgILSupport" BO_ 1190 1;
BA_ "DiagState" BO_ 1190 0;
BA_ "DiagRequest" BO_ 1190 0;
BA_ "DiagResponse" BO_ 1190 0;
BA_ "GenMsgStartValue" BO_ 1190 "0";
BA_ "GenMsgCycleTime" BO_ 1190 500;
BA_ "GenMsgSendType" BO_ 1190 0;
    */
    _Fuel_Stat2_AR_Timebase =          c_tDBKomTimer_20ms;
    _Fuel_Stat2_AR_CycleCount =      500 / _Fuel_Stat2_AR_Timebase;
    _Fuel_Stat2_AR_StartDelay =        0 / _Fuel_Stat2_AR_Timebase;
    _Fuel_Stat2_AR_Cnt = _Fuel_Stat2_AR_StartDelay;

    putValue( HMI__STMSGSD_Fuel_Stat2_AR, _Fuel_Stat2_AR_StartDelay * _Fuel_Stat2_AR_Timebase );

    _mFuel_Stat2_AR.CNG_Style.phys = getValue( HMI_CNG_Style );
    _mFuel_Stat2_AR.FuelType_AdBlue_Avl.phys = getValue( HMI_FuelType_AdBlue_Avl );
    _mFuel_Stat2_AR.FuelType_CNG_Avl.phys = getValue( HMI_FuelType_CNG_Avl );
    _mFuel_Stat2_AR.FuelType_Diesel_Avl.phys = getValue( HMI_FuelType_Diesel_Avl );
    _mFuel_Stat2_AR.FuelType_ElecPlugIn_Avl.phys = getValue( HMI_FuelType_ElecPlugIn_Avl );
    _mFuel_Stat2_AR.FuelType_Ethanol_Avl.phys = getValue( HMI_FuelType_Ethanol_Avl );
    _mFuel_Stat2_AR.FuelType_Gasoline_Avl.phys = getValue( HMI_FuelType_Gasoline_Avl );
    _mFuel_Stat2_AR.FuelType_Hydrogen_Avl.phys = getValue( HMI_FuelType_Hydrogen_Avl );
    _mFuel_Stat2_AR.FuelTypeCfg_Vld.phys = getValue( HMI_FuelTypeCfg_Vld );
    _mFuel_Stat2_AR.HybDrv_Avl.phys = getValue( HMI_HybDrv_Avl );
    _mFuel_Stat2_AR.PNHV_Avl.phys = getValue( HMI_PNHV_Avl );
    _mFuel_Stat2_AR.TankRng.phys = getValue( HMI_TankRng );
}
/*@@end*/

/*@@caplFunc:Fuel_Stat2_AR_output():*/
Fuel_Stat2_AR_output(void)
{
    output( _mFuel_Stat2_AR );
}
/*@@end*/

/*@@caplFunc:Fuel_Stat2_AR_saveEnvVars(dword):*/
Fuel_Stat2_AR_saveEnvVars( dword hFile )
{
    filePutString("\n// Knoten EIS: Fuel_Stat2_AR\n", 26, hFile );
    snprintf( buffer, elcount( buffer ), "0.0000 HMI__STMSG_Fuel_Stat2_AR := %X\n", getValue( HMI__STMSG_Fuel_Stat2_AR ) );    filePutString( buffer, elcount( buffer ), hFile );
    snprintf( buffer, elcount( buffer ), "0.0000 HMI__STMSGT_Fuel_Stat2_AR := %X\n", getValue( HMI__STMSGT_Fuel_Stat2_AR ) );    filePutString( buffer, elcount( buffer ), hFile );
    snprintf( buffer, elcount( buffer ), "0.0000 HMI_CNG_Style := %X\n", getValue( HMI_CNG_Style ) );    filePutString( buffer, elcount( buffer ), hFile );
    snprintf( buffer, elcount( buffer ), "0.0000 HMI_FuelType_AdBlue_Avl := %X\n", getValue( HMI_FuelType_AdBlue_Avl ) );    filePutString( buffer, elcount( buffer ), hFile );
    snprintf( buffer, elcount( buffer ), "0.0000 HMI_FuelType_CNG_Avl := %X\n", getValue( HMI_FuelType_CNG_Avl ) );    filePutString( buffer, elcount( buffer ), hFile );
    snprintf( buffer, elcount( buffer ), "0.0000 HMI_FuelType_Diesel_Avl := %X\n", getValue( HMI_FuelType_Diesel_Avl ) );    filePutString( buffer, elcount( buffer ), hFile );
    snprintf( buffer, elcount( buffer ), "0.0000 HMI_FuelType_ElecPlugIn_Avl := %X\n", getValue( HMI_FuelType_ElecPlugIn_Avl ) );    filePutString( buffer, elcount( buffer ), hFile );
    snprintf( buffer, elcount( buffer ), "0.0000 HMI_FuelType_Ethanol_Avl := %X\n", getValue( HMI_FuelType_Ethanol_Avl ) );    filePutString( buffer, elcount( buffer ), hFile );
    snprintf( buffer, elcount( buffer ), "0.0000 HMI_FuelType_Gasoline_Avl := %X\n", getValue( HMI_FuelType_Gasoline_Avl ) );    filePutString( buffer, elcount( buffer ), hFile );
    snprintf( buffer, elcount( buffer ), "0.0000 HMI_FuelType_Hydrogen_Avl := %X\n", getValue( HMI_FuelType_Hydrogen_Avl ) );    filePutString( buffer, elcount( buffer ), hFile );
    snprintf( buffer, elcount( buffer ), "0.0000 HMI_FuelTypeCfg_Vld := %X\n", getValue( HMI_FuelTypeCfg_Vld ) );    filePutString( buffer, elcount( buffer ), hFile );
    snprintf( buffer, elcount( buffer ), "0.0000 HMI_HybDrv_Avl := %X\n", getValue( HMI_HybDrv_Avl ) );    filePutString( buffer, elcount( buffer ), hFile );
    snprintf( buffer, elcount( buffer ), "0.0000 HMI_PNHV_Avl := %X\n", getValue( HMI_PNHV_Avl ) );    filePutString( buffer, elcount( buffer ), hFile );
    snprintf( buffer, elcount( buffer ), "0.0000 HMI_TankRng := %X\n", getValue( HMI_TankRng ) );    filePutString( buffer, elcount( buffer ), hFile );
}
/*@@end*/

/*@@timer:_tFuel_Stat2_AR:*/
on timer _tFuel_Stat2_AR
{
    putValue( HMI__STMSG_Fuel_Stat2_AR, 0 );
}
/*@@end*/

/*@@envVar:HMI__STMSG_Fuel_Stat2_AR:*/
on EnvVar HMI__STMSG_Fuel_Stat2_AR
{
    long tDelay;
    if( getValue( this ) == 2 )
    {
        tDelay = getValue( HMI__STMSGT_Fuel_Stat2_AR );
        if( tDelay > 0)    
            setTimer( _tFuel_Stat2_AR, tDelay );
        else
            putValue( HMI__STMSG_Fuel_Stat2_AR, 0 );
    }
}
/*@@end*/

/*@@envVar:HMI_CNG_Style:*/
on EnvVar HMI_CNG_Style
{
   _mFuel_Stat2_AR.CNG_Style.phys = getValue(this);
}
/*@@end*/

/*@@envVar:HMI_FuelType_AdBlue_Avl:*/
on EnvVar HMI_FuelType_AdBlue_Avl
{
   _mFuel_Stat2_AR.FuelType_AdBlue_Avl.phys = getValue(this);
}
/*@@end*/

/*@@envVar:HMI_FuelType_CNG_Avl:*/
on EnvVar HMI_FuelType_CNG_Avl
{
   _mFuel_Stat2_AR.FuelType_CNG_Avl.phys = getValue(this);
}
/*@@end*/

/*@@envVar:HMI_FuelType_Diesel_Avl:*/
on EnvVar HMI_FuelType_Diesel_Avl
{
   _mFuel_Stat2_AR.FuelType_Diesel_Avl.phys = getValue(this);
}
/*@@end*/

/*@@envVar:HMI_FuelType_ElecPlugIn_Avl:*/
on EnvVar HMI_FuelType_ElecPlugIn_Avl
{
   _mFuel_Stat2_AR.FuelType_ElecPlugIn_Avl.phys = getValue(this);
}
/*@@end*/

/*@@envVar:HMI_FuelType_Ethanol_Avl:*/
on EnvVar HMI_FuelType_Ethanol_Avl
{
   _mFuel_Stat2_AR.FuelType_Ethanol_Avl.phys = getValue(this);
}
/*@@end*/

/*@@envVar:HMI_FuelType_Gasoline_Avl:*/
on EnvVar HMI_FuelType_Gasoline_Avl
{
   _mFuel_Stat2_AR.FuelType_Gasoline_Avl.phys = getValue(this);
}
/*@@end*/

/*@@envVar:HMI_FuelType_Hydrogen_Avl:*/
on EnvVar HMI_FuelType_Hydrogen_Avl
{
   _mFuel_Stat2_AR.FuelType_Hydrogen_Avl.phys = getValue(this);
}
/*@@end*/

/*@@envVar:HMI_FuelTypeCfg_Vld:*/
on EnvVar HMI_FuelTypeCfg_Vld
{
   _mFuel_Stat2_AR.FuelTypeCfg_Vld.phys = getValue(this);
}
/*@@end*/

/*@@envVar:HMI_HybDrv_Avl:*/
on EnvVar HMI_HybDrv_Avl
{
   _mFuel_Stat2_AR.HybDrv_Avl.phys = getValue(this);
}
/*@@end*/

/*@@envVar:HMI_PNHV_Avl:*/
on EnvVar HMI_PNHV_Avl
{
   _mFuel_Stat2_AR.PNHV_Avl.phys = getValue(this);
}
/*@@end*/

/*@@envVar:HMI_TankRng:*/
on EnvVar HMI_TankRng
{
   _mFuel_Stat2_AR.TankRng.phys = getValue(this);
}
/*@@end*/

/*@@caplFunc:FWLP_D_AR_check_output():*/
FWLP_D_AR_check_output()
{
    if( !getValue( HMI__STMSG_FWLP_D_AR ) )
    {
        // Botschaft FWLP_D_AR ID: 1191 --- Sendeart 5 cyclicAndSpontanWithDelay --- 
        if( _FWLP_D_AR_DelayCnt > 0) _FWLP_D_AR_DelayCnt--; // Mindestsendeabstand
        _FWLP_D_AR_Cnt--;
        if( _FWLP_D_AR_Cnt < 1 )
        {
            if( _FWLP_D_AR_DelayCnt < 1 )
            {
                FWLP_D_AR_output(); // Nachricht wg. abgelaufenem Zyklus ausgeben (Mindestsendeabstand eingehalten)
                _FWLP_D_AR_SpontanFlag = 0; // Spontan-Flag zurücksetzen
                _FWLP_D_AR_DelayCnt = _FWLP_D_AR_MinDelay;
            }
            else
            {
                // Spontanflag setzen damit nach Ablauf Mindestsendeabstand gesendet wird
                 _FWLP_D_AR_SpontanFlag = 1;
            }
            _FWLP_D_AR_Cnt = _FWLP_D_AR_CycleCount; // Zyklus-Zähler zurücksetzen
        }
        else if( _FWLP_D_AR_SpontanFlag)
        {
            if( _FWLP_D_AR_DelayCnt < 1 )
            {
                FWLP_D_AR_output(); // Nachricht wg. spontaner Änderung ausgeben (Mindestsendeabstand eingehalten)
                _FWLP_D_AR_SpontanFlag = 0; // Spontan-Flag zurücksetzen
                _FWLP_D_AR_DelayCnt = _FWLP_D_AR_MinDelay;
            }
        }
    }
}
/*@@end*/

/*@@caplFunc:FWLP_D_AR_init():*/
FWLP_D_AR_init()
{   /* Botschaft FWLP_D_AR ID: 1191 --- Sendeart 5 cyclicAndSpontanWithDelay --- 
BA_ "ApplMessage" BO_ 1191 0;
BA_ "NmAsrMessage" BO_ 1191 0;
BA_ "GenMsgMinAcceptLength" BO_ 1191 5;
BA_ "GenMsgILSupport" BO_ 1191 1;
BA_ "DiagState" BO_ 1191 0;
BA_ "DiagRequest" BO_ 1191 0;
BA_ "DiagResponse" BO_ 1191 0;
BA_ "GenMsgStartValue" BO_ 1191 "0";
BA_ "GenMsgDelayTime" BO_ 1191 100;
BA_ "GenMsgNrOfRepetitions" BO_ 1191 0;
BA_ "GenMsgCycleTime" BO_ 1191 1000;
BA_ "GenMsgSendType" BO_ 1191 5;
    */
    _FWLP_D_AR_Timebase =             c_tDBKomTimer_20ms;
    _FWLP_D_AR_CycleCount =         1000 / _FWLP_D_AR_Timebase;
    _FWLP_D_AR_StartDelay =            0 / _FWLP_D_AR_Timebase;
    _FWLP_D_AR_MinDelay =            100 / _FWLP_D_AR_Timebase;
    _FWLP_D_AR_Cnt = _FWLP_D_AR_StartDelay;
    _FWLP_D_AR_SpontanFlag = 0;
    _FWLP_D_AR_DelayCnt = 0;

    putValue( HMI__STMSGSD_FWLP_D_AR, _FWLP_D_AR_StartDelay * _FWLP_D_AR_Timebase );

    _mFWLP_D_AR.FWLP_AirCons_On_D.phys = getValue( HMI_FWLP_AirCons_On_D );
    _mFWLP_D_AR.FWLP_LumPad_D.phys = getValue( HMI_FWLP_LumPad_D );
    _mFWLP_D_AR.FWLP_LumPad_Stat_D.phys = getValue( HMI_FWLP_LumPad_Stat_D );
    _mFWLP_D_AR.FWLP_LumPosn_D.phys = getValue( HMI_FWLP_LumPosn_D );
    _mFWLP_D_AR.FWLP_LumPosn_Stat_D.phys = getValue( HMI_FWLP_LumPosn_Stat_D );
}
/*@@end*/

/*@@caplFunc:FWLP_D_AR_output():*/
FWLP_D_AR_output(void)
{
    output( _mFWLP_D_AR );
}
/*@@end*/

/*@@caplFunc:FWLP_D_AR_saveEnvVars(dword):*/
FWLP_D_AR_saveEnvVars( dword hFile )
{
    filePutString("\n// Knoten EIS: FWLP_D_AR\n", 23, hFile );
    snprintf( buffer, elcount( buffer ), "0.0000 HMI__STMSG_FWLP_D_AR := %X\n", getValue( HMI__STMSG_FWLP_D_AR ) );        filePutString ( buffer, elcount( buffer ), hFile );
    snprintf( buffer, elcount( buffer ), "0.0000 HMI__STMSGT_FWLP_D_AR := %X\n", getValue( HMI__STMSGT_FWLP_D_AR ) );        filePutString ( buffer, elcount( buffer ), hFile );
    snprintf( buffer, elcount( buffer ), "0.0000 HMI_FWLP_AirCons_On_D := %X\n", getValue( HMI_FWLP_AirCons_On_D ) );        filePutString ( buffer, elcount( buffer ), hFile );
    snprintf( buffer, elcount( buffer ), "0.0000 HMI_FWLP_LumPad_D := %X\n", getValue( HMI_FWLP_LumPad_D ) );        filePutString ( buffer, elcount( buffer ), hFile );
    snprintf( buffer, elcount( buffer ), "0.0000 HMI_FWLP_LumPad_Stat_D := %X\n", getValue( HMI_FWLP_LumPad_Stat_D ) );        filePutString ( buffer, elcount( buffer ), hFile );
    snprintf( buffer, elcount( buffer ), "0.0000 HMI_FWLP_LumPosn_D := %X\n", getValue( HMI_FWLP_LumPosn_D ) );        filePutString ( buffer, elcount( buffer ), hFile );
    snprintf( buffer, elcount( buffer ), "0.0000 HMI_FWLP_LumPosn_Stat_D := %X\n", getValue( HMI_FWLP_LumPosn_Stat_D ) );        filePutString ( buffer, elcount( buffer ), hFile );
}
/*@@end*/

/*@@timer:_tFWLP_D_AR:*/
on timer _tFWLP_D_AR
{
    putValue( HMI__STMSG_FWLP_D_AR, 0 );
}
/*@@end*/

/*@@envVar:HMI__STMSG_FWLP_D_AR:*/
on EnvVar HMI__STMSG_FWLP_D_AR
{
    long tDelay;
    if( getValue( this ) == 2 )
    {
        tDelay = getValue( HMI__STMSGT_FWLP_D_AR );
        if( tDelay > 0)    
            setTimer( _tFWLP_D_AR, tDelay );
        else
            putValue( HMI__STMSG_FWLP_D_AR, 0 );
    }
}
/*@@end*/

/*@@envVar:HMI_FWLP_AirCons_On_D:*/
on EnvVar HMI_FWLP_AirCons_On_D
{
    _mFWLP_D_AR.FWLP_AirCons_On_D.phys = getValue(this);
    _FWLP_D_AR_SpontanFlag = 1;
}
/*@@end*/

/*@@envVar:HMI_FWLP_LumPad_D:*/
on EnvVar HMI_FWLP_LumPad_D
{
    _mFWLP_D_AR.FWLP_LumPad_D.phys = getValue(this);
    _FWLP_D_AR_SpontanFlag = 1;
}
/*@@end*/

/*@@envVar:HMI_FWLP_LumPad_Stat_D:*/
on EnvVar HMI_FWLP_LumPad_Stat_D
{
    _mFWLP_D_AR.FWLP_LumPad_Stat_D.phys = getValue(this);
    _FWLP_D_AR_SpontanFlag = 1;
}
/*@@end*/

/*@@envVar:HMI_FWLP_LumPosn_D:*/
on EnvVar HMI_FWLP_LumPosn_D
{
    _mFWLP_D_AR.FWLP_LumPosn_D.phys = getValue(this);
    _FWLP_D_AR_SpontanFlag = 1;
}
/*@@end*/

/*@@envVar:HMI_FWLP_LumPosn_Stat_D:*/
on EnvVar HMI_FWLP_LumPosn_Stat_D
{
    _mFWLP_D_AR.FWLP_LumPosn_Stat_D.phys = getValue(this);
    _FWLP_D_AR_SpontanFlag = 1;
}
/*@@end*/

/*@@caplFunc:FWLP_P_AR_check_output():*/
FWLP_P_AR_check_output()
{
    if( !getValue( HMI__STMSG_FWLP_P_AR ) )
    {
        // Botschaft FWLP_P_AR ID: 1189 --- Sendeart 5 cyclicAndSpontanWithDelay --- 
        if( _FWLP_P_AR_DelayCnt > 0) _FWLP_P_AR_DelayCnt--; // Mindestsendeabstand
        _FWLP_P_AR_Cnt--;
        if( _FWLP_P_AR_Cnt < 1 )
        {
            if( _FWLP_P_AR_DelayCnt < 1 )
            {
                FWLP_P_AR_output(); // Nachricht wg. abgelaufenem Zyklus ausgeben (Mindestsendeabstand eingehalten)
                _FWLP_P_AR_SpontanFlag = 0; // Spontan-Flag zurücksetzen
                _FWLP_P_AR_DelayCnt = _FWLP_P_AR_MinDelay;
            }
            else
            {
                // Spontanflag setzen damit nach Ablauf Mindestsendeabstand gesendet wird
                 _FWLP_P_AR_SpontanFlag = 1;
            }
            _FWLP_P_AR_Cnt = _FWLP_P_AR_CycleCount; // Zyklus-Zähler zurücksetzen
        }
        else if( _FWLP_P_AR_SpontanFlag)
        {
            if( _FWLP_P_AR_DelayCnt < 1 )
            {
                FWLP_P_AR_output(); // Nachricht wg. spontaner Änderung ausgeben (Mindestsendeabstand eingehalten)
                _FWLP_P_AR_SpontanFlag = 0; // Spontan-Flag zurücksetzen
                _FWLP_P_AR_DelayCnt = _FWLP_P_AR_MinDelay;
            }
        }
    }
}
/*@@end*/

/*@@caplFunc:FWLP_P_AR_init():*/
FWLP_P_AR_init()
{   /* Botschaft FWLP_P_AR ID: 1189 --- Sendeart 5 cyclicAndSpontanWithDelay --- 
BA_ "ApplMessage" BO_ 1189 0;
BA_ "NmAsrMessage" BO_ 1189 0;
BA_ "GenMsgMinAcceptLength" BO_ 1189 5;
BA_ "GenMsgILSupport" BO_ 1189 1;
BA_ "DiagState" BO_ 1189 0;
BA_ "DiagRequest" BO_ 1189 0;
BA_ "DiagResponse" BO_ 1189 0;
BA_ "GenMsgStartValue" BO_ 1189 "0";
BA_ "GenMsgDelayTime" BO_ 1189 100;
BA_ "GenMsgNrOfRepetitions" BO_ 1189 0;
BA_ "GenMsgCycleTime" BO_ 1189 1000;
BA_ "GenMsgSendType" BO_ 1189 5;
    */
    _FWLP_P_AR_Timebase =             c_tDBKomTimer_20ms;
    _FWLP_P_AR_CycleCount =         1000 / _FWLP_P_AR_Timebase;
    _FWLP_P_AR_StartDelay =            0 / _FWLP_P_AR_Timebase;
    _FWLP_P_AR_MinDelay =            100 / _FWLP_P_AR_Timebase;
    _FWLP_P_AR_Cnt = _FWLP_P_AR_StartDelay;
    _FWLP_P_AR_SpontanFlag = 0;
    _FWLP_P_AR_DelayCnt = 0;

    putValue( HMI__STMSGSD_FWLP_P_AR, _FWLP_P_AR_StartDelay * _FWLP_P_AR_Timebase );

    _mFWLP_P_AR.FWLP_AirCons_On_P.phys = getValue( HMI_FWLP_AirCons_On_P );
    _mFWLP_P_AR.FWLP_LumPad_P.phys = getValue( HMI_FWLP_LumPad_P );
    _mFWLP_P_AR.FWLP_LumPad_Stat_P.phys = getValue( HMI_FWLP_LumPad_Stat_P );
    _mFWLP_P_AR.FWLP_LumPosn_P.phys = getValue( HMI_FWLP_LumPosn_P );
    _mFWLP_P_AR.FWLP_LumPosn_Stat_P.phys = getValue( HMI_FWLP_LumPosn_Stat_P );
}
/*@@end*/

/*@@caplFunc:FWLP_P_AR_output():*/
FWLP_P_AR_output(void)
{
    output( _mFWLP_P_AR );
}
/*@@end*/

/*@@caplFunc:FWLP_P_AR_saveEnvVars(dword):*/
FWLP_P_AR_saveEnvVars( dword hFile )
{
    filePutString("\n// Knoten EIS: FWLP_P_AR\n", 23, hFile );
    snprintf( buffer, elcount( buffer ), "0.0000 HMI__STMSG_FWLP_P_AR := %X\n", getValue( HMI__STMSG_FWLP_P_AR ) );        filePutString ( buffer, elcount( buffer ), hFile );
    snprintf( buffer, elcount( buffer ), "0.0000 HMI__STMSGT_FWLP_P_AR := %X\n", getValue( HMI__STMSGT_FWLP_P_AR ) );        filePutString ( buffer, elcount( buffer ), hFile );
    snprintf( buffer, elcount( buffer ), "0.0000 HMI_FWLP_AirCons_On_P := %X\n", getValue( HMI_FWLP_AirCons_On_P ) );        filePutString ( buffer, elcount( buffer ), hFile );
    snprintf( buffer, elcount( buffer ), "0.0000 HMI_FWLP_LumPad_P := %X\n", getValue( HMI_FWLP_LumPad_P ) );        filePutString ( buffer, elcount( buffer ), hFile );
    snprintf( buffer, elcount( buffer ), "0.0000 HMI_FWLP_LumPad_Stat_P := %X\n", getValue( HMI_FWLP_LumPad_Stat_P ) );        filePutString ( buffer, elcount( buffer ), hFile );
    snprintf( buffer, elcount( buffer ), "0.0000 HMI_FWLP_LumPosn_P := %X\n", getValue( HMI_FWLP_LumPosn_P ) );        filePutString ( buffer, elcount( buffer ), hFile );
    snprintf( buffer, elcount( buffer ), "0.0000 HMI_FWLP_LumPosn_Stat_P := %X\n", getValue( HMI_FWLP_LumPosn_Stat_P ) );        filePutString ( buffer, elcount( buffer ), hFile );
}
/*@@end*/

/*@@timer:_tFWLP_P_AR:*/
on timer _tFWLP_P_AR
{
    putValue( HMI__STMSG_FWLP_P_AR, 0 );
}
/*@@end*/

/*@@envVar:HMI__STMSG_FWLP_P_AR:*/
on EnvVar HMI__STMSG_FWLP_P_AR
{
    long tDelay;
    if( getValue( this ) == 2 )
    {
        tDelay = getValue( HMI__STMSGT_FWLP_P_AR );
        if( tDelay > 0)    
            setTimer( _tFWLP_P_AR, tDelay );
        else
            putValue( HMI__STMSG_FWLP_P_AR, 0 );
    }
}
/*@@end*/

/*@@envVar:HMI_FWLP_AirCons_On_P:*/
on EnvVar HMI_FWLP_AirCons_On_P
{
    _mFWLP_P_AR.FWLP_AirCons_On_P.phys = getValue(this);
    _FWLP_P_AR_SpontanFlag = 1;
}
/*@@end*/

/*@@envVar:HMI_FWLP_LumPad_P:*/
on EnvVar HMI_FWLP_LumPad_P
{
    _mFWLP_P_AR.FWLP_LumPad_P.phys = getValue(this);
    _FWLP_P_AR_SpontanFlag = 1;
}
/*@@end*/

/*@@envVar:HMI_FWLP_LumPad_Stat_P:*/
on EnvVar HMI_FWLP_LumPad_Stat_P
{
    _mFWLP_P_AR.FWLP_LumPad_Stat_P.phys = getValue(this);
    _FWLP_P_AR_SpontanFlag = 1;
}
/*@@end*/

/*@@envVar:HMI_FWLP_LumPosn_P:*/
on EnvVar HMI_FWLP_LumPosn_P
{
    _mFWLP_P_AR.FWLP_LumPosn_P.phys = getValue(this);
    _FWLP_P_AR_SpontanFlag = 1;
}
/*@@end*/

/*@@envVar:HMI_FWLP_LumPosn_Stat_P:*/
on EnvVar HMI_FWLP_LumPosn_Stat_P
{
    _mFWLP_P_AR.FWLP_LumPosn_Stat_P.phys = getValue(this);
    _FWLP_P_AR_SpontanFlag = 1;
}
/*@@end*/

/*@@caplFunc:HumanMachineIfc_AR_check_output():*/
HumanMachineIfc_AR_check_output()
{
    if( !getValue( HMI__STMSG_HumanMachineIfc_AR ) )
    {
        // Botschaft HumanMachineIfc_AR --- Sendeart 0 cyclicX
        _HumanMachineIfc_AR_Cnt--;
        if( _HumanMachineIfc_AR_Cnt < 1 )
        {
            HumanMachineIfc_AR_output(); // Nachricht wg. abgelaufenem Zyklus ausgeben
            _HumanMachineIfc_AR_Cnt = _HumanMachineIfc_AR_CycleCount; // Zyklus-Zähler zurücksetzen
        }
    }
}
/*@@end*/

/*@@caplFunc:HumanMachineIfc_AR_init():*/
HumanMachineIfc_AR_init()
{   /* Botschaft HumanMachineIfc_AR ID:489 --- Sendeart 0 cyclicX --- 
BA_ "ApplMessage" BO_ 489 0;
BA_ "NmAsrMessage" BO_ 489 0;
BA_ "GenMsgMinAcceptLength" BO_ 489 8;
BA_ "GenMsgILSupport" BO_ 489 1;
BA_ "DiagState" BO_ 489 0;
BA_ "DiagRequest" BO_ 489 0;
BA_ "DiagResponse" BO_ 489 0;
BA_ "GenMsgStartValue" BO_ 489 "0";
BA_ "GenMsgCycleTime" BO_ 489 100;
BA_ "GenMsgSendType" BO_ 489 0;
    */
    _HumanMachineIfc_AR_Timebase =          c_tDBKomTimer_20ms;
    _HumanMachineIfc_AR_CycleCount =      100 / _HumanMachineIfc_AR_Timebase;
    _HumanMachineIfc_AR_StartDelay =        0 / _HumanMachineIfc_AR_Timebase;
    _HumanMachineIfc_AR_Cnt = _HumanMachineIfc_AR_StartDelay;

    putValue( HMI__STMSGSD_HumanMachineIfc_AR, _HumanMachineIfc_AR_StartDelay * _HumanMachineIfc_AR_Timebase );

    _mHumanMachineIfc_AR.ClutchCoolDn_WaitTm_Minute_Disp_Rq.phys = getValue( HMI_ClutchCoolDn_WaitTm_Minute_Disp_Rq );
    _mHumanMachineIfc_AR.ClutchCoolDn_WaitTm_Second_Disp_Rq.phys = getValue( HMI_ClutchCoolDn_WaitTm_Second_Disp_Rq );
    _mHumanMachineIfc_AR.ClutchPdlPosn.phys = getValue( HMI_ClutchPdlPosn );
    _mHumanMachineIfc_AR.EngRPMDisp_RedRngStart.phys = getValue( HMI_EngRPMDisp_RedRngStart );
    _mHumanMachineIfc_AR.Gr_MTX_Disp_Rq_ECM_V2.phys = getValue( HMI_Gr_MTX_Disp_Rq_ECM_V2 );
    _mHumanMachineIfc_AR.Gr_Target_Disp_Rq_ECM.phys = getValue( HMI_Gr_Target_Disp_Rq_ECM );
    _mHumanMachineIfc_AR.PNHV_Perf_Total_Disp_Rq.phys = getValue( HMI_PNHV_Perf_Total_Disp_Rq );
    _mHumanMachineIfc_AR.TxShiftRcmmnd_Disp_Rq_ECM.phys = getValue( HMI_TxShiftRcmmnd_Disp_Rq_ECM );
}
/*@@end*/

/*@@caplFunc:HumanMachineIfc_AR_output():*/
HumanMachineIfc_AR_output(void)
{
    output( _mHumanMachineIfc_AR );
}
/*@@end*/

/*@@caplFunc:HumanMachineIfc_AR_saveEnvVars(dword):*/
HumanMachineIfc_AR_saveEnvVars( dword hFile )
{
    filePutString("\n// Knoten EIS: HumanMachineIfc_AR\n", 33, hFile );
    snprintf( buffer, elcount( buffer ), "0.0000 HMI__STMSG_HumanMachineIfc_AR := %X\n", getValue( HMI__STMSG_HumanMachineIfc_AR ) );    filePutString( buffer, elcount( buffer ), hFile );
    snprintf( buffer, elcount( buffer ), "0.0000 HMI__STMSGT_HumanMachineIfc_AR := %X\n", getValue( HMI__STMSGT_HumanMachineIfc_AR ) );    filePutString( buffer, elcount( buffer ), hFile );
    snprintf( buffer, elcount( buffer ), "0.0000 HMI_ClutchCoolDn_WaitTm_Minute_Disp_Rq := %X\n", getValue( HMI_ClutchCoolDn_WaitTm_Minute_Disp_Rq ) );    filePutString( buffer, elcount( buffer ), hFile );
    snprintf( buffer, elcount( buffer ), "0.0000 HMI_ClutchCoolDn_WaitTm_Second_Disp_Rq := %X\n", getValue( HMI_ClutchCoolDn_WaitTm_Second_Disp_Rq ) );    filePutString( buffer, elcount( buffer ), hFile );
    snprintf( buffer, elcount( buffer ), "0.0000 HMI_ClutchPdlPosn := %X\n", getValue( HMI_ClutchPdlPosn ) );    filePutString( buffer, elcount( buffer ), hFile );
    snprintf( buffer, elcount( buffer ), "0.0000 HMI_EngRPMDisp_RedRngStart := %X\n", getValue( HMI_EngRPMDisp_RedRngStart ) );    filePutString( buffer, elcount( buffer ), hFile );
    snprintf( buffer, elcount( buffer ), "0.0000 HMI_Gr_MTX_Disp_Rq_ECM_V2 := %X\n", getValue( HMI_Gr_MTX_Disp_Rq_ECM_V2 ) );    filePutString( buffer, elcount( buffer ), hFile );
    snprintf( buffer, elcount( buffer ), "0.0000 HMI_Gr_Target_Disp_Rq_ECM := %X\n", getValue( HMI_Gr_Target_Disp_Rq_ECM ) );    filePutString( buffer, elcount( buffer ), hFile );
    snprintf( buffer, elcount( buffer ), "0.0000 HMI_PNHV_Perf_Total_Disp_Rq := %X\n", getValue( HMI_PNHV_Perf_Total_Disp_Rq ) );    filePutString( buffer, elcount( buffer ), hFile );
    snprintf( buffer, elcount( buffer ), "0.0000 HMI_TxShiftRcmmnd_Disp_Rq_ECM := %X\n", getValue( HMI_TxShiftRcmmnd_Disp_Rq_ECM ) );    filePutString( buffer, elcount( buffer ), hFile );
}
/*@@end*/

/*@@timer:_tHumanMachineIfc_AR:*/
on timer _tHumanMachineIfc_AR
{
    putValue( HMI__STMSG_HumanMachineIfc_AR, 0 );
}
/*@@end*/

/*@@envVar:HMI__STMSG_HumanMachineIfc_AR:*/
on EnvVar HMI__STMSG_HumanMachineIfc_AR
{
    long tDelay;
    if( getValue( this ) == 2 )
    {
        tDelay = getValue( HMI__STMSGT_HumanMachineIfc_AR );
        if( tDelay > 0)    
            setTimer( _tHumanMachineIfc_AR, tDelay );
        else
            putValue( HMI__STMSG_HumanMachineIfc_AR, 0 );
    }
}
/*@@end*/

/*@@envVar:HMI_ClutchCoolDn_WaitTm_Minute_Disp_Rq:*/
on EnvVar HMI_ClutchCoolDn_WaitTm_Minute_Disp_Rq
{
    _mHumanMachineIfc_AR.ClutchCoolDn_WaitTm_Minute_Disp_Rq.phys = getValue(this);
}
/*@@end*/

/*@@envVar:HMI_ClutchCoolDn_WaitTm_Second_Disp_Rq:*/
on EnvVar HMI_ClutchCoolDn_WaitTm_Second_Disp_Rq
{
    _mHumanMachineIfc_AR.ClutchCoolDn_WaitTm_Second_Disp_Rq.phys = getValue(this);
}
/*@@end*/

/*@@envVar:HMI_ClutchPdlPosn:*/
on EnvVar HMI_ClutchPdlPosn
{
    _mHumanMachineIfc_AR.ClutchPdlPosn.phys = getValue(this);
}
/*@@end*/

/*@@envVar:HMI_EngRPMDisp_RedRngStart:*/
on EnvVar HMI_EngRPMDisp_RedRngStart
{
    _mHumanMachineIfc_AR.EngRPMDisp_RedRngStart.phys = getValue(this);
}
/*@@end*/

/*@@envVar:HMI_Gr_MTX_Disp_Rq_ECM_V2:*/
on EnvVar HMI_Gr_MTX_Disp_Rq_ECM_V2
{
    _mHumanMachineIfc_AR.Gr_MTX_Disp_Rq_ECM_V2.phys = getValue(this);
}
/*@@end*/

/*@@envVar:HMI_Gr_Target_Disp_Rq_ECM:*/
on EnvVar HMI_Gr_Target_Disp_Rq_ECM
{
    _mHumanMachineIfc_AR.Gr_Target_Disp_Rq_ECM.phys = getValue(this);
}
/*@@end*/

/*@@envVar:HMI_PNHV_Perf_Total_Disp_Rq:*/
on EnvVar HMI_PNHV_Perf_Total_Disp_Rq
{
    _mHumanMachineIfc_AR.PNHV_Perf_Total_Disp_Rq.phys = getValue(this);
}
/*@@end*/

/*@@envVar:HMI_TxShiftRcmmnd_Disp_Rq_ECM:*/
on EnvVar HMI_TxShiftRcmmnd_Disp_Rq_ECM
{
    _mHumanMachineIfc_AR.TxShiftRcmmnd_Disp_Rq_ECM.phys = getValue(this);
}
/*@@end*/

/*@@caplFunc:HumanMachineIfc_Rq_AR_check_output():*/
HumanMachineIfc_Rq_AR_check_output()
{
    if( !getValue( HMI__STMSG_HumanMachineIfc_Rq_AR ) )
    {
        // Botschaft HumanMachineIfc_Rq_AR ID: 269 --- Sendeart 0 cyclicX --- 
        _HumanMachineIfc_Rq_AR_Cnt--;
        if( _HumanMachineIfc_Rq_AR_Cnt < 1 )
        {
            // Nachricht wg. abgelaufenem Zyklus ausgeben
            HumanMachineIfc_Rq_AR_output();
            // Zyklus-Zähler zurücksetzen
            _HumanMachineIfc_Rq_AR_Cnt = _HumanMachineIfc_Rq_AR_CycleCount;
        }
    }
}
/*@@end*/

/*@@caplFunc:HumanMachineIfc_Rq_AR_init():*/
HumanMachineIfc_Rq_AR_init()
{   /* Botschaft HumanMachineIfc_Rq_AR ID: 269 --- Sendeart 0 cyclicX --- 
BA_ "ApplMessage" BO_ 269 0;
BA_ "NmAsrMessage" BO_ 269 0;
BA_ "GenMsgMinAcceptLength" BO_ 269 4;
BA_ "GenMsgILSupport" BO_ 269 1;
BA_ "DiagState" BO_ 269 0;
BA_ "DiagRequest" BO_ 269 0;
BA_ "DiagResponse" BO_ 269 0;
BA_ "GenMsgStartValue" BO_ 269 "0";
BA_ "GenMsgCycleTime" BO_ 269 20;
BA_ "GenMsgSendType" BO_ 269 0;
    */
    _HumanMachineIfc_Rq_AR_Timebase =           c_tDBKomTimer_20ms;
    _HumanMachineIfc_Rq_AR_CycleCount =         20 / _HumanMachineIfc_Rq_AR_Timebase;
    _HumanMachineIfc_Rq_AR_StartDelay =          0 / _HumanMachineIfc_Rq_AR_Timebase;
    _HumanMachineIfc_Rq_AR_Cnt = _HumanMachineIfc_Rq_AR_StartDelay;

    putValue( HMI__STMSGSD_HumanMachineIfc_Rq_AR, _HumanMachineIfc_Rq_AR_StartDelay * _HumanMachineIfc_Rq_AR_Timebase );

    _mHumanMachineIfc_Rq_AR.EngRPM_Dyn_Disp_Rq.phys = getValue( HMI_EngRPM_Dyn_Disp_Rq );
}
/*@@end*/

/*@@caplFunc:HumanMachineIfc_Rq_AR_output():*/
HumanMachineIfc_Rq_AR_output(void)
{
    output( _mHumanMachineIfc_Rq_AR );
}
/*@@end*/

/*@@caplFunc:HumanMachineIfc_Rq_AR_saveEnvVars(dword):*/
HumanMachineIfc_Rq_AR_saveEnvVars( dword hFile )
{
    filePutString("\n// Knoten EIS: HumanMachineIfc_Rq_AR\n", 35, hFile );
    snprintf( buffer, elcount( buffer ), "0.0000 HMI__STMSG_HumanMachineIfc_Rq := %X\n", getValue( HMI__STMSG_HumanMachineIfc_Rq_AR ) );        filePutString( buffer, elcount( buffer ), hFile );
    snprintf( buffer, elcount( buffer ), "0.0000 HMI__STMSGT_HumanMachineIfc_Rq := %X\n", getValue( HMI__STMSGT_HumanMachineIfc_Rq_AR ) );        filePutString( buffer, elcount( buffer ), hFile );
    snprintf( buffer, elcount( buffer ), "0.0000 HMI_EngRPM_Dyn_Disp_Rq := %X\n", getValue( HMI_EngRPM_Dyn_Disp_Rq ) );        filePutString( buffer, elcount( buffer ), hFile );
}
/*@@end*/

/*@@timer:_tHumanMachineIfc_Rq_AR:*/
on timer _tHumanMachineIfc_Rq_AR
{
    putValue( HMI__STMSG_HumanMachineIfc_Rq_AR, 0 );
}
/*@@end*/

/*@@envVar:HMI__STMSG_HumanMachineIfc_Rq_AR:*/
on EnvVar HMI__STMSG_HumanMachineIfc_Rq_AR
{
    long tDelay;
    if( getValue( this ) == 2 )
    {
        tDelay = getValue( HMI__STMSGT_HumanMachineIfc_Rq_AR );
        if( tDelay > 0)    
            setTimer( _tHumanMachineIfc_Rq_AR, tDelay );
        else
            putValue( HMI__STMSG_HumanMachineIfc_Rq_AR, 0 );
    }
}
/*@@end*/

/*@@envVar:HMI_EngRPM_Dyn_Disp_Rq:*/
on EnvVar HMI_EngRPM_Dyn_Disp_Rq
{
    _mHumanMachineIfc_Rq_AR.EngRPM_Dyn_Disp_Rq.phys = getValue(this);
}
/*@@end*/

/*@@caplFunc:HVAC_Disp_Stat1_AR_check_output():*/
HVAC_Disp_Stat1_AR_check_output()
{
    if( !getValue( HMI__STMSG_HVAC_Disp_Stat1_AR ) )
    {
        // Botschaft HVAC_Disp_Stat1_AR ID: 851 --- Sendeart 5 cyclicAndSpontanWithDelay --- 
        _HVAC_Disp_Stat1_AR_Cnt--;
        if( _HVAC_Disp_Stat1_AR_Cnt < 1 )
        {
            // Nachricht wg. abgelaufenem Zyklus ausgeben
            HVAC_Disp_Stat1_AR_output();
            _HVAC_Disp_Stat1_AR_Cnt = _HVAC_Disp_Stat1_AR_CycleCount; // Zyklus-Zähler zurücksetzen
            _HVAC_Disp_Stat1_AR_SpontanFlag = 0; // Spontan-Flag zurücksetzen
        }
        else if( _HVAC_Disp_Stat1_AR_SpontanFlag)
        {
            // Nachricht wg. spontaner Änderung ausgeben
            HVAC_Disp_Stat1_AR_output();
            _HVAC_Disp_Stat1_AR_SpontanFlag = 0; // Spontan-Flag zurücksetzen
        }
    }
}
/*@@end*/

/*@@caplFunc:HVAC_Disp_Stat1_AR_init():*/
HVAC_Disp_Stat1_AR_init()
{   /* Botschaft HVAC_Disp_Stat1_AR ID: 851 --- Sendeart 5 cyclicAndSpontanWithDelay --- 
BA_ "ApplMessage" BO_ 851 0;
BA_ "NmAsrMessage" BO_ 851 0;
BA_ "GenMsgMinAcceptLength" BO_ 851 8;
BA_ "GenMsgILSupport" BO_ 851 1;
BA_ "DiagState" BO_ 851 0;
BA_ "DiagRequest" BO_ 851 0;
BA_ "DiagResponse" BO_ 851 0;
BA_ "GenMsgStartValue" BO_ 851 "0";
BA_ "GenMsgDelayTime" BO_ 851 5;
BA_ "GenMsgNrOfRepetitions" BO_ 851 0;
BA_ "GenMsgCycleTime" BO_ 851 1000;
BA_ "GenMsgSendType" BO_ 851 5;
    */
    _HVAC_Disp_Stat1_AR_Timebase =           c_tDBKomTimer_20ms;
    _HVAC_Disp_Stat1_AR_CycleCount =       1000 / _HVAC_Disp_Stat1_AR_Timebase;
    _HVAC_Disp_Stat1_AR_StartDelay =          0 / _HVAC_Disp_Stat1_AR_Timebase;
    _HVAC_Disp_Stat1_AR_Cnt = _HVAC_Disp_Stat1_AR_StartDelay;
    _HVAC_Disp_Stat1_AR_SpontanFlag = 0;

    putValue( HMI__STMSGSD_HVAC_Disp_Stat1_AR, _HVAC_Disp_Stat1_AR_StartDelay * _HVAC_Disp_Stat1_AR_Timebase );

    _mHVAC_Disp_Stat1_AR.HVAC_AC_Z1Z2_Actv.phys = getValue( HMI_HVAC_AC_Z1Z2_Actv );
    _mHVAC_Disp_Stat1_AR.HVAC_AirDist_Zone1_Stat.phys = getValue( HMI_HVAC_AirDist_Zone1_Stat );
    _mHVAC_Disp_Stat1_AR.HVAC_AirDist_Zone2_Stat.phys = getValue( HMI_HVAC_AirDist_Zone2_Stat );
    _mHVAC_Disp_Stat1_AR.HVAC_Airflow_Zone1_Stat.phys = getValue( HMI_HVAC_Airflow_Zone1_Stat );
    _mHVAC_Disp_Stat1_AR.HVAC_Airflow_Zone2_Stat.phys = getValue( HMI_HVAC_Airflow_Zone2_Stat );
    _mHVAC_Disp_Stat1_AR.HVAC_Auto_Zone1_Stat .phys = getValue( HMI_HVAC_Auto_Zone1_Stat  );
    _mHVAC_Disp_Stat1_AR.HVAC_Auto_Zone2_Stat .phys = getValue( HMI_HVAC_Auto_Zone2_Stat  );
    _mHVAC_Disp_Stat1_AR.HVAC_Dfrst_Z1Z2_Actv .phys = getValue( HMI_HVAC_Dfrst_Z1Z2_Actv  );
    _mHVAC_Disp_Stat1_AR.HVAC_eHeV_Disp_Rq.phys = getValue( HMI_HVAC_eHeV_Disp_Rq );
    _mHVAC_Disp_Stat1_AR.HVAC_eHeV_Stat.phys = getValue( HMI_HVAC_eHeV_Stat );
    _mHVAC_Disp_Stat1_AR.HVAC_Fan_Zone1_Stat.phys = getValue( HMI_HVAC_Fan_Zone1_Stat );
    _mHVAC_Disp_Stat1_AR.HVAC_Fan_Zone2_Stat.phys = getValue( HMI_HVAC_Fan_Zone2_Stat );
    _mHVAC_Disp_Stat1_AR.HVAC_FtwInc_Zone1_Stat.phys = getValue( HMI_HVAC_FtwInc_Zone1_Stat );
    _mHVAC_Disp_Stat1_AR.HVAC_FtwInc_Zone2_Stat.phys = getValue( HMI_HVAC_FtwInc_Zone2_Stat );
    _mHVAC_Disp_Stat1_AR.HVAC_ICH1_2_LED_On_Rq.phys = getValue( HMI_HVAC_ICH1_2_LED_On_Rq );
    _mHVAC_Disp_Stat1_AR.HVAC_Off_Z1Z2_Actv.phys = getValue( HMI_HVAC_Off_Z1Z2_Actv );
    _mHVAC_Disp_Stat1_AR.HVAC_RHU_Z1Z2_Actv.phys = getValue( HMI_HVAC_RHU_Z1Z2_Actv );
    _mHVAC_Disp_Stat1_AR.HVAC_Temp_Zone1_Stat.phys = getValue( HMI_HVAC_Temp_Zone1_Stat );
    _mHVAC_Disp_Stat1_AR.HVAC_Temp_Zone2_Stat.phys = getValue( HMI_HVAC_Temp_Zone2_Stat );
}
/*@@end*/

/*@@caplFunc:HVAC_Disp_Stat1_AR_output():*/
HVAC_Disp_Stat1_AR_output(void)
{
    output( _mHVAC_Disp_Stat1_AR );
}
/*@@end*/

/*@@caplFunc:HVAC_Disp_Stat1_AR_saveEnvVars(dword):*/
HVAC_Disp_Stat1_AR_saveEnvVars( dword hFile )
{
    filePutString("\n// Knoten EIS: HVAC_Disp_Stat1_AR\n", 32, hFile );
    snprintf( buffer, elcount( buffer ), "0.0000 HMI__STMSG_HVAC_Disp_Stat1_AR := %X\n", getValue( HMI__STMSG_HVAC_Disp_Stat1_AR ) );    filePutString( buffer, elcount( buffer ), hFile );
    snprintf( buffer, elcount( buffer ), "0.0000 HMI__STMSGT_HVAC_Disp_Stat1_AR := %X\n", getValue( HMI__STMSGT_HVAC_Disp_Stat1_AR ) );    filePutString( buffer, elcount( buffer ), hFile );
    snprintf( buffer, elcount( buffer ), "0.0000 HMI_HVAC_AC_Z1Z2_Actv := %X\n", getValue( HMI_HVAC_AC_Z1Z2_Actv ) );    filePutString( buffer, elcount( buffer ), hFile );
    snprintf( buffer, elcount( buffer ), "0.0000 HMI_HVAC_AirDist_Zone1_Stat := %X\n", getValue( HMI_HVAC_AirDist_Zone1_Stat ) );    filePutString( buffer, elcount( buffer ), hFile );
    snprintf( buffer, elcount( buffer ), "0.0000 HMI_HVAC_AirDist_Zone2_Stat := %X\n", getValue( HMI_HVAC_AirDist_Zone2_Stat ) );    filePutString( buffer, elcount( buffer ), hFile );
    snprintf( buffer, elcount( buffer ), "0.0000 HMI_HVAC_Airflow_Zone1_Stat := %X\n", getValue( HMI_HVAC_Airflow_Zone1_Stat ) );    filePutString( buffer, elcount( buffer ), hFile );
    snprintf( buffer, elcount( buffer ), "0.0000 HMI_HVAC_Airflow_Zone2_Stat := %X\n", getValue( HMI_HVAC_Airflow_Zone2_Stat ) );    filePutString( buffer, elcount( buffer ), hFile );
    snprintf( buffer, elcount( buffer ), "0.0000 HMI_HVAC_Auto_Zone1_Stat  := %X\n", getValue( HMI_HVAC_Auto_Zone1_Stat  ) );    filePutString( buffer, elcount( buffer ), hFile );
    snprintf( buffer, elcount( buffer ), "0.0000 HMI_HVAC_Auto_Zone2_Stat  := %X\n", getValue( HMI_HVAC_Auto_Zone2_Stat  ) );    filePutString( buffer, elcount( buffer ), hFile );
    snprintf( buffer, elcount( buffer ), "0.0000 HMI_HVAC_Dfrst_Z1Z2_Actv  := %X\n", getValue( HMI_HVAC_Dfrst_Z1Z2_Actv  ) );    filePutString( buffer, elcount( buffer ), hFile );
    snprintf( buffer, elcount( buffer ), "0.0000 HMI_HVAC_eHeV_Disp_Rq := %X\n", getValue( HMI_HVAC_eHeV_Disp_Rq ) );    filePutString( buffer, elcount( buffer ), hFile );
    snprintf( buffer, elcount( buffer ), "0.0000 HMI_HVAC_eHeV_Stat := %X\n", getValue( HMI_HVAC_eHeV_Stat ) );    filePutString( buffer, elcount( buffer ), hFile );
    snprintf( buffer, elcount( buffer ), "0.0000 HMI_HVAC_Fan_Zone1_Stat := %X\n", getValue( HMI_HVAC_Fan_Zone1_Stat ) );    filePutString( buffer, elcount( buffer ), hFile );
    snprintf( buffer, elcount( buffer ), "0.0000 HMI_HVAC_Fan_Zone2_Stat := %X\n", getValue( HMI_HVAC_Fan_Zone2_Stat ) );    filePutString( buffer, elcount( buffer ), hFile );
    snprintf( buffer, elcount( buffer ), "0.0000 HMI_HVAC_FtwInc_Zone1_Stat := %X\n", getValue( HMI_HVAC_FtwInc_Zone1_Stat ) );    filePutString( buffer, elcount( buffer ), hFile );
    snprintf( buffer, elcount( buffer ), "0.0000 HMI_HVAC_FtwInc_Zone2_Stat := %X\n", getValue( HMI_HVAC_FtwInc_Zone2_Stat ) );    filePutString( buffer, elcount( buffer ), hFile );
    snprintf( buffer, elcount( buffer ), "0.0000 HMI_HVAC_ICH1_2_LED_On_Rq := %X\n", getValue( HMI_HVAC_ICH1_2_LED_On_Rq ) );    filePutString( buffer, elcount( buffer ), hFile );
    snprintf( buffer, elcount( buffer ), "0.0000 HMI_HVAC_Off_Z1Z2_Actv := %X\n", getValue( HMI_HVAC_Off_Z1Z2_Actv ) );    filePutString( buffer, elcount( buffer ), hFile );
    snprintf( buffer, elcount( buffer ), "0.0000 HMI_HVAC_RHU_Z1Z2_Actv := %X\n", getValue( HMI_HVAC_RHU_Z1Z2_Actv ) );    filePutString( buffer, elcount( buffer ), hFile );
    snprintf( buffer, elcount( buffer ), "0.0000 HMI_HVAC_Temp_Zone1_Stat := %X\n", getValue( HMI_HVAC_Temp_Zone1_Stat ) );    filePutString( buffer, elcount( buffer ), hFile );
    snprintf( buffer, elcount( buffer ), "0.0000 HMI_HVAC_Temp_Zone2_Stat := %X\n", getValue( HMI_HVAC_Temp_Zone2_Stat ) );    filePutString( buffer, elcount( buffer ), hFile );
}
/*@@end*/

/*@@timer:_tHVAC_Disp_Stat1_AR:*/
on timer _tHVAC_Disp_Stat1_AR
{
    putValue( HMI__STMSG_HVAC_Disp_Stat1_AR, 0 );
}
/*@@end*/

/*@@envVar:HMI__STMSG_HVAC_Disp_Stat1_AR:*/
on EnvVar HMI__STMSG_HVAC_Disp_Stat1_AR
{
    long tDelay;
    if( getValue( this ) == 2 )
    {
        tDelay = getValue( HMI__STMSGT_HVAC_Disp_Stat1_AR );
        if( tDelay > 0)    
            setTimer( _tHVAC_Disp_Stat1_AR, tDelay );
        else
            putValue( HMI__STMSG_HVAC_Disp_Stat1_AR, 0 );
    }
}
/*@@end*/

/*@@envVar:HMI_HVAC_AC_Z1Z2_Actv:*/
on EnvVar HMI_HVAC_AC_Z1Z2_Actv
{
    _mHVAC_Disp_Stat1_AR.HVAC_AC_Z1Z2_Actv.phys = getValue(this);
    _HVAC_Disp_Stat1_AR_SpontanFlag = 1;
}
/*@@end*/

/*@@envVar:HMI_HVAC_AirDist_Zone1_Stat:*/
on EnvVar HMI_HVAC_AirDist_Zone1_Stat
{
    _mHVAC_Disp_Stat1_AR.HVAC_AirDist_Zone1_Stat.phys = getValue(this);
    _HVAC_Disp_Stat1_AR_SpontanFlag = 1;
}
/*@@end*/

/*@@envVar:HMI_HVAC_AirDist_Zone2_Stat:*/
on EnvVar HMI_HVAC_AirDist_Zone2_Stat
{
    _mHVAC_Disp_Stat1_AR.HVAC_AirDist_Zone2_Stat.phys = getValue(this);
    _HVAC_Disp_Stat1_AR_SpontanFlag = 1;
}
/*@@end*/

/*@@envVar:HMI_HVAC_Airflow_Zone1_Stat:*/
on EnvVar HMI_HVAC_Airflow_Zone1_Stat
{
    _mHVAC_Disp_Stat1_AR.HVAC_Airflow_Zone1_Stat.phys = getValue(this);
    _HVAC_Disp_Stat1_AR_SpontanFlag = 1;
}
/*@@end*/

/*@@envVar:HMI_HVAC_Airflow_Zone2_Stat:*/
on EnvVar HMI_HVAC_Airflow_Zone2_Stat
{
    _mHVAC_Disp_Stat1_AR.HVAC_Airflow_Zone2_Stat.phys = getValue(this);
    _HVAC_Disp_Stat1_AR_SpontanFlag = 1;
}
/*@@end*/

/*@@envVar:HMI_HVAC_Auto_Zone1_Stat:*/
on EnvVar HMI_HVAC_Auto_Zone1_Stat
{
    _mHVAC_Disp_Stat1_AR.HVAC_Auto_Zone1_Stat.phys = getValue(this);
    _HVAC_Disp_Stat1_AR_SpontanFlag = 1;
}
/*@@end*/

/*@@envVar:HMI_HVAC_Auto_Zone2_Stat:*/
on EnvVar HMI_HVAC_Auto_Zone2_Stat
{
    _mHVAC_Disp_Stat1_AR.HVAC_Auto_Zone2_Stat.phys = getValue(this);
    _HVAC_Disp_Stat1_AR_SpontanFlag = 1;
}
/*@@end*/

/*@@envVar:HMI_HVAC_Dfrst_Z1Z2_Actv:*/
on EnvVar HMI_HVAC_Dfrst_Z1Z2_Actv
{
    _mHVAC_Disp_Stat1_AR.HVAC_Dfrst_Z1Z2_Actv.phys = getValue(this);
    _HVAC_Disp_Stat1_AR_SpontanFlag = 1;
}
/*@@end*/

/*@@envVar:HMI_HVAC_eHeV_Disp_Rq:*/
on EnvVar HMI_HVAC_eHeV_Disp_Rq
{
    _mHVAC_Disp_Stat1_AR.HVAC_eHeV_Disp_Rq.phys = getValue(this);
    _HVAC_Disp_Stat1_AR_SpontanFlag = 1;
}
/*@@end*/

/*@@envVar:HMI_HVAC_eHeV_Stat:*/
on EnvVar HMI_HVAC_eHeV_Stat
{
    _mHVAC_Disp_Stat1_AR.HVAC_eHeV_Stat.phys = getValue(this);
    _HVAC_Disp_Stat1_AR_SpontanFlag = 1;
}
/*@@end*/

/*@@envVar:HMI_HVAC_Fan_Zone1_Stat:*/
on EnvVar HMI_HVAC_Fan_Zone1_Stat
{
    _mHVAC_Disp_Stat1_AR.HVAC_Fan_Zone1_Stat.phys = getValue(this);
    _HVAC_Disp_Stat1_AR_SpontanFlag = 1;
}
/*@@end*/

/*@@envVar:HMI_HVAC_Fan_Zone2_Stat:*/
on EnvVar HMI_HVAC_Fan_Zone2_Stat
{
    _mHVAC_Disp_Stat1_AR.HVAC_Fan_Zone2_Stat.phys = getValue(this);
    _HVAC_Disp_Stat1_AR_SpontanFlag = 1;
}
/*@@end*/

/*@@envVar:HMI_HVAC_FtwInc_Zone1_Stat:*/
on EnvVar HMI_HVAC_FtwInc_Zone1_Stat
{
    _mHVAC_Disp_Stat1_AR.HVAC_FtwInc_Zone1_Stat.phys = getValue(this);
    _HVAC_Disp_Stat1_AR_SpontanFlag = 1;
}
/*@@end*/

/*@@envVar:HMI_HVAC_FtwInc_Zone2_Stat:*/
on EnvVar HMI_HVAC_FtwInc_Zone2_Stat
{
    _mHVAC_Disp_Stat1_AR.HVAC_FtwInc_Zone2_Stat.phys = getValue(this);
    _HVAC_Disp_Stat1_AR_SpontanFlag = 1;
}
/*@@end*/

/*@@envVar:HMI_HVAC_ICH1_2_LED_On_Rq:*/
on EnvVar HMI_HVAC_ICH1_2_LED_On_Rq
{
    _mHVAC_Disp_Stat1_AR.HVAC_ICH1_2_LED_On_Rq.phys = getValue(this);
    _HVAC_Disp_Stat1_AR_SpontanFlag = 1;
}
/*@@end*/

/*@@envVar:HMI_HVAC_Off_Z1Z2_Actv:*/
on EnvVar HMI_HVAC_Off_Z1Z2_Actv
{
    _mHVAC_Disp_Stat1_AR.HVAC_Off_Z1Z2_Actv.phys = getValue(this);
    _HVAC_Disp_Stat1_AR_SpontanFlag = 1;
}
/*@@end*/

/*@@envVar:HMI_HVAC_RHU_Z1Z2_Actv:*/
on EnvVar HMI_HVAC_RHU_Z1Z2_Actv
{
    _mHVAC_Disp_Stat1_AR.HVAC_RHU_Z1Z2_Actv.phys = getValue(this);
    _HVAC_Disp_Stat1_AR_SpontanFlag = 1;
}
/*@@end*/

/*@@envVar:HMI_HVAC_Temp_Zone1_Stat:*/
on EnvVar HMI_HVAC_Temp_Zone1_Stat
{
    _mHVAC_Disp_Stat1_AR.HVAC_Temp_Zone1_Stat.phys = getValue(this);
    _HVAC_Disp_Stat1_AR_SpontanFlag = 1;
}
/*@@end*/

/*@@envVar:HMI_HVAC_Temp_Zone2_Stat:*/
on EnvVar HMI_HVAC_Temp_Zone2_Stat
{
    _mHVAC_Disp_Stat1_AR.HVAC_Temp_Zone2_Stat.phys = getValue(this);
    _HVAC_Disp_Stat1_AR_SpontanFlag = 1;
}
/*@@end*/

/*@@caplFunc:HVAC_Disp_Stat2_AR_check_output():*/
HVAC_Disp_Stat2_AR_check_output()
{
    if( !getValue( HMI__STMSG_HVAC_Disp_Stat2_AR ) )
    {
        // Botschaft HVAC_Disp_Stat2_AR ID: 853 --- Sendeart 5 cyclicAndSpontanWithDelay --- 
        _HVAC_Disp_Stat2_AR_Cnt--;
        if( _HVAC_Disp_Stat2_AR_Cnt < 1 )
        {
            // Nachricht wg. abgelaufenem Zyklus ausgeben
            HVAC_Disp_Stat2_AR_output();
            _HVAC_Disp_Stat2_AR_Cnt = _HVAC_Disp_Stat2_AR_CycleCount; // Zyklus-Zähler zurücksetzen
            _HVAC_Disp_Stat2_AR_SpontanFlag = 0; // Spontan-Flag zurücksetzen
        }
        else if( _HVAC_Disp_Stat2_AR_SpontanFlag )
        {
            // Nachricht wg. spontaner Änderung ausgeben
            HVAC_Disp_Stat2_AR_output();
            _HVAC_Disp_Stat2_AR_SpontanFlag = 0; // Spontan-Flag zurücksetzen
        }
    }
}
/*@@end*/

/*@@caplFunc:HVAC_Disp_Stat2_AR_init():*/
HVAC_Disp_Stat2_AR_init()
{   /* Botschaft HVAC_Disp_Stat2_AR ID: 853 --- Sendeart 5 cyclicAndSpontanWithDelay --- 
BA_ "ApplMessage" BO_ 853 0;
BA_ "NmAsrMessage" BO_ 853 0;
BA_ "GenMsgMinAcceptLength" BO_ 853 8;
BA_ "GenMsgILSupport" BO_ 853 1;
BA_ "DiagState" BO_ 853 0;
BA_ "DiagRequest" BO_ 853 0;
BA_ "DiagResponse" BO_ 853 0;
BA_ "GenMsgStartValue" BO_ 853 "0";
BA_ "GenMsgDelayTime" BO_ 853 5;
BA_ "GenMsgNrOfRepetitions" BO_ 853 0;
BA_ "GenMsgCycleTime" BO_ 853 1000;
BA_ "GenMsgSendType" BO_ 853 5;
    */
    _HVAC_Disp_Stat2_AR_Timebase =           c_tDBKomTimer_20ms;
    _HVAC_Disp_Stat2_AR_CycleCount =      1000 / _HVAC_Disp_Stat2_AR_Timebase;
    _HVAC_Disp_Stat2_AR_StartDelay =         0 / _HVAC_Disp_Stat2_AR_Timebase;
    _HVAC_Disp_Stat2_AR_Cnt = _HVAC_Disp_Stat2_AR_StartDelay;
    _HVAC_Disp_Stat2_AR_SpontanFlag = 0;

    putValue( HMI__STMSGSD_HVAC_Disp_Stat2_AR, _HVAC_Disp_Stat2_AR_StartDelay * _HVAC_Disp_Stat2_AR_Timebase );

    _mHVAC_Disp_Stat2_AR.HVAC_AC_Z3Z4_Actv.phys = getValue( HMI_HVAC_AC_Z3Z4_Actv );
    _mHVAC_Disp_Stat2_AR.HVAC_AirDist_Zone3_Stat.phys = getValue( HMI_HVAC_AirDist_Zone3_Stat );
    _mHVAC_Disp_Stat2_AR.HVAC_AirDist_Zone4_Stat.phys = getValue( HMI_HVAC_AirDist_Zone4_Stat );
    _mHVAC_Disp_Stat2_AR.HVAC_Auto_Zone3_Stat.phys = getValue( HMI_HVAC_Auto_Zone3_Stat );
    _mHVAC_Disp_Stat2_AR.HVAC_Auto_Zone4_Stat.phys = getValue( HMI_HVAC_Auto_Zone4_Stat );
    _mHVAC_Disp_Stat2_AR.HVAC_Fan_Zone3_Stat.phys = getValue( HMI_HVAC_Fan_Zone3_Stat );
    _mHVAC_Disp_Stat2_AR.HVAC_Fan_Zone4_Stat.phys = getValue( HMI_HVAC_Fan_Zone4_Stat );
    _mHVAC_Disp_Stat2_AR.HVAC_Off_Z3Z4_Actv.phys = getValue( HMI_HVAC_Off_Z3Z4_Actv );
    _mHVAC_Disp_Stat2_AR.HVAC_RHU_Z3Z4_Actv.phys = getValue( HMI_HVAC_RHU_Z3Z4_Actv );
    _mHVAC_Disp_Stat2_AR.HVAC_Temp_Zone3_Stat.phys = getValue( HMI_HVAC_Temp_Zone3_Stat );
    _mHVAC_Disp_Stat2_AR.HVAC_Temp_Zone4_Stat.phys = getValue( HMI_HVAC_Temp_Zone4_Stat );
}
/*@@end*/

/*@@caplFunc:HVAC_Disp_Stat2_AR_output():*/
HVAC_Disp_Stat2_AR_output(void)
{
    output( _mHVAC_Disp_Stat2_AR );
}
/*@@end*/

/*@@caplFunc:HVAC_Disp_Stat2_AR_saveEnvVars(dword):*/
HVAC_Disp_Stat2_AR_saveEnvVars( dword hFile )
{
    filePutString("\n// Knoten EIS: HVAC_Disp_Stat2_AR \n", 32, hFile );
    snprintf( buffer, elcount( buffer ), "0.0000 HMI__STMSG_HVAC_Disp_Stat2_AR := %X\n", getValue( HMI__STMSG_HVAC_Disp_Stat2_AR ) );    filePutString( buffer, elcount( buffer ), hFile );
    snprintf( buffer, elcount( buffer ), "0.0000 HMI__STMSGT_HVAC_Disp_Stat2_AR := %X\n", getValue( HMI__STMSGT_HVAC_Disp_Stat2_AR ) );    filePutString( buffer, elcount( buffer ), hFile );
    snprintf( buffer, elcount( buffer ), "0.0000 HMI_HVAC_AC_Z3Z4_Actv := %X\n", getValue( HMI_HVAC_AC_Z3Z4_Actv ) );    filePutString( buffer, elcount( buffer ), hFile );
    snprintf( buffer, elcount( buffer ), "0.0000 HMI_HVAC_AirDist_Zone3_Stat := %X\n", getValue( HMI_HVAC_AirDist_Zone3_Stat ) );    filePutString( buffer, elcount( buffer ), hFile );
    snprintf( buffer, elcount( buffer ), "0.0000 HMI_HVAC_AirDist_Zone4_Stat := %X\n", getValue( HMI_HVAC_AirDist_Zone4_Stat ) );    filePutString( buffer, elcount( buffer ), hFile );
    snprintf( buffer, elcount( buffer ), "0.0000 HMI_HVAC_Auto_Zone3_Stat := %X\n", getValue( HMI_HVAC_Auto_Zone3_Stat ) );    filePutString( buffer, elcount( buffer ), hFile );
    snprintf( buffer, elcount( buffer ), "0.0000 HMI_HVAC_Auto_Zone4_Stat := %X\n", getValue( HMI_HVAC_Auto_Zone4_Stat ) );    filePutString( buffer, elcount( buffer ), hFile );
    snprintf( buffer, elcount( buffer ), "0.0000 HMI_HVAC_Fan_Zone3_Stat := %X\n", getValue( HMI_HVAC_Fan_Zone3_Stat ) );    filePutString( buffer, elcount( buffer ), hFile );
    snprintf( buffer, elcount( buffer ), "0.0000 HMI_HVAC_Fan_Zone4_Stat := %X\n", getValue( HMI_HVAC_Fan_Zone4_Stat ) );    filePutString( buffer, elcount( buffer ), hFile );
    snprintf( buffer, elcount( buffer ), "0.0000 HMI_HVAC_Off_Z3Z4_Actv := %X\n", getValue( HMI_HVAC_Off_Z3Z4_Actv ) );    filePutString( buffer, elcount( buffer ), hFile );
    snprintf( buffer, elcount( buffer ), "0.0000 HMI_HVAC_RHU_Z3Z4_Actv := %X\n", getValue( HMI_HVAC_RHU_Z3Z4_Actv ) );    filePutString( buffer, elcount( buffer ), hFile );
    snprintf( buffer, elcount( buffer ), "0.0000 HMI_HVAC_Temp_Zone3_Stat := %X\n", getValue( HMI_HVAC_Temp_Zone3_Stat ) );    filePutString( buffer, elcount( buffer ), hFile );
    snprintf( buffer, elcount( buffer ), "0.0000 HMI_HVAC_Temp_Zone4_Stat := %X\n", getValue( HMI_HVAC_Temp_Zone4_Stat ) );    filePutString( buffer, elcount( buffer ), hFile );

}
/*@@end*/

/*@@timer:_tHVAC_Disp_Stat2_AR:*/
on timer _tHVAC_Disp_Stat2_AR
{
    putValue( HMI__STMSG_HVAC_Disp_Stat2_AR, 0 );
}
/*@@end*/

/*@@envVar:HMI__STMSG_HVAC_Disp_Stat2_AR:*/
on EnvVar HMI__STMSG_HVAC_Disp_Stat2_AR
{
    long tDelay;
    if( getValue( this ) == 2 )
    {
        tDelay = getValue( HMI__STMSGT_HVAC_Disp_Stat2_AR );
        if( tDelay > 0)    
            setTimer( _tHVAC_Disp_Stat2_AR, tDelay );
        else
            putValue( HMI__STMSG_HVAC_Disp_Stat2_AR, 0 );
    }
}
/*@@end*/

/*@@envVar:HMI_HVAC_AC_Z3Z4_Actv:*/
on EnvVar HMI_HVAC_AC_Z3Z4_Actv
{
    _mHVAC_Disp_Stat2_AR.HVAC_AC_Z3Z4_Actv.phys = getValue(this);
    _HVAC_Disp_Stat2_AR_SpontanFlag = 1;
}
/*@@end*/

/*@@envVar:HMI_HVAC_AirDist_Zone3_Stat:*/
on EnvVar HMI_HVAC_AirDist_Zone3_Stat
{
    _mHVAC_Disp_Stat2_AR.HVAC_AirDist_Zone3_Stat.phys = getValue(this);
    _HVAC_Disp_Stat2_AR_SpontanFlag = 1;
}
/*@@end*/

/*@@envVar:HMI_HVAC_AirDist_Zone4_Stat:*/
on EnvVar HMI_HVAC_AirDist_Zone4_Stat
{
    _mHVAC_Disp_Stat2_AR.HVAC_AirDist_Zone4_Stat.phys = getValue(this);
    _HVAC_Disp_Stat2_AR_SpontanFlag = 1;
}
/*@@end*/

/*@@envVar:HMI_HVAC_Auto_Zone3_Stat:*/
on EnvVar HMI_HVAC_Auto_Zone3_Stat
{
    _mHVAC_Disp_Stat2_AR.HVAC_Auto_Zone3_Stat.phys = getValue(this);
    _HVAC_Disp_Stat2_AR_SpontanFlag = 1;
}
/*@@end*/

/*@@envVar:HMI_HVAC_Auto_Zone4_Stat:*/
on EnvVar HMI_HVAC_Auto_Zone4_Stat
{
    _mHVAC_Disp_Stat2_AR.HVAC_Auto_Zone4_Stat.phys = getValue(this);
    _HVAC_Disp_Stat2_AR_SpontanFlag = 1;
}
/*@@end*/

/*@@envVar:HMI_HVAC_Fan_Zone3_Stat:*/
on EnvVar HMI_HVAC_Fan_Zone3_Stat
{
    _mHVAC_Disp_Stat2_AR.HVAC_Fan_Zone3_Stat.phys = getValue(this);
    _HVAC_Disp_Stat2_AR_SpontanFlag = 1;
}
/*@@end*/

/*@@envVar:HMI_HVAC_Fan_Zone4_Stat:*/
on EnvVar HMI_HVAC_Fan_Zone4_Stat
{
    _mHVAC_Disp_Stat2_AR.HVAC_Fan_Zone4_Stat.phys = getValue(this);
    _HVAC_Disp_Stat2_AR_SpontanFlag = 1;
}
/*@@end*/

/*@@envVar:HMI_HVAC_Off_Z3Z4_Actv:*/
on EnvVar HMI_HVAC_Off_Z3Z4_Actv
{
    _mHVAC_Disp_Stat2_AR.HVAC_Off_Z3Z4_Actv.phys = getValue(this);
    _HVAC_Disp_Stat2_AR_SpontanFlag = 1;
}
/*@@end*/

/*@@envVar:HMI_HVAC_RHU_Z3Z4_Actv:*/
on EnvVar HMI_HVAC_RHU_Z3Z4_Actv
{
    _mHVAC_Disp_Stat2_AR.HVAC_RHU_Z3Z4_Actv.phys = getValue(this);
    _HVAC_Disp_Stat2_AR_SpontanFlag = 1;
}
/*@@end*/

/*@@envVar:HMI_HVAC_Temp_Zone3_Stat:*/
on EnvVar HMI_HVAC_Temp_Zone3_Stat
{
    _mHVAC_Disp_Stat2_AR.HVAC_Temp_Zone3_Stat.phys = getValue(this);
    _HVAC_Disp_Stat2_AR_SpontanFlag = 1;
}
/*@@end*/

/*@@envVar:HMI_HVAC_Temp_Zone4_Stat:*/
on EnvVar HMI_HVAC_Temp_Zone4_Stat
{
    _mHVAC_Disp_Stat2_AR.HVAC_Temp_Zone4_Stat.phys = getValue(this);
    _HVAC_Disp_Stat2_AR_SpontanFlag = 1;
}
/*@@end*/

/*@@caplFunc:HVAC_Disp_Stat3_AR_check_output():*/
HVAC_Disp_Stat3_AR_check_output()
{
    if( !getValue( HMI__STMSG_HVAC_Disp_Stat3_AR ) )
    {
        // Botschaft HVAC_Disp_Stat3_AR ID: 855 --- Sendeart 5 cyclicAndSpontanWithDelay --- 
        if( _HVAC_Disp_Stat3_AR_DelayCnt > 0) _HVAC_Disp_Stat3_AR_DelayCnt--; // Mindestsendeabstand
        _HVAC_Disp_Stat3_AR_Cnt--;
        if( _HVAC_Disp_Stat3_AR_Cnt < 1 )
        {
            if( _HVAC_Disp_Stat3_AR_DelayCnt < 1 )
            {
                HVAC_Disp_Stat3_AR_output(); // Nachricht wg. abgelaufenem Zyklus ausgeben (Mindestsendeabstand eingehalten)
                _HVAC_Disp_Stat3_AR_SpontanFlag = 0; // Spontan-Flag zurücksetzen
                _HVAC_Disp_Stat3_AR_DelayCnt = _HVAC_Disp_Stat3_AR_MinDelay;
            }
            else
            {
                // Spontanflag setzen damit nach Ablauf Mindestsendeabstand gesendet wird
                 _HVAC_Disp_Stat3_AR_SpontanFlag = 1;
            }
            _HVAC_Disp_Stat3_AR_Cnt = _HVAC_Disp_Stat3_AR_CycleCount; // Zyklus-Zähler zurücksetzen
        }
        else if( _HVAC_Disp_Stat3_AR_SpontanFlag )
        {
            if( _HVAC_Disp_Stat3_AR_DelayCnt < 1 )
            {
                HVAC_Disp_Stat3_AR_output(); // Nachricht wg. spontaner Änderung ausgeben (Mindestsendeabstand eingehalten)
                _HVAC_Disp_Stat3_AR_SpontanFlag = 0; // Spontan-Flag zurücksetzen
                _HVAC_Disp_Stat3_AR_DelayCnt = _HVAC_Disp_Stat3_AR_MinDelay;
            }
        }
    }
}
/*@@end*/

/*@@caplFunc:HVAC_Disp_Stat3_AR_init():*/
HVAC_Disp_Stat3_AR_init()
{   /* Botschaft HVAC_Disp_Stat3_AR ID: 855 --- Sendeart 5 cyclicAndSpontanWithDelay --- 
BA_ "ApplMessage" BO_ 855 0;
BA_ "NmAsrMessage" BO_ 855 0;
BA_ "GenMsgMinAcceptLength" BO_ 855 8;
BA_ "GenMsgILSupport" BO_ 855 1;
BA_ "DiagState" BO_ 855 0;
BA_ "DiagRequest" BO_ 855 0;
BA_ "DiagResponse" BO_ 855 0;
BA_ "GenMsgStartValue" BO_ 855 "0";
BA_ "GenMsgDelayTime" BO_ 855 200;
BA_ "GenMsgNrOfRepetitions" BO_ 855 0;
BA_ "GenMsgCycleTime" BO_ 855 1000;
BA_ "GenMsgSendType" BO_ 855 5;
    */
    _HVAC_Disp_Stat3_AR_Timebase =           c_tDBKomTimer_20ms;
    _HVAC_Disp_Stat3_AR_CycleCount =       1000 / _HVAC_Disp_Stat3_AR_Timebase;
    _HVAC_Disp_Stat3_AR_StartDelay =          0 / _HVAC_Disp_Stat3_AR_Timebase;
    _HVAC_Disp_Stat3_AR_MinDelay =          200 / _HVAC_Disp_Stat3_AR_Timebase;
    _HVAC_Disp_Stat3_AR_Cnt = _HVAC_Disp_Stat3_AR_StartDelay;
    _HVAC_Disp_Stat3_AR_SpontanFlag = 0;
    _HVAC_Disp_Stat3_AR_DelayCnt = 0;

    putValue( HMI__STMSGSD_HVAC_Disp_Stat3_AR, _HVAC_Disp_Stat3_AR_StartDelay * _HVAC_Disp_Stat3_AR_Timebase );

    _mHVAC_Disp_Stat3_AR.AirTemp_Insd_Disp.phys = getValue( HMI_AirTemp_Insd_Disp );
    _mHVAC_Disp_Stat3_AR.HVAC_ActvComf_TempCtrl_Stat.phys = getValue( HMI_HVAC_ActvComf_TempCtrl_Stat );
    _mHVAC_Disp_Stat3_AR.HVAC_FondKey_Psd.phys = getValue( HMI_HVAC_FondKey_Psd );
    _mHVAC_Disp_Stat3_AR.HVAC_Ionzr_Actv.phys = getValue( HMI_HVAC_Ionzr_Actv );
    _mHVAC_Disp_Stat3_AR.HVAC_Ionzr_Md.phys = getValue( HMI_HVAC_Ionzr_Md );
    _mHVAC_Disp_Stat3_AR.HVAC_MenuKey_Psd.phys = getValue( HMI_HVAC_MenuKey_Psd );
    _mHVAC_Disp_Stat3_AR.HVAC_Mono_Actv.phys = getValue( HMI_HVAC_Mono_Actv );
    _mHVAC_Disp_Stat3_AR.HVAC_Pulsation_ActvComf_Stat.phys = getValue( HMI_HVAC_Pulsation_ActvComf_Stat );
    _mHVAC_Disp_Stat3_AR.HVAC_SGEN_Actv.phys = getValue( HMI_HVAC_SGEN_Actv );
    _mHVAC_Disp_Stat3_AR.HVAC_SGEN_Insty.phys = getValue( HMI_HVAC_SGEN_Insty );
    _mHVAC_Disp_Stat3_AR.HVAC_Temp_FL_Psd_HVAC_F.phys = getValue( HMI_HVAC_Temp_FL_Psd_HVAC_F );
    _mHVAC_Disp_Stat3_AR.HVAC_Temp_FR_Psd_HVAC_F.phys = getValue( HMI_HVAC_Temp_FR_Psd_HVAC_F );
    _mHVAC_Disp_Stat3_AR.HVAC_Temp_RL_Psd_HVAC_R.phys = getValue( HMI_HVAC_Temp_RL_Psd_HVAC_R );
    _mHVAC_Disp_Stat3_AR.HVAC_Temp_RR_Psd_HVAC_R.phys = getValue( HMI_HVAC_Temp_RR_Psd_HVAC_R );
    _mHVAC_Disp_Stat3_AR.SGEN_Flacon_Flt.phys = getValue( HMI_SGEN_Flacon_Flt );
}
/*@@end*/

/*@@caplFunc:HVAC_Disp_Stat3_AR_output():*/
HVAC_Disp_Stat3_AR_output(void)
{
    output( _mHVAC_Disp_Stat3_AR );
}
/*@@end*/

/*@@caplFunc:HVAC_Disp_Stat3_AR_saveEnvVars(dword):*/
HVAC_Disp_Stat3_AR_saveEnvVars( dword hFile )
{
    filePutString("\n// Knoten EIS: HVAC_Disp_Stat3_AR\n", 32, hFile );
    snprintf( buffer, elcount( buffer ), "0.0000 HMI__STMSG_HVAC_Disp_Stat3_AR := %X\n", getValue( HMI__STMSG_HVAC_Disp_Stat3_AR ) );    filePutString( buffer, elcount( buffer ), hFile );
    snprintf( buffer, elcount( buffer ), "0.0000 HMI__STMSGT_HVAC_Disp_Stat3_AR := %X\n", getValue( HMI__STMSGT_HVAC_Disp_Stat3_AR ) );    filePutString( buffer, elcount( buffer ), hFile );
    snprintf( buffer, elcount( buffer ), "0.0000 HMI_AirTemp_Insd_Disp := %X\n", getValue( HMI_AirTemp_Insd_Disp ) );    filePutString( buffer, elcount( buffer ), hFile );
    snprintf( buffer, elcount( buffer ), "0.0000 HMI_HVAC_ActvComf_TempCtrl_Stat := %X\n", getValue( HMI_HVAC_ActvComf_TempCtrl_Stat ) );    filePutString( buffer, elcount( buffer ), hFile );
    snprintf( buffer, elcount( buffer ), "0.0000 HMI_HVAC_FondKey_Psd := %X\n", getValue( HMI_HVAC_FondKey_Psd ) );    filePutString( buffer, elcount( buffer ), hFile );
    snprintf( buffer, elcount( buffer ), "0.0000 HMI_HVAC_Ionzr_Actv := %X\n", getValue( HMI_HVAC_Ionzr_Actv ) );    filePutString( buffer, elcount( buffer ), hFile );
    snprintf( buffer, elcount( buffer ), "0.0000 HMI_HVAC_Ionzr_Md := %X\n", getValue( HMI_HVAC_Ionzr_Md ) );    filePutString( buffer, elcount( buffer ), hFile );
    snprintf( buffer, elcount( buffer ), "0.0000 HMI_HVAC_MenuKey_Psd := %X\n", getValue( HMI_HVAC_MenuKey_Psd ) );    filePutString( buffer, elcount( buffer ), hFile );
    snprintf( buffer, elcount( buffer ), "0.0000 HMI_HVAC_Mono_Actv := %X\n", getValue( HMI_HVAC_Mono_Actv ) );    filePutString( buffer, elcount( buffer ), hFile );
    snprintf( buffer, elcount( buffer ), "0.0000 HMI_HVAC_Pulsation_ActvComf_Stat := %X\n", getValue( HMI_HVAC_Pulsation_ActvComf_Stat ) );    filePutString( buffer, elcount( buffer ), hFile );
    snprintf( buffer, elcount( buffer ), "0.0000 HMI_HVAC_SGEN_Actv := %X\n", getValue( HMI_HVAC_SGEN_Actv ) );    filePutString( buffer, elcount( buffer ), hFile );
    snprintf( buffer, elcount( buffer ), "0.0000 HMI_HVAC_SGEN_Insty := %X\n", getValue( HMI_HVAC_SGEN_Insty ) );    filePutString( buffer, elcount( buffer ), hFile );
    snprintf( buffer, elcount( buffer ), "0.0000 HMI_HVAC_Temp_FL_Psd_HVAC_F := %X\n", getValue( HMI_HVAC_Temp_FL_Psd_HVAC_F ) );    filePutString( buffer, elcount( buffer ), hFile );
    snprintf( buffer, elcount( buffer ), "0.0000 HMI_HVAC_Temp_FR_Psd_HVAC_F := %X\n", getValue( HMI_HVAC_Temp_FR_Psd_HVAC_F ) );    filePutString( buffer, elcount( buffer ), hFile );
    snprintf( buffer, elcount( buffer ), "0.0000 HMI_HVAC_Temp_RL_Psd_HVAC_R := %X\n", getValue( HMI_HVAC_Temp_RL_Psd_HVAC_R ) );    filePutString( buffer, elcount( buffer ), hFile );
    snprintf( buffer, elcount( buffer ), "0.0000 HMI_HVAC_Temp_RR_Psd_HVAC_R := %X\n", getValue( HMI_HVAC_Temp_RR_Psd_HVAC_R ) );    filePutString( buffer, elcount( buffer ), hFile );
    snprintf( buffer, elcount( buffer ), "0.0000 HMI_SGEN_Flacon_Flt := %X\n", getValue( HMI_SGEN_Flacon_Flt ) );    filePutString( buffer, elcount( buffer ), hFile );
}
/*@@end*/

/*@@timer:_tHVAC_Disp_Stat3_AR:*/
on timer _tHVAC_Disp_Stat3_AR
{
    putValue( HMI__STMSG_HVAC_Disp_Stat3_AR, 0 );
}
/*@@end*/

/*@@envVar:HMI__STMSG_HVAC_Disp_Stat3_AR:*/
on EnvVar HMI__STMSG_HVAC_Disp_Stat3_AR
{
    long tDelay;
    if( getValue( this ) == 2 )
    {
        tDelay = getValue( HMI__STMSGT_HVAC_Disp_Stat3_AR );
        if( tDelay > 0)    
            setTimer( _tHVAC_Disp_Stat3_AR, tDelay );
        else
            putValue( HMI__STMSG_HVAC_Disp_Stat3_AR, 0 );
    }
}
/*@@end*/

/*@@envVar:HMI_AirTemp_Insd_Disp:*/
on EnvVar HMI_AirTemp_Insd_Disp
{
    _mHVAC_Disp_Stat3_AR.AirTemp_Insd_Disp.phys = getValue(this);
    _HVAC_Disp_Stat3_AR_SpontanFlag = 1;
}
/*@@end*/

/*@@envVar:HMI_HVAC_ActvComf_TempCtrl_Stat:*/
on EnvVar HMI_HVAC_ActvComf_TempCtrl_Stat
{
    _mHVAC_Disp_Stat3_AR.HVAC_ActvComf_TempCtrl_Stat.phys = getValue(this);
    _HVAC_Disp_Stat3_AR_SpontanFlag = 1;
}
/*@@end*/

/*@@envVar:HMI_HVAC_FondKey_Psd:*/
on EnvVar HMI_HVAC_FondKey_Psd
{
    _mHVAC_Disp_Stat3_AR.HVAC_FondKey_Psd.phys = getValue(this);
    _HVAC_Disp_Stat3_AR_SpontanFlag = 1;
}
/*@@end*/

/*@@envVar:HMI_HVAC_Ionzr_Actv:*/
on EnvVar HMI_HVAC_Ionzr_Actv
{
    _mHVAC_Disp_Stat3_AR.HVAC_Ionzr_Actv.phys = getValue(this);
    _HVAC_Disp_Stat3_AR_SpontanFlag = 1;
}
/*@@end*/

/*@@envVar:HMI_HVAC_Ionzr_Md:*/
on EnvVar HMI_HVAC_Ionzr_Md
{
    _mHVAC_Disp_Stat3_AR.HVAC_Ionzr_Md.phys = getValue(this);
    _HVAC_Disp_Stat3_AR_SpontanFlag = 1;
}
/*@@end*/

/*@@envVar:HMI_HVAC_MenuKey_Psd:*/
on EnvVar HMI_HVAC_MenuKey_Psd
{
    _mHVAC_Disp_Stat3_AR.HVAC_MenuKey_Psd.phys = getValue(this);
    _HVAC_Disp_Stat3_AR_SpontanFlag = 1;
}
/*@@end*/

/*@@envVar:HMI_HVAC_Mono_Actv:*/
on EnvVar HMI_HVAC_Mono_Actv
{
    _mHVAC_Disp_Stat3_AR.HVAC_Mono_Actv.phys = getValue(this);
    _HVAC_Disp_Stat3_AR_SpontanFlag = 1;
}
/*@@end*/

/*@@envVar:HMI_HVAC_Pulsation_ActvComf_Stat:*/
on EnvVar HMI_HVAC_Pulsation_ActvComf_Stat
{
    _mHVAC_Disp_Stat3_AR.HVAC_Pulsation_ActvComf_Stat.phys = getValue(this);
    _HVAC_Disp_Stat3_AR_SpontanFlag = 1;
}
/*@@end*/

/*@@envVar:HMI_HVAC_SGEN_Actv:*/
on EnvVar HMI_HVAC_SGEN_Actv
{
    _mHVAC_Disp_Stat3_AR.HVAC_SGEN_Actv.phys = getValue(this);
    _HVAC_Disp_Stat3_AR_SpontanFlag = 1;
}
/*@@end*/

/*@@envVar:HMI_HVAC_SGEN_Insty:*/
on EnvVar HMI_HVAC_SGEN_Insty
{
    _mHVAC_Disp_Stat3_AR.HVAC_SGEN_Insty.phys = getValue(this);
    _HVAC_Disp_Stat3_AR_SpontanFlag = 1;
}
/*@@end*/

/*@@envVar:HMI_HVAC_Temp_FL_Psd_HVAC_F:*/
on EnvVar HMI_HVAC_Temp_FL_Psd_HVAC_F
{
    _mHVAC_Disp_Stat3_AR.HVAC_Temp_FL_Psd_HVAC_F.phys = getValue(this);
    _HVAC_Disp_Stat3_AR_SpontanFlag = 1;
}
/*@@end*/

/*@@envVar:HMI_HVAC_Temp_FR_Psd_HVAC_F:*/
on EnvVar HMI_HVAC_Temp_FR_Psd_HVAC_F
{
    _mHVAC_Disp_Stat3_AR.HVAC_Temp_FR_Psd_HVAC_F.phys = getValue(this);
    _HVAC_Disp_Stat3_AR_SpontanFlag = 1;
}
/*@@end*/

/*@@envVar:HMI_HVAC_Temp_RL_Psd_HVAC_R:*/
on EnvVar HMI_HVAC_Temp_RL_Psd_HVAC_R
{
    _mHVAC_Disp_Stat3_AR.HVAC_Temp_RL_Psd_HVAC_R.phys = getValue(this);
    _HVAC_Disp_Stat3_AR_SpontanFlag = 1;
}
/*@@end*/

/*@@envVar:HMI_HVAC_Temp_RR_Psd_HVAC_R:*/
on EnvVar HMI_HVAC_Temp_RR_Psd_HVAC_R
{
    _mHVAC_Disp_Stat3_AR.HVAC_Temp_RR_Psd_HVAC_R.phys = getValue(this);
    _HVAC_Disp_Stat3_AR_SpontanFlag = 1;
}
/*@@end*/

/*@@envVar:HMI_SGEN_Flacon_Flt:*/
on EnvVar HMI_SGEN_Flacon_Flt
{
    _mHVAC_Disp_Stat3_AR.SGEN_Flacon_Flt.phys = getValue(this);
    _HVAC_Disp_Stat3_AR_SpontanFlag = 1;
}
/*@@end*/

/*@@caplFunc:HVAC_State1_AR_check_output():*/
HVAC_State1_AR_check_output()
{
    if( !getValue( HMI__STMSG_HVAC_State1_AR ) )
    {
        // Botschaft HVAC_State1_AR ID: 895 --- Sendeart 5 cyclicAndSpontanWithDelay --- 
        _HVAC_State1_AR_Cnt--;
        if( _HVAC_State1_AR_Cnt < 1 )
        {
            HVAC_State1_AR_output(); // Nachricht wg. abgelaufenem Zyklus ausgeben
            _HVAC_State1_AR_Cnt = _HVAC_State1_AR_CycleCount; // Zyklus-Zähler zurücksetzen
            _HVAC_State1_AR_SpontanFlag = 0; // Spontan-Flag zurücksetzen
        }
        else if( _HVAC_State1_AR_SpontanFlag)
        {
            HVAC_State1_AR_output(); // Nachricht wg. spontaner Änderung ausgeben
            _HVAC_State1_AR_SpontanFlag = 0; // Spontan-Flag zurücksetzen
        }
    }
}
/*@@end*/

/*@@caplFunc:HVAC_State1_AR_init():*/
HVAC_State1_AR_init()
{   /* Botschaft HVAC_State1_AR ID: 895 --- Sendeart 5 cyclicAndSpontanWithDelay --- 
BA_ "ApplMessage" BO_ 895 0;
BA_ "NmAsrMessage" BO_ 895 0;
BA_ "GenMsgMinAcceptLength" BO_ 895 8;
BA_ "GenMsgILSupport" BO_ 895 1;
BA_ "DiagState" BO_ 895 0;
BA_ "DiagRequest" BO_ 895 0;
BA_ "DiagResponse" BO_ 895 0;
BA_ "GenMsgStartValue" BO_ 895 "0";
BA_ "GenMsgDelayTime" BO_ 895 5;
BA_ "GenMsgNrOfRepetitions" BO_ 895 0;
BA_ "GenMsgCycleTime" BO_ 895 500;
BA_ "GenMsgSendType" BO_ 895 5;
    */
    _HVAC_State1_AR_Timebase =           c_tDBKomTimer_20ms;
    _HVAC_State1_AR_CycleCount =        500 / _HVAC_State1_AR_Timebase;
    _HVAC_State1_AR_StartDelay =          0 / _HVAC_State1_AR_Timebase;
    _HVAC_State1_AR_Cnt = _HVAC_State1_AR_StartDelay;
    _HVAC_State1_AR_SpontanFlag = 0;

    putValue( HMI__STMSGSD_HVAC_State1_AR, _HVAC_State1_AR_StartDelay * _HVAC_State1_AR_Timebase );

    _mHVAC_State1_AR.AirTemp_Insd_V2.phys = getValue( HMI_AirTemp_Insd_V2 );
    _mHVAC_State1_AR.AirTemp_InsdSens_OHCM_FanOnRq.phys = getValue( HMI_AirTemp_InsdSens_OHCM_FanOnRq );
    _mHVAC_State1_AR.DewTemp.phys = getValue( HMI_DewTemp );
    _mHVAC_State1_AR.DPC_Md_AC_Rs.phys = getValue( HMI_DPC_Md_AC_Rs );
    _mHVAC_State1_AR.DPC_Md_Ht_Rs.phys = getValue( HMI_DPC_Md_Ht_Rs );
    _mHVAC_State1_AR.EBL_Sw_Psd.phys = getValue( HMI_EBL_Sw_Psd );
    _mHVAC_State1_AR.HVAC_AC_Off.phys = getValue( HMI_HVAC_AC_Off );
    _mHVAC_State1_AR.HVAC_AuxHt_Enbl.phys = getValue( HMI_HVAC_AuxHt_Enbl );
    _mHVAC_State1_AR.HVAC_Dfrst_Actv.phys = getValue( HMI_HVAC_Dfrst_Actv );
    _mHVAC_State1_AR.HVAC_Fan_Actv_IgnOff.phys = getValue( HMI_HVAC_Fan_Actv_IgnOff );
    _mHVAC_State1_AR.HVAC_Fan_F.phys = getValue( HMI_HVAC_Fan_F );
    _mHVAC_State1_AR.HVAC_Off_Ft_Actv.phys = getValue( HMI_HVAC_Off_Ft_Actv );
    _mHVAC_State1_AR.HVAC_Pulsation_Stat.phys = getValue( HMI_HVAC_Pulsation_Stat );
    _mHVAC_State1_AR.HVAC_RecircAir_Actv.phys = getValue( HMI_HVAC_RecircAir_Actv );
    _mHVAC_State1_AR.HVAC_RecircAirSw_F_Psd_HVAC_F.phys = getValue( HMI_HVAC_RecircAirSw_F_Psd_HVAC_F );
    _mHVAC_State1_AR.HVAC_RHU_Ft_Actv.phys = getValue( HMI_HVAC_RHU_Ft_Actv );
    _mHVAC_State1_AR.HVAC_RHU_R_Actv.phys = getValue( HMI_HVAC_RHU_R_Actv );
    _mHVAC_State1_AR.HVAC_Vprzr_DryVn_Actv.phys = getValue( HMI_HVAC_Vprzr_DryVn_Actv );
    _mHVAC_State1_AR.HVAC_Vprzr_DryVnTmr_On_Rq.phys = getValue( HMI_HVAC_Vprzr_DryVnTmr_On_Rq );
    _mHVAC_State1_AR.ICH_Dur_Stat.phys = getValue( HMI_ICH_Dur_Stat );
    _mHVAC_State1_AR.ICH_HtVnSw_Psd.phys = getValue( HMI_ICH_HtVnSw_Psd );
    _mHVAC_State1_AR.ICH_LED_Rd_Flt.phys = getValue( HMI_ICH_LED_Rd_Flt );
    _mHVAC_State1_AR.ICH_LED_Ye_Flt.phys = getValue( HMI_ICH_LED_Ye_Flt );
    _mHVAC_State1_AR.ICH_Rq.phys = getValue( HMI_ICH_Rq );
    _mHVAC_State1_AR.ICH_WtrPmp_On_Rq_HVAC.phys = getValue( HMI_ICH_WtrPmp_On_Rq_HVAC );
    _mHVAC_State1_AR.PN14_GM1_Off_Rq_HVAC.phys = getValue( HMI_PN14_GM1_Off_Rq_HVAC );
}
/*@@end*/

/*@@caplFunc:HVAC_State1_AR_output():*/
HVAC_State1_AR_output(void)
{
    output( _mHVAC_State1_AR );
}
/*@@end*/

/*@@caplFunc:HVAC_State1_AR_saveEnvVars(dword):*/
HVAC_State1_AR_saveEnvVars( dword hFile )
{
    filePutString("\n// Knoten EIS: HVAC_State1_AR\n", 28, hFile );
    snprintf( buffer, elcount( buffer ), "0.0000 HMI__STMSG_HVAC_State1 := %X\n", getValue( HMI__STMSG_HVAC_State1_AR ) );    filePutString( buffer, elcount( buffer ), hFile );
    snprintf( buffer, elcount( buffer ), "0.0000 HMI__STMSGT_HVAC_State1 := %X\n", getValue( HMI__STMSGT_HVAC_State1_AR ) );    filePutString( buffer, elcount( buffer ), hFile );
    snprintf( buffer, elcount( buffer ), "0.0000 HMI_AirTemp_Insd_V2 := %X\n", getValue( HMI_AirTemp_Insd_V2 ) );    filePutString( buffer, elcount( buffer ), hFile );
    snprintf( buffer, elcount( buffer ), "0.0000 HMI_AirTemp_InsdSens_OHCM_FanOnRq := %X\n", getValue( HMI_AirTemp_InsdSens_OHCM_FanOnRq ) );    filePutString( buffer, elcount( buffer ), hFile );
    snprintf( buffer, elcount( buffer ), "0.0000 HMI_DewTemp := %X\n", getValue( HMI_DewTemp ) );    filePutString( buffer, elcount( buffer ), hFile );
    snprintf( buffer, elcount( buffer ), "0.0000 HMI_DPC_Md_AC_Rs := %X\n", getValue( HMI_DPC_Md_AC_Rs ) );    filePutString( buffer, elcount( buffer ), hFile );
    snprintf( buffer, elcount( buffer ), "0.0000 HMI_DPC_Md_Ht_Rs := %X\n", getValue( HMI_DPC_Md_Ht_Rs ) );    filePutString( buffer, elcount( buffer ), hFile );
    snprintf( buffer, elcount( buffer ), "0.0000 HMI_EBL_Sw_Psd := %X\n", getValue( HMI_EBL_Sw_Psd ) );    filePutString( buffer, elcount( buffer ), hFile );
    snprintf( buffer, elcount( buffer ), "0.0000 HMI_HVAC_AuxHt_Enbl := %X\n", getValue( HMI_HVAC_AuxHt_Enbl ) );    filePutString( buffer, elcount( buffer ), hFile );
    snprintf( buffer, elcount( buffer ), "0.0000 HMI_HVAC_Dfrst_Actv := %X\n", getValue( HMI_HVAC_Dfrst_Actv ) );    filePutString( buffer, elcount( buffer ), hFile );
    snprintf( buffer, elcount( buffer ), "0.0000 HMI_HVAC_Fan_Actv_IgnOff := %X\n", getValue( HMI_HVAC_Fan_Actv_IgnOff ) );    filePutString( buffer, elcount( buffer ), hFile );
    snprintf( buffer, elcount( buffer ), "0.0000 HMI_HVAC_Fan_F := %X\n", getValue( HMI_HVAC_Fan_F ) );    filePutString( buffer, elcount( buffer ), hFile );
    snprintf( buffer, elcount( buffer ), "0.0000 HMI_HVAC_AC_Off := %X\n", getValue( HMI_HVAC_AC_Off ) );    filePutString( buffer, elcount( buffer ), hFile );
    snprintf( buffer, elcount( buffer ), "0.0000 HMI_HVAC_Off_Ft_Actv := %X\n", getValue( HMI_HVAC_Off_Ft_Actv ) );    filePutString( buffer, elcount( buffer ), hFile );
    snprintf( buffer, elcount( buffer ), "0.0000 HMI_HVAC_Pulsation_Stat := %X\n", getValue( HMI_HVAC_Pulsation_Stat ) );    filePutString( buffer, elcount( buffer ), hFile );
    snprintf( buffer, elcount( buffer ), "0.0000 HMI_HVAC_RecircAir_Actv := %X\n", getValue( HMI_HVAC_RecircAir_Actv ) );    filePutString( buffer, elcount( buffer ), hFile );
    snprintf( buffer, elcount( buffer ), "0.0000 HMI_HVAC_RecircAirSw_F_Psd_HVAC_F := %X\n", getValue( HMI_HVAC_RecircAirSw_F_Psd_HVAC_F ) );    filePutString( buffer, elcount( buffer ), hFile );
    snprintf( buffer, elcount( buffer ), "0.0000 HMI_HVAC_RHU_Ft_Actv := %X\n", getValue( HMI_HVAC_RHU_Ft_Actv ) );    filePutString( buffer, elcount( buffer ), hFile );
    snprintf( buffer, elcount( buffer ), "0.0000 HMI_HVAC_RHU_R_Actv := %X\n", getValue( HMI_HVAC_RHU_R_Actv ) );    filePutString( buffer, elcount( buffer ), hFile );
    snprintf( buffer, elcount( buffer ), "0.0000 HMI_HVAC_Vprzr_DryVn_Actv := %X\n", getValue( HMI_HVAC_Vprzr_DryVn_Actv ) );    filePutString( buffer, elcount( buffer ), hFile );
    snprintf( buffer, elcount( buffer ), "0.0000 HMI_HVAC_Vprzr_DryVnTmr_On_Rq := %X\n", getValue( HMI_HVAC_Vprzr_DryVnTmr_On_Rq ) );    filePutString( buffer, elcount( buffer ), hFile );
    snprintf( buffer, elcount( buffer ), "0.0000 HMI_ICH_Dur_Stat := %X\n", getValue( HMI_ICH_Dur_Stat ) );    filePutString( buffer, elcount( buffer ), hFile );
    snprintf( buffer, elcount( buffer ), "0.0000 HMI_ICH_HtVnSw_Psd := %X\n", getValue( HMI_ICH_HtVnSw_Psd ) );    filePutString( buffer, elcount( buffer ), hFile );
    snprintf( buffer, elcount( buffer ), "0.0000 HMI_ICH_LED_Rd_Flt := %X\n", getValue( HMI_ICH_LED_Rd_Flt ) );    filePutString( buffer, elcount( buffer ), hFile );
    snprintf( buffer, elcount( buffer ), "0.0000 HMI_ICH_LED_Ye_Flt := %X\n", getValue( HMI_ICH_LED_Ye_Flt ) );    filePutString( buffer, elcount( buffer ), hFile );
    snprintf( buffer, elcount( buffer ), "0.0000 HMI_ICH_Rq := %X\n", getValue( HMI_ICH_Rq ) );    filePutString( buffer, elcount( buffer ), hFile );
    snprintf( buffer, elcount( buffer ), "0.0000 HMI_ICH_WtrPmp_On_Rq_HVAC := %X\n", getValue( HMI_ICH_WtrPmp_On_Rq_HVAC ) );    filePutString( buffer, elcount( buffer ), hFile );
    snprintf( buffer, elcount( buffer ), "0.0000 HMI_PN14_GM1_Off_Rq_HVAC := %X\n", getValue( HMI_PN14_GM1_Off_Rq_HVAC ) );    filePutString( buffer, elcount( buffer ), hFile );
}
/*@@end*/

/*@@timer:_tHVAC_State1_AR:*/
on timer _tHVAC_State1_AR
{
    putValue( HMI__STMSG_HVAC_State1_AR, 0 );
}
/*@@end*/

/*@@envVar:HMI__STMSG_HVAC_State1_AR:*/
on EnvVar HMI__STMSG_HVAC_State1_AR
{
    long tDelay;
    if( getValue( this ) == 2 )
    {
        tDelay = getValue( HMI__STMSGT_HVAC_State1_AR );
        if( tDelay > 0)    
            setTimer( _tHVAC_State1_AR, tDelay );
        else
            putValue( HMI__STMSG_HVAC_State1_AR, 0 );
    }
}
/*@@end*/

/*@@envVar:HMI_AirTemp_Insd_V2:*/
on EnvVar HMI_AirTemp_Insd_V2
{
    _mHVAC_State1_AR.AirTemp_Insd_V2.phys = getValue(this);
    _HVAC_State1_AR_SpontanFlag = 1;
}
/*@@end*/

/*@@envVar:HMI_DewTemp:*/
on EnvVar HMI_DewTemp
{
    _mHVAC_State1_AR.DewTemp.phys = getValue(this);
    _HVAC_State1_AR_SpontanFlag = 1;
}
/*@@end*/

/*@@envVar:HMI_DPC_Md_AC_Rs:*/
on EnvVar HMI_DPC_Md_AC_Rs
{
    _mHVAC_State1_AR.DPC_Md_AC_Rs.phys = getValue(this);
    _HVAC_State1_AR_SpontanFlag = 1;
}
/*@@end*/

/*@@envVar:HMI_DPC_Md_Ht_Rs:*/
on EnvVar HMI_DPC_Md_Ht_Rs
{
    _mHVAC_State1_AR.DPC_Md_Ht_Rs.phys = getValue(this);
    _HVAC_State1_AR_SpontanFlag = 1;
}
/*@@end*/

/*@@envVar:HMI_EBL_Sw_Psd:*/
on EnvVar HMI_EBL_Sw_Psd
{
    _mHVAC_State1_AR.EBL_Sw_Psd.phys = getValue(this);
    _HVAC_State1_AR_SpontanFlag = 1;
}
/*@@end*/

/*@@envVar:HMI_HVAC_AC_Off:*/
on EnvVar HMI_HVAC_AC_Off
{
    _mHVAC_State1_AR.HVAC_AC_Off.phys = getValue(this);
    _HVAC_State1_AR_SpontanFlag = 1;
}
/*@@end*/

/*@@envVar:HMI_HVAC_AuxHt_Enbl:*/
on EnvVar HMI_HVAC_AuxHt_Enbl
{
    _mHVAC_State1_AR.HVAC_AuxHt_Enbl.phys = getValue(this);
    _HVAC_State1_AR_SpontanFlag = 1;
}
/*@@end*/

/*@@envVar:HMI_HVAC_Dfrst_Actv:*/
on EnvVar HMI_HVAC_Dfrst_Actv
{
    _mHVAC_State1_AR.HVAC_Dfrst_Actv.phys = getValue(this);
    _HVAC_State1_AR_SpontanFlag = 1;
}
/*@@end*/

/*@@envVar:HMI_HVAC_Fan_Actv_IgnOff:*/
on EnvVar HMI_HVAC_Fan_Actv_IgnOff
{
    _mHVAC_State1_AR.HVAC_Fan_Actv_IgnOff.phys = getValue(this);
    _HVAC_State1_AR_SpontanFlag = 1;
}
/*@@end*/

/*@@envVar:HMI_HVAC_Fan_F:*/
on EnvVar HMI_HVAC_Fan_F
{
    _mHVAC_State1_AR.HVAC_Fan_F.phys = getValue(this);
    _HVAC_State1_AR_SpontanFlag = 1;
}
/*@@end*/

/*@@envVar:HMI_HVAC_Off_Ft_Actv:*/
on EnvVar HMI_HVAC_Off_Ft_Actv
{
    _mHVAC_State1_AR.HVAC_Off_Ft_Actv.phys = getValue(this);
    _HVAC_State1_AR_SpontanFlag = 1;
}
/*@@end*/

/*@@envVar:HMI_HVAC_Pulsation_Stat:*/
on EnvVar HMI_HVAC_Pulsation_Stat
{
    _mHVAC_State1_AR.HVAC_Pulsation_Stat.phys = getValue(this);
    _HVAC_State1_AR_SpontanFlag = 1;
}
/*@@end*/

/*@@envVar:HMI_HVAC_RecircAir_Actv:*/
on EnvVar HMI_HVAC_RecircAir_Actv
{
    _mHVAC_State1_AR.HVAC_RecircAir_Actv.phys = getValue(this);
    _HVAC_State1_AR_SpontanFlag = 1;
}
/*@@end*/

/*@@envVar:HMI_HVAC_RHU_Ft_Actv:*/
on EnvVar HMI_HVAC_RHU_Ft_Actv
{
    _mHVAC_State1_AR.HVAC_RHU_Ft_Actv.phys = getValue(this);
    _HVAC_State1_AR_SpontanFlag = 1;
}
/*@@end*/

/*@@envVar:HMI_HVAC_RHU_R_Actv:*/
on EnvVar HMI_HVAC_RHU_R_Actv
{
    _mHVAC_State1_AR.HVAC_RHU_R_Actv.phys = getValue(this);
    _HVAC_State1_AR_SpontanFlag = 1;
}
/*@@end*/

/*@@envVar:HMI_HVAC_Vprzr_DryVn_Actv:*/
on EnvVar HMI_HVAC_Vprzr_DryVn_Actv
{
    _mHVAC_State1_AR.HVAC_Vprzr_DryVn_Actv.phys = getValue(this);
    _HVAC_State1_AR_SpontanFlag = 1;
}
/*@@end*/

/*@@envVar:HMI_HVAC_Vprzr_DryVnTmr_On_Rq:*/
on EnvVar HMI_HVAC_Vprzr_DryVnTmr_On_Rq
{
    _mHVAC_State1_AR.HVAC_Vprzr_DryVnTmr_On_Rq.phys = getValue(this);
    _HVAC_State1_AR_SpontanFlag = 1;
}
/*@@end*/

/*@@envVar:HMI_ICH_Dur_Stat:*/
on EnvVar HMI_ICH_Dur_Stat
{
    _mHVAC_State1_AR.ICH_Dur_Stat.phys = getValue(this);
    _HVAC_State1_AR_SpontanFlag = 1;
}
/*@@end*/

/*@@envVar:HMI_ICH_HtVnSw_Psd:*/
on EnvVar HMI_ICH_HtVnSw_Psd
{
    _mHVAC_State1_AR.ICH_HtVnSw_Psd.phys = getValue(this);
    _HVAC_State1_AR_SpontanFlag = 1;
}
/*@@end*/

/*@@envVar:HMI_ICH_LED_Rd_Flt:*/
on EnvVar HMI_ICH_LED_Rd_Flt
{
    _mHVAC_State1_AR.ICH_LED_Rd_Flt.phys = getValue(this);
    _HVAC_State1_AR_SpontanFlag = 1;
}
/*@@end*/

/*@@envVar:HMI_ICH_LED_Ye_Flt:*/
on EnvVar HMI_ICH_LED_Ye_Flt
{
    _mHVAC_State1_AR.ICH_LED_Ye_Flt.phys = getValue(this);
    _HVAC_State1_AR_SpontanFlag = 1;
}
/*@@end*/

/*@@envVar:HMI_ICH_Rq:*/
on EnvVar HMI_ICH_Rq
{
    _mHVAC_State1_AR.ICH_Rq.phys = getValue(this);
    _HVAC_State1_AR_SpontanFlag = 1;
}
/*@@end*/

/*@@envVar:HMI_ICH_WtrPmp_On_Rq_HVAC:*/
on EnvVar HMI_ICH_WtrPmp_On_Rq_HVAC
{
    _mHVAC_State1_AR.ICH_WtrPmp_On_Rq_HVAC.phys = getValue(this);
    _HVAC_State1_AR_SpontanFlag = 1;
}
/*@@end*/

/*@@envVar:HMI_PN14_GM1_Off_Rq_HVAC:*/
on EnvVar HMI_PN14_GM1_Off_Rq_HVAC
{
    _mHVAC_State1_AR.PN14_GM1_Off_Rq_HVAC.phys = getValue(this);
    _HVAC_State1_AR_SpontanFlag = 1;
}
/*@@end*/

/*@@caplFunc:ICH_PreTime_Stat_AR_check_output():*/
ICH_PreTime_Stat_AR_check_output()
{
    if( !getValue( HMI__STMSG_ICH_PreTime_Stat_AR ) )
    {
        // Botschaft ICH_PreTime_Stat_AR ID: 889 --- Sendeart 5 cyclicAndSpontanWithDelay --- 
        _ICH_PreTime_Stat_AR_Cnt--;
        if( _ICH_PreTime_Stat_AR_Cnt < 1 )
        {
            ICH_PreTime_Stat_AR_output(); // Nachricht wg. abgelaufenem Zyklus ausgeben
            _ICH_PreTime_Stat_AR_Cnt = _ICH_PreTime_Stat_AR_CycleCount; // Zyklus-Zähler zurücksetzen
            _ICH_PreTime_Stat_AR_SpontanFlag = 0; // Spontan-Flag zurücksetzen
        }
        else if( _ICH_PreTime_Stat_AR_SpontanFlag )
        {
            ICH_PreTime_Stat_AR_output(); // Nachricht wg. spontaner Änderung ausgeben
            _ICH_PreTime_Stat_AR_SpontanFlag = 0; // Spontan-Flag zurücksetzen
        }
    }
}
/*@@end*/

/*@@caplFunc:ICH_PreTime_Stat_AR_init():*/
ICH_PreTime_Stat_AR_init()
{   /* Botschaft ICH_PreTime_Stat_AR ID: 889 --- Sendeart 5 cyclicAndSpontanWithDelay --- 
BA_ "ApplMessage" BO_ 889 0;
BA_ "NmAsrMessage" BO_ 889 0;
BA_ "GenMsgMinAcceptLength" BO_ 889 7;
BA_ "GenMsgILSupport" BO_ 889 1;
BA_ "DiagState" BO_ 889 0;
BA_ "DiagRequest" BO_ 889 0;
BA_ "DiagResponse" BO_ 889 0;
BA_ "GenMsgStartValue" BO_ 889 "0";
BA_ "GenMsgDelayTime" BO_ 889 5;
BA_ "GenMsgNrOfRepetitions" BO_ 889 0;
BA_ "GenMsgCycleTime" BO_ 889 1000;
BA_ "GenMsgSendType" BO_ 889 5;
    */
    _ICH_PreTime_Stat_AR_Timebase =           c_tDBKomTimer_20ms;
    _ICH_PreTime_Stat_AR_CycleCount =       1000 / _ICH_PreTime_Stat_AR_Timebase;
    _ICH_PreTime_Stat_AR_StartDelay =          0 / _ICH_PreTime_Stat_AR_Timebase;
    _ICH_PreTime_Stat_AR_Cnt = _ICH_PreTime_Stat_AR_StartDelay;
    _ICH_PreTime_Stat_AR_SpontanFlag = 0;

    putValue( HMI__STMSGSD_ICH_PreTime_Stat_AR, _ICH_PreTime_Stat_AR_StartDelay * _ICH_PreTime_Stat_AR_Timebase );

    _mICH_PreTime_Stat_AR.ICH_PreTm1_Hour_Stat.phys = getValue( HMI_ICH_PreTm1_Hour_Stat );
    _mICH_PreTime_Stat_AR.ICH_PreTm1_Minute_Stat.phys = getValue( HMI_ICH_PreTm1_Minute_Stat );
    _mICH_PreTime_Stat_AR.ICH_PreTm2_Hour_Stat.phys = getValue( HMI_ICH_PreTm2_Hour_Stat );
    _mICH_PreTime_Stat_AR.ICH_PreTm2_Minute_Stat.phys = getValue( HMI_ICH_PreTm2_Minute_Stat );
    _mICH_PreTime_Stat_AR.ICH_PreTm3_Hour_Stat.phys = getValue( HMI_ICH_PreTm3_Hour_Stat );
    _mICH_PreTime_Stat_AR.ICH_PreTm3_Minute_Stat.phys = getValue( HMI_ICH_PreTm3_Minute_Stat );
    _mICH_PreTime_Stat_AR.ICH_PreTm_Stat.phys = getValue( HMI_ICH_PreTm_Stat );
}
/*@@end*/

/*@@caplFunc:ICH_PreTime_Stat_AR_output():*/
ICH_PreTime_Stat_AR_output(void)
{
    output( _mICH_PreTime_Stat_AR );
}
/*@@end*/

/*@@caplFunc:ICH_PreTime_Stat_AR_saveEnvVars(dword):*/
ICH_PreTime_Stat_AR_saveEnvVars( dword hFile )
{
    filePutString("\n// Knoten EIS: ICH_PreTime_Stat_AR\n", 33, hFile );
    snprintf( buffer, elcount( buffer ), "0.0000 HMI__STMSG_ICH_PreTime_Stat := %X\n", getValue( HMI__STMSG_ICH_PreTime_Stat_AR ) );        filePutString( buffer, elcount( buffer ), hFile );
    snprintf( buffer, elcount( buffer ), "0.0000 HMI__STMSGT_ICH_PreTime_Stat := %X\n", getValue( HMI__STMSGT_ICH_PreTime_Stat_AR ) );        filePutString( buffer, elcount( buffer ), hFile );
    snprintf( buffer, elcount( buffer ), "0.0000 HMI_ICH_PreTm1_Hour_Stat := %X\n", getValue( HMI_ICH_PreTm1_Hour_Stat ) );        filePutString( buffer, elcount( buffer ), hFile );
    snprintf( buffer, elcount( buffer ), "0.0000 HMI_ICH_PreTm1_Minute_Stat := %X\n", getValue( HMI_ICH_PreTm1_Minute_Stat ) );        filePutString( buffer, elcount( buffer ), hFile );
    snprintf( buffer, elcount( buffer ), "0.0000 HMI_ICH_PreTm2_Hour_Stat := %X\n", getValue( HMI_ICH_PreTm2_Hour_Stat ) );        filePutString( buffer, elcount( buffer ), hFile );
    snprintf( buffer, elcount( buffer ), "0.0000 HMI_ICH_PreTm2_Minute_Stat := %X\n", getValue( HMI_ICH_PreTm2_Minute_Stat ) );        filePutString( buffer, elcount( buffer ), hFile );
    snprintf( buffer, elcount( buffer ), "0.0000 HMI_ICH_PreTm3_Hour_Stat := %X\n", getValue( HMI_ICH_PreTm3_Hour_Stat ) );        filePutString( buffer, elcount( buffer ), hFile );
    snprintf( buffer, elcount( buffer ), "0.0000 HMI_ICH_PreTm3_Minute_Stat := %X\n", getValue( HMI_ICH_PreTm3_Minute_Stat ) );        filePutString( buffer, elcount( buffer ), hFile );
    snprintf( buffer, elcount( buffer ), "0.0000 HMI_ICH_PreTm_Stat := %X\n", getValue( HMI_ICH_PreTm_Stat ) );        filePutString( buffer, elcount( buffer ), hFile );
}
/*@@end*/

/*@@timer:_tICH_PreTime_Stat_AR:*/
on timer _tICH_PreTime_Stat_AR
{
    putValue( HMI__STMSG_ICH_PreTime_Stat_AR, 0 );
}
/*@@end*/

/*@@envVar:HMI__STMSG_ICH_PreTime_Stat_AR:*/
on EnvVar HMI__STMSG_ICH_PreTime_Stat_AR
{
    long tDelay;
    if( getValue( this ) == 2 )
    {
        tDelay = getValue( HMI__STMSGT_ICH_PreTime_Stat_AR );
        if( tDelay > 0)    
            setTimer( _tICH_PreTime_Stat_AR, tDelay );
        else
            putValue( HMI__STMSG_ICH_PreTime_Stat_AR, 0 );
    }
}
/*@@end*/

/*@@envVar:HMI_ICH_PreTm1_Hour_Stat:*/
on EnvVar HMI_ICH_PreTm1_Hour_Stat
{
    _mICH_PreTime_Stat_AR.ICH_PreTm1_Hour_Stat.phys = getValue(this);
    _ICH_PreTime_Stat_AR_SpontanFlag = 1;
}
/*@@end*/

/*@@envVar:HMI_ICH_PreTm1_Minute_Stat:*/
on EnvVar HMI_ICH_PreTm1_Minute_Stat
{
    _mICH_PreTime_Stat_AR.ICH_PreTm1_Minute_Stat.phys = getValue(this);
    _ICH_PreTime_Stat_AR_SpontanFlag = 1;
}
/*@@end*/

/*@@envVar:HMI_ICH_PreTm2_Hour_Stat:*/
on EnvVar HMI_ICH_PreTm2_Hour_Stat
{
    _mICH_PreTime_Stat_AR.ICH_PreTm2_Hour_Stat.phys = getValue(this);
    _ICH_PreTime_Stat_AR_SpontanFlag = 1;
}
/*@@end*/

/*@@envVar:HMI_ICH_PreTm2_Minute_Stat:*/
on EnvVar HMI_ICH_PreTm2_Minute_Stat
{
    _mICH_PreTime_Stat_AR.ICH_PreTm2_Minute_Stat.phys = getValue(this);
    _ICH_PreTime_Stat_AR_SpontanFlag = 1;
}
/*@@end*/

/*@@envVar:HMI_ICH_PreTm3_Hour_Stat:*/
on EnvVar HMI_ICH_PreTm3_Hour_Stat
{
    _mICH_PreTime_Stat_AR.ICH_PreTm3_Hour_Stat.phys = getValue(this);
    _ICH_PreTime_Stat_AR_SpontanFlag = 1;
}
/*@@end*/

/*@@envVar:HMI_ICH_PreTm3_Minute_Stat:*/
on EnvVar HMI_ICH_PreTm3_Minute_Stat
{
    _mICH_PreTime_Stat_AR.ICH_PreTm3_Minute_Stat.phys = getValue(this);
    _ICH_PreTime_Stat_AR_SpontanFlag = 1;
}
/*@@end*/

/*@@envVar:HMI_ICH_PreTm_Stat:*/
on EnvVar HMI_ICH_PreTm_Stat
{
    _mICH_PreTime_Stat_AR.ICH_PreTm_Stat.phys = getValue(this);
    _ICH_PreTime_Stat_AR_SpontanFlag = 1;
}
/*@@end*/

/*@@caplFunc:ICH_Stat_AR_check_output():*/
ICH_Stat_AR_check_output()
{
    if( !getValue( HMI__STMSG_ICH_Stat_AR ) )
    {
        // Botschaft ICH_Stat_AR ID: 887 --- Sendeart 5 cyclicAndSpontanWithDelay --- 
        _ICH_Stat_AR_Cnt--;
        if( _ICH_Stat_AR_Cnt < 1 )
        {
            ICH_Stat_AR_output(); // Nachricht wg. abgelaufenem Zyklus ausgeben
            _ICH_Stat_AR_Cnt = _ICH_Stat_AR_CycleCount; // Zyklus-Zähler zurücksetzen
            _ICH_Stat_AR_SpontanFlag = 0; // Spontan-Flag zurücksetzen
        }
        else if( _ICH_Stat_AR_SpontanFlag)
        {
            ICH_Stat_AR_output();// Nachricht wg. spontaner Änderung ausgeben
            _ICH_Stat_AR_SpontanFlag = 0; // Spontan-Flag zurücksetzen
        }
    }
}
/*@@end*/

/*@@caplFunc:ICH_Stat_AR_init():*/
ICH_Stat_AR_init()
{   /* Botschaft ICH_Stat_AR ID: 887 --- Sendeart 5 cyclicAndSpontanWithDelay --- 
BA_ "ApplMessage" BO_ 887 0;
BA_ "NmAsrMessage" BO_ 887 0;
BA_ "GenMsgMinAcceptLength" BO_ 887 8;
BA_ "GenMsgILSupport" BO_ 887 1;
BA_ "DiagState" BO_ 887 0;
BA_ "DiagRequest" BO_ 887 0;
BA_ "DiagResponse" BO_ 887 0;
BA_ "GenMsgStartValue" BO_ 887 "0";
BA_ "GenMsgDelayTime" BO_ 887 5;
BA_ "GenMsgNrOfRepetitions" BO_ 887 0;
BA_ "GenMsgCycleTime" BO_ 887 500;
BA_ "GenMsgSendType" BO_ 887 5;
    */
    _ICH_Stat_AR_Timebase =           c_tDBKomTimer_20ms;
    _ICH_Stat_AR_CycleCount =        500 / _ICH_Stat_AR_Timebase;
    _ICH_Stat_AR_StartDelay =          0 / _ICH_Stat_AR_Timebase;
    _ICH_Stat_AR_Cnt = _ICH_Stat_AR_StartDelay;
    _ICH_Stat_AR_SpontanFlag = 0;

    putValue( HMI__STMSGSD_ICH_Stat_AR, _ICH_Stat_AR_StartDelay * _ICH_Stat_AR_Timebase );

    _mICH_Stat_AR.HU_Disp_On_Rq.phys = getValue( HMI_HU_Disp_On_Rq );
    _mICH_Stat_AR.HVAC_Fan_On_Rq.phys = getValue( HMI_HVAC_Fan_On_Rq );
    _mICH_Stat_AR.ICH_AuxHt_LED_On_Rq.phys = getValue( HMI_ICH_AuxHt_LED_On_Rq );
    _mICH_Stat_AR.ICH_Bdgt_Empty.phys = getValue( HMI_ICH_Bdgt_Empty );
    _mICH_Stat_AR.ICH_Bdgt_Empty_ErrDisp.phys = getValue( HMI_ICH_Bdgt_Empty_ErrDisp );
    _mICH_Stat_AR.ICH_Bdgt_Empty_Occ.phys = getValue( HMI_ICH_Bdgt_Empty_Occ );
    _mICH_Stat_AR.ICH_Bdgt_Empty_Stat.phys = getValue( HMI_ICH_Bdgt_Empty_Stat );
    _mICH_Stat_AR.ICH_Flt.phys = getValue( HMI_ICH_Flt );
    _mICH_Stat_AR.ICH_Flt_ErrDisp.phys = getValue( HMI_ICH_Flt_ErrDisp );
    _mICH_Stat_AR.ICH_Flt_Occ.phys = getValue( HMI_ICH_Flt_Occ );
    _mICH_Stat_AR.ICH_Flt_Stat.phys = getValue( HMI_ICH_Flt_Stat );
    _mICH_Stat_AR.ICH_Ht_Test.phys = getValue( HMI_ICH_Ht_Test );
    _mICH_Stat_AR.ICH_HtVn_Actv_V2.phys = getValue( HMI_ICH_HtVn_Actv_V2 );
    _mICH_Stat_AR.ICH_PreTm_Actv_V2.phys = getValue( HMI_ICH_PreTm_Actv_V2 );
    _mICH_Stat_AR.ICH_PreTm_Hour.phys = getValue( HMI_ICH_PreTm_Hour );
    _mICH_Stat_AR.ICH_PreTm_Minute.phys = getValue( HMI_ICH_PreTm_Minute );
    _mICH_Stat_AR.ICH_Pwr_Stat.phys = getValue( HMI_ICH_Pwr_Stat );
    _mICH_Stat_AR.ICH_ResRunTm.phys = getValue( HMI_ICH_ResRunTm );
    _mICH_Stat_AR.ICH_SupVolt_Lo.phys = getValue( HMI_ICH_SupVolt_Lo );
    _mICH_Stat_AR.ICH_SupVolt_Lo_ErrDisp.phys = getValue( HMI_ICH_SupVolt_Lo_ErrDisp );
    _mICH_Stat_AR.ICH_SupVolt_Lo_Occ.phys = getValue( HMI_ICH_SupVolt_Lo_Occ );
    _mICH_Stat_AR.ICH_SupVolt_Lo_Stat.phys = getValue( HMI_ICH_SupVolt_Lo_Stat );
    _mICH_Stat_AR.ICH_SwitchVlv_Stat.phys = getValue( HMI_ICH_SwitchVlv_Stat );
    _mICH_Stat_AR.ICH_TankLvl_Min.phys = getValue( HMI_ICH_TankLvl_Min );
    _mICH_Stat_AR.ICH_TankLvl_Min_ErrDisp.phys = getValue( HMI_ICH_TankLvl_Min_ErrDisp );
    _mICH_Stat_AR.ICH_TankLvl_Min_Occ.phys = getValue( HMI_ICH_TankLvl_Min_Occ );
    _mICH_Stat_AR.ICH_TankLvl_Min_Stat.phys = getValue( HMI_ICH_TankLvl_Min_Stat );
    _mICH_Stat_AR.ICH_WtrPmp_Stat.phys = getValue( HMI_ICH_WtrPmp_Stat );
    _mICH_Stat_AR.ICH_WtrTemp_V2.phys = getValue( HMI_ICH_WtrTemp_V2 );
    _mICH_Stat_AR.TxmtSync_Actv.phys = getValue( HMI_TxmtSync_Actv );
}
/*@@end*/

/*@@caplFunc:ICH_Stat_AR_output():*/
ICH_Stat_AR_output(void)
{
    output( _mICH_Stat_AR );
}
/*@@end*/

/*@@caplFunc:ICH_Stat_AR_saveEnvVars(dword):*/
ICH_Stat_AR_saveEnvVars( dword hFile )
{
    filePutString("\n// Knoten EIS: ICH_Stat_AR\n", 25, hFile );
    snprintf( buffer, elcount( buffer ), "0.0000 HMI__STMSG_ICH_Stat_AR := %X\n", getValue( HMI__STMSG_ICH_Stat_AR ) );    filePutString( buffer, elcount( buffer ), hFile );
    snprintf( buffer, elcount( buffer ), "0.0000 HMI__STMSGT_ICH_Stat_AR := %X\n", getValue( HMI__STMSGT_ICH_Stat_AR ) );    filePutString( buffer, elcount( buffer ), hFile );
    snprintf( buffer, elcount( buffer ), "0.0000 HMI_HU_Disp_On_Rq := %X\n", getValue( HMI_HU_Disp_On_Rq ) );    filePutString( buffer, elcount( buffer ), hFile );
    snprintf( buffer, elcount( buffer ), "0.0000 HMI_HVAC_Fan_On_Rq := %X\n", getValue( HMI_HVAC_Fan_On_Rq ) );    filePutString( buffer, elcount( buffer ), hFile );
    snprintf( buffer, elcount( buffer ), "0.0000 HMI_ICH_AuxHt_LED_On_Rq := %X\n", getValue( HMI_ICH_AuxHt_LED_On_Rq ) );    filePutString( buffer, elcount( buffer ), hFile );
    snprintf( buffer, elcount( buffer ), "0.0000 HMI_ICH_Bdgt_Empty := %X\n", getValue( HMI_ICH_Bdgt_Empty ) );    filePutString( buffer, elcount( buffer ), hFile );
    snprintf( buffer, elcount( buffer ), "0.0000 HMI_ICH_Bdgt_Empty_ErrDisp := %X\n", getValue( HMI_ICH_Bdgt_Empty_ErrDisp ) );    filePutString( buffer, elcount( buffer ), hFile );
    snprintf( buffer, elcount( buffer ), "0.0000 HMI_ICH_Bdgt_Empty_Occ := %X\n", getValue( HMI_ICH_Bdgt_Empty_Occ ) );    filePutString( buffer, elcount( buffer ), hFile );
    snprintf( buffer, elcount( buffer ), "0.0000 HMI_ICH_Bdgt_Empty_Stat := %X\n", getValue( HMI_ICH_Bdgt_Empty_Stat ) );    filePutString( buffer, elcount( buffer ), hFile );
    snprintf( buffer, elcount( buffer ), "0.0000 HMI_ICH_Flt := %X\n", getValue( HMI_ICH_Flt ) );    filePutString( buffer, elcount( buffer ), hFile );
    snprintf( buffer, elcount( buffer ), "0.0000 HMI_ICH_Flt_ErrDisp := %X\n", getValue( HMI_ICH_Flt_ErrDisp ) );    filePutString( buffer, elcount( buffer ), hFile );
    snprintf( buffer, elcount( buffer ), "0.0000 HMI_ICH_Flt_Occ := %X\n", getValue( HMI_ICH_Flt_Occ ) );    filePutString( buffer, elcount( buffer ), hFile );
    snprintf( buffer, elcount( buffer ), "0.0000 HMI_ICH_Flt_Stat := %X\n", getValue( HMI_ICH_Flt_Stat ) );    filePutString( buffer, elcount( buffer ), hFile );
    snprintf( buffer, elcount( buffer ), "0.0000 HMI_ICH_Ht_Test := %X\n", getValue( HMI_ICH_Ht_Test ) );    filePutString( buffer, elcount( buffer ), hFile );
    snprintf( buffer, elcount( buffer ), "0.0000 HMI_ICH_HtVn_Actv_V2 := %X\n", getValue( HMI_ICH_HtVn_Actv_V2 ) );    filePutString( buffer, elcount( buffer ), hFile );
    snprintf( buffer, elcount( buffer ), "0.0000 HMI_ICH_PreTm_Actv_V2 := %X\n", getValue( HMI_ICH_PreTm_Actv_V2 ) );    filePutString( buffer, elcount( buffer ), hFile );
    snprintf( buffer, elcount( buffer ), "0.0000 HMI_ICH_PreTm_Hour := %X\n", getValue( HMI_ICH_PreTm_Hour ) );    filePutString( buffer, elcount( buffer ), hFile );
    snprintf( buffer, elcount( buffer ), "0.0000 HMI_ICH_PreTm_Minute := %X\n", getValue( HMI_ICH_PreTm_Minute ) );    filePutString( buffer, elcount( buffer ), hFile );
    snprintf( buffer, elcount( buffer ), "0.0000 HMI_ICH_Pwr_Stat := %X\n", getValue( HMI_ICH_Pwr_Stat ) );    filePutString( buffer, elcount( buffer ), hFile );
    snprintf( buffer, elcount( buffer ), "0.0000 HMI_ICH_ResRunTm := %X\n", getValue( HMI_ICH_ResRunTm ) );    filePutString( buffer, elcount( buffer ), hFile );
    snprintf( buffer, elcount( buffer ), "0.0000 HMI_ICH_SupVolt_Lo := %X\n", getValue( HMI_ICH_SupVolt_Lo ) );    filePutString( buffer, elcount( buffer ), hFile );
    snprintf( buffer, elcount( buffer ), "0.0000 HMI_ICH_SupVolt_Lo_ErrDisp := %X\n", getValue( HMI_ICH_SupVolt_Lo_ErrDisp ) );    filePutString( buffer, elcount( buffer ), hFile );
    snprintf( buffer, elcount( buffer ), "0.0000 HMI_ICH_SupVolt_Lo_Occ := %X\n", getValue( HMI_ICH_SupVolt_Lo_Occ ) );    filePutString( buffer, elcount( buffer ), hFile );
    snprintf( buffer, elcount( buffer ), "0.0000 HMI_ICH_SupVolt_Lo_Stat := %X\n", getValue( HMI_ICH_SupVolt_Lo_Stat ) );    filePutString( buffer, elcount( buffer ), hFile );
    snprintf( buffer, elcount( buffer ), "0.0000 HMI_ICH_SwitchVlv_Stat := %X\n", getValue( HMI_ICH_SwitchVlv_Stat ) );    filePutString( buffer, elcount( buffer ), hFile );
    snprintf( buffer, elcount( buffer ), "0.0000 HMI_ICH_TankLvl_Min := %X\n", getValue( HMI_ICH_TankLvl_Min ) );    filePutString( buffer, elcount( buffer ), hFile );
    snprintf( buffer, elcount( buffer ), "0.0000 HMI_ICH_TankLvl_Min_ErrDisp := %X\n", getValue( HMI_ICH_TankLvl_Min_ErrDisp ) );    filePutString( buffer, elcount( buffer ), hFile );
    snprintf( buffer, elcount( buffer ), "0.0000 HMI_ICH_TankLvl_Min_Occ := %X\n", getValue( HMI_ICH_TankLvl_Min_Occ ) );    filePutString( buffer, elcount( buffer ), hFile );
    snprintf( buffer, elcount( buffer ), "0.0000 HMI_ICH_TankLvl_Min_Stat := %X\n", getValue( HMI_ICH_TankLvl_Min_Stat ) );    filePutString( buffer, elcount( buffer ), hFile );
    snprintf( buffer, elcount( buffer ), "0.0000 HMI_ICH_WtrPmp_Stat := %X\n", getValue( HMI_ICH_WtrPmp_Stat ) );    filePutString( buffer, elcount( buffer ), hFile );
    snprintf( buffer, elcount( buffer ), "0.0000 HMI_ICH_WtrTemp_V2 := %X\n", getValue( HMI_ICH_WtrTemp_V2 ) );    filePutString( buffer, elcount( buffer ), hFile );
    snprintf( buffer, elcount( buffer ), "0.0000 HMI_TxmtSync_Actv := %X\n", getValue( HMI_TxmtSync_Actv ) );    filePutString( buffer, elcount( buffer ), hFile );
}
/*@@end*/

/*@@timer:_tICH_Stat_AR:*/
on timer _tICH_Stat_AR
{
    putValue( HMI__STMSG_ICH_Stat_AR, 0 );
}
/*@@end*/

/*@@envVar:HMI__STMSG_ICH_Stat_AR:*/
on EnvVar HMI__STMSG_ICH_Stat_AR
{
    long tDelay;
    if( getValue( this ) == 2 )
    {
        tDelay = getValue( HMI__STMSGT_ICH_Stat_AR );
        if( tDelay > 0)    
            setTimer( _tICH_Stat_AR, tDelay );
        else
            putValue( HMI__STMSG_ICH_Stat_AR, 0 );
    }
}
/*@@end*/

/*@@envVar:HMI_HU_Disp_On_Rq:*/
on EnvVar HMI_HU_Disp_On_Rq
{
    _mICH_Stat_AR.HU_Disp_On_Rq.phys = getValue(this);
    _ICH_Stat_AR_SpontanFlag = 1;
}
/*@@end*/

/*@@envVar:HMI_HVAC_Fan_On_Rq:*/
on EnvVar HMI_HVAC_Fan_On_Rq
{
    _mICH_Stat_AR.HVAC_Fan_On_Rq.phys = getValue(this);
    _ICH_Stat_AR_SpontanFlag = 1;
}
/*@@end*/

/*@@envVar:HMI_ICH_AuxHt_LED_On_Rq:*/
on EnvVar HMI_ICH_AuxHt_LED_On_Rq
{
    _mICH_Stat_AR.ICH_AuxHt_LED_On_Rq.phys = getValue(this);
    _ICH_Stat_AR_SpontanFlag = 1;
}
/*@@end*/

/*@@envVar:HMI_ICH_Bdgt_Empty:*/
on EnvVar HMI_ICH_Bdgt_Empty
{
    _mICH_Stat_AR.ICH_Bdgt_Empty.phys = getValue(this);
    _ICH_Stat_AR_SpontanFlag = 1;
}
/*@@end*/

/*@@envVar:HMI_ICH_Bdgt_Empty_Occ:*/
on EnvVar HMI_ICH_Bdgt_Empty_Occ
{
    _mICH_Stat_AR.ICH_Bdgt_Empty_Occ.phys = getValue(this);
    _ICH_Stat_AR_SpontanFlag = 1;
}
/*@@end*/

/*@@envVar:HMI_ICH_Flt:*/
on EnvVar HMI_ICH_Flt
{
    _mICH_Stat_AR.ICH_Flt.phys = getValue(this);
    _ICH_Stat_AR_SpontanFlag = 1;
}
/*@@end*/

/*@@envVar:HMI_ICH_Flt_Occ:*/
on EnvVar HMI_ICH_Flt_Occ
{
    _mICH_Stat_AR.ICH_Flt_Occ.phys = getValue(this);
    _ICH_Stat_AR_SpontanFlag = 1;
}
/*@@end*/

/*@@envVar:HMI_ICH_Ht_Test:*/
on EnvVar HMI_ICH_Ht_Test
{
    _mICH_Stat_AR.ICH_Ht_Test.phys = getValue(this);
    _ICH_Stat_AR_SpontanFlag = 1;
}
/*@@end*/

/*@@envVar:HMI_ICH_HtVn_Actv_V2:*/
on EnvVar HMI_ICH_HtVn_Actv_V2
{
    _mICH_Stat_AR.ICH_HtVn_Actv_V2.phys = getValue(this);
    _ICH_Stat_AR_SpontanFlag = 1;
}
/*@@end*/

/*@@envVar:HMI_ICH_PreTm_Actv_V2:*/
on EnvVar HMI_ICH_PreTm_Actv_V2
{
    _mICH_Stat_AR.ICH_PreTm_Actv_V2.phys = getValue(this);
    _ICH_Stat_AR_SpontanFlag = 1;
}
/*@@end*/

/*@@envVar:HMI_ICH_PreTm_Hour:*/
on EnvVar HMI_ICH_PreTm_Hour
{
    _mICH_Stat_AR.ICH_PreTm_Hour.phys = getValue(this);
    _ICH_Stat_AR_SpontanFlag = 1;
}
/*@@end*/

/*@@envVar:HMI_ICH_PreTm_Minute:*/
on EnvVar HMI_ICH_PreTm_Minute
{
    _mICH_Stat_AR.ICH_PreTm_Minute.phys = getValue(this);
    _ICH_Stat_AR_SpontanFlag = 1;
}
/*@@end*/

/*@@envVar:HMI_ICH_Pwr_Stat:*/
on EnvVar HMI_ICH_Pwr_Stat
{
    _mICH_Stat_AR.ICH_Pwr_Stat.phys = getValue(this);
    _ICH_Stat_AR_SpontanFlag = 1;
}
/*@@end*/

/*@@envVar:HMI_ICH_SupVolt_Lo:*/
on EnvVar HMI_ICH_SupVolt_Lo
{
    _mICH_Stat_AR.ICH_SupVolt_Lo.phys = getValue(this);
    _ICH_Stat_AR_SpontanFlag = 1;
}
/*@@end*/

/*@@envVar:HMI_ICH_SupVolt_Lo_Occ:*/
on EnvVar HMI_ICH_SupVolt_Lo_Occ
{
    _mICH_Stat_AR.ICH_SupVolt_Lo_Occ.phys = getValue(this);
    _ICH_Stat_AR_SpontanFlag = 1;
}
/*@@end*/

/*@@envVar:HMI_ICH_SwitchVlv_Stat:*/
on EnvVar HMI_ICH_SwitchVlv_Stat
{
    _mICH_Stat_AR.ICH_SwitchVlv_Stat.phys = getValue(this);
    _ICH_Stat_AR_SpontanFlag = 1;
}
/*@@end*/

/*@@envVar:HMI_ICH_TankLvl_Min:*/
on EnvVar HMI_ICH_TankLvl_Min
{
    _mICH_Stat_AR.ICH_TankLvl_Min.phys = getValue(this);
    _ICH_Stat_AR_SpontanFlag = 1;
}
/*@@end*/

/*@@envVar:HMI_ICH_TankLvl_Min_Occ:*/
on EnvVar HMI_ICH_TankLvl_Min_Occ
{
    _mICH_Stat_AR.ICH_TankLvl_Min_Occ.phys = getValue(this);
    _ICH_Stat_AR_SpontanFlag = 1;
}
/*@@end*/

/*@@envVar:HMI_ICH_WtrPmp_Stat:*/
on EnvVar HMI_ICH_WtrPmp_Stat
{
    _mICH_Stat_AR.ICH_WtrPmp_Stat.phys = getValue(this);
    _ICH_Stat_AR_SpontanFlag = 1;
}
/*@@end*/

/*@@envVar:HMI_ICH_WtrTemp_V2:*/
on EnvVar HMI_ICH_WtrTemp_V2
{
    _mICH_Stat_AR.ICH_WtrTemp_V2.phys = getValue(this);
    _ICH_Stat_AR_SpontanFlag = 1;
}
/*@@end*/

/*@@envVar:HMI_TxmtSync_Actv:*/
on EnvVar HMI_TxmtSync_Actv
{
    _mICH_Stat_AR.TxmtSync_Actv.phys = getValue(this);
    _ICH_Stat_AR_SpontanFlag = 1;
}
/*@@end*/

/*@@caplFunc:Ign_Veh_Stat_AR_check_output():*/
Ign_Veh_Stat_AR_check_output()
{
    if( !getValue( HMI__STMSG_Ign_Veh_Stat_AR ) )
    {
        // Botschaft Ign_Veh_Stat_AR ID: 32 --- Sendeart 5 cyclicAndSpontanWithDelay --- 
        _Ign_Veh_Stat_AR_Cnt--;
        if( _Ign_Veh_Stat_AR_Cnt < 1 )
        {
            // Nachricht wg. abgelaufenem Zyklus ausgeben
            Ign_Veh_Stat_AR_output();
            _Ign_Veh_Stat_AR_Cnt = _Ign_Veh_Stat_AR_CycleCount; // Zyklus-Zähler zurücksetzen
            _Ign_Veh_Stat_AR_SpontanFlag = 0; // Spontan-Flag zurücksetzen
        }
        else if( _Ign_Veh_Stat_AR_SpontanFlag )
        {
            // Nachricht wg. spontaner Änderung ausgeben
            Ign_Veh_Stat_AR_output();
            _Ign_Veh_Stat_AR_SpontanFlag = 0; // Spontan-Flag zurücksetzen
        }
    }
}
/*@@end*/

/*@@caplFunc:Ign_Veh_Stat_AR_init():*/
Ign_Veh_Stat_AR_init()
{   /* Botschaft Ign_Veh_Stat_AR ID: 32 --- Sendeart 5 cyclicAndSpontanWithDelay --- 
BA_ "ApplMessage" BO_ 32 0;
BA_ "NmAsrMessage" BO_ 32 0;
BA_ "GenMsgMinAcceptLength" BO_ 32 8;
BA_ "GenMsgILSupport" BO_ 32 1;
BA_ "DiagState" BO_ 32 0;
BA_ "DiagRequest" BO_ 32 0;
BA_ "DiagResponse" BO_ 32 0;
BA_ "GenMsgStartValue" BO_ 32 "0";
BA_ "GenMsgStartDelayTime" BO_ 32 0;
BA_ "GenMsgDelayTime" BO_ 32 5;
BA_ "GenMsgNrOfRepetitions" BO_ 32 0;
BA_ "GenMsgCycleTime" BO_ 32 100;
BA_ "GenMsgSendType" BO_ 32 5;
    */
    _Ign_Veh_Stat_AR_Timebase =           c_tDBKomTimer_20ms;
    _Ign_Veh_Stat_AR_CycleCount =        100 / _Ign_Veh_Stat_AR_Timebase;
    _Ign_Veh_Stat_AR_StartDelay =          0 / _Ign_Veh_Stat_AR_Timebase;
    _Ign_Veh_Stat_AR_Cnt = _Ign_Veh_Stat_AR_StartDelay;
    _Ign_Veh_Stat_AR_SpontanFlag = 0;

    putValue( HMI__STMSGSD_Ign_Veh_Stat_AR, _Ign_Veh_Stat_AR_StartDelay * _Ign_Veh_Stat_AR_Timebase );

    _mIgn_Veh_Stat_AR.BusFlt_PrmntActv.phys = getValue( HMI_BusFlt_PrmntActv );
    _mIgn_Veh_Stat_AR.ContEngRun_Stat.phys = getValue( HMI_ContEngRun_Stat );
    _mIgn_Veh_Stat_AR.DidA_ExtTest_Pres.phys = getValue( HMI_DidA_ExtTest_Pres );
    _mIgn_Veh_Stat_AR.EngSt_Enbl_Rq_KG.phys = getValue( HMI_EngSt_Enbl_Rq_KG );
    _mIgn_Veh_Stat_AR.ESL_Lk_Rq.phys = getValue( HMI_ESL_Lk_Rq );
    _mIgn_Veh_Stat_AR.Ign_On_StartProc_Inact.phys = getValue( HMI_Ign_On_StartProc_Inact );
    _mIgn_Veh_Stat_AR.ISw_Stat.phys = getValue( HMI_ISw_Stat );
    _mIgn_Veh_Stat_AR.KG_IgnCtrl_Actv.phys = getValue( HMI_KG_IgnCtrl_Actv );
    _mIgn_Veh_Stat_AR.KG_StartSw_Psd.phys = getValue( HMI_KG_StartSw_Psd );
    _mIgn_Veh_Stat_AR.Mobile_Chrg_Rq_EIS.phys = getValue( HMI_Mobile_Chrg_Rq_EIS );
    _mIgn_Veh_Stat_AR.RemSt_IgnCtrl_Actv.phys = getValue( HMI_RemSt_IgnCtrl_Actv );
    _mIgn_Veh_Stat_AR.RemSt_IgnCtrl_Info.phys = getValue( HMI_RemSt_IgnCtrl_Info );
    _mIgn_Veh_Stat_AR.RevGr_Engg.phys = getValue( HMI_RevGr_Engg );
    _mIgn_Veh_Stat_AR.SPCR_AcustWarn_Rq_EIS.phys = getValue( HMI_SPCR_AcustWarn_Rq_EIS );
    _mIgn_Veh_Stat_AR.SPCR_Conf_EIS.phys = getValue( HMI_SPCR_Conf_EIS );
    _mIgn_Veh_Stat_AR.SPCR_Flt_EIS.phys = getValue( HMI_SPCR_Flt_EIS );
    _mIgn_Veh_Stat_AR.TxPkPosn_Emg_Rq.phys = getValue( HMI_TxPkPosn_Emg_Rq );
    _mIgn_Veh_Stat_AR.TxPkPosn_Rq.phys = getValue( HMI_TxPkPosn_Rq );
    _mIgn_Veh_Stat_AR.TxPkPosn_Rq_SPCR_Enbl.phys = getValue( HMI_TxPkPosn_Rq_SPCR_Enbl );
    _mIgn_Veh_Stat_AR.TxPkPosnAuto_Enbl.phys = getValue( HMI_TxPkPosnAuto_Enbl );
}
/*@@end*/

/*@@caplFunc:Ign_Veh_Stat_AR_output():*/
void Ign_Veh_Stat_AR_output(void)
{
    byte crc;
    byte SQC_help;

    if( !getValue( HMI_SQC_Ign_Stat_Auto ) )
    {
        // berechne message counter
        SQC_help = getValue( HMI_SQC_Ign_Stat );
        if( SQC_help >= 15 ) SQC_help = 0;
        else SQC_help++;
        putValue( HMI_SQC_Ign_Stat, SQC_help );
        _mIgn_Veh_Stat_AR.SQC_Ign_Stat = SQC_help;
    }
    else
          _mIgn_Veh_Stat_AR.SQC_Ign_Stat = getValue( HMI_SQC_Ign_Stat );

    if( getValue( HMI_CRC_Ign_Stat_Profile_02 ) )
    {
        if( !getValue( HMI_CRC_Ign_Stat_Auto ) )
        {   // CRC according Profile_02 ( W213 )
            // berechne crc
            crc = 0xFF;
//            crc = crctable_profile02[ crc ^ _mIgn_Veh_Stat_AR.byte( 0 ) ];  CRC
            crc = crctable_profile02[ crc ^ _mIgn_Veh_Stat_AR.byte( 1 ) ];
            crc = crctable_profile02[ crc ^ _mIgn_Veh_Stat_AR.byte( 2 ) ];
            crc = crctable_profile02[ crc ^ _mIgn_Veh_Stat_AR.byte( 3 ) ];
//            crc = crctable_profile02[ crc ^ _mIgn_Veh_Stat_AR.byte( 4 ) ];
//            crc = crctable_profile02[ crc ^ _mIgn_Veh_Stat_AR.byte( 5 ) ];
//            crc = crctable_profile02[ crc ^ _mIgn_Veh_Stat_AR.byte( 6 ) ];
//            crc = crctable_profile02[ crc ^ _mIgn_Veh_Stat_AR.byte( 7 ) ];
            crc = crctable_profile02[ crc ^ _Ign_Veh_Stat_AR_CRC_Offset[ _mIgn_Veh_Stat_AR.SQC_Ign_Stat ] ]; // load offset
            crc = (crc ^ 0xFF);
            if( getValue(  HMI_CRC_Ign_Stat_Invalid ) )
                crc++;
            _mIgn_Veh_Stat_AR.CRC_Ign_Stat = crc;
            putValue( HMI_CRC_Ign_Stat, crc );
        }
        else
            _mIgn_Veh_Stat_AR.CRC_Ign_Stat = getValue( HMI_CRC_Ign_Stat );
    }
    else
    {
        if( !getValue( HMI_CRC_Ign_Stat_Auto ) )
        {   // CRC according to SAE1850 ( W222 )
            // berechne crc
            crc = 0xFF;
//            crc = crctable[crc ^ _mIgn_Veh_Stat_AR.byte( 0 )];  CRC
            crc = crctable[crc ^ _mIgn_Veh_Stat_AR.byte( 1 )];
            crc = crctable[crc ^ _mIgn_Veh_Stat_AR.byte( 2 )];
            crc = crctable[crc ^ _mIgn_Veh_Stat_AR.byte( 3 )];
//            crc = crctable[crc ^ _mIgn_Veh_Stat_AR.byte( 4 )];
//            crc = crctable[crc ^ _mIgn_Veh_Stat_AR.byte( 5 )];
//            crc = crctable[crc ^ _mIgn_Veh_Stat_AR.byte( 6 )];
//            crc = crctable[crc ^ _mIgn_Veh_Stat_AR.byte( 7 )];
            crc = (crc ^ 0xFF);
            if( getValue(  HMI_CRC_Ign_Stat_Invalid ) )
                crc++;
            _mIgn_Veh_Stat_AR.CRC_Ign_Stat = crc;
            putValue( HMI_CRC_Ign_Stat, crc );
        }
        else
            _mIgn_Veh_Stat_AR.CRC_Ign_Stat = getValue( HMI_CRC_Ign_Stat );
    }
    output( _mIgn_Veh_Stat_AR );
}
/*@@end*/

/*@@caplFunc:Ign_Veh_Stat_AR_saveEnvVars(dword):*/
Ign_Veh_Stat_AR_saveEnvVars( dword hFile )
{
    filePutString("\n// Knoten EIS: Ign_Veh_Stat_AR\n", 29, hFile );
    snprintf( buffer, elcount( buffer ), "0.0000 HMI__STMSG_Ign_Veh_Stat_AR := %X\n", getValue( HMI__STMSG_Ign_Veh_Stat_AR ) );        filePutString( buffer, elcount( buffer ), hFile );
    snprintf( buffer, elcount( buffer ), "0.0000 HMI__STMSGT_Ign_Veh_Stat_AR := %X\n", getValue( HMI__STMSGT_Ign_Veh_Stat_AR ) );        filePutString( buffer, elcount( buffer ), hFile );
    snprintf( buffer, elcount( buffer ), "0.0000 HMI_BusFlt_PrmntActv := %X\n", getValue( HMI_BusFlt_PrmntActv ) );        filePutString( buffer, elcount( buffer ), hFile );
    snprintf( buffer, elcount( buffer ), "0.0000 HMI_ContEngRun_Stat := %X\n", getValue( HMI_ContEngRun_Stat ) );        filePutString( buffer, elcount( buffer ), hFile );
    snprintf( buffer, elcount( buffer ), "0.0000 HMI_CRC_Ign_Stat := %X\n", getValue( HMI_CRC_Ign_Stat ) );        filePutString( buffer, elcount( buffer ), hFile );
    snprintf( buffer, elcount( buffer ), "0.0000 HMI_CRC_Ign_Stat_Auto := %X\n", getValue( HMI_CRC_Ign_Stat_Auto ) );        filePutString( buffer, elcount( buffer ), hFile );
    snprintf( buffer, elcount( buffer ), "0.0000 HMI_DidA_ExtTest_Pres := %X\n", getValue( HMI_DidA_ExtTest_Pres ) );        filePutString( buffer, elcount( buffer ), hFile );
    snprintf( buffer, elcount( buffer ), "0.0000 HMI_EngSt_Enbl_Rq_KG := %X\n", getValue( HMI_EngSt_Enbl_Rq_KG ) );        filePutString( buffer, elcount( buffer ), hFile );
    snprintf( buffer, elcount( buffer ), "0.0000 HMI_ESL_Lk_Rq := %X\n", getValue( HMI_ESL_Lk_Rq ) );        filePutString( buffer, elcount( buffer ), hFile );
    snprintf( buffer, elcount( buffer ), "0.0000 HMI_Ign_On_StartProc_Inact := %X\n", getValue( HMI_Ign_On_StartProc_Inact ) );        filePutString( buffer, elcount( buffer ), hFile );
    snprintf( buffer, elcount( buffer ), "0.0000 HMI_ISw_Stat := %X\n", getValue( HMI_ISw_Stat ) );        filePutString( buffer, elcount( buffer ), hFile );
    snprintf( buffer, elcount( buffer ), "0.0000 HMI_KG_IgnCtrl_Actv := %X\n", getValue( HMI_KG_IgnCtrl_Actv ) );        filePutString( buffer, elcount( buffer ), hFile );
    snprintf( buffer, elcount( buffer ), "0.0000 HMI_KG_StartSw_Psd := %X\n", getValue( HMI_KG_StartSw_Psd ) );        filePutString( buffer, elcount( buffer ), hFile );
    snprintf( buffer, elcount( buffer ), "0.0000 HMI_Mobile_Chrg_Rq_EIS := %X\n", getValue( HMI_Mobile_Chrg_Rq_EIS ) );        filePutString( buffer, elcount( buffer ), hFile );
    snprintf( buffer, elcount( buffer ), "0.0000 HMI_RemSt_IgnCtrl_Actv := %X\n", getValue( HMI_RemSt_IgnCtrl_Actv ) );        filePutString( buffer, elcount( buffer ), hFile );
    snprintf( buffer, elcount( buffer ), "0.0000 HMI_RemSt_IgnCtrl_Info := %X\n", getValue( HMI_RemSt_IgnCtrl_Info ) );        filePutString( buffer, elcount( buffer ), hFile );
    snprintf( buffer, elcount( buffer ), "0.0000 HMI_RevGr_Engg := %X\n", getValue( HMI_RevGr_Engg ) );        filePutString( buffer, elcount( buffer ), hFile );
    snprintf( buffer, elcount( buffer ), "0.0000 HMI_SPCR_AcustWarn_Rq_EIS := %X\n", getValue( HMI_SPCR_AcustWarn_Rq_EIS ) );        filePutString( buffer, elcount( buffer ), hFile );
    snprintf( buffer, elcount( buffer ), "0.0000 HMI_SPCR_Conf_EIS := %X\n", getValue( HMI_SPCR_Conf_EIS ) );        filePutString( buffer, elcount( buffer ), hFile );
    snprintf( buffer, elcount( buffer ), "0.0000 HMI_SPCR_Flt_EIS := %X\n", getValue( HMI_SPCR_Flt_EIS ) );        filePutString( buffer, elcount( buffer ), hFile );
    snprintf( buffer, elcount( buffer ), "0.0000 HMI_SQC_Ign_Stat := %X\n", getValue( HMI_SQC_Ign_Stat ) );        filePutString( buffer, elcount( buffer ), hFile );
    snprintf( buffer, elcount( buffer ), "0.0000 HMI_SQC_Ign_Stat_Auto := %X\n", getValue( HMI_SQC_Ign_Stat_Auto ) );        filePutString( buffer, elcount( buffer ), hFile );
    snprintf( buffer, elcount( buffer ), "0.0000 HMI_TxPkPosn_Emg_Rq := %X\n", getValue( HMI_TxPkPosn_Emg_Rq ) );        filePutString( buffer, elcount( buffer ), hFile );
    snprintf( buffer, elcount( buffer ), "0.0000 HMI_TxPkPosn_Rq := %X\n", getValue( HMI_TxPkPosn_Rq ) );        filePutString( buffer, elcount( buffer ), hFile );
    snprintf( buffer, elcount( buffer ), "0.0000 HMI_TxPkPosn_Rq_SPCR_Enbl := %X\n", getValue( HMI_TxPkPosn_Rq_SPCR_Enbl ) );        filePutString( buffer, elcount( buffer ), hFile );
    snprintf( buffer, elcount( buffer ), "0.0000 HMI_TxPkPosnAuto_Enbl := %X\n", getValue( HMI_TxPkPosnAuto_Enbl ) );        filePutString( buffer, elcount( buffer ), hFile );
}
/*@@end*/

/*@@timer:_tIgn_Veh_Stat_AR:*/
on timer _tIgn_Veh_Stat_AR
{
    putValue( HMI__STMSG_Ign_Veh_Stat_AR, 0 );
}
/*@@end*/

/*@@envVar:HMI__STMSG_Ign_Veh_Stat_AR:*/
on EnvVar HMI__STMSG_Ign_Veh_Stat_AR
{
    long tDelay;
    if( getValue( this ) == 2 )
    {
        tDelay = getValue( HMI__STMSGT_Ign_Veh_Stat_AR );
        if( tDelay > 0)    
            setTimer( _tIgn_Veh_Stat_AR, tDelay );
        else
            putValue( HMI__STMSG_Ign_Veh_Stat_AR, 0 );
    }
}
/*@@end*/

/*@@envVar:HMI_BusFlt_PrmntActv:*/
on EnvVar HMI_BusFlt_PrmntActv
{
    _mIgn_Veh_Stat_AR.BusFlt_PrmntActv.phys = getValue(this);
    _Ign_Veh_Stat_AR_SpontanFlag = 1;
}
/*@@end*/

/*@@envVar:HMI_ContEngRun_Stat:*/
on EnvVar HMI_ContEngRun_Stat
{
    _mIgn_Veh_Stat_AR.ContEngRun_Stat.phys = getValue(this);
    _Ign_Veh_Stat_AR_SpontanFlag = 1;
}
/*@@end*/

/*@@envVar:HMI_DidA_ExtTest_Pres:*/
on EnvVar HMI_DidA_ExtTest_Pres
{
    _mIgn_Veh_Stat_AR.DidA_ExtTest_Pres.phys = getValue(this);
    _Ign_Veh_Stat_AR_SpontanFlag = 1;
}
/*@@end*/

/*@@envVar:HMI_EngSt_Enbl_Rq_KG:*/
on EnvVar HMI_EngSt_Enbl_Rq_KG
{
    _mIgn_Veh_Stat_AR.EngSt_Enbl_Rq_KG.phys = getValue(this);
    _Ign_Veh_Stat_AR_SpontanFlag = 1;
}
/*@@end*/

/*@@envVar:HMI_ESL_Lk_Rq:*/
on EnvVar HMI_ESL_Lk_Rq
{
    _mIgn_Veh_Stat_AR.ESL_Lk_Rq.phys = getValue(this);
    _Ign_Veh_Stat_AR_SpontanFlag = 1;
}
/*@@end*/

/*@@envVar:HMI_Ign_On_StartProc_Inact:*/
on EnvVar HMI_Ign_On_StartProc_Inact
{
    _mIgn_Veh_Stat_AR.Ign_On_StartProc_Inact.phys = getValue(this);
    _Ign_Veh_Stat_AR_SpontanFlag = 1;
}
/*@@end*/

/*@@envVar:HMI_ISw_Stat:*/
on EnvVar HMI_ISw_Stat
{
    byte temp;   //actual ISw_stat
    temp = getValue( this );
    if( temp == 0)
    {
        if( getValue( HMI__NM_EIS_AutomaticModeActive ) == 1 )
        {
        cancelTimer( t_KeyInLockNMCancelTimer );
        _SetCommRequest( cIgnitionNMRequest );
        setTimer( t_KeyInLockNMCancelTimer, c_NMCancelTimer_05sec );
//        write("HJH:_tKeyInLockNMCancelTimer : armed, ISw_Stat = %d", temp );
        }
    }
    if( temp == 1 )
    {
        if( getValue( HMI__NM_EIS_AutomaticModeActive ) == 1 )
        {
        cancelTimer( t_KeyInLockNMCancelTimer );
        _SetCommRequest( cIgnitionNMRequest );
        setTimer( t_KeyInLockNMCancelTimer, c_NMCancelTimer_05sec );
//        write("HJH:_tKeyInLockNMCancelTimer : armed, ISw_Stat = %d", temp );
        }
    }
    if( temp == 2)
    {
        if( getValue( HMI__NM_EIS_AutomaticModeActive ) == 1 )
        {
        cancelTimer( t_KeyInLockNMCancelTimer );
//        write("HJH:_tKeyInLockNMCancelTimer : canceled, ISw_Stat = %d", temp );
        _SetCommRequest( cIgnitionNMRequest );
        }
    }
    if( temp == 4 )
    {
        if( getValue( HMI__NM_EIS_AutomaticModeActive ) == 1 )
        {
        cancelTimer( t_KeyInLockNMCancelTimer );
//        write("HJH:_tKeyInLockNMCancelTimer : canceled, ISw_Stat = %d", temp );
        _SetCommRequest( cIgnitionNMRequest );
        }
    }
    if( temp == 5 )
    {
        if( getValue( HMI__NM_EIS_AutomaticModeActive ) == 1 )
        {
        cancelTimer( t_KeyInLockNMCancelTimer );
 //       write("HJH:_tKeyInLockNMCancelTimer : canceled, ISw_Stat = %d", temp );
        _SetCommRequest( cIgnitionNMRequest );
        }
    }
    if( temp == 3)
    {
        _ReleaseCommRequest( cIgnitionNMRequest );
    }
    if( temp == 6)
    {
        _ReleaseCommRequest( cIgnitionNMRequest );
    }
    if( temp == 7)
    {
        _ReleaseCommRequest( cIgnitionNMRequest );
    }
    _mIgn_Veh_Stat_AR.ISw_Stat.phys = temp;
    _Ign_Veh_Stat_AR_SpontanFlag = 1;
}
/*@@end*/

/*@@envVar:HMI_KG_IgnCtrl_Actv:*/
on EnvVar HMI_KG_IgnCtrl_Actv
{
    _mIgn_Veh_Stat_AR.KG_IgnCtrl_Actv.phys = getValue(this);
    _Ign_Veh_Stat_AR_SpontanFlag = 1;
}
/*@@end*/

/*@@envVar:HMI_KG_StartSw_Psd:*/
on EnvVar HMI_KG_StartSw_Psd
{
    _mIgn_Veh_Stat_AR.KG_StartSw_Psd.phys = getValue(this);
    _Ign_Veh_Stat_AR_SpontanFlag = 1;
}
/*@@end*/

/*@@envVar:HMI_Mobile_Chrg_Rq_EIS:*/
on EnvVar HMI_Mobile_Chrg_Rq_EIS
{
    _mIgn_Veh_Stat_AR.Mobile_Chrg_Rq_EIS.phys = getValue(this);
    _Ign_Veh_Stat_AR_SpontanFlag = 1;
}
/*@@end*/

/*@@envVar:HMI_RemSt_IgnCtrl_Actv:*/
on EnvVar HMI_RemSt_IgnCtrl_Actv
{
    _mIgn_Veh_Stat_AR.RemSt_IgnCtrl_Actv.phys = getValue(this);
    _Ign_Veh_Stat_AR_SpontanFlag = 1;
}
/*@@end*/

/*@@envVar:HMI_RemSt_IgnCtrl_Info:*/
on EnvVar HMI_RemSt_IgnCtrl_Info
{
    _mIgn_Veh_Stat_AR.RemSt_IgnCtrl_Info.phys = getValue(this);
    _Ign_Veh_Stat_AR_SpontanFlag = 1;
}
/*@@end*/

/*@@envVar:HMI_RevGr_Engg:*/
on EnvVar HMI_RevGr_Engg
{
    _mIgn_Veh_Stat_AR.RevGr_Engg.phys = getValue(this);
    _Ign_Veh_Stat_AR_SpontanFlag = 1;
}
/*@@end*/

/*@@envVar:HMI_SPCR_AcustWarn_Rq_EIS:*/
on EnvVar HMI_SPCR_AcustWarn_Rq_EIS
{
    _mIgn_Veh_Stat_AR.SPCR_AcustWarn_Rq_EIS.phys = getValue(this);
    _Ign_Veh_Stat_AR_SpontanFlag = 1;
}
/*@@end*/

/*@@envVar:HMI_SPCR_Conf_EIS:*/
on EnvVar HMI_SPCR_Conf_EIS
{
    _mIgn_Veh_Stat_AR.SPCR_Conf_EIS.phys = getValue(this);
    _Ign_Veh_Stat_AR_SpontanFlag = 1;
}
/*@@end*/

/*@@envVar:HMI_SPCR_Flt_EIS:*/
on EnvVar HMI_SPCR_Flt_EIS
{
    _mIgn_Veh_Stat_AR.SPCR_Flt_EIS.phys = getValue(this);
    _Ign_Veh_Stat_AR_SpontanFlag = 1;
}
/*@@end*/

/*@@envVar:HMI_TxPkPosn_Emg_Rq:*/
on EnvVar HMI_TxPkPosn_Emg_Rq
{
    _mIgn_Veh_Stat_AR.TxPkPosn_Emg_Rq.phys = getValue(this);
    _Ign_Veh_Stat_AR_SpontanFlag = 1;
}
/*@@end*/

/*@@envVar:HMI_TxPkPosn_Rq:*/
on EnvVar HMI_TxPkPosn_Rq
{
    _mIgn_Veh_Stat_AR.TxPkPosn_Rq.phys = getValue(this);
    _Ign_Veh_Stat_AR_SpontanFlag = 1;
}
/*@@end*/

/*@@envVar:HMI_TxPkPosn_Rq_SPCR_Enbl:*/
on EnvVar HMI_TxPkPosn_Rq_SPCR_Enbl
{
    _mIgn_Veh_Stat_AR.TxPkPosn_Rq_SPCR_Enbl.phys = getValue(this);
    _Ign_Veh_Stat_AR_SpontanFlag = 1;
}
/*@@end*/

/*@@envVar:HMI_TxPkPosnAuto_Enbl:*/
on EnvVar HMI_TxPkPosnAuto_Enbl
{
    _mIgn_Veh_Stat_AR.TxPkPosnAuto_Enbl.phys = getValue(this);
    _Ign_Veh_Stat_AR_SpontanFlag = 1;
}
/*@@end*/

/*@@caplFunc:IHC_Lgt_Stat_MPC_AR_check_output():*/
IHC_Lgt_Stat_MPC_AR_check_output()
{
    if( !getValue( HMI__STMSG_IHC_Lgt_Stat_MPC_AR ) )
    {
        // Botschaft IHC_Lgt_Stat_MPC_AR ID: 551 --- Sendeart 0 cyclicX --- 
        _IHC_Lgt_Stat_MPC_AR_Cnt--;
        if( _IHC_Lgt_Stat_MPC_AR_Cnt < 1 )
        {
            IHC_Lgt_Stat_MPC_AR_output(); // Nachricht wg. abgelaufenem Zyklus ausgeben
            _IHC_Lgt_Stat_MPC_AR_Cnt = _IHC_Lgt_Stat_MPC_AR_CycleCount; // Zyklus-Zähler zurücksetzen
        }
    }
}
/*@@end*/

/*@@caplFunc:IHC_Lgt_Stat_MPC_AR_init():*/
IHC_Lgt_Stat_MPC_AR_init()
{   /* Botschaft IHC_Lgt_Stat_MPC_AR ID: 551 --- Sendeart 0 cyclicX --- 
BA_ "ApplMessage" BO_ 551 0;
BA_ "NmAsrMessage" BO_ 551 0;
BA_ "GenMsgMinAcceptLength" BO_ 551 8;
BA_ "GenMsgILSupport" BO_ 551 1;
BA_ "DiagState" BO_ 551 0;
BA_ "DiagRequest" BO_ 551 0;
BA_ "DiagResponse" BO_ 551 0;
BA_ "GenMsgStartValue" BO_ 551 "0";
BA_ "GenMsgCycleTime" BO_ 551 40;
BA_ "GenMsgSendType" BO_ 551 0;
    */
    _IHC_Lgt_Stat_MPC_AR_Timebase =           c_tDBKomTimer_20ms;
    _IHC_Lgt_Stat_MPC_AR_CycleCount =        40 / _IHC_Lgt_Stat_MPC_AR_Timebase;
    _IHC_Lgt_Stat_MPC_AR_StartDelay =         0 / _IHC_Lgt_Stat_MPC_AR_Timebase;
    _IHC_Lgt_Stat_MPC_AR_Cnt = _IHC_Lgt_Stat_MPC_AR_StartDelay;

    putValue( HMI__STMSGSD_IHC_Lgt_Stat_MPC_AR, _IHC_Lgt_Stat_MPC_AR_StartDelay * _IHC_Lgt_Stat_MPC_AR_Timebase );
    
    _mIHC_Lgt_Stat_MPC_AR.IHC_Block_Disp_Rq.phys = getValue( HMI_IHC_Block_Disp_Rq__IHC_Lgt_Stat );
    _mIHC_Lgt_Stat_MPC_AR.IHC_Brt_Outsd.phys = getValue( HMI_IHC_Brt_Outsd );
    _mIHC_Lgt_Stat_MPC_AR.IHC_ChgovrLvl_V2.phys = getValue( HMI_IHC_ChgovrLvl_V2 );
    _mIHC_Lgt_Stat_MPC_AR.IHC_City_Dtct.phys = getValue( HMI_IHC_City_Dtct );
    _mIHC_Lgt_Stat_MPC_AR.IHC_DrvDir.phys = getValue( HMI_IHC_DrvDir );
    _mIHC_Lgt_Stat_MPC_AR.IHC_HiBm_Stat.phys = getValue( HMI_IHC_HiBm_Stat );
    _mIHC_Lgt_Stat_MPC_AR.IHC_LgtDist_Rq.phys = getValue( HMI_IHC_LgtDist_Rq );
    _mIHC_Lgt_Stat_MPC_AR.IHC_MotorWay_Dtct.phys = getValue( HMI_IHC_MotorWay_Dtct );
    _mIHC_Lgt_Stat_MPC_AR.IHC_ObjAngl.phys = getValue( HMI_IHC_ObjAngl );
    _mIHC_Lgt_Stat_MPC_AR.IHC_OptHdLgtLvl_Stat.phys = getValue( HMI_IHC_OptHdLgtLvl_Stat );
    _mIHC_Lgt_Stat_MPC_AR.IHC_Plus_HL_Lt_LgtOut_V2.phys = getValue( HMI_IHC_Plus_HL_Lt_LgtOut_V2 );
    _mIHC_Lgt_Stat_MPC_AR.IHC_Plus_HL_Rt_LgtOut_V2.phys = getValue( HMI_IHC_Plus_HL_Rt_LgtOut_V2 );
    _mIHC_Lgt_Stat_MPC_AR.IHC_Stat_MPC.phys = getValue( HMI_IHC_Stat_MPC );
    _mIHC_Lgt_Stat_MPC_AR.IHC_TrffcStyle.phys = getValue( HMI_IHC_TrffcStyle );
    _mIHC_Lgt_Stat_MPC_AR.IHC_Tunnel.phys = getValue( HMI_IHC_Tunnel );
    _mIHC_Lgt_Stat_MPC_AR.IHC_WShHt_Rq_Stat.phys = getValue( HMI_IHC_WShHt_Rq_Stat );
    _mIHC_Lgt_Stat_MPC_AR.IHC_Wthr_Dtct.phys = getValue( HMI_IHC_Wthr_Dtct );
}
/*@@end*/

/*@@caplFunc:IHC_Lgt_Stat_MPC_AR_output():*/
void IHC_Lgt_Stat_MPC_AR_output(void)
{
    byte crc;
    byte SQC_help;

    if( !getValue( HMI_SQC_IHC_Lgt_Stat_MPC_Auto ) )
    {
        // berechne message counter
        SQC_help = getValue( HMI_SQC_IHC_Lgt_Stat_MPC );
        if( SQC_help >= 15 ) SQC_help = 0;
        else SQC_help++;
        putValue( HMI_SQC_IHC_Lgt_Stat_MPC, SQC_help );
        _mIHC_Lgt_Stat_MPC_AR.SQC_IHC_Lgt_Stat_MPC = SQC_help;
    }
    else
          _mIHC_Lgt_Stat_MPC_AR.SQC_IHC_Lgt_Stat_MPC = getValue( HMI_SQC_IHC_Lgt_Stat_MPC );

    if( getValue( HMI_CRC_IHC_Lgt_Stat_MPC_Profile_02 ) )
    {
        if( !getValue( HMI_CRC_IHC_Lgt_Stat_MPC_Auto ) )
        {   // CRC according Profile_02 ( W213 )
            // berechne crc
            crc = 0xFF;
//            crc = crctable_profile02[ crc ^ _mIHC_Lgt_Stat_MPC_AR.byte( 0 ) ];  CRC
            crc = crctable_profile02[ crc ^ _mIHC_Lgt_Stat_MPC_AR.byte( 1 ) ];
            crc = crctable_profile02[ crc ^ _mIHC_Lgt_Stat_MPC_AR.byte( 2 )];
            crc = crctable_profile02[ crc ^ _mIHC_Lgt_Stat_MPC_AR.byte( 3 )];
            crc = crctable_profile02[ crc ^ _mIHC_Lgt_Stat_MPC_AR.byte( 4 )];
            crc = crctable_profile02[ crc ^ _mIHC_Lgt_Stat_MPC_AR.byte( 5 )];
            crc = crctable_profile02[ crc ^ _mIHC_Lgt_Stat_MPC_AR.byte( 6 )];
            crc = crctable_profile02[ crc ^ _mIHC_Lgt_Stat_MPC_AR.byte( 7 )];
            crc = crctable_profile02[ crc ^ _IHC_Lgt_Stat_MPC_AR_CRC_Offset[ _mIHC_Lgt_Stat_MPC_AR.SQC_IHC_Lgt_Stat_MPC ] ]; // load offset
            crc = (crc ^ 0xFF);
            if( getValue(  HMI_CRC_IHC_Lgt_Stat_MPC_Invalid ) )
                crc++;
            _mIHC_Lgt_Stat_MPC_AR.CRC_IHC_Lgt_Stat_MPC = crc;
            putValue( HMI_CRC_IHC_Lgt_Stat_MPC, crc );
        }
        else
             _mIHC_Lgt_Stat_MPC_AR.CRC_IHC_Lgt_Stat_MPC = getValue( HMI_CRC_IHC_Lgt_Stat_MPC );
    }
    else
    {
        if( !getValue( HMI_CRC_IHC_Lgt_Stat_MPC_Auto ) )
        {   // CRC according to SAE1850 ( W222 )
            // berechne crc
            crc = 0xFF;
 //           crc = crctable[crc ^ _mIHC_Lgt_Stat_MPC_AR.byte( 0 )];  CRC
            crc = crctable[crc ^ _mIHC_Lgt_Stat_MPC_AR.byte( 1 )];
            crc = crctable[crc ^ _mIHC_Lgt_Stat_MPC_AR.byte( 2 )];
            crc = crctable[crc ^ _mIHC_Lgt_Stat_MPC_AR.byte( 3 )];
            crc = crctable[crc ^ _mIHC_Lgt_Stat_MPC_AR.byte( 4 )];
            crc = crctable[crc ^ _mIHC_Lgt_Stat_MPC_AR.byte( 5 )];
            crc = crctable[crc ^ _mIHC_Lgt_Stat_MPC_AR.byte( 6 )];
            crc = crctable[crc ^ _mIHC_Lgt_Stat_MPC_AR.byte( 7 )];
            crc = (crc ^ 0xFF);
            if( getValue(  HMI_CRC_IHC_Lgt_Stat_MPC_Invalid ) )
                crc++;
            _mIHC_Lgt_Stat_MPC_AR.CRC_IHC_Lgt_Stat_MPC = crc;
            putValue( HMI_CRC_IHC_Lgt_Stat_MPC, crc );
        }
        else
          _mIHC_Lgt_Stat_MPC_AR.CRC_IHC_Lgt_Stat_MPC = getValue( HMI_CRC_IHC_Lgt_Stat_MPC );
    }
    output( _mIHC_Lgt_Stat_MPC_AR );
}
/*@@end*/

/*@@caplFunc:IHC_Lgt_Stat_MPC_AR_saveEnvVars(dword):*/
IHC_Lgt_Stat_MPC_AR_saveEnvVars( dword hFile )
{
    filePutString("\n// Knoten EIS: IHC_Lgt_Stat_MPC_AR\n", 33, hFile );
    snprintf( buffer, elcount( buffer ), "0.0000 HMI__STMSG_IHC_Lgt_Stat_MPC := %X\n", getValue( HMI__STMSG_IHC_Lgt_Stat_MPC_AR ) );    filePutString( buffer, elcount( buffer ), hFile );
    snprintf( buffer, elcount( buffer ), "0.0000 HMI__STMSGT_IHC_Lgt_Stat_MPC := %X\n", getValue( HMI__STMSGT_IHC_Lgt_Stat_MPC_AR ) );    filePutString( buffer, elcount( buffer ), hFile );
    snprintf( buffer, elcount( buffer ), "0.0000 HMI_CRC_IHC_Lgt_Stat_MPC := %X\n", getValue( HMI_CRC_IHC_Lgt_Stat_MPC ) );    filePutString( buffer, elcount( buffer ), hFile );
    snprintf( buffer, elcount( buffer ), "0.0000 HMI_CRC_IHC_Lgt_Stat_MPC_Auto := %X\n", getValue( HMI_CRC_IHC_Lgt_Stat_MPC_Auto ) );    filePutString( buffer, elcount( buffer ), hFile );
    snprintf( buffer, elcount( buffer ), "0.0000 HMI_IHC_Block_Disp_Rq__IHC_Lgt_Stat := %X\n", getValue( HMI_IHC_Block_Disp_Rq__IHC_Lgt_Stat ) );    filePutString( buffer, elcount( buffer ), hFile );
    snprintf( buffer, elcount( buffer ), "0.0000 HMI_IHC_Brt_Outsd := %X\n", getValue( HMI_IHC_Brt_Outsd ) );    filePutString( buffer, elcount( buffer ), hFile );
    snprintf( buffer, elcount( buffer ), "0.0000 HMI_IHC_ChgovrLvl_V2 := %X\n", getValue( HMI_IHC_ChgovrLvl_V2 ) );    filePutString( buffer, elcount( buffer ), hFile );
    snprintf( buffer, elcount( buffer ), "0.0000 HMI_IHC_City_Dtct := %X\n", getValue( HMI_IHC_City_Dtct ) );    filePutString( buffer, elcount( buffer ), hFile );
    snprintf( buffer, elcount( buffer ), "0.0000 HMI_IHC_DrvDir := %X\n", getValue( HMI_IHC_DrvDir ) );    filePutString( buffer, elcount( buffer ), hFile );
    snprintf( buffer, elcount( buffer ), "0.0000 HMI_IHC_HiBm_Stat := %X\n", getValue( HMI_IHC_HiBm_Stat ) );    filePutString( buffer, elcount( buffer ), hFile );
    snprintf( buffer, elcount( buffer ), "0.0000 HMI_IHC_LgtDist_Rq := %X\n", getValue( HMI_IHC_LgtDist_Rq ) );    filePutString( buffer, elcount( buffer ), hFile );
    snprintf( buffer, elcount( buffer ), "0.0000 HMI_IHC_MotorWay_Dtct := %X\n", getValue( HMI_IHC_MotorWay_Dtct ) );    filePutString( buffer, elcount( buffer ), hFile );
    snprintf( buffer, elcount( buffer ), "0.0000 HMI_IHC_ObjAngl := %X\n", getValue( HMI_IHC_ObjAngl ) );    filePutString( buffer, elcount( buffer ), hFile );
    snprintf( buffer, elcount( buffer ), "0.0000 HMI_IHC_OptHdLgtLvl_Stat := %X\n", getValue( HMI_IHC_OptHdLgtLvl_Stat ) );    filePutString( buffer, elcount( buffer ), hFile );
    snprintf( buffer, elcount( buffer ), "0.0000 HMI_IHC_Plus_HL_Lt_LgtOut_V2 := %X\n", getValue( HMI_IHC_Plus_HL_Lt_LgtOut_V2 ) );    filePutString( buffer, elcount( buffer ), hFile );
    snprintf( buffer, elcount( buffer ), "0.0000 HMI_IHC_Plus_HL_Rt_LgtOut_V2 := %X\n", getValue( HMI_IHC_Plus_HL_Rt_LgtOut_V2 ) );    filePutString( buffer, elcount( buffer ), hFile );
    snprintf( buffer, elcount( buffer ), "0.0000 HMI_IHC_Stat_MPC := %X\n", getValue( HMI_IHC_Stat_MPC ) );    filePutString( buffer, elcount( buffer ), hFile );
    snprintf( buffer, elcount( buffer ), "0.0000 HMI_IHC_TrffcStyle := %X\n", getValue( HMI_IHC_TrffcStyle ) );    filePutString( buffer, elcount( buffer ), hFile );
    snprintf( buffer, elcount( buffer ), "0.0000 HMI_IHC_Tunnel := %X\n", getValue( HMI_IHC_Tunnel ) );    filePutString( buffer, elcount( buffer ), hFile );
    snprintf( buffer, elcount( buffer ), "0.0000 HMI_IHC_WShHt_Rq_Stat := %X\n", getValue( HMI_IHC_WShHt_Rq_Stat ) );    filePutString( buffer, elcount( buffer ), hFile );
    snprintf( buffer, elcount( buffer ), "0.0000 HMI_IHC_Wthr_Dtct := %X\n", getValue( HMI_IHC_Wthr_Dtct ) );    filePutString( buffer, elcount( buffer ), hFile );
    snprintf( buffer, elcount( buffer ), "0.0000 HMI_SQC_IHC_Lgt_Stat_MPC := %X\n", getValue( HMI_SQC_IHC_Lgt_Stat_MPC ) );    filePutString( buffer, elcount( buffer ), hFile );
    snprintf( buffer, elcount( buffer ), "0.0000 HMI_SQC_IHC_Lgt_Stat_MPC_Auto := %X\n", getValue( HMI_SQC_IHC_Lgt_Stat_MPC_Auto ) );    filePutString( buffer, elcount( buffer ), hFile );
}
/*@@end*/

/*@@timer:_tIHC_Lgt_Stat_MPC_AR:*/
on timer _tIHC_Lgt_Stat_MPC_AR
{
    putValue( HMI__STMSG_IHC_Lgt_Stat_MPC_AR, 0 );
}
/*@@end*/

/*@@envVar:HMI__STMSG_IHC_Lgt_Stat_MPC_AR:*/
on EnvVar HMI__STMSG_IHC_Lgt_Stat_MPC_AR
{
    long tDelay;
    if( getValue( this ) == 2 )
    {
        tDelay = getValue( HMI__STMSGT_IHC_Lgt_Stat_MPC_AR );
        if( tDelay > 0)    
            setTimer( _tIHC_Lgt_Stat_MPC_AR, tDelay );
        else
            putValue( HMI__STMSG_IHC_Lgt_Stat_MPC_AR, 0 );
    }
}
/*@@end*/

/*@@envVar:HMI_IHC_Block_Disp_Rq__IHC_Lgt_Stat:*/
on EnvVar HMI_IHC_Block_Disp_Rq__IHC_Lgt_Stat
{
    _mIHC_Lgt_Stat_MPC_AR.IHC_Block_Disp_Rq.phys = getValue(this);
}
/*@@end*/

/*@@envVar:HMI_IHC_Brt_Outsd:*/
on EnvVar HMI_IHC_Brt_Outsd
{
    _mIHC_Lgt_Stat_MPC_AR.IHC_Brt_Outsd.phys = getValue(this);
}
/*@@end*/

/*@@envVar:HMI_IHC_ChgovrLvl_V2:*/
on EnvVar HMI_IHC_ChgovrLvl_V2
{
    _mIHC_Lgt_Stat_MPC_AR.IHC_ChgovrLvl_V2.phys = getValue(this);
}
/*@@end*/

/*@@envVar:HMI_IHC_City_Dtct:*/
on EnvVar HMI_IHC_City_Dtct
{
    _mIHC_Lgt_Stat_MPC_AR.IHC_City_Dtct.phys = getValue(this);
}
/*@@end*/

/*@@envVar:HMI_IHC_DrvDir:*/
on EnvVar HMI_IHC_DrvDir
{
    _mIHC_Lgt_Stat_MPC_AR.IHC_DrvDir.phys = getValue(this);
}
/*@@end*/

/*@@envVar:HMI_IHC_HiBm_Stat:*/
on EnvVar HMI_IHC_HiBm_Stat
{
    _mIHC_Lgt_Stat_MPC_AR.IHC_HiBm_Stat.phys = getValue(this);
}
/*@@end*/

/*@@envVar:HMI_IHC_LgtDist_Rq:*/
on EnvVar HMI_IHC_LgtDist_Rq
{
    _mIHC_Lgt_Stat_MPC_AR.IHC_LgtDist_Rq.phys = getValue(this);
}
/*@@end*/

/*@@envVar:HMI_IHC_MotorWay_Dtct:*/
on EnvVar HMI_IHC_MotorWay_Dtct
{
    _mIHC_Lgt_Stat_MPC_AR.IHC_MotorWay_Dtct.phys = getValue(this);
}
/*@@end*/

/*@@envVar:HMI_IHC_ObjAngl:*/
on EnvVar HMI_IHC_ObjAngl
{
    _mIHC_Lgt_Stat_MPC_AR.IHC_ObjAngl.phys = getValue(this);
}
/*@@end*/

/*@@envVar:HMI_IHC_OptHdLgtLvl_Stat:*/
on EnvVar HMI_IHC_OptHdLgtLvl_Stat
{
    _mIHC_Lgt_Stat_MPC_AR.IHC_OptHdLgtLvl_Stat.phys = getValue(this);
}
/*@@end*/

/*@@envVar:HMI_IHC_Plus_HL_Lt_LgtOut_V2:*/
on EnvVar HMI_IHC_Plus_HL_Lt_LgtOut_V2
{
    _mIHC_Lgt_Stat_MPC_AR.IHC_Plus_HL_Lt_LgtOut_V2.phys = getValue(this);
}
/*@@end*/

/*@@envVar:HMI_IHC_Plus_HL_Rt_LgtOut_V2:*/
on EnvVar HMI_IHC_Plus_HL_Rt_LgtOut_V2
{
    _mIHC_Lgt_Stat_MPC_AR.IHC_Plus_HL_Rt_LgtOut_V2.phys = getValue(this);
}
/*@@end*/

/*@@envVar:HMI_IHC_Stat_MPC:*/
on EnvVar HMI_IHC_Stat_MPC
{
    _mIHC_Lgt_Stat_MPC_AR.IHC_Stat_MPC.phys = getValue(this);
}
/*@@end*/

/*@@envVar:HMI_IHC_TrffcStyle:*/
on EnvVar HMI_IHC_TrffcStyle
{
    _mIHC_Lgt_Stat_MPC_AR.IHC_TrffcStyle.phys = getValue(this);
}
/*@@end*/

/*@@envVar:HMI_IHC_Tunnel:*/
on EnvVar HMI_IHC_Tunnel
{
    _mIHC_Lgt_Stat_MPC_AR.IHC_Tunnel.phys = getValue(this);
}
/*@@end*/

/*@@envVar:HMI_IHC_WShHt_Rq_Stat:*/
on EnvVar HMI_IHC_WShHt_Rq_Stat
{
    _mIHC_Lgt_Stat_MPC_AR.IHC_WShHt_Rq_Stat.phys = getValue(this);
}
/*@@end*/

/*@@envVar:HMI_IHC_Wthr_Dtct:*/
on EnvVar HMI_IHC_Wthr_Dtct
{
    _mIHC_Lgt_Stat_MPC_AR.IHC_Wthr_Dtct.phys = getValue(this);
}
/*@@end*/

/*@@caplFunc:IL_AmbLgt_Disp_AR_check_output():*/
IL_AmbLgt_Disp_AR_check_output()
{
    if( !getValue( HMI__STMSG_IL_AmbLgt_Disp_AR ) )
    {
        // Botschaft IL_AmbLgt_Disp_AR ID: 1067 --- Sendeart 5 cyclicAndSpontanWithDelay --- 
        _IL_AmbLgt_Disp_AR_Cnt--;
        if( _IL_AmbLgt_Disp_AR_Cnt < 1 )
        {
            IL_AmbLgt_Disp_AR_output(); // Nachricht wg. abgelaufenem Zyklus ausgeben
            _IL_AmbLgt_Disp_AR_Cnt = _IL_AmbLgt_Disp_AR_CycleCount; // Zyklus-Zähler zurücksetzen
            _IL_AmbLgt_Disp_AR_SpontanFlag = 0; // Spontan-Flag zurücksetzen
        }
        else if( _IL_AmbLgt_Disp_AR_SpontanFlag)
        {
            IL_AmbLgt_Disp_AR_output(); // Nachricht wg. spontaner Änderung ausgeben
            _IL_AmbLgt_Disp_AR_SpontanFlag = 0; // Spontan-Flag zurücksetzen
        }
    }
}
/*@@end*/

/*@@caplFunc:IL_AmbLgt_Disp_AR_init():*/
IL_AmbLgt_Disp_AR_init()
{   /* Botschaft IL_AmbLgt_Disp_AR ID: 1067 --- Sendeart 5 cyclicAndSpontanWithDelay --- 
BA_ "ApplMessage" BO_ 1067 0;
BA_ "NmAsrMessage" BO_ 1067 0;
BA_ "GenMsgMinAcceptLength" BO_ 1067 8;
BA_ "GenMsgILSupport" BO_ 1067 1;
BA_ "DiagState" BO_ 1067 0;
BA_ "DiagRequest" BO_ 1067 0;
BA_ "DiagResponse" BO_ 1067 0;
BA_ "GenMsgStartValue" BO_ 1067 "0";
BA_ "GenMsgDelayTime" BO_ 1067 5;
BA_ "GenMsgNrOfRepetitions" BO_ 1067 0;
BA_ "GenMsgCycleTime" BO_ 1067 1000;
BA_ "GenMsgSendType" BO_ 1067 5;
    */
    _IL_AmbLgt_Disp_AR_Timebase =           c_tDBKomTimer_20ms;
    _IL_AmbLgt_Disp_AR_CycleCount =      1000 / _IL_AmbLgt_Disp_AR_Timebase;
    _IL_AmbLgt_Disp_AR_StartDelay =         0 / _IL_AmbLgt_Disp_AR_Timebase;
    _IL_AmbLgt_Disp_AR_Cnt = _IL_AmbLgt_Disp_AR_StartDelay;
    _IL_AmbLgt_Disp_AR_SpontanFlag = 0;

    putValue( HMI__STMSGSD_IL_AmbLgt_Disp_AR, _IL_AmbLgt_Disp_AR_StartDelay * _IL_AmbLgt_Disp_AR_Timebase );

    _mIL_AmbLgt_Disp_AR.AmbBrt_Disp1.phys = getValue( HMI_AmbBrt_Disp1 );
    _mIL_AmbLgt_Disp_AR.AmbBrt_Disp2.phys = getValue( HMI_AmbBrt_Disp2 );
    _mIL_AmbLgt_Disp_AR.AmbBrt_Disp3.phys = getValue( HMI_AmbBrt_Disp3 );
    _mIL_AmbLgt_Disp_AR.DrHdl_Brt_F.phys = getValue( HMI_DrHdl_Brt_F );
    _mIL_AmbLgt_Disp_AR.DrHdl_Brt_R.phys = getValue( HMI_DrHdl_Brt_R );
}
/*@@end*/

/*@@caplFunc:IL_AmbLgt_Disp_AR_output():*/
IL_AmbLgt_Disp_AR_output(void)
{
    output( _mIL_AmbLgt_Disp_AR );
}
/*@@end*/

/*@@caplFunc:IL_AmbLgt_Disp_AR_saveEnvVars(dword):*/
IL_AmbLgt_Disp_AR_saveEnvVars( dword hFile )
{
    filePutString("\n// Knoten EIS: IL_AmbLgt_Disp_AR\n", 31, hFile );
    snprintf( buffer, elcount( buffer ), "0.0000 HMI__STMSG_IL_AmbLgt_Disp_AR := %X\n", getValue( HMI__STMSG_IL_AmbLgt_Disp_AR ) );    filePutString( buffer, elcount( buffer ), hFile );
    snprintf( buffer, elcount( buffer ), "0.0000 HMI__STMSGT_IL_AmbLgt_Disp_AR := %X\n", getValue( HMI__STMSGT_IL_AmbLgt_Disp_AR ) );    filePutString( buffer, elcount( buffer ), hFile );
    snprintf( buffer, elcount( buffer ), "0.0000 HMI_AmbBrt_Disp1 := %f\n", getValue( HMI_AmbBrt_Disp1 ) );    filePutString( buffer, elcount( buffer ), hFile );
    snprintf( buffer, elcount( buffer ), "0.0000 HMI_AmbBrt_Disp2 := %f\n", getValue( HMI_AmbBrt_Disp2 ) );    filePutString( buffer, elcount( buffer ), hFile );
    snprintf( buffer, elcount( buffer ), "0.0000 HMI_AmbBrt_Disp3 := %f\n", getValue( HMI_AmbBrt_Disp3 ) );    filePutString( buffer, elcount( buffer ), hFile );
    snprintf( buffer, elcount( buffer ), "0.0000 HMI_DrHdl_Brt_F := %f\n", getValue( HMI_DrHdl_Brt_F ) );    filePutString( buffer, elcount( buffer ), hFile );
    snprintf( buffer, elcount( buffer ), "0.0000 HMI_DrHdl_Brt_R := %f\n", getValue( HMI_DrHdl_Brt_R ) );    filePutString( buffer, elcount( buffer ), hFile );
}
/*@@end*/

/*@@timer:_tIL_AmbLgt_Disp_AR:*/
on timer _tIL_AmbLgt_Disp_AR
{
    putValue( HMI__STMSG_IL_AmbLgt_Disp_AR, 0 );
}
/*@@end*/

/*@@envVar:HMI__STMSG_IL_AmbLgt_Disp_AR:*/
on EnvVar HMI__STMSG_IL_AmbLgt_Disp_AR
{
    long tDelay;
    if( getValue( this ) == 2 )
    {
        tDelay = getValue( HMI__STMSGT_IL_AmbLgt_Disp_AR );
        if( tDelay > 0)    
            setTimer( _tIL_AmbLgt_Disp_AR, tDelay );
        else
            putValue( HMI__STMSG_IL_AmbLgt_Disp_AR, 0 );
    }
}
/*@@end*/

/*@@envVar:HMI_AmbBrt_Disp1:*/
on EnvVar HMI_AmbBrt_Disp1
{

   _mIL_AmbLgt_Disp_AR.AmbBrt_Disp1.phys = getValue(this);
    _IL_AmbLgt_Disp_AR_SpontanFlag = 1;
}
/*@@end*/

/*@@envVar:HMI_AmbBrt_Disp2:*/
on EnvVar HMI_AmbBrt_Disp2
{

   _mIL_AmbLgt_Disp_AR.AmbBrt_Disp2.phys = getValue(this);
    _IL_AmbLgt_Disp_AR_SpontanFlag = 1;
}
/*@@end*/

/*@@envVar:HMI_AmbBrt_Disp3:*/
on EnvVar HMI_AmbBrt_Disp3
{

   _mIL_AmbLgt_Disp_AR.AmbBrt_Disp3.phys = getValue(this);
    _IL_AmbLgt_Disp_AR_SpontanFlag = 1;
}
/*@@end*/

/*@@envVar:HMI_DrHdl_Brt_F:*/
on EnvVar HMI_DrHdl_Brt_F
{

   _mIL_AmbLgt_Disp_AR.DrHdl_Brt_F.phys = getValue(this);
    _IL_AmbLgt_Disp_AR_SpontanFlag = 1;
}
/*@@end*/

/*@@envVar:HMI_DrHdl_Brt_R:*/
on EnvVar HMI_DrHdl_Brt_R
{

   _mIL_AmbLgt_Disp_AR.DrHdl_Brt_R.phys = getValue(this);
    _IL_AmbLgt_Disp_AR_SpontanFlag = 1;
}
/*@@end*/

/*@@caplFunc:IL_AmbLgtCfg_Stat_AR_check_output():*/
IL_AmbLgtCfg_Stat_AR_check_output()
{
    if( !getValue( HMI__STMSG_IL_AmbLgtCfg_Stat_AR ) )
    {
        // Botschaft IL_AmbLgtCfg_Stat_AR ID: 842 --- Sendeart 5 cyclicAndSpontanWithDelay --- 
        _IL_AmbLgtCfg_Stat_AR_Cnt--;
        if( _IL_AmbLgtCfg_Stat_AR_Cnt < 1 )
        {
            IL_AmbLgtCfg_Stat_AR_output(); // Nachricht wg. abgelaufenem Zyklus ausgeben
            _IL_AmbLgtCfg_Stat_AR_Cnt = _IL_AmbLgtCfg_Stat_AR_CycleCount; // Zyklus-Zähler zurücksetzen
            _IL_AmbLgtCfg_Stat_AR_SpontanFlag = 0; // Spontan-Flag zurücksetzen
        }
        else if( _IL_AmbLgtCfg_Stat_AR_SpontanFlag )
        {
            IL_AmbLgtCfg_Stat_AR_output(); // Nachricht wg. spontaner Änderung ausgeben
            _IL_AmbLgtCfg_Stat_AR_SpontanFlag = 0; // Spontan-Flag zurücksetzen
        }
    }
}
/*@@end*/

/*@@caplFunc:IL_AmbLgtCfg_Stat_AR_init():*/
IL_AmbLgtCfg_Stat_AR_init()
{   /* Botschaft IL_AmbLgtCfg_Stat_AR ID: 842 --- Sendeart 5 cyclicAndSpontanWithDelay --- 
BA_ "ApplMessage" BO_ 842 0;
BA_ "NmAsrMessage" BO_ 842 0;
BA_ "GenMsgMinAcceptLength" BO_ 842 8;
BA_ "GenMsgILSupport" BO_ 842 1;
BA_ "DiagState" BO_ 842 0;
BA_ "DiagRequest" BO_ 842 0;
BA_ "DiagResponse" BO_ 842 0;
BA_ "GenMsgStartValue" BO_ 842 "0";
BA_ "GenMsgDelayTime" BO_ 842 5;
BA_ "GenMsgNrOfRepetitions" BO_ 842 0;
BA_ "GenMsgCycleTime" BO_ 842 1000;
BA_ "GenMsgSendType" BO_ 842 5;
    */
    _IL_AmbLgtCfg_Stat_AR_Timebase =           c_tDBKomTimer_20ms;
    _IL_AmbLgtCfg_Stat_AR_CycleCount =      1000 / _IL_AmbLgtCfg_Stat_AR_Timebase;
    _IL_AmbLgtCfg_Stat_AR_StartDelay =         0 / _IL_AmbLgtCfg_Stat_AR_Timebase;
    _IL_AmbLgtCfg_Stat_AR_Cnt = _IL_AmbLgtCfg_Stat_AR_StartDelay;
    _IL_AmbLgtCfg_Stat_AR_SpontanFlag = 0;

    putValue( HMI__STMSGSD_IL_AmbLgtCfg_Stat_AR, _IL_AmbLgtCfg_Stat_AR_StartDelay * _IL_AmbLgtCfg_Stat_AR_Timebase );

    _mIL_AmbLgtCfg_Stat_AR.AmbLgtCfg_01_Stat.phys = getValue( HMI_AmbLgtCfg_01_Stat );
    _mIL_AmbLgtCfg_Stat_AR.AmbLgtCfg_02_Stat.phys = getValue( HMI_AmbLgtCfg_02_Stat );
    _mIL_AmbLgtCfg_Stat_AR.AmbLgtColor_Stat_V2.phys = getValue( HMI_AmbLgtColor_Stat_V2 );
    _mIL_AmbLgtCfg_Stat_AR.AmbLgtColProg_Stat.phys = getValue( HMI_AmbLgtColProg_Stat );
}
/*@@end*/

/*@@caplFunc:IL_AmbLgtCfg_Stat_AR_output():*/
IL_AmbLgtCfg_Stat_AR_output(void)
{
    output( _mIL_AmbLgtCfg_Stat_AR );
}
/*@@end*/

/*@@caplFunc:IL_AmbLgtCfg_Stat_AR_saveEnvVars(dword):*/
IL_AmbLgtCfg_Stat_AR_saveEnvVars( dword hFile )
{
    filePutString("\n// Knoten EIS: IL_AmbLgtCfg_Stat_AR\n", 36, hFile );
    snprintf( buffer, elcount( buffer ), "0.0000 HMI__STMSG_IL_AmbLgtCfg_Stat_AR := %X\n", getValue( HMI__STMSG_IL_AmbLgtCfg_Stat_AR ) );        filePutString( buffer, elcount( buffer ), hFile );
    snprintf( buffer, elcount( buffer ), "0.0000 HMI__STMSGT_IL_AmbLgtCfg_Stat_AR := %X\n", getValue( HMI__STMSGT_IL_AmbLgtCfg_Stat_AR ) );        filePutString( buffer, elcount( buffer ), hFile );
    snprintf( buffer, elcount( buffer ), "0.0000 HMI_AmbLgtCfg_01_Stat := %X\n", getValue( HMI_AmbLgtCfg_01_Stat ) );        filePutString( buffer, elcount( buffer ), hFile );
    snprintf( buffer, elcount( buffer ), "0.0000 HMI_AmbLgtCfg_02_Stat := %X\n", getValue( HMI_AmbLgtCfg_02_Stat ) );        filePutString( buffer, elcount( buffer ), hFile );
    snprintf( buffer, elcount( buffer ), "0.0000 HMI_AmbLgtColor_Stat_V2 := %X\n", getValue( HMI_AmbLgtColor_Stat_V2 ) );        filePutString( buffer, elcount( buffer ), hFile );
    snprintf( buffer, elcount( buffer ), "0.0000 HMI_AmbLgtColProg_Stat := %X\n", getValue( HMI_AmbLgtColProg_Stat ) );        filePutString( buffer, elcount( buffer ), hFile );
}
/*@@end*/

/*@@timer:_tIL_AmbLgtCfg_Stat_AR:*/
on timer _tIL_AmbLgtCfg_Stat_AR
{
    putValue( HMI__STMSG_IL_AmbLgtCfg_Stat_AR, 0 );
}
/*@@end*/

/*@@envVar:HMI__STMSG_IL_AmbLgtCfg_Stat_AR:*/
on EnvVar HMI__STMSG_IL_AmbLgtCfg_Stat_AR
{
    long tDelay;
    if( getValue( this ) == 2 )
    {
        tDelay = getValue( HMI__STMSGT_IL_AmbLgtCfg_Stat_AR );
        if( tDelay > 0)    
            setTimer( _tIL_AmbLgtCfg_Stat_AR, tDelay );
        else
            putValue( HMI__STMSG_IL_AmbLgtCfg_Stat_AR, 0 );
    }
}
/*@@end*/

/*@@envVar:HMI_AmbLgtCfg_01_Stat:*/
on EnvVar HMI_AmbLgtCfg_01_Stat
{
    _mIL_AmbLgtCfg_Stat_AR.AmbLgtCfg_01_Stat.phys = getValue(this);
    _IL_AmbLgtCfg_Stat_AR_SpontanFlag = 1;
}
/*@@end*/

/*@@envVar:HMI_AmbLgtCfg_02_Stat:*/
on EnvVar HMI_AmbLgtCfg_02_Stat
{
    _mIL_AmbLgtCfg_Stat_AR.AmbLgtCfg_02_Stat.phys = getValue(this);
    _IL_AmbLgtCfg_Stat_AR_SpontanFlag = 1;
}
/*@@end*/

/*@@envVar:HMI_AmbLgtColor_Stat_V2:*/
on EnvVar HMI_AmbLgtColor_Stat_V2
{
    _mIL_AmbLgtCfg_Stat_AR.AmbLgtColor_Stat_V2.phys = getValue(this);
    _IL_AmbLgtCfg_Stat_AR_SpontanFlag = 1;
}
/*@@end*/

/*@@envVar:HMI_AmbLgtColProg_Stat:*/
on EnvVar HMI_AmbLgtColProg_Stat
{
    _mIL_AmbLgtCfg_Stat_AR.AmbLgtColProg_Stat.phys = getValue(this);
    _IL_AmbLgtCfg_Stat_AR_SpontanFlag = 1;
}
/*@@end*/

/*@@caplFunc:IL_AmbLgtCfg_Stat2_AR_check_output():*/
IL_AmbLgtCfg_Stat2_AR_check_output()
{
    if( !getValue( HMI__STMSG_IL_AmbLgtCfg_Stat2_AR ) )
    {
        // Botschaft IL_AmbLgtCfg_Stat2_AR ID: 846 --- Sendeart 5 cyclicAndSpontanWithDelay --- 
        _IL_AmbLgtCfg_Stat2_AR_Cnt--;
        if( _IL_AmbLgtCfg_Stat2_AR_Cnt < 1 )
        {
            IL_AmbLgtCfg_Stat2_AR_output(); // Nachricht wg. abgelaufenem Zyklus ausgeben
            _IL_AmbLgtCfg_Stat2_AR_Cnt = _IL_AmbLgtCfg_Stat2_AR_CycleCount; // Zyklus-Zähler zurücksetzen
            _IL_AmbLgtCfg_Stat2_AR_SpontanFlag = 0; // Spontan-Flag zurücksetzen
        }
        else if( _IL_AmbLgtCfg_Stat2_AR_SpontanFlag )
        {
            IL_AmbLgtCfg_Stat2_AR_output(); // Nachricht wg. spontaner Änderung ausgeben
            _IL_AmbLgtCfg_Stat2_AR_SpontanFlag = 0; // Spontan-Flag zurücksetzen
        }
    }
}
/*@@end*/

/*@@caplFunc:IL_AmbLgtCfg_Stat2_AR_init():*/
IL_AmbLgtCfg_Stat2_AR_init()
{   /* Botschaft IL_AmbLgtCfg_Stat2_AR ID: 846 --- Sendeart 5 cyclicAndSpontanWithDelay --- 
BA_ "ApplMessage" BO_ 846 0;
BA_ "NmAsrMessage" BO_ 846 0;
BA_ "GenMsgMinAcceptLength" BO_ 846 8;
BA_ "GenMsgILSupport" BO_ 846 1;
BA_ "DiagState" BO_ 846 0;
BA_ "DiagRequest" BO_ 846 0;
BA_ "DiagResponse" BO_ 846 0;
BA_ "GenMsgStartValue" BO_ 846 "0";
BA_ "GenMsgDelayTime" BO_ 846 5;
BA_ "GenMsgNrOfRepetitions" BO_ 846 0;
BA_ "GenMsgCycleTime" BO_ 846 1000;
BA_ "GenMsgSendType" BO_ 846 5;
    */
    _IL_AmbLgtCfg_Stat2_AR_Timebase =           c_tDBKomTimer_20ms;
    _IL_AmbLgtCfg_Stat2_AR_CycleCount =      1000 / _IL_AmbLgtCfg_Stat2_AR_Timebase;
    _IL_AmbLgtCfg_Stat2_AR_StartDelay =         0 / _IL_AmbLgtCfg_Stat2_AR_Timebase;
    _IL_AmbLgtCfg_Stat2_AR_Cnt = _IL_AmbLgtCfg_Stat2_AR_StartDelay;
    _IL_AmbLgtCfg_Stat2_AR_SpontanFlag = 0;

    putValue( HMI__STMSGSD_IL_AmbLgtCfg_Stat2_AR, _IL_AmbLgtCfg_Stat2_AR_StartDelay * _IL_AmbLgtCfg_Stat2_AR_Timebase );

    _mIL_AmbLgtCfg_Stat2_AR.AmbBrt_Z01_Stat.phys = getValue( HMI_AmbBrt_Z01_Stat );
    _mIL_AmbLgtCfg_Stat2_AR.AmbBrt_Z02_Stat.phys = getValue( HMI_AmbBrt_Z02_Stat );
    _mIL_AmbLgtCfg_Stat2_AR.AmbBrt_Z03_Stat.phys = getValue( HMI_AmbBrt_Z03_Stat );
    _mIL_AmbLgtCfg_Stat2_AR.AmbBrt_Z04_Stat.phys = getValue( HMI_AmbBrt_Z04_Stat );
    _mIL_AmbLgtCfg_Stat2_AR.AmbBrt_Z05_Stat.phys = getValue( HMI_AmbBrt_Z05_Stat );
    _mIL_AmbLgtCfg_Stat2_AR.AmbBrt_Z06_Stat.phys = getValue( HMI_AmbBrt_Z06_Stat );
    _mIL_AmbLgtCfg_Stat2_AR.AmbBrt_Z07_Stat.phys = getValue( HMI_AmbBrt_Z07_Stat );
}
/*@@end*/

/*@@caplFunc:IL_AmbLgtCfg_Stat2_AR_output():*/
IL_AmbLgtCfg_Stat2_AR_output(void)
{
    output( _mIL_AmbLgtCfg_Stat2_AR );
}
/*@@end*/

/*@@caplFunc:IL_AmbLgtCfg_Stat2_AR_saveEnvVars(dword):*/
IL_AmbLgtCfg_Stat2_AR_saveEnvVars( dword hFile )
{
    filePutString("\n// Knoten EIS: IL_AmbLgtCfg_Stat2_AR\n", 36, hFile );
    snprintf( buffer, elcount( buffer ), "0.0000 HMI__STMSG_IL_AmbLgtCfg_Stat2_AR := %X\n", getValue( HMI__STMSG_IL_AmbLgtCfg_Stat2_AR ) );        filePutString( buffer, elcount( buffer ), hFile );
    snprintf( buffer, elcount( buffer ), "0.0000 HMI__STMSGT_IL_AmbLgtCfg_Stat2_AR := %X\n", getValue( HMI__STMSGT_IL_AmbLgtCfg_Stat2_AR ) );        filePutString( buffer, elcount( buffer ), hFile );
    snprintf( buffer, elcount( buffer ), "0.0000 HMI_AmbBrt_Z01_Stat := %X\n", getValue( HMI_AmbBrt_Z01_Stat ) );        filePutString( buffer, elcount( buffer ), hFile );
    snprintf( buffer, elcount( buffer ), "0.0000 HMI_AmbBrt_Z02_Stat := %X\n", getValue( HMI_AmbBrt_Z02_Stat ) );        filePutString( buffer, elcount( buffer ), hFile );
    snprintf( buffer, elcount( buffer ), "0.0000 HMI_AmbBrt_Z03_Stat := %X\n", getValue( HMI_AmbBrt_Z03_Stat ) );        filePutString( buffer, elcount( buffer ), hFile );
    snprintf( buffer, elcount( buffer ), "0.0000 HMI_AmbBrt_Z04_Stat := %X\n", getValue( HMI_AmbBrt_Z04_Stat ) );        filePutString( buffer, elcount( buffer ), hFile );
    snprintf( buffer, elcount( buffer ), "0.0000 HMI_AmbBrt_Z05_Stat := %X\n", getValue( HMI_AmbBrt_Z05_Stat ) );        filePutString( buffer, elcount( buffer ), hFile );
    snprintf( buffer, elcount( buffer ), "0.0000 HMI_AmbBrt_Z06_Stat := %X\n", getValue( HMI_AmbBrt_Z06_Stat ) );        filePutString( buffer, elcount( buffer ), hFile );
    snprintf( buffer, elcount( buffer ), "0.0000 HMI_AmbBrt_Z07_Stat := %X\n", getValue( HMI_AmbBrt_Z07_Stat ) );        filePutString( buffer, elcount( buffer ), hFile );
}
/*@@end*/

/*@@timer:_tIL_AmbLgtCfg_Stat2_AR:*/
on timer _tIL_AmbLgtCfg_Stat2_AR
{
    putValue( HMI__STMSG_IL_AmbLgtCfg_Stat2_AR, 0 );
}
/*@@end*/

/*@@envVar:HMI__STMSG_IL_AmbLgtCfg_Stat2_AR:*/
on EnvVar HMI__STMSG_IL_AmbLgtCfg_Stat2_AR
{
    long tDelay;
    if( getValue( this ) == 2 )
    {
        tDelay = getValue( HMI__STMSGT_IL_AmbLgtCfg_Stat2_AR );
        if( tDelay > 0)    
            setTimer( _tIL_AmbLgtCfg_Stat2_AR, tDelay );
        else
            putValue( HMI__STMSG_IL_AmbLgtCfg_Stat2_AR, 0 );
    }
}
/*@@end*/

/*@@envVar:HMI_AmbBrt_Z01_Stat:*/
on EnvVar HMI_AmbBrt_Z01_Stat
{
    _mIL_AmbLgtCfg_Stat2_AR.AmbBrt_Z01_Stat.phys = getValue(this);
    _IL_AmbLgtCfg_Stat2_AR_SpontanFlag = 1;
}
/*@@end*/

/*@@envVar:HMI_AmbBrt_Z02_Stat:*/
on EnvVar HMI_AmbBrt_Z02_Stat
{
    _mIL_AmbLgtCfg_Stat2_AR.AmbBrt_Z02_Stat.phys = getValue(this);
    _IL_AmbLgtCfg_Stat2_AR_SpontanFlag = 1;
}
/*@@end*/

/*@@envVar:HMI_AmbBrt_Z03_Stat:*/
on EnvVar HMI_AmbBrt_Z03_Stat
{
    _mIL_AmbLgtCfg_Stat2_AR.AmbBrt_Z03_Stat.phys = getValue(this);
    _IL_AmbLgtCfg_Stat2_AR_SpontanFlag = 1;
}
/*@@end*/

/*@@envVar:HMI_AmbBrt_Z04_Stat:*/
on EnvVar HMI_AmbBrt_Z04_Stat
{
    _mIL_AmbLgtCfg_Stat2_AR.AmbBrt_Z04_Stat.phys = getValue(this);
    _IL_AmbLgtCfg_Stat2_AR_SpontanFlag = 1;
}
/*@@end*/

/*@@envVar:HMI_AmbBrt_Z05_Stat:*/
on EnvVar HMI_AmbBrt_Z05_Stat
{
    _mIL_AmbLgtCfg_Stat2_AR.AmbBrt_Z05_Stat.phys = getValue(this);
    _IL_AmbLgtCfg_Stat2_AR_SpontanFlag = 1;
}
/*@@end*/

/*@@envVar:HMI_AmbBrt_Z06_Stat:*/
on EnvVar HMI_AmbBrt_Z06_Stat
{
    _mIL_AmbLgtCfg_Stat2_AR.AmbBrt_Z06_Stat.phys = getValue(this);
    _IL_AmbLgtCfg_Stat2_AR_SpontanFlag = 1;
}
/*@@end*/

/*@@envVar:HMI_AmbBrt_Z07_Stat:*/
on EnvVar HMI_AmbBrt_Z07_Stat
{
    _mIL_AmbLgtCfg_Stat2_AR.AmbBrt_Z07_Stat.phys = getValue(this);
    _IL_AmbLgtCfg_Stat2_AR_SpontanFlag = 1;
}
/*@@end*/

/*@@caplFunc:Immobilizer_Disp_Rq_AR_check_output():*/
Immobilizer_Disp_Rq_AR_check_output()
{
    if( !getValue( HMI__STMSG_Immobilizer_Disp_Rq_AR ) )
    {
        // Botschaft Immobilizer_Disp_Rq_AR ID: 1037 --- Sendeart 5 cyclicAndSpontanWithDelay --- 
        _Immobilizer_Disp_Rq_AR_Cnt--;
        if( _Immobilizer_Disp_Rq_AR_Cnt < 1 )
        {
            Immobilizer_Disp_Rq_AR_output(); // Nachricht wg. abgelaufenem Zyklus ausgeben
            _Immobilizer_Disp_Rq_AR_Cnt = _Immobilizer_Disp_Rq_AR_CycleCount; // Zyklus-Zähler zurücksetzen
            _Immobilizer_Disp_Rq_AR_SpontanFlag = 0; // Spontan-Flag zurücksetzen
        }
        else if( _Immobilizer_Disp_Rq_AR_SpontanFlag )
        {
            Immobilizer_Disp_Rq_AR_output(); // Nachricht wg. spontaner Änderung ausgeben
            _Immobilizer_Disp_Rq_AR_SpontanFlag = 0; // Spontan-Flag zurücksetzen
        }
    }
}
/*@@end*/

/*@@caplFunc:Immobilizer_Disp_Rq_AR_init():*/
Immobilizer_Disp_Rq_AR_init()
{   /* Botschaft Immobilizer_Disp_Rq_AR ID: 1037 --- Sendeart 5 cyclicAndSpontanWithDelay --- 
BA_ "ApplMessage" BO_ 1037 0;
BA_ "NmAsrMessage" BO_ 1037 0;
BA_ "GenMsgMinAcceptLength" BO_ 1037 4;
BA_ "GenMsgILSupport" BO_ 1037 1;
BA_ "DiagState" BO_ 1037 0;
BA_ "DiagRequest" BO_ 1037 0;
BA_ "DiagResponse" BO_ 1037 0;
BA_ "GenMsgStartValue" BO_ 1037 "0";
BA_ "GenMsgStartDelayTime" BO_ 1037 110;
BA_ "GenMsgDelayTime" BO_ 1037 20;
BA_ "GenMsgNrOfRepetitions" BO_ 1037 0;
BA_ "GenMsgCycleTime" BO_ 1037 1000;
BA_ "GenMsgSendType" BO_ 1037 5;
    */
    _Immobilizer_Disp_Rq_AR_Timebase =           c_tDBKomTimer_20ms;
    _Immobilizer_Disp_Rq_AR_CycleCount =      1000 / _Immobilizer_Disp_Rq_AR_Timebase;
    _Immobilizer_Disp_Rq_AR_StartDelay =       110 / _Immobilizer_Disp_Rq_AR_Timebase;
    _Immobilizer_Disp_Rq_AR_Cnt = _Immobilizer_Disp_Rq_AR_StartDelay;
    _Immobilizer_Disp_Rq_AR_SpontanFlag = 0;

    putValue( HMI__STMSGSD_Immobilizer_Disp_Rq_AR, _Immobilizer_Disp_Rq_AR_StartDelay * _Immobilizer_Disp_Rq_AR_Timebase );

    _mImmobilizer_Disp_Rq_AR.EIS_Msg0.phys = getValue( HMI_EIS_Msg0 );
    _mImmobilizer_Disp_Rq_AR.EIS_Msg1.phys = getValue( HMI_EIS_Msg1 );
    _mImmobilizer_Disp_Rq_AR.EIS_Msg3.phys = getValue( HMI_EIS_Msg3 );
    _mImmobilizer_Disp_Rq_AR.EIS_Msg4.phys = getValue( HMI_EIS_Msg4 );
    _mImmobilizer_Disp_Rq_AR.EIS_Msg5.phys = getValue( HMI_EIS_Msg5 );
    _mImmobilizer_Disp_Rq_AR.EIS_Msg6.phys = getValue( HMI_EIS_Msg6 );
    _mImmobilizer_Disp_Rq_AR.EIS_Msg7.phys = getValue( HMI_EIS_Msg7 );
    _mImmobilizer_Disp_Rq_AR.EIS_Msg8.phys = getValue( HMI_EIS_Msg8 );
    _mImmobilizer_Disp_Rq_AR.EIS_Msg9.phys = getValue( HMI_EIS_Msg9 );
    _mImmobilizer_Disp_Rq_AR.EIS_Msg10.phys = getValue( HMI_EIS_Msg10 );
    _mImmobilizer_Disp_Rq_AR.EIS_Msg11.phys = getValue( HMI_EIS_Msg11 );
    _mImmobilizer_Disp_Rq_AR.EIS_Msg12.phys = getValue( HMI_EIS_Msg12 );
    _mImmobilizer_Disp_Rq_AR.EIS_Msg13.phys = getValue( HMI_EIS_Msg13 );
    _mImmobilizer_Disp_Rq_AR.EIS_Msg14.phys = getValue( HMI_EIS_Msg14 );
    _mImmobilizer_Disp_Rq_AR.EIS_Msg15.phys = getValue( HMI_EIS_Msg15 );
    _mImmobilizer_Disp_Rq_AR.EIS_Msg16.phys = getValue( HMI_EIS_Msg16 );
    _mImmobilizer_Disp_Rq_AR.EIS_Msg17.phys = getValue( HMI_EIS_Msg17 );
    _mImmobilizer_Disp_Rq_AR.EIS_Msg18.phys = getValue( HMI_EIS_Msg18 );
}
/*@@end*/

/*@@caplFunc:Immobilizer_Disp_Rq_AR_output():*/
Immobilizer_Disp_Rq_AR_output(void)
{
    output( _mImmobilizer_Disp_Rq_AR );
}
/*@@end*/

/*@@caplFunc:Immobilizer_Disp_Rq_AR_saveEnvVars(dword):*/
Immobilizer_Disp_Rq_AR_saveEnvVars( dword hFile )
{
    filePutString("\n// Knoten EIS: Immobilizer_Disp_Rq_AR\n", 36, hFile );
    snprintf( buffer, elcount( buffer ), "0.0000 HMI__STMSG_Immobilizer_Disp_Rq_AR := %X\n", getValue( HMI__STMSG_Immobilizer_Disp_Rq_AR ) );        filePutString( buffer, elcount( buffer ), hFile );
    snprintf( buffer, elcount( buffer ), "0.0000 HMI__STMSGT_Immobilizer_Disp_Rq_AR := %X\n", getValue( HMI__STMSGT_Immobilizer_Disp_Rq_AR ) );        filePutString( buffer, elcount( buffer ), hFile );
    snprintf( buffer, elcount( buffer ), "0.0000 HMI_EIS_Msg0 := %X\n", getValue( HMI_EIS_Msg0 ) );        filePutString( buffer, elcount( buffer ), hFile );
    snprintf( buffer, elcount( buffer ), "0.0000 HMI_EIS_Msg1 := %X\n", getValue( HMI_EIS_Msg1 ) );        filePutString( buffer, elcount( buffer ), hFile );
    snprintf( buffer, elcount( buffer ), "0.0000 HMI_EIS_Msg3 := %X\n", getValue( HMI_EIS_Msg3 ) );        filePutString( buffer, elcount( buffer ), hFile );
    snprintf( buffer, elcount( buffer ), "0.0000 HMI_EIS_Msg4 := %X\n", getValue( HMI_EIS_Msg4 ) );        filePutString( buffer, elcount( buffer ), hFile );
    snprintf( buffer, elcount( buffer ), "0.0000 HMI_EIS_Msg5 := %X\n", getValue( HMI_EIS_Msg5 ) );        filePutString( buffer, elcount( buffer ), hFile );
    snprintf( buffer, elcount( buffer ), "0.0000 HMI_EIS_Msg6 := %X\n", getValue( HMI_EIS_Msg6 ) );        filePutString( buffer, elcount( buffer ), hFile );
    snprintf( buffer, elcount( buffer ), "0.0000 HMI_EIS_Msg7 := %X\n", getValue( HMI_EIS_Msg7 ) );        filePutString( buffer, elcount( buffer ), hFile );
    snprintf( buffer, elcount( buffer ), "0.0000 HMI_EIS_Msg8 := %X\n", getValue( HMI_EIS_Msg8 ) );        filePutString( buffer, elcount( buffer ), hFile );
    snprintf( buffer, elcount( buffer ), "0.0000 HMI_EIS_Msg9 := %X\n", getValue( HMI_EIS_Msg9 ) );        filePutString( buffer, elcount( buffer ), hFile );
    snprintf( buffer, elcount( buffer ), "0.0000 HMI_EIS_Msg10 := %X\n", getValue( HMI_EIS_Msg10 ) );        filePutString( buffer, elcount( buffer ), hFile );
    snprintf( buffer, elcount( buffer ), "0.0000 HMI_EIS_Msg11 := %X\n", getValue( HMI_EIS_Msg11 ) );        filePutString( buffer, elcount( buffer ), hFile );
    snprintf( buffer, elcount( buffer ), "0.0000 HMI_EIS_Msg12 := %X\n", getValue( HMI_EIS_Msg12 ) );        filePutString( buffer, elcount( buffer ), hFile );
    snprintf( buffer, elcount( buffer ), "0.0000 HMI_EIS_Msg13 := %X\n", getValue( HMI_EIS_Msg13 ) );        filePutString( buffer, elcount( buffer ), hFile );
    snprintf( buffer, elcount( buffer ), "0.0000 HMI_EIS_Msg14 := %X\n", getValue( HMI_EIS_Msg14 ) );        filePutString( buffer, elcount( buffer ), hFile );
    snprintf( buffer, elcount( buffer ), "0.0000 HMI_EIS_Msg15 := %X\n", getValue( HMI_EIS_Msg15 ) );        filePutString( buffer, elcount( buffer ), hFile );
    snprintf( buffer, elcount( buffer ), "0.0000 HMI_EIS_Msg16 := %X\n", getValue( HMI_EIS_Msg16 ) );        filePutString( buffer, elcount( buffer ), hFile );
    snprintf( buffer, elcount( buffer ), "0.0000 HMI_EIS_Msg17 := %X\n", getValue( HMI_EIS_Msg17 ) );        filePutString( buffer, elcount( buffer ), hFile );
    snprintf( buffer, elcount( buffer ), "0.0000 HMI_EIS_Msg18 := %X\n", getValue( HMI_EIS_Msg18 ) );        filePutString( buffer, elcount( buffer ), hFile );
}
/*@@end*/

/*@@timer:_tImmobilizer_Disp_Rq_AR:*/
on timer _tImmobilizer_Disp_Rq_AR
{
    putValue( HMI__STMSG_Immobilizer_Disp_Rq_AR, 0 );
}
/*@@end*/

/*@@envVar:HMI__STMSG_Immobilizer_Disp_Rq_AR:*/
on EnvVar HMI__STMSG_Immobilizer_Disp_Rq_AR
{
    long tDelay;
    if( getValue( this ) == 2 )
    {
        tDelay = getValue( HMI__STMSGT_Immobilizer_Disp_Rq_AR );
        if( tDelay > 0)    
            setTimer( _tImmobilizer_Disp_Rq_AR, tDelay );
        else
            putValue( HMI__STMSG_Immobilizer_Disp_Rq_AR, 0 );
    }
}
/*@@end*/

/*@@envVar:HMI_EIS_Msg0:*/
on EnvVar HMI_EIS_Msg0
{
    _mImmobilizer_Disp_Rq_AR.EIS_Msg0.phys = getValue(this);
    _Immobilizer_Disp_Rq_AR_SpontanFlag = 1;
}
/*@@end*/

/*@@envVar:HMI_EIS_Msg1:*/
on EnvVar HMI_EIS_Msg1
{
    _mImmobilizer_Disp_Rq_AR.EIS_Msg1.phys = getValue(this);
    _Immobilizer_Disp_Rq_AR_SpontanFlag = 1;
}
/*@@end*/

/*@@envVar:HMI_EIS_Msg3:*/
on EnvVar HMI_EIS_Msg3
{
    _mImmobilizer_Disp_Rq_AR.EIS_Msg3.phys = getValue(this);
    _Immobilizer_Disp_Rq_AR_SpontanFlag = 1;
}
/*@@end*/

/*@@envVar:HMI_EIS_Msg4:*/
on EnvVar HMI_EIS_Msg4
{
    _mImmobilizer_Disp_Rq_AR.EIS_Msg4.phys = getValue(this);
    _Immobilizer_Disp_Rq_AR_SpontanFlag = 1;
}
/*@@end*/

/*@@envVar:HMI_EIS_Msg5:*/
on EnvVar HMI_EIS_Msg5
{
    _mImmobilizer_Disp_Rq_AR.EIS_Msg5.phys = getValue(this);
    _Immobilizer_Disp_Rq_AR_SpontanFlag = 1;
}
/*@@end*/

/*@@envVar:HMI_EIS_Msg6:*/
on EnvVar HMI_EIS_Msg6
{
    _mImmobilizer_Disp_Rq_AR.EIS_Msg6.phys = getValue(this);
    _Immobilizer_Disp_Rq_AR_SpontanFlag = 1;
}
/*@@end*/

/*@@envVar:HMI_EIS_Msg7:*/
on EnvVar HMI_EIS_Msg7
{
    _mImmobilizer_Disp_Rq_AR.EIS_Msg7.phys = getValue(this);
    _Immobilizer_Disp_Rq_AR_SpontanFlag = 1;
}
/*@@end*/

/*@@envVar:HMI_EIS_Msg8:*/
on EnvVar HMI_EIS_Msg8
{
    _mImmobilizer_Disp_Rq_AR.EIS_Msg8.phys = getValue(this);
    _Immobilizer_Disp_Rq_AR_SpontanFlag = 1;
}
/*@@end*/

/*@@envVar:HMI_EIS_Msg9:*/
on EnvVar HMI_EIS_Msg9
{
    _mImmobilizer_Disp_Rq_AR.EIS_Msg9.phys = getValue(this);
    _Immobilizer_Disp_Rq_AR_SpontanFlag = 1;
}
/*@@end*/

/*@@envVar:HMI_EIS_Msg10:*/
on EnvVar HMI_EIS_Msg10
{
    _mImmobilizer_Disp_Rq_AR.EIS_Msg10.phys = getValue(this);
    _Immobilizer_Disp_Rq_AR_SpontanFlag = 1;
}
/*@@end*/

/*@@envVar:HMI_EIS_Msg11:*/
on EnvVar HMI_EIS_Msg11
{
    _mImmobilizer_Disp_Rq_AR.EIS_Msg11.phys = getValue(this);
    _Immobilizer_Disp_Rq_AR_SpontanFlag = 1;
}
/*@@end*/

/*@@envVar:HMI_EIS_Msg12:*/
on EnvVar HMI_EIS_Msg12
{
    _mImmobilizer_Disp_Rq_AR.EIS_Msg12.phys = getValue(this);
    _Immobilizer_Disp_Rq_AR_SpontanFlag = 1;
}
/*@@end*/

/*@@envVar:HMI_EIS_Msg13:*/
on EnvVar HMI_EIS_Msg13
{
    _mImmobilizer_Disp_Rq_AR.EIS_Msg13.phys = getValue(this);
    _Immobilizer_Disp_Rq_AR_SpontanFlag = 1;
}
/*@@end*/

/*@@envVar:HMI_EIS_Msg14:*/
on EnvVar HMI_EIS_Msg14
{
    _mImmobilizer_Disp_Rq_AR.EIS_Msg14.phys = getValue(this);
    _Immobilizer_Disp_Rq_AR_SpontanFlag = 1;
}
/*@@end*/

/*@@envVar:HMI_EIS_Msg15:*/
on EnvVar HMI_EIS_Msg15
{
    _mImmobilizer_Disp_Rq_AR.EIS_Msg15.phys = getValue(this);
    _Immobilizer_Disp_Rq_AR_SpontanFlag = 1;
}
/*@@end*/

/*@@envVar:HMI_EIS_Msg16:*/
on EnvVar HMI_EIS_Msg16
{
    _mImmobilizer_Disp_Rq_AR.EIS_Msg16.phys = getValue(this);
    _Immobilizer_Disp_Rq_AR_SpontanFlag = 1;
}
/*@@end*/

/*@@envVar:HMI_EIS_Msg17:*/
on EnvVar HMI_EIS_Msg17
{
    _mImmobilizer_Disp_Rq_AR.EIS_Msg17.phys = getValue(this);
    _Immobilizer_Disp_Rq_AR_SpontanFlag = 1;
}
/*@@end*/

/*@@envVar:HMI_EIS_Msg18:*/
on EnvVar HMI_EIS_Msg18
{
    _mImmobilizer_Disp_Rq_AR.EIS_Msg18.phys = getValue(this);
    _Immobilizer_Disp_Rq_AR_SpontanFlag = 1;
}
/*@@end*/

/*@@caplFunc:Immobilizer_IC_AR_check_output():*/
Immobilizer_IC_AR_check_output()
{
    if( !getValue( HMI__STMSG_Immobilizer_IC_AR ) )
    {
        // Botschaft Immobilizer_IC_AR ID: 1039 --- Sendeart 5 cyclicAndSpontanWithDelay --- 
        _Immobilizer_IC_AR_Cnt--;
        if( _Immobilizer_IC_AR_Cnt < 1 )
        {
            Immobilizer_IC_AR_output(); // Nachricht wg. abgelaufenem Zyklus ausgeben
            _Immobilizer_IC_AR_Cnt = _Immobilizer_IC_AR_CycleCount; // Zyklus-Zähler zurücksetzen
        }
    }
}
/*@@end*/

/*@@caplFunc:Immobilizer_IC_AR_init():*/
Immobilizer_IC_AR_init()
{   /* Botschaft Immobilizer_IC_AR ID: 1039 --- Sendeart 0 cyclicX --- 
BA_ "ApplMessage" BO_ 1039 0;
BA_ "NmAsrMessage" BO_ 1039 0;
BA_ "GenMsgMinAcceptLength" BO_ 1039 8;
BA_ "GenMsgILSupport" BO_ 1039 1;
BA_ "DiagState" BO_ 1039 0;
BA_ "DiagRequest" BO_ 1039 0;
BA_ "DiagResponse" BO_ 1039 0;
BA_ "GenMsgStartValue" BO_ 1039 "0";
BA_ "GenMsgStartDelayTime" BO_ 1039 240;
BA_ "GenMsgCycleTime" BO_ 1039 1000;
BA_ "GenMsgSendType" BO_ 1039 0;
    */
    dword KeyIdByte1;              // Für Ident.Schlüssel
    dword KeyIdByte2;              // Für Ident.Schlüssel
    dword KeyIdByte3;              // Für Ident.Schlüssel
    dword KeyIdByte4;              // Für Ident.Schlüssel

    _Immobilizer_IC_AR_Timebase =           c_tDBKomTimer_20ms;
    _Immobilizer_IC_AR_CycleCount =      1000 / _Immobilizer_IC_AR_Timebase;
    _Immobilizer_IC_AR_StartDelay =       240 / _Immobilizer_IC_AR_Timebase;
    _Immobilizer_IC_AR_Cnt = _Immobilizer_IC_AR_StartDelay;

    putValue( HMI__STMSGSD_Immobilizer_IC_AR, _Immobilizer_IC_AR_StartDelay * _Immobilizer_IC_AR_Timebase );

    putValue( HMI_KeyId_EIS_V2, 0xfffffffe );
    _mImmobilizer_IC_AR.Odo_EIS.phys = getValue( HMI_Odo_EIS);
    KeyIdByte1 = getvalue( Env_KeyId_EIS_V2_Byte1 );
    KeyIdByte2 = getvalue( Env_KeyId_EIS_V2_Byte2 ) * 0x100;
    KeyIdByte3 = getvalue( Env_KeyId_EIS_V2_Byte3 ) * 0x10000;
    KeyIdByte4 = getvalue( Env_KeyId_EIS_V2_Byte4 ) * 0x1000000;
  
    putValue( HMI_KeyId_EIS_V2, ( KeyIdByte4 + KeyIdByte3 + KeyIdByte2 + KeyIdByte1 ) );
    _mImmobilizer_IC_AR.KeyId_EIS_V2.phys = getValue( HMI_KeyId_EIS_V2);
}
/*@@end*/

/*@@caplFunc:Immobilizer_IC_AR_output():*/
Immobilizer_IC_AR_output(void)
{
    output( _mImmobilizer_IC_AR );
}
/*@@end*/

/*@@caplFunc:Immobilizer_IC_AR_saveEnvVars(dword):*/
Immobilizer_IC_AR_saveEnvVars( dword hFile )
{
    filePutString("\n// Knoten EIS: Immobilizer_IC_AR\n", 31, hFile );
    snprintf( buffer, elcount( buffer ), "0.0000 HMI__STMSG_Immobilizer_IC := %X\n", getValue( HMI__STMSG_Immobilizer_IC_AR ) );    filePutString( buffer, elcount( buffer ), hFile );
    snprintf( buffer, elcount( buffer ), "0.0000 HMI__STMSGT_Immobilizer_IC := %X\n", getValue( HMI__STMSGT_Immobilizer_IC_AR ) );    filePutString( buffer, elcount( buffer ), hFile );
    snprintf( buffer, elcount( buffer ), "0.0000 HMI_Odo_EIS := %f\n", getValue( HMI_Odo_EIS ) );    filePutString( buffer, elcount( buffer ), hFile );
    snprintf( buffer, elcount( buffer ), "0.0000 HMI_KeyId_EIS_V2 := %X\n", getValue( HMI_KeyId_EIS_V2 ) );    filePutString( buffer, elcount( buffer ), hFile );
    snprintf( buffer, elcount( buffer ), "0.0000 Env_KeyId_EIS_V2_Byte4 := %X\n", getValue( Env_KeyId_EIS_V2_Byte4 ) );    filePutString( buffer, elcount( buffer ), hFile );
    snprintf( buffer, elcount( buffer ), "0.0000 Env_KeyId_EIS_V2_Byte3 := %X\n", getValue( Env_KeyId_EIS_V2_Byte3 ) );    filePutString( buffer, elcount( buffer ), hFile );
    snprintf( buffer, elcount( buffer ), "0.0000 Env_KeyId_EIS_V2_Byte2 := %X\n", getValue( Env_KeyId_EIS_V2_Byte2 ) );    filePutString( buffer, elcount( buffer ), hFile );
    snprintf( buffer, elcount( buffer ), "0.0000 Env_KeyId_EIS_V2_Byte1 := %X\n", getValue( Env_KeyId_EIS_V2_Byte1 ) );    filePutString( buffer, elcount( buffer ), hFile );
}
/*@@end*/

/*@@timer:_tImmobilizer_IC_AR:*/
on timer _tImmobilizer_IC_AR
{
    putValue( HMI__STMSG_Immobilizer_IC_AR, 0 );
}
/*@@end*/

/*@@envVar:HMI__STMSG_Immobilizer_IC_AR:*/
on EnvVar HMI__STMSG_Immobilizer_IC_AR
{
    long tDelay;
    if( getValue( this ) == 2 )
    {
        tDelay = getValue( HMI__STMSGT_Immobilizer_IC_AR );
        if( tDelay > 0)    
            setTimer( _tImmobilizer_IC_AR, tDelay );
        else
            putValue( HMI__STMSG_Immobilizer_IC_AR, 0 );
    }
}
/*@@end*/

/*@@envVar:HMI_Odo_EIS:*/
on EnvVar HMI_Odo_EIS
{
    _mImmobilizer_IC_AR.Odo_EIS.phys = getValue(this);
}
/*@@end*/

/*@@caplFunc:Immobilizer_KeyID_AR_check_output():*/
Immobilizer_KeyID_AR_check_output()
{   // Botschaft Immobilizer_KeyID_AR --- Sendeart 5 cyclicAndSpontanWithDelay --- 
    if( !getValue( HMI__STMSG_Immobilizer_KeyID_AR ) ) 
    {
        // Botschaft Immobilizer_KeyID_AR ID: 1038 --- Sendeart 5 cyclicAndSpontanWithDelay --- 
        _Immobilizer_KeyID_AR_Cnt--;
        if( _Immobilizer_KeyID_AR_Cnt < 1 )
        {
            // Nachricht wg. abgelaufenem Zyklus ausgeben
            Immobilizer_KeyID_AR_output();
            _Immobilizer_KeyID_AR_Cnt = _Immobilizer_KeyID_AR_CycleCount; // Zyklus-Zähler zurücksetzen
            _Immobilizer_KeyID_AR_SpontanFlag = 0; // Spontan-Flag zurücksetzen
        }
        else if( _Immobilizer_KeyID_AR_SpontanFlag)
        {
            // Nachricht wg. spontaner Änderung ausgeben
            Immobilizer_KeyID_AR_output();
            _Immobilizer_KeyID_AR_SpontanFlag = 0; // Spontan-Flag zurücksetzen
        }
    }
}
/*@@end*/

/*@@caplFunc:Immobilizer_KeyID_AR_init():*/
Immobilizer_KeyID_AR_init()
{   /* Botschaft Immobilizer_KeyID_AR ID: 1038 --- Sendeart 5 cyclicAndSpontanWithDelay --- 
BA_ "ApplMessage" BO_ 1038 0;
BA_ "NmAsrMessage" BO_ 1038 0;
BA_ "GenMsgMinAcceptLength" BO_ 1038 6;
BA_ "GenMsgILSupport" BO_ 1038 1;
BA_ "DiagState" BO_ 1038 0;
BA_ "DiagRequest" BO_ 1038 0;
BA_ "DiagResponse" BO_ 1038 0;
BA_ "GenMsgStartValue" BO_ 1038 "0";
BA_ "GenMsgStartDelayTime" BO_ 1038 205;
BA_ "GenMsgDelayTime" BO_ 1038 200;
BA_ "GenMsgNrOfRepetitions" BO_ 1038 0;
BA_ "GenMsgCycleTime" BO_ 1038 1000;
BA_ "GenMsgSendType" BO_ 1038 5;
    */
    dword KeyIdByte1;              // Für Ident.Schlüssel
    dword KeyIdByte2;              // Für Ident.Schlüssel
    dword KeyIdByte3;              // Für Ident.Schlüssel
    dword KeyIdByte4;              // Für Ident.Schlüssel
    
    _Immobilizer_KeyID_AR_Timebase =           c_tDBKomTimer_20ms;
    _Immobilizer_KeyID_AR_CycleCount =       1000 / _Immobilizer_KeyID_AR_Timebase;
    _Immobilizer_KeyID_AR_StartDelay =        205 / _Immobilizer_KeyID_AR_Timebase;
    _Immobilizer_KeyID_AR_MinDelay =          200 / _Immobilizer_KeyID_AR_Timebase;
    _Immobilizer_KeyID_AR_Cnt = _Immobilizer_KeyID_AR_StartDelay;
    _Immobilizer_KeyID_AR_SpontanFlag = 0;
    _Immobilizer_KeyID_AR_DelayCnt = 0;

    putValue( HMI__STMSGSD_Immobilizer_KeyID_AR, _Immobilizer_KeyID_AR_StartDelay * _Immobilizer_KeyID_AR_Timebase );

    putValue( HMI_KeyId_EIS_V2, 0xfffffffe );
    _mImmobilizer_KeyID_AR.Rsrv1_Immobilizer_KeyID = getValue( HMI_Rsrv1_Immobilizer_KeyID );
    _mImmobilizer_KeyID_AR.KeyId_EIS_V2.phys = getValue( HMI_KeyId_EIS_V2 );
    KeyIdByte1 = getvalue( Env_KeyId_EIS_V2_Byte1 );
    KeyIdByte2 = getvalue( Env_KeyId_EIS_V2_Byte2 ) * 0x100;
    KeyIdByte3 = getvalue( Env_KeyId_EIS_V2_Byte3 ) * 0x10000;
    KeyIdByte4 = getvalue( Env_KeyId_EIS_V2_Byte4 ) * 0x1000000;
  
    putValue( HMI_KeyId_EIS_V2, ( KeyIdByte4 + KeyIdByte3 + KeyIdByte2 + KeyIdByte1 ) );
    _mImmobilizer_KeyID_AR.KeyId_EIS_V2.phys = getValue( HMI_KeyId_EIS_V2);
}
/*@@end*/

/*@@caplFunc:Immobilizer_KeyID_AR_output():*/
void Immobilizer_KeyID_AR_output(void)
{
    byte crc;
    byte SQC_help;

    if( !getValue( HMI_SQC_Immobilizer_KeyID_Auto ) )
    {
        // berechne message counter
        SQC_help = getValue( HMI_SQC_Immobilizer_KeyID );
        if( SQC_help >= 15 ) SQC_help = 0;
        else SQC_help++;
        putValue( HMI_SQC_Immobilizer_KeyID, SQC_help );
        _mImmobilizer_KeyID_AR.SQC_Immobilizer_KeyID = SQC_help;
    }
    else
          _mImmobilizer_KeyID_AR.SQC_Immobilizer_KeyID = getValue( HMI_SQC_Immobilizer_KeyID );

    if( !getValue( HMI_CRC_Immobilizer_KeyID_Profile_02 ) )
    {
        if( !getValue( HMI_CRC_Immobilizer_KeyID_Auto ) )
        {   // CRC according Profile_02 ( W213 )
            // berechne crc
            crc = 0xFF;
//          crc = crctable_profile02[ crc ^ _mImmobilizer_KeyID_AR.byte( 0 ) ];  CRC
            crc = crctable_profile02[ crc ^ _mImmobilizer_KeyID_AR.byte( 1 )];
            crc = crctable_profile02[ crc ^ _mImmobilizer_KeyID_AR.byte( 2 )];
            crc = crctable_profile02[ crc ^ _mImmobilizer_KeyID_AR.byte( 3 )];
            crc = crctable_profile02[ crc ^ _mImmobilizer_KeyID_AR.byte( 4 )];
            crc = crctable_profile02[ crc ^ _mImmobilizer_KeyID_AR.byte( 5 )];
          //  crc = crctable_profile02[ crc ^ _mImmobilizer_KeyID_AR.byte( 6 )];
          //  crc = crctable_profile02[ crc ^ _mImmobilizer_KeyID_AR.byte( 7 )];
            crc = crctable_profile02[ crc ^ _Immobilizer_KeyID_AR_CRC_Offset[ _mImmobilizer_KeyID_AR.SQC_Immobilizer_KeyID ] ]; // load offset
            crc = (crc ^ 0xFF);
            if( getValue(  HMI_CRC_Immobilizer_KeyID_Invalid ) )
                crc++;
            _mImmobilizer_KeyID_AR.CRC_Immobilizer_KeyID = crc;
            putValue( HMI_CRC_Immobilizer_KeyID, crc );
        }
        else
            _mImmobilizer_KeyID_AR.CRC_Immobilizer_KeyID = getValue( HMI_CRC_Immobilizer_KeyID );
    }
    else
    {
        if( !getValue( HMI_CRC_Immobilizer_KeyID_Auto ) )
        {   // CRC according to SAE1850 ( W222 )
            // berechne crc
            crc = 0xFF;
//            crc = crctable[crc ^ _mImmobilizer_KeyID_AR.byte( 0 )];  CRC
            crc = crctable[crc ^ _mImmobilizer_KeyID_AR.byte( 1 )];
            crc = crctable[crc ^ _mImmobilizer_KeyID_AR.byte( 2 )];
            crc = crctable[crc ^ _mImmobilizer_KeyID_AR.byte( 3 )];
            crc = crctable[crc ^ _mImmobilizer_KeyID_AR.byte( 4 )];
            crc = crctable[crc ^ _mImmobilizer_KeyID_AR.byte( 5 )];
         //   crc = crctable[crc ^ _mImmobilizer_KeyID_AR.byte( 6 )];
         //   crc = crctable[crc ^ _mImmobilizer_KeyID_AR.byte( 7 )];
            crc = (crc ^ 0xFF);
            if( getValue(  HMI_CRC_Immobilizer_KeyID_Invalid ) )
                crc++;
            _mImmobilizer_KeyID_AR.CRC_Immobilizer_KeyID = crc;
            putValue( HMI_CRC_Immobilizer_KeyID, crc );
        }
        else
            _mImmobilizer_KeyID_AR.CRC_Immobilizer_KeyID = getValue( HMI_CRC_Immobilizer_KeyID );
    }
    output( _mImmobilizer_KeyID_AR );
}
/*@@end*/

/*@@caplFunc:Immobilizer_KeyID_AR_saveEnvVars(dword):*/
Immobilizer_KeyID_AR_saveEnvVars( dword hFile )
{
    filePutString("\n// Knoten EIS: Immobilizer_KeyID_AR\n", 31, hFile );
    snprintf( buffer, elcount( buffer ), "0.0000 HMI__STMSG_Immobilizer_KeyID := %X\n", getValue( HMI__STMSG_Immobilizer_KeyID_AR ) );    filePutString( buffer, elcount( buffer ), hFile );
    snprintf( buffer, elcount( buffer ), "0.0000 HMI__STMSGT_Immobilizer_KeyID := %X\n", getValue( HMI__STMSGT_Immobilizer_KeyID_AR ) );    filePutString( buffer, elcount( buffer ), hFile );
    snprintf( buffer, elcount( buffer ), "0.0000 Rsrv1_Immobilizer_KeyID := %f\n", getValue( HMI_Rsrv1_Immobilizer_KeyID ) );    filePutString( buffer, elcount( buffer ), hFile );
    snprintf( buffer, elcount( buffer ), "0.0000 HMI_KeyId_EIS_V2 := %X\n", getValue( HMI_KeyId_EIS_V2 ) );    filePutString( buffer, elcount( buffer ), hFile );
    snprintf( buffer, elcount( buffer ), "0.0000 Env_KeyId_EIS_V2_Byte4 := %X\n", getValue( Env_KeyId_EIS_V2_Byte4 ) );    filePutString( buffer, elcount( buffer ), hFile );
    snprintf( buffer, elcount( buffer ), "0.0000 Env_KeyId_EIS_V2_Byte3 := %X\n", getValue( Env_KeyId_EIS_V2_Byte3 ) );    filePutString( buffer, elcount( buffer ), hFile );
    snprintf( buffer, elcount( buffer ), "0.0000 Env_KeyId_EIS_V2_Byte2 := %X\n", getValue( Env_KeyId_EIS_V2_Byte2 ) );    filePutString( buffer, elcount( buffer ), hFile );
    snprintf( buffer, elcount( buffer ), "0.0000 Env_KeyId_EIS_V2_Byte1 := %X\n", getValue( Env_KeyId_EIS_V2_Byte1 ) );    filePutString( buffer, elcount( buffer ), hFile );
}
/*@@end*/

/*@@timer:_tImmobilizer_KeyID_AR:*/
on timer _tImmobilizer_KeyID_AR
{
    putValue( HMI__STMSG_Immobilizer_KeyID_AR, 0 );
}
/*@@end*/

/*@@envVar:HMI__STMSG_Immobilizer_KeyID_AR:*/
on EnvVar HMI__STMSG_Immobilizer_KeyID_AR
{
    long tDelay;
    if( getValue( this ) == 2 )
    {
        tDelay = getValue( HMI__STMSGT_Immobilizer_KeyID_AR );
        if( tDelay > 0)    
            setTimer( _tImmobilizer_KeyID_AR, tDelay );
        else
            putValue( HMI__STMSG_Immobilizer_KeyID_AR, 0 );
    }
}
/*@@end*/

/*@@envVar:HMI_KeyId_EIS_V2:*/
on EnvVar HMI_KeyId_EIS_V2
{
    _mImmobilizer_KeyID_AR.KeyId_EIS_V2.phys = getValue(this);
    _Immobilizer_KeyID_AR_SpontanFlag = 1;

    _mImmobilizer_IC_AR.KeyId_EIS_V2.phys = getValue(this);
}
/*@@end*/

/*@@envVar:HMI_Rsrv1_Immobilizer_KeyID:*/
on EnvVar HMI_Rsrv1_Immobilizer_KeyID
{
    _mImmobilizer_KeyID_AR.Rsrv1_Immobilizer_KeyID.phys = getValue(this);
    _Immobilizer_KeyID_AR_SpontanFlag = 1;
}
/*@@end*/

/*@@caplFunc:KG_Msg_Disp_Rq_AR_check_output():*/
KG_Msg_Disp_Rq_AR_check_output()
{
    if( !getValue( HMI__STMSG_KG_Msg_Disp_Rq_AR ) )
    {
        // Botschaft KG_Msg_Disp_Rq_AR ID: 857 --- Sendeart 5 cyclicAndSpontanWithDelay --- 
        _KG_Msg_Disp_Rq_AR_Cnt--;
        if( _KG_Msg_Disp_Rq_AR_Cnt < 1 )
        {
            KG_Msg_Disp_Rq_AR_output(); // Nachricht wg. abgelaufenem Zyklus ausgeben
            _KG_Msg_Disp_Rq_AR_Cnt = _KG_Msg_Disp_Rq_AR_CycleCount; // Zyklus-Zähler zurücksetzen
            _KG_Msg_Disp_Rq_AR_SpontanFlag = 0; // Spontan-Flag zurücksetzen
        }
        else if( _KG_Msg_Disp_Rq_AR_SpontanFlag )
        {
            KG_Msg_Disp_Rq_AR_output(); // Nachricht wg. spontaner Änderung ausgeben
            _KG_Msg_Disp_Rq_AR_SpontanFlag = 0; // Spontan-Flag zurücksetzen
        }
    }
}
/*@@end*/

/*@@caplFunc:KG_Msg_Disp_Rq_AR_init():*/
KG_Msg_Disp_Rq_AR_init()
{   /* Botschaft KG_Msg_Disp_Rq_AR ID: 857 --- Sendeart 5 cyclicAndSpontanWithDelay --- 
BA_ "ApplMessage" BO_ 857 0;
BA_ "NmAsrMessage" BO_ 857 0;
BA_ "GenMsgMinAcceptLength" BO_ 857 2;
BA_ "GenMsgILSupport" BO_ 857 1;
BA_ "DiagState" BO_ 857 0;
BA_ "DiagRequest" BO_ 857 0;
BA_ "DiagResponse" BO_ 857 0;
BA_ "GenMsgStartValue" BO_ 857 "0";
BA_ "GenMsgStartDelayTime" BO_ 857 270;
BA_ "GenMsgDelayTime" BO_ 857 5;
BA_ "GenMsgNrOfRepetitions" BO_ 857 0;
BA_ "GenMsgCycleTime" BO_ 857 1000;
BA_ "GenMsgSendType" BO_ 857 5;
    */
    _KG_Msg_Disp_Rq_AR_Timebase =           c_tDBKomTimer_20ms;
    _KG_Msg_Disp_Rq_AR_CycleCount =       1000 / _KG_Msg_Disp_Rq_AR_Timebase;
    _KG_Msg_Disp_Rq_AR_StartDelay =        270 / _KG_Msg_Disp_Rq_AR_Timebase;
    _KG_Msg_Disp_Rq_AR_Cnt = _KG_Msg_Disp_Rq_AR_StartDelay;
    _KG_Msg_Disp_Rq_AR_SpontanFlag = 0;

    putValue( HMI__STMSGSD_KG_Msg_Disp_Rq_AR, _KG_Msg_Disp_Rq_AR_StartDelay * _KG_Msg_Disp_Rq_AR_Timebase );

    _mKG_Msg_Disp_Rq_AR.KG_Msg0.phys = getValue( HMI_KG_Msg0 );
    _mKG_Msg_Disp_Rq_AR.KG_Msg1.phys = getValue( HMI_KG_Msg1 );
    _mKG_Msg_Disp_Rq_AR.KG_Msg2.phys = getValue( HMI_KG_Msg2 );
    _mKG_Msg_Disp_Rq_AR.KG_Msg3.phys = getValue( HMI_KG_Msg3 );
    _mKG_Msg_Disp_Rq_AR.KG_Msg4.phys = getValue( HMI_KG_Msg4 );
    _mKG_Msg_Disp_Rq_AR.KG_Msg5.phys = getValue( HMI_KG_Msg5 );
    _mKG_Msg_Disp_Rq_AR.KG_Msg8.phys = getValue( HMI_KG_Msg8 );
    _mKG_Msg_Disp_Rq_AR.KG_Msg12.phys = getValue( HMI_KG_Msg12 );
}
/*@@end*/

/*@@caplFunc:KG_Msg_Disp_Rq_AR_output():*/
KG_Msg_Disp_Rq_AR_output(void)
{
    output( _mKG_Msg_Disp_Rq_AR );
}
/*@@end*/

/*@@caplFunc:KG_Msg_Disp_Rq_AR_saveEnvVars(dword):*/
KG_Msg_Disp_Rq_AR_saveEnvVars( dword hFile )
{
    filePutString("\n// Knoten EIS: KG_Msg_Disp_Rq_AR\n", 31, hFile );
    snprintf( buffer, elcount( buffer ), "0.0000 HMI__STMSG_KG_Msg_Disp_Rq := %X\n", getValue( HMI__STMSG_KG_Msg_Disp_Rq_AR ) );    filePutString( buffer, elcount( buffer ), hFile );
    snprintf( buffer, elcount( buffer ), "0.0000 HMI__STMSGT_KG_Msg_Disp_Rq := %X\n", getValue( HMI__STMSGT_KG_Msg_Disp_Rq_AR ) );    filePutString( buffer, elcount( buffer ), hFile );
    snprintf( buffer, elcount( buffer ), "0.0000 HMI_KG_Msg0 := %X\n", getValue( HMI_KG_Msg0 ) );    filePutString( buffer, elcount( buffer ), hFile );
    snprintf( buffer, elcount( buffer ), "0.0000 HMI_KG_Msg1 := %X\n", getValue( HMI_KG_Msg1 ) );    filePutString( buffer, elcount( buffer ), hFile );
    snprintf( buffer, elcount( buffer ), "0.0000 HMI_KG_Msg12 := %X\n", getValue( HMI_KG_Msg12 ) );    filePutString( buffer, elcount( buffer ), hFile );
    snprintf( buffer, elcount( buffer ), "0.0000 HMI_KG_Msg2 := %X\n", getValue( HMI_KG_Msg2 ) );    filePutString( buffer, elcount( buffer ), hFile );
    snprintf( buffer, elcount( buffer ), "0.0000 HMI_KG_Msg3 := %X\n", getValue( HMI_KG_Msg3 ) );    filePutString( buffer, elcount( buffer ), hFile );
    snprintf( buffer, elcount( buffer ), "0.0000 HMI_KG_Msg4 := %X\n", getValue( HMI_KG_Msg4 ) );    filePutString( buffer, elcount( buffer ), hFile );
    snprintf( buffer, elcount( buffer ), "0.0000 HMI_KG_Msg5 := %X\n", getValue( HMI_KG_Msg5 ) );    filePutString( buffer, elcount( buffer ), hFile );
    snprintf( buffer, elcount( buffer ), "0.0000 HMI_KG_Msg8 := %X\n", getValue( HMI_KG_Msg8 ) );    filePutString( buffer, elcount( buffer ), hFile );
}
/*@@end*/

/*@@timer:_tKG_Msg_Disp_Rq_AR:*/
on timer _tKG_Msg_Disp_Rq_AR
{
    putValue( HMI__STMSG_KG_Msg_Disp_Rq_AR, 0 );
}
/*@@end*/

/*@@envVar:HMI__STMSG_KG_Msg_Disp_Rq_AR:*/
on EnvVar HMI__STMSG_KG_Msg_Disp_Rq_AR
{
    long tDelay;
    if( getValue( this ) == 2 )
    {
        tDelay = getValue( HMI__STMSGT_KG_Msg_Disp_Rq_AR );
        if( tDelay > 0)    
            setTimer( _tKG_Msg_Disp_Rq_AR, tDelay );
        else
            putValue( HMI__STMSG_KG_Msg_Disp_Rq_AR, 0 );
    }
}
/*@@end*/

/*@@envVar:HMI_KG_Msg0:*/
on EnvVar HMI_KG_Msg0
{
    _mKG_Msg_Disp_Rq_AR.KG_Msg0.phys = getValue(this);
    _KG_Msg_Disp_Rq_AR_SpontanFlag = 1;
}
/*@@end*/

/*@@envVar:HMI_KG_Msg1:*/
on EnvVar HMI_KG_Msg1
{
    _mKG_Msg_Disp_Rq_AR.KG_Msg1.phys = getValue(this);
    _KG_Msg_Disp_Rq_AR_SpontanFlag = 1;
}
/*@@end*/

/*@@envVar:HMI_KG_Msg2:*/
on EnvVar HMI_KG_Msg2
{
    _mKG_Msg_Disp_Rq_AR.KG_Msg2.phys = getValue(this);
    _KG_Msg_Disp_Rq_AR_SpontanFlag = 1;
}
/*@@end*/

/*@@envVar:HMI_KG_Msg3:*/
on EnvVar HMI_KG_Msg3
{
    _mKG_Msg_Disp_Rq_AR.KG_Msg3.phys = getValue(this);
    _KG_Msg_Disp_Rq_AR_SpontanFlag = 1;
}
/*@@end*/

/*@@envVar:HMI_KG_Msg4:*/
on EnvVar HMI_KG_Msg4
{
    _mKG_Msg_Disp_Rq_AR.KG_Msg4.phys = getValue(this);
    _KG_Msg_Disp_Rq_AR_SpontanFlag = 1;
}
/*@@end*/

/*@@envVar:HMI_KG_Msg5:*/
on EnvVar HMI_KG_Msg5
{
    _mKG_Msg_Disp_Rq_AR.KG_Msg5.phys = getValue(this);
    _KG_Msg_Disp_Rq_AR_SpontanFlag = 1;
}
/*@@end*/

/*@@envVar:HMI_KG_Msg8:*/
on EnvVar HMI_KG_Msg8
{
    _mKG_Msg_Disp_Rq_AR.KG_Msg8.phys = getValue(this);
    _KG_Msg_Disp_Rq_AR_SpontanFlag = 1;
}
/*@@end*/

/*@@envVar:HMI_KG_Msg12:*/
on EnvVar HMI_KG_Msg12
{
    if( ( getValue( Env_Stress__StresstestMainActiv ) == 0 )   &&
        ( getValue( HMI__NM_EIS_AutomaticNM_Switching ) == 0 )    )
    {
        _SetCommRequest( cWakeWarningNMRequest );
        setTimer( t_WakeWarningNMCancelTimer, c_NMCancelTimer_05sec ); // 5 seconds for auto-shut-off
    }
    _mKG_Msg_Disp_Rq_AR.KG_Msg12.phys = getValue(this);
    _KG_Msg_Disp_Rq_AR_SpontanFlag = 1;
}
/*@@end*/

/*@@caplFunc:LDC_Disp_Rq_ESP_AR_check_output():*/
LDC_Disp_Rq_ESP_AR_check_output()
{
    if( !getValue( HMI__STMSG_LDC_Disp_Rq_ESP_AR ) )
    {
        // Botschaft LDC_Disp_Rq_ESP_AR ID: 1047 --- Sendeart 5 cyclicAndSpontanWithDelay --- 
        _LDC_Disp_Rq_ESP_AR_Cnt--;
        if( _LDC_Disp_Rq_ESP_AR_Cnt < 1 )
        {
            LDC_Disp_Rq_ESP_AR_output(); // Nachricht wg. abgelaufenem Zyklus ausgeben
            _LDC_Disp_Rq_ESP_AR_Cnt = _LDC_Disp_Rq_ESP_AR_CycleCount; // Zyklus-Zähler zurücksetzen
            _LDC_Disp_Rq_ESP_AR_SpontanFlag = 0; // Spontan-Flag zurücksetzen
        }
        else if( _LDC_Disp_Rq_ESP_AR_SpontanFlag)
        {
            LDC_Disp_Rq_ESP_AR_output(); // Nachricht wg. spontaner Änderung ausgeben
            _LDC_Disp_Rq_ESP_AR_SpontanFlag = 0; // Spontan-Flag zurücksetzen
        }
    }
}
/*@@end*/

/*@@caplFunc:LDC_Disp_Rq_ESP_AR_init():*/
LDC_Disp_Rq_ESP_AR_init()
{   /* Botschaft LDC_Disp_Rq_ESP_AR ID: 1047 --- Sendeart 5 cyclicAndSpontanWithDelay --- 
BA_ "ApplMessage" BO_ 1047 0;
BA_ "NmAsrMessage" BO_ 1047 0;
BA_ "GenMsgMinAcceptLength" BO_ 1047 8;
BA_ "GenMsgILSupport" BO_ 1047 1;
BA_ "DiagState" BO_ 1047 0;
BA_ "DiagRequest" BO_ 1047 0;
BA_ "DiagResponse" BO_ 1047 0;
BA_ "GenMsgStartValue" BO_ 1047 "0";
BA_ "GenMsgStartDelayTime" BO_ 1047 0;
BA_ "GenMsgDelayTime" BO_ 1047 5;
BA_ "GenMsgNrOfRepetitions" BO_ 1047 0;
BA_ "GenMsgCycleTime" BO_ 1047 200;
BA_ "GenMsgSendType" BO_ 1047 5;
    */
    _LDC_Disp_Rq_ESP_AR_Timebase =           c_tDBKomTimer_20ms;
    _LDC_Disp_Rq_ESP_AR_CycleCount =        200 / _LDC_Disp_Rq_ESP_AR_Timebase;
    _LDC_Disp_Rq_ESP_AR_StartDelay =          0 / _LDC_Disp_Rq_ESP_AR_Timebase;
    _LDC_Disp_Rq_ESP_AR_Cnt = _LDC_Disp_Rq_ESP_AR_StartDelay;
    _LDC_Disp_Rq_ESP_AR_SpontanFlag = 0;

    putValue( HMI__STMSGSD_LDC_Disp_Rq_ESP_AR, _LDC_Disp_Rq_ESP_AR_StartDelay * _LDC_Disp_Rq_ESP_AR_Timebase );

    _mLDC_Disp_Rq_ESP_AR.LDC_AcustWarn_Rq.phys = getValue( HMI_LDC_AcustWarn_Rq );
    _mLDC_Disp_Rq_ESP_AR.LDC_DTR_MM_Ctrl_Actv.phys = getValue( HMI_LDC_DTR_MM_Ctrl_Actv );
    _mLDC_Disp_Rq_ESP_AR.LDC_DTR_MsgDisp_Rq.phys = getValue( HMI_LDC_DTR_MsgDisp_Rq );
    _mLDC_Disp_Rq_ESP_AR.LDC_DTR_Stat.phys = getValue( HMI_LDC_DTR_Stat );
    _mLDC_Disp_Rq_ESP_AR.LDC_IconDisp_Rq_ESP.phys = getValue( HMI_LDC_IconDisp_Rq_ESP );
    _mLDC_Disp_Rq_ESP_AR.LDC_Master.phys = getValue( HMI_LDC_Master );
    _mLDC_Disp_Rq_ESP_AR.LDC_MsgDisp_Rq.phys = getValue( HMI_LDC_MsgDisp_Rq );
    _mLDC_Disp_Rq_ESP_AR.LDC_MsgDisp_TrgrRq.phys = getValue( HMI_LDC_MsgDisp_TrgrRq );
    _mLDC_Disp_Rq_ESP_AR.LDC_Spd_Add.phys = getValue( HMI_LDC_Spd_Add );
    _mLDC_Disp_Rq_ESP_AR.LDC_Spd_Dsr.phys = getValue( HMI_LDC_Spd_Dsr );
    _mLDC_Disp_Rq_ESP_AR.LDC_SpdUnit_Rs.phys = getValue( HMI_LDC_SpdUnit_Rs );
    _mLDC_Disp_Rq_ESP_AR.LDC_SPEEDO_SegRing_Disp_Rq.phys = getValue( HMI_LDC_SPEEDO_SegRing_Disp_Rq );
    _mLDC_Disp_Rq_ESP_AR.LDC_VSL_On.phys = getValue( HMI_LDC_VSL_On );
    _mLDC_Disp_Rq_ESP_AR.LDC_WTSL_Flt.phys = getValue( HMI_LDC_WTSL_Flt );
    _mLDC_Disp_Rq_ESP_AR.LDC_WTSL_Spd_Max_Disp_TrgrRq.phys = getValue( HMI_LDC_WTSL_Spd_Max_Disp_TrgrRq );
    _mLDC_Disp_Rq_ESP_AR.LDC_WTSL_Spd_Max_Stat.phys = getValue( HMI_LDC_WTSL_Spd_Max_Stat );
}
/*@@end*/

/*@@caplFunc:LDC_Disp_Rq_ESP_AR_output():*/
LDC_Disp_Rq_ESP_AR_output(void)
{
    output( _mLDC_Disp_Rq_ESP_AR );
}
/*@@end*/

/*@@caplFunc:LDC_Disp_Rq_ESP_AR_saveEnvVars(dword):*/
LDC_Disp_Rq_ESP_AR_saveEnvVars( dword hFile )
{
    filePutString("\n// Knoten EIS: LDC_Disp_Rq_ESP_AR\n", 32, hFile );
    snprintf( buffer, elcount( buffer ), "0.0000 HMI__STMSG_LDC_Disp_Rq_ESP := %X\n", getValue( HMI__STMSG_LDC_Disp_Rq_ESP_AR ) );    filePutString( buffer, elcount( buffer ), hFile );
    snprintf( buffer, elcount( buffer ), "0.0000 HMI__STMSGT_LDC_Disp_Rq_ESP := %X\n", getValue( HMI__STMSGT_LDC_Disp_Rq_ESP_AR ) );    filePutString( buffer, elcount( buffer ), hFile );
    snprintf( buffer, elcount( buffer ), "0.0000 HMI_LDC_AcustWarn_Rq := %X\n", getValue( HMI_LDC_AcustWarn_Rq ) );    filePutString( buffer, elcount( buffer ), hFile );
    snprintf( buffer, elcount( buffer ), "0.0000 HMI_LDC_DTR_MM_Ctrl_Actv := %X\n", getValue( HMI_LDC_DTR_MM_Ctrl_Actv ) );    filePutString( buffer, elcount( buffer ), hFile );
    snprintf( buffer, elcount( buffer ), "0.0000 HMI_LDC_DTR_MsgDisp_Rq := %X\n", getValue( HMI_LDC_DTR_MsgDisp_Rq ) );    filePutString( buffer, elcount( buffer ), hFile );
    snprintf( buffer, elcount( buffer ), "0.0000 HMI_LDC_DTR_Stat := %X\n", getValue( HMI_LDC_DTR_Stat ) );    filePutString( buffer, elcount( buffer ), hFile );
    snprintf( buffer, elcount( buffer ), "0.0000 HMI_LDC_IconDisp_Rq_ESP := %X\n", getValue( HMI_LDC_IconDisp_Rq_ESP ) );    filePutString( buffer, elcount( buffer ), hFile );
    snprintf( buffer, elcount( buffer ), "0.0000 HMI_LDC_Master := %X\n", getValue( HMI_LDC_Master ) );    filePutString( buffer, elcount( buffer ), hFile );
    snprintf( buffer, elcount( buffer ), "0.0000 HMI_LDC_MsgDisp_Rq := %X\n", getValue( HMI_LDC_MsgDisp_Rq ) );    filePutString( buffer, elcount( buffer ), hFile );
    snprintf( buffer, elcount( buffer ), "0.0000 HMI_LDC_MsgDisp_TrgrRq := %X\n", getValue( HMI_LDC_MsgDisp_TrgrRq ) );    filePutString( buffer, elcount( buffer ), hFile );
    snprintf( buffer, elcount( buffer ), "0.0000 HMI_LDC_Spd_Add := %X\n", getValue( HMI_LDC_Spd_Add ) );    filePutString( buffer, elcount( buffer ), hFile );
    snprintf( buffer, elcount( buffer ), "0.0000 HMI_LDC_Spd_Dsr := %X\n", getValue( HMI_LDC_Spd_Dsr ) );    filePutString( buffer, elcount( buffer ), hFile );
    snprintf( buffer, elcount( buffer ), "0.0000 HMI_LDC_SpdUnit_Rs := %X\n", getValue( HMI_LDC_SpdUnit_Rs ) );    filePutString( buffer, elcount( buffer ), hFile );
    snprintf( buffer, elcount( buffer ), "0.0000 HMI_LDC_SPEEDO_SegRing_Disp_Rq := %X\n", getValue( HMI_LDC_SPEEDO_SegRing_Disp_Rq ) );    filePutString( buffer, elcount( buffer ), hFile );
    snprintf( buffer, elcount( buffer ), "0.0000 HMI_LDC_VSL_On := %X\n", getValue( HMI_LDC_VSL_On ) );    filePutString( buffer, elcount( buffer ), hFile );
    snprintf( buffer, elcount( buffer ), "0.0000 HMI_LDC_WTSL_Flt := %X\n", getValue( HMI_LDC_WTSL_Flt ) );    filePutString( buffer, elcount( buffer ), hFile );
    snprintf( buffer, elcount( buffer ), "0.0000 HMI_LDC_WTSL_Spd_Max_Disp_TrgrRq := %X\n", getValue( HMI_LDC_WTSL_Spd_Max_Disp_TrgrRq ) );    filePutString( buffer, elcount( buffer ), hFile );
    snprintf( buffer, elcount( buffer ), "0.0000 HMI_LDC_WTSL_Spd_Max_Stat := %X\n", getValue( HMI_LDC_WTSL_Spd_Max_Stat ) );    filePutString( buffer, elcount( buffer ), hFile );
}
/*@@end*/

/*@@timer:_tLDC_Disp_Rq_ESP_AR:*/
on timer _tLDC_Disp_Rq_ESP_AR
{
    putValue( HMI__STMSG_LDC_Disp_Rq_ESP_AR, 0 );
}
/*@@end*/

/*@@envVar:HMI__STMSG_LDC_Disp_Rq_ESP_AR:*/
on EnvVar HMI__STMSG_LDC_Disp_Rq_ESP_AR
{
    long tDelay;
    if( getValue( this ) == 2 )
    {
        tDelay = getValue( HMI__STMSGT_LDC_Disp_Rq_ESP_AR );
        if( tDelay > 0)    
            setTimer( _tLDC_Disp_Rq_ESP_AR, tDelay );
        else
            putValue( HMI__STMSG_LDC_Disp_Rq_ESP_AR, 0 );
    }
}
/*@@end*/

/*@@envVar:HMI_LDC_AcustWarn_Rq:*/
on EnvVar HMI_LDC_AcustWarn_Rq
{
    _mLDC_Disp_Rq_ESP_AR.LDC_AcustWarn_Rq.phys = getValue(this);
    _LDC_Disp_Rq_ESP_AR_SpontanFlag = 1;
}
/*@@end*/

/*@@envVar:HMI_LDC_DTR_MM_Ctrl_Actv:*/
on EnvVar HMI_LDC_DTR_MM_Ctrl_Actv
{
    _mLDC_Disp_Rq_ESP_AR.LDC_DTR_MM_Ctrl_Actv.phys = getValue(this);
    _LDC_Disp_Rq_ESP_AR_SpontanFlag = 1;
}
/*@@end*/

/*@@envVar:HMI_LDC_DTR_MsgDisp_Rq:*/
on EnvVar HMI_LDC_DTR_MsgDisp_Rq
{
    _mLDC_Disp_Rq_ESP_AR.LDC_DTR_MsgDisp_Rq.phys = getValue(this);
    _LDC_Disp_Rq_ESP_AR_SpontanFlag = 1;
}
/*@@end*/

/*@@envVar:HMI_LDC_DTR_Stat:*/
on EnvVar HMI_LDC_DTR_Stat
{
    _mLDC_Disp_Rq_ESP_AR.LDC_DTR_Stat.phys = getValue(this);
    _LDC_Disp_Rq_ESP_AR_SpontanFlag = 1;
}
/*@@end*/

/*@@envVar:HMI_LDC_IconDisp_Rq_ESP:*/
on EnvVar HMI_LDC_IconDisp_Rq_ESP
{
    _mLDC_Disp_Rq_ESP_AR.LDC_IconDisp_Rq_ESP.phys = getValue(this);
    _LDC_Disp_Rq_ESP_AR_SpontanFlag = 1;
}
/*@@end*/

/*@@envVar:HMI_LDC_Master:*/
on EnvVar HMI_LDC_Master
{
    _mLDC_Disp_Rq_ESP_AR.LDC_Master.phys = getValue(this);
    _LDC_Disp_Rq_ESP_AR_SpontanFlag = 1;
}
/*@@end*/

/*@@envVar:HMI_LDC_MsgDisp_Rq:*/
on EnvVar HMI_LDC_MsgDisp_Rq
{
    _mLDC_Disp_Rq_ESP_AR.LDC_MsgDisp_Rq.phys = getValue(this);
    _LDC_Disp_Rq_ESP_AR_SpontanFlag = 1;
}
/*@@end*/

/*@@envVar:HMI_LDC_MsgDisp_TrgrRq:*/
on EnvVar HMI_LDC_MsgDisp_TrgrRq
{
    _mLDC_Disp_Rq_ESP_AR.LDC_MsgDisp_TrgrRq.phys = getValue(this);
    _LDC_Disp_Rq_ESP_AR_SpontanFlag = 1;
}
/*@@end*/

/*@@envVar:HMI_LDC_Spd_Add:*/
on EnvVar HMI_LDC_Spd_Add
{
    _mLDC_Disp_Rq_ESP_AR.LDC_Spd_Add.phys = getValue(this);
    _LDC_Disp_Rq_ESP_AR_SpontanFlag = 1;
}
/*@@end*/

/*@@envVar:HMI_LDC_Spd_Dsr:*/
on EnvVar HMI_LDC_Spd_Dsr
{
    _mLDC_Disp_Rq_ESP_AR.LDC_Spd_Dsr.phys = getValue(this);
    _LDC_Disp_Rq_ESP_AR_SpontanFlag = 1;
}
/*@@end*/

/*@@envVar:HMI_LDC_SpdUnit_Rs:*/
on EnvVar HMI_LDC_SpdUnit_Rs
{
    _mLDC_Disp_Rq_ESP_AR.LDC_SpdUnit_Rs.phys = getValue(this);
    _LDC_Disp_Rq_ESP_AR_SpontanFlag = 1;
}
/*@@end*/

/*@@envVar:HMI_LDC_SPEEDO_SegRing_Disp_Rq:*/
on EnvVar HMI_LDC_SPEEDO_SegRing_Disp_Rq
{
    _mLDC_Disp_Rq_ESP_AR.LDC_SPEEDO_SegRing_Disp_Rq.phys = getValue(this);
    _LDC_Disp_Rq_ESP_AR_SpontanFlag = 1;
}
/*@@end*/

/*@@envVar:HMI_LDC_VSL_On:*/
on EnvVar HMI_LDC_VSL_On
{
    _mLDC_Disp_Rq_ESP_AR.LDC_VSL_On.phys = getValue(this);
    _LDC_Disp_Rq_ESP_AR_SpontanFlag = 1;
}
/*@@end*/

/*@@envVar:HMI_LDC_WTSL_Flt:*/
on EnvVar HMI_LDC_WTSL_Flt
{
    _mLDC_Disp_Rq_ESP_AR.LDC_WTSL_Flt.phys = getValue(this);
    _LDC_Disp_Rq_ESP_AR_SpontanFlag = 1;
}
/*@@end*/

/*@@envVar:HMI_LDC_WTSL_Spd_Max_Disp_TrgrRq:*/
on EnvVar HMI_LDC_WTSL_Spd_Max_Disp_TrgrRq
{
    _mLDC_Disp_Rq_ESP_AR.LDC_WTSL_Spd_Max_Disp_TrgrRq.phys = getValue(this);
    _LDC_Disp_Rq_ESP_AR_SpontanFlag = 1;
}
/*@@end*/

/*@@envVar:HMI_LDC_WTSL_Spd_Max_Stat:*/
on EnvVar HMI_LDC_WTSL_Spd_Max_Stat
{
    _mLDC_Disp_Rq_ESP_AR.LDC_WTSL_Spd_Max_Stat.phys = getValue(this);
    _LDC_Disp_Rq_ESP_AR_SpontanFlag = 1;
}
/*@@end*/

/*@@caplFunc:LDC_Disp_Rq_RDU_AR_check_output():*/
LDC_Disp_Rq_RDU_AR_check_output()
{
    if( !getValue( HMI__STMSG_LDC_Disp_Rq_RDU_AR ) )
    {
        // Botschaft LDC_Disp_Rq_RDU_AR ID: 1027 --- Sendeart 5 cyclicAndSpontanWithDelay --- 
        _LDC_Disp_Rq_RDU_AR_Cnt--;
        if( _LDC_Disp_Rq_RDU_AR_Cnt < 1 )
        {
            LDC_Disp_Rq_RDU_AR_output(); // Nachricht wg. abgelaufenem Zyklus ausgeben
            _LDC_Disp_Rq_RDU_AR_Cnt = _LDC_Disp_Rq_RDU_AR_CycleCount; // Zyklus-Zähler zurücksetzen
            _LDC_Disp_Rq_RDU_AR_SpontanFlag = 0; // Spontan-Flag zurücksetzen
        }
        else if( _LDC_Disp_Rq_RDU_AR_SpontanFlag)
        {
            LDC_Disp_Rq_RDU_AR_output(); // Nachricht wg. spontaner Änderung ausgeben
            _LDC_Disp_Rq_RDU_AR_SpontanFlag = 0; // Spontan-Flag zurücksetzen
        }
    }
}
/*@@end*/

/*@@caplFunc:LDC_Disp_Rq_RDU_AR_init():*/
LDC_Disp_Rq_RDU_AR_init()
{   /* Botschaft LDC_Disp_Rq_RDU_AR ID: 1027 --- Sendeart 5 cyclicAndSpontanWithDelay --- 
BA_ "ApplMessage" BO_ 1027 0;
BA_ "NmAsrMessage" BO_ 1027 0;
BA_ "GenMsgMinAcceptLength" BO_ 1027 8;
BA_ "GenMsgILSupport" BO_ 1027 1;
BA_ "DiagState" BO_ 1027 0;
BA_ "DiagRequest" BO_ 1027 0;
BA_ "DiagResponse" BO_ 1027 0;
BA_ "GenMsgStartValue" BO_ 1027 "0";
BA_ "GenMsgStartDelayTime" BO_ 1027 0;
BA_ "GenMsgDelayTime" BO_ 1027 5;
BA_ "GenMsgNrOfRepetitions" BO_ 1027 0;
BA_ "GenMsgCycleTime" BO_ 1027 200;
BA_ "GenMsgSendType" BO_ 1027 5;
    */
    _LDC_Disp_Rq_RDU_AR_Timebase =           c_tDBKomTimer_20ms;
    _LDC_Disp_Rq_RDU_AR_CycleCount =        200 / _LDC_Disp_Rq_RDU_AR_Timebase;
    _LDC_Disp_Rq_RDU_AR_StartDelay =          0 / _LDC_Disp_Rq_RDU_AR_Timebase;
    _LDC_Disp_Rq_RDU_AR_Cnt = _LDC_Disp_Rq_RDU_AR_StartDelay;
    _LDC_Disp_Rq_RDU_AR_SpontanFlag = 0;

    putValue( HMI__STMSGSD_LDC_Disp_Rq_RDU_AR, _LDC_Disp_Rq_RDU_AR_StartDelay * _LDC_Disp_Rq_RDU_AR_Timebase );

    _mLDC_Disp_Rq_RDU_AR.LDC_AcustWarn_Rq_RDU.phys = getValue( HMI_LDC_AcustWarn_Rq_RDU );
    _mLDC_Disp_Rq_RDU_AR.LDC_CMS_MsgDisp_Rq_RDU.phys = getValue( HMI_LDC_CMS_MsgDisp_Rq_RDU );
    _mLDC_Disp_Rq_RDU_AR.LDC_CMS_Stat_RDU.phys = getValue( HMI_LDC_CMS_Stat_RDU );
    _mLDC_Disp_Rq_RDU_AR.LDC_Dist_Dsr_RDU.phys = getValue( HMI_LDC_Dist_Dsr_RDU );
    _mLDC_Disp_Rq_RDU_AR.LDC_Dist_RDU.phys = getValue( HMI_LDC_Dist_RDU );
    _mLDC_Disp_Rq_RDU_AR.LDC_DTR_IndLmp_On_Rq_RDU.phys = getValue( HMI_LDC_DTR_IndLmp_On_Rq_RDU );
    _mLDC_Disp_Rq_RDU_AR.LDC_DTR_MsgDisp_Rq_RDU.phys = getValue( HMI_LDC_DTR_MsgDisp_Rq_RDU );
    _mLDC_Disp_Rq_RDU_AR.LDC_DTR_Stat_RDU_V2.phys = getValue( HMI_LDC_DTR_Stat_RDU_V2 );
    _mLDC_Disp_Rq_RDU_AR.LDC_IconDisp_Rq_RDU.phys = getValue( HMI_LDC_IconDisp_Rq_RDU );
    _mLDC_Disp_Rq_RDU_AR.LDC_MsgDisp_Rq_RDU.phys = getValue( HMI_LDC_MsgDisp_Rq_RDU );
    _mLDC_Disp_Rq_RDU_AR.LDC_MsgDisp_TrgrRq_RDU.phys = getValue( HMI_LDC_MsgDisp_TrgrRq_RDU );
    _mLDC_Disp_Rq_RDU_AR.LDC_RadarSensSoil_Disp_Rq_RDU.phys = getValue( HMI_LDC_RadarSensSoil_Disp_Rq_RDU );
    _mLDC_Disp_Rq_RDU_AR.LDC_Spd_Add_RDU.phys = getValue( HMI_LDC_Spd_Add_RDU );
    _mLDC_Disp_Rq_RDU_AR.LDC_Spd_Dsr_RDU.phys = getValue( HMI_LDC_Spd_Dsr_RDU );
    _mLDC_Disp_Rq_RDU_AR.LDC_SpdUnit_Rs_RDU.phys = getValue( HMI_LDC_SpdUnit_Rs_RDU );
    _mLDC_Disp_Rq_RDU_AR.LDC_SPEEDO_SegRing_Disp_Rq_RDU.phys = getValue( HMI_LDC_SPEEDO_SegRing_Disp_Rq_RDU );
    _mLDC_Disp_Rq_RDU_AR.TSA_Warn_Supp_Rq_RDU.phys = getValue( HMI_TSA_Warn_Supp_Rq_RDU );
}
/*@@end*/

/*@@caplFunc:LDC_Disp_Rq_RDU_AR_output():*/
LDC_Disp_Rq_RDU_AR_output(void)
{
    output( _mLDC_Disp_Rq_RDU_AR );
}
/*@@end*/

/*@@caplFunc:LDC_Disp_Rq_RDU_AR_saveEnvVars(dword):*/
LDC_Disp_Rq_RDU_AR_saveEnvVars( dword hFile )
{
    filePutString("\n// Knoten EIS: LDC_Disp_Rq_RDU_AR\n", 32, hFile );
    snprintf( buffer, elcount( buffer ), "0.0000 HMI__STMSG_LDC_Disp_Rq_RDU := %X\n", getValue( HMI__STMSG_LDC_Disp_Rq_RDU_AR ) );    filePutString( buffer, elcount( buffer ), hFile );
    snprintf( buffer, elcount( buffer ), "0.0000 HMI__STMSGT_LDC_Disp_Rq_RDU := %X\n", getValue( HMI__STMSGT_LDC_Disp_Rq_RDU_AR ) );    filePutString( buffer, elcount( buffer ), hFile );
    snprintf( buffer, elcount( buffer ), "0.0000 HMI_LDC_AcustWarn_Rq_RDU := %X\n", getValue( HMI_LDC_AcustWarn_Rq_RDU ) );    filePutString( buffer, elcount( buffer ), hFile );
    snprintf( buffer, elcount( buffer ), "0.0000 HMI_LDC_CMS_MsgDisp_Rq_RDU := %X\n", getValue( HMI_LDC_CMS_MsgDisp_Rq_RDU ) );    filePutString( buffer, elcount( buffer ), hFile );
    snprintf( buffer, elcount( buffer ), "0.0000 HMI_LDC_CMS_Stat_RDU := %X\n", getValue( HMI_LDC_CMS_Stat_RDU ) );    filePutString( buffer, elcount( buffer ), hFile );
    snprintf( buffer, elcount( buffer ), "0.0000 HMI_LDC_Dist_Dsr_RDU := %X\n", getValue( HMI_LDC_Dist_Dsr_RDU ) );    filePutString( buffer, elcount( buffer ), hFile );
    snprintf( buffer, elcount( buffer ), "0.0000 HMI_LDC_Dist_RDU := %X\n", getValue( HMI_LDC_Dist_RDU ) );    filePutString( buffer, elcount( buffer ), hFile );
    snprintf( buffer, elcount( buffer ), "0.0000 HMI_LDC_DTR_IndLmp_On_Rq_RDU := %X\n", getValue( HMI_LDC_DTR_IndLmp_On_Rq_RDU ) );    filePutString( buffer, elcount( buffer ), hFile );
    snprintf( buffer, elcount( buffer ), "0.0000 HMI_LDC_DTR_MsgDisp_Rq_RDU := %X\n", getValue( HMI_LDC_DTR_MsgDisp_Rq_RDU ) );    filePutString( buffer, elcount( buffer ), hFile );
    snprintf( buffer, elcount( buffer ), "0.0000 HMI_LDC_DTR_Stat_RDU_V2 := %X\n", getValue( HMI_LDC_DTR_Stat_RDU_V2 ) );    filePutString( buffer, elcount( buffer ), hFile );
    snprintf( buffer, elcount( buffer ), "0.0000 HMI_LDC_IconDisp_Rq_RDU := %X\n", getValue( HMI_LDC_IconDisp_Rq_RDU ) );    filePutString( buffer, elcount( buffer ), hFile );
    snprintf( buffer, elcount( buffer ), "0.0000 HMI_LDC_MsgDisp_Rq_RDU := %X\n", getValue( HMI_LDC_MsgDisp_Rq_RDU ) );    filePutString( buffer, elcount( buffer ), hFile );
    snprintf( buffer, elcount( buffer ), "0.0000 HMI_LDC_MsgDisp_TrgrRq_RDU := %X\n", getValue( HMI_LDC_MsgDisp_TrgrRq_RDU ) );    filePutString( buffer, elcount( buffer ), hFile );
    snprintf( buffer, elcount( buffer ), "0.0000 HMI_LDC_RadarSensSoil_Disp_Rq_RDU := %X\n", getValue( HMI_LDC_RadarSensSoil_Disp_Rq_RDU ) );    filePutString( buffer, elcount( buffer ), hFile );
    snprintf( buffer, elcount( buffer ), "0.0000 HMI_LDC_Spd_Add_RDU := %X\n", getValue( HMI_LDC_Spd_Add_RDU ) );    filePutString( buffer, elcount( buffer ), hFile );
    snprintf( buffer, elcount( buffer ), "0.0000 HMI_LDC_Spd_Dsr_RDU := %X\n", getValue( HMI_LDC_Spd_Dsr_RDU ) );    filePutString( buffer, elcount( buffer ), hFile );
    snprintf( buffer, elcount( buffer ), "0.0000 HMI_LDC_SpdUnit_Rs_RDU := %X\n", getValue( HMI_LDC_SpdUnit_Rs_RDU ) );    filePutString( buffer, elcount( buffer ), hFile );
    snprintf( buffer, elcount( buffer ), "0.0000 HMI_LDC_SPEEDO_SegRing_Disp_Rq_RDU := %X\n", getValue( HMI_LDC_SPEEDO_SegRing_Disp_Rq_RDU ) );    filePutString( buffer, elcount( buffer ), hFile );
    snprintf( buffer, elcount( buffer ), "0.0000 HMI_TSA_Warn_Supp_Rq_RDU := %X\n", getValue( HMI_TSA_Warn_Supp_Rq_RDU ) );    filePutString( buffer, elcount( buffer ), hFile );
}
/*@@end*/

/*@@timer:_tLDC_Disp_Rq_RDU_AR:*/
on timer _tLDC_Disp_Rq_RDU_AR
{
    putValue( HMI__STMSG_LDC_Disp_Rq_RDU_AR, 0 );
}
/*@@end*/

/*@@envVar:HMI__STMSG_LDC_Disp_Rq_RDU_AR:*/
on EnvVar HMI__STMSG_LDC_Disp_Rq_RDU_AR
{
    long tDelay;
    if( getValue( this ) == 2 )
    {
        tDelay = getValue( HMI__STMSGT_LDC_Disp_Rq_RDU_AR );
        if( tDelay > 0)    
            setTimer( _tLDC_Disp_Rq_RDU_AR, tDelay );
        else
            putValue( HMI__STMSG_LDC_Disp_Rq_RDU_AR, 0 );
    }
}
/*@@end*/

/*@@envVar:HMI_LDC_AcustWarn_Rq_RDU:*/
on EnvVar HMI_LDC_AcustWarn_Rq_RDU
{
    _mLDC_Disp_Rq_RDU_AR.LDC_AcustWarn_Rq_RDU.phys = getValue(this);
    _LDC_Disp_Rq_RDU_AR_SpontanFlag = 1;
}
/*@@end*/

/*@@envVar:HMI_LDC_CMS_MsgDisp_Rq_RDU:*/
on EnvVar HMI_LDC_CMS_MsgDisp_Rq_RDU
{
    _mLDC_Disp_Rq_RDU_AR.LDC_CMS_MsgDisp_Rq_RDU.phys = getValue(this);
    _LDC_Disp_Rq_RDU_AR_SpontanFlag = 1;
}
/*@@end*/

/*@@envVar:HMI_LDC_CMS_Stat_RDU:*/
on EnvVar HMI_LDC_CMS_Stat_RDU
{
    _mLDC_Disp_Rq_RDU_AR.LDC_CMS_Stat_RDU.phys = getValue(this);
    _LDC_Disp_Rq_RDU_AR_SpontanFlag = 1;
}
/*@@end*/

/*@@envVar:HMI_LDC_Dist_Dsr_RDU:*/
on EnvVar HMI_LDC_Dist_Dsr_RDU
{
    _mLDC_Disp_Rq_RDU_AR.LDC_Dist_Dsr_RDU.phys = getValue(this);
    _LDC_Disp_Rq_RDU_AR_SpontanFlag = 1;
}
/*@@end*/

/*@@envVar:HMI_LDC_Dist_RDU:*/
on EnvVar HMI_LDC_Dist_RDU
{
    _mLDC_Disp_Rq_RDU_AR.LDC_Dist_RDU.phys = getValue(this);
    _LDC_Disp_Rq_RDU_AR_SpontanFlag = 1;
}
/*@@end*/

/*@@envVar:HMI_LDC_DTR_IndLmp_On_Rq_RDU:*/
on EnvVar HMI_LDC_DTR_IndLmp_On_Rq_RDU
{
    _mLDC_Disp_Rq_RDU_AR.LDC_DTR_IndLmp_On_Rq_RDU.phys = getValue(this);
    _LDC_Disp_Rq_RDU_AR_SpontanFlag = 1;
}
/*@@end*/

/*@@envVar:HMI_LDC_DTR_MsgDisp_Rq_RDU:*/
on EnvVar HMI_LDC_DTR_MsgDisp_Rq_RDU
{
    _mLDC_Disp_Rq_RDU_AR.LDC_DTR_MsgDisp_Rq_RDU.phys = getValue(this);
    _LDC_Disp_Rq_RDU_AR_SpontanFlag = 1;
}
/*@@end*/

/*@@envVar:HMI_LDC_DTR_Stat_RDU_V2:*/
on EnvVar HMI_LDC_DTR_Stat_RDU_V2
{
    _mLDC_Disp_Rq_RDU_AR.LDC_DTR_Stat_RDU_V2.phys = getValue(this);
    _LDC_Disp_Rq_RDU_AR_SpontanFlag = 1;
}
/*@@end*/

/*@@envVar:HMI_LDC_IconDisp_Rq_RDU:*/
on EnvVar HMI_LDC_IconDisp_Rq_RDU
{
    _mLDC_Disp_Rq_RDU_AR.LDC_IconDisp_Rq_RDU.phys = getValue(this);
    _LDC_Disp_Rq_RDU_AR_SpontanFlag = 1;
}
/*@@end*/

/*@@envVar:HMI_LDC_MsgDisp_Rq_RDU:*/
on EnvVar HMI_LDC_MsgDisp_Rq_RDU
{
    _mLDC_Disp_Rq_RDU_AR.LDC_MsgDisp_Rq_RDU.phys = getValue(this);
    _LDC_Disp_Rq_RDU_AR_SpontanFlag = 1;
}
/*@@end*/

/*@@envVar:HMI_LDC_MsgDisp_TrgrRq_RDU:*/
on EnvVar HMI_LDC_MsgDisp_TrgrRq_RDU
{
    _mLDC_Disp_Rq_RDU_AR.LDC_MsgDisp_TrgrRq_RDU.phys = getValue(this);
    _LDC_Disp_Rq_RDU_AR_SpontanFlag = 1;
}
/*@@end*/

/*@@envVar:HMI_LDC_RadarSensSoil_Disp_Rq_RDU:*/
on EnvVar HMI_LDC_RadarSensSoil_Disp_Rq_RDU
{
    _mLDC_Disp_Rq_RDU_AR.LDC_RadarSensSoil_Disp_Rq_RDU.phys = getValue(this);
    _LDC_Disp_Rq_RDU_AR_SpontanFlag = 1;
}
/*@@end*/

/*@@envVar:HMI_LDC_Spd_Add_RDU:*/
on EnvVar HMI_LDC_Spd_Add_RDU
{
    _mLDC_Disp_Rq_RDU_AR.LDC_Spd_Add_RDU.phys = getValue(this);
    _LDC_Disp_Rq_RDU_AR_SpontanFlag = 1;
}
/*@@end*/

/*@@envVar:HMI_LDC_Spd_Dsr_RDU:*/
on EnvVar HMI_LDC_Spd_Dsr_RDU
{
    _mLDC_Disp_Rq_RDU_AR.LDC_Spd_Dsr_RDU.phys = getValue(this);
    _LDC_Disp_Rq_RDU_AR_SpontanFlag = 1;
}
/*@@end*/

/*@@envVar:HMI_LDC_SpdUnit_Rs_RDU:*/
on EnvVar HMI_LDC_SpdUnit_Rs_RDU
{
    _mLDC_Disp_Rq_RDU_AR.LDC_SpdUnit_Rs_RDU.phys = getValue(this);
    _LDC_Disp_Rq_RDU_AR_SpontanFlag = 1;
}
/*@@end*/

/*@@envVar:HMI_LDC_SPEEDO_SegRing_Disp_Rq_RDU:*/
on EnvVar HMI_LDC_SPEEDO_SegRing_Disp_Rq_RDU
{
    _mLDC_Disp_Rq_RDU_AR.LDC_SPEEDO_SegRing_Disp_Rq_RDU.phys = getValue(this);
    _LDC_Disp_Rq_RDU_AR_SpontanFlag = 1;
}
/*@@end*/

/*@@envVar:HMI_TSA_Warn_Supp_Rq_RDU:*/
on EnvVar HMI_TSA_Warn_Supp_Rq_RDU
{
    _mLDC_Disp_Rq_RDU_AR.TSA_Warn_Supp_Rq_RDU.phys = getValue(this);
    _LDC_Disp_Rq_RDU_AR_SpontanFlag = 1;
}
/*@@end*/

/*@@caplFunc:LDP_Warn_Rq_AR_check_output():*/
LDP_Warn_Rq_AR_check_output()
{
    if( !getValue( HMI__STMSG_LDP_Warn_Rq_AR ) )
    {
        // Botschaft LDP_Warn_Rq_AR ID: 1026 --- Sendeart 5 cyclicAndSpontanWithDelay --- 
        _LDP_Warn_Rq_AR_Cnt--;
        if( _LDP_Warn_Rq_AR_Cnt < 1 )
        {
            // Nachricht wg. abgelaufenem Zyklus ausgeben
            LDP_Warn_Rq_AR_output();
            _LDP_Warn_Rq_AR_Cnt = _LDP_Warn_Rq_AR_CycleCount; // Zyklus-Zähler zurücksetzen
            _LDP_Warn_Rq_AR_SpontanFlag = 0; // Spontan-Flag zurücksetzen
        }
        else if( _LDP_Warn_Rq_AR_SpontanFlag )
        {
            // Nachricht wg. spontaner Änderung ausgeben
            LDP_Warn_Rq_AR_output();
            _LDP_Warn_Rq_AR_SpontanFlag = 0; // Spontan-Flag zurücksetzen
        }
    }
}
/*@@end*/

/*@@caplFunc:LDP_Warn_Rq_AR_init():*/
LDP_Warn_Rq_AR_init()
{   /* Botschaft LDP_Warn_Rq_AR ID: 1026 --- Sendeart 5 cyclicAndSpontanWithDelay --- 
BA_ "ApplMessage" BO_ 1026 0;
BA_ "NmAsrMessage" BO_ 1026 0;
BA_ "GenMsgMinAcceptLength" BO_ 1026 8;
BA_ "GenMsgILSupport" BO_ 1026 1;
BA_ "DiagState" BO_ 1026 0;
BA_ "DiagRequest" BO_ 1026 0;
BA_ "DiagResponse" BO_ 1026 0;
BA_ "GenMsgStartValue" BO_ 1026 "0";
BA_ "GenMsgDelayTime" BO_ 1026 20;
BA_ "GenMsgNrOfRepetitions" BO_ 1026 0;
BA_ "GenMsgCycleTime" BO_ 1026 200;
BA_ "GenMsgSendType" BO_ 1026 5;
    */
    _LDP_Warn_Rq_AR_Timebase =             c_tDBKomTimer_20ms;
    _LDP_Warn_Rq_AR_CycleCount =          200 / _LDP_Warn_Rq_AR_Timebase;
    _LDP_Warn_Rq_AR_StartDelay =            0 / _LDP_Warn_Rq_AR_Timebase;
    _LDP_Warn_Rq_AR_MinDelay =             20 / _LDP_Warn_Rq_AR_Timebase;
    _LDP_Warn_Rq_AR_Cnt = _LDP_Warn_Rq_AR_StartDelay;
    _LDP_Warn_Rq_AR_SpontanFlag = 0;
    _LDP_Warn_Rq_AR_DelayCnt = 0;

    putValue( HMI__STMSGSD_LDP_Warn_Rq_AR, _LDP_Warn_Rq_AR_StartDelay * _LDP_Warn_Rq_AR_Timebase );
    
    _mLDP_Warn_Rq_AR.LDP_BrkMsgDisp_Rq.phys = getValue( HMI_LDP_BrkMsgDisp_Rq );
    _mLDP_Warn_Rq_AR.LDP_IndLmp_On_Rq_V2.phys = getValue( HMI_LDP_IndLmp_On_Rq_V2 );
    _mLDP_Warn_Rq_AR.LDP_Md_Stat.phys = getValue( HMI_LDP_Md_Stat );
    _mLDP_Warn_Rq_AR.LDP_MsgDisp_Rq_V2.phys = getValue( HMI_LDP_MsgDisp_Rq_V2 );
}
/*@@end*/

/*@@caplFunc:LDP_Warn_Rq_AR_output():*/
LDP_Warn_Rq_AR_output()
{
    output( _mLDP_Warn_Rq_AR );
}
/*@@end*/

/*@@caplFunc:LDP_Warn_Rq_AR_saveEnvVars(dword):*/
LDP_Warn_Rq_AR_saveEnvVars( dword hFile )
{
    filePutString("\n// Knoten EIS: LDP_Warn_Rq_AR\n", 30, hFile );
    snprintf( buffer, elcount( buffer ), "0.0000 HMI__STMSG_LDP_Warn_Rq_AR := %X\n", getValue( HMI__STMSG_LDP_Warn_Rq_AR ) );    filePutString( buffer, elcount( buffer ), hFile );
    snprintf( buffer, elcount( buffer ), "0.0000 HMI__STMSGT_LDP_Warn_Rq_AR := %X\n", getValue( HMI__STMSGT_LDP_Warn_Rq_AR ) );    filePutString( buffer, elcount( buffer ), hFile );
    snprintf( buffer, elcount( buffer ), "0.0000 HMI_LDP_BrkMsgDisp_Rq := %X\n", getValue( HMI_LDP_BrkMsgDisp_Rq ) );    filePutString( buffer, elcount( buffer ), hFile );
    snprintf( buffer, elcount( buffer ), "0.0000 HMI_LDP_IndLmp_On_Rq_V2 := %X\n", getValue( HMI_LDP_IndLmp_On_Rq_V2 ) );    filePutString( buffer, elcount( buffer ), hFile );
    snprintf( buffer, elcount( buffer ), "0.0000 HMI_LDP_Md_Stat := %X\n", getValue( HMI_LDP_Md_Stat ) );    filePutString( buffer, elcount( buffer ), hFile );
    snprintf( buffer, elcount( buffer ), "0.0000 HMI_LDP_MsgDisp_Rq_V2 := %X\n", getValue( HMI_LDP_MsgDisp_Rq_V2 ) );    filePutString( buffer, elcount( buffer ), hFile );
}
/*@@end*/

/*@@timer:_tLDP_Warn_Rq_AR:*/
on timer _tLDP_Warn_Rq_AR
{
    putValue( HMI__STMSG_LDP_Warn_Rq_AR, 0 );
}
/*@@end*/

/*@@envVar:HMI__STMSG_LDP_Warn_Rq_AR:*/
on EnvVar HMI__STMSG_LDP_Warn_Rq_AR
{
    long tDelay;
    if( getValue( this ) == 2 )
    {
        tDelay = getValue( HMI__STMSGT_LDP_Warn_Rq_AR );
        if( tDelay > 0)    
            setTimer( _tLDP_Warn_Rq_AR, tDelay );
        else
            putValue( HMI__STMSG_LDP_Warn_Rq_AR, 0 );
    }
}
/*@@end*/

/*@@envVar:HMI_LDP_BrkMsgDisp_Rq:*/
on EnvVar HMI_LDP_BrkMsgDisp_Rq
{
    _mLDP_Warn_Rq_AR.LDP_BrkMsgDisp_Rq.phys = getValue(this);
    _LDP_Warn_Rq_AR_SpontanFlag = 1;
}
/*@@end*/

/*@@envVar:HMI_LDP_IndLmp_On_Rq_V2:*/
on EnvVar HMI_LDP_IndLmp_On_Rq_V2
{
    _mLDP_Warn_Rq_AR.LDP_IndLmp_On_Rq_V2.phys = getValue(this);
    _LDP_Warn_Rq_AR_SpontanFlag = 1;
}
/*@@end*/

/*@@envVar:HMI_LDP_Md_Stat:*/
on EnvVar HMI_LDP_Md_Stat
{
    _mLDP_Warn_Rq_AR.LDP_Md_Stat.phys = getValue(this);
    _LDP_Warn_Rq_AR_SpontanFlag = 1;
}
/*@@end*/

/*@@envVar:HMI_LDP_MsgDisp_Rq_V2:*/
on EnvVar HMI_LDP_MsgDisp_Rq_V2
{
    _mLDP_Warn_Rq_AR.LDP_MsgDisp_Rq_V2.phys = getValue(this);
    _LDP_Warn_Rq_AR_SpontanFlag = 1;
}
/*@@end*/

/*@@caplFunc:LgtSens_State_AR_check_output():*/
LgtSens_State_AR_check_output()
{
    if( !getValue( HMI__STMSG_LgtSens_State_AR ) )
    {
        // Botschaft LgtSens_State_AR ID: 783 --- Sendeart 5 cyclicAndSpontanWithDelay --- 
        if( _LgtSens_State_AR_DelayCnt > 0) _LgtSens_State_AR_DelayCnt--; // Mindestsendeabstand
        _LgtSens_State_AR_Cnt--;
        if( _LgtSens_State_AR_Cnt < 1 )
        {
            if( _LgtSens_State_AR_DelayCnt < 1 )
            {
                // Nachricht wg. abgelaufenem Zyklus ausgeben (Mindestsendeabstand eingehalten)
                LgtSens_State_AR_output();
                _LgtSens_State_AR_SpontanFlag = 0; // Spontan-Flag zurücksetzen
                _LgtSens_State_AR_DelayCnt = _LgtSens_State_AR_MinDelay;
            }
            else
            {
                // Spontanflag setzen damit nach Ablauf Mindestsendeabstand gesendet wird
                 _LgtSens_State_AR_SpontanFlag = 1;
            }
            _LgtSens_State_AR_Cnt = _LgtSens_State_AR_CycleCount; // Zyklus-Zähler zurücksetzen
        }
        else if( _LgtSens_State_AR_SpontanFlag)
        {
            if( _LgtSens_State_AR_DelayCnt < 1 )
            {
                // Nachricht wg. spontaner Änderung ausgeben (Mindestsendeabstand eingehalten)
                LgtSens_State_AR_output();
                _LgtSens_State_AR_SpontanFlag = 0; // Spontan-Flag zurücksetzen
                _LgtSens_State_AR_DelayCnt = _LgtSens_State_AR_MinDelay;
            }
        }
    }
}
/*@@end*/

/*@@caplFunc:LgtSens_State_AR_init():*/
LgtSens_State_AR_init()
{   /* Botschaft LgtSens_State_AR ID: 783 --- Sendeart 5 cyclicAndSpontanWithDelay --- 
BA_ "ApplMessage" BO_ 783 0;
BA_ "NmAsrMessage" BO_ 783 0;
BA_ "GenMsgMinAcceptLength" BO_ 783 6;
BA_ "GenMsgILSupport" BO_ 783 1;
BA_ "DiagState" BO_ 783 0;
BA_ "DiagRequest" BO_ 783 0;
BA_ "DiagResponse" BO_ 783 0;
BA_ "GenMsgStartValue" BO_ 783 "0";
BA_ "GenMsgDelayTime" BO_ 783 100;
BA_ "GenMsgNrOfRepetitions" BO_ 783 0;
BA_ "GenMsgCycleTime" BO_ 783 1000;
BA_ "GenMsgSendType" BO_ 783 5;
    */
    _LgtSens_State_AR_Timebase =               c_tDBKomTimer_20ms;
    _LgtSens_State_AR_CycleCount =           1000 / _LgtSens_State_AR_Timebase;
    _LgtSens_State_AR_StartDelay =              0 / _LgtSens_State_AR_Timebase;
    _LgtSens_State_AR_MinDelay =              100 / _LgtSens_State_AR_Timebase;
    _LgtSens_State_AR_Cnt = _LgtSens_State_AR_StartDelay;
    _LgtSens_State_AR_SpontanFlag = 0;
    _LgtSens_State_AR_DelayCnt = 0;

    putValue( HMI__STMSGSD_LgtSens_State_AR, _LgtSens_State_AR_StartDelay * _LgtSens_State_AR_Timebase );

    putValue( HMI_LgtSens_SNA, 0 );
    _mLgtSens_State_AR.HUD_Sens_Actv.phys = getValue( HMI_HUD_Sens_Actv );
    _mLgtSens_State_AR.HUD_Sens_Init.phys = getValue( HMI_HUD_Sens_Init );
    _mLgtSens_State_AR.HUD_Sens_Value.phys = getValue( HMI_HUD_Sens_Value );
    _mLgtSens_State_AR.HUD_Sens_Variant.phys = getValue( HMI_HUD_Sens_Variant );
    _mLgtSens_State_AR.HUD_SensCode_Flt.phys = getValue( HMI_HUD_SensCode_Flt );
    _mLgtSens_State_AR.HUD_SensInt_Flt.phys = getValue( HMI_HUD_SensInt_Flt );
    _mLgtSens_State_AR.LgtSens_Flt.phys = getValue( HMI_LgtSens_Flt );
    _mLgtSens_State_AR.LgtSens_LoBm_On_Rq.phys = getValue( HMI_LgtSens_LoBm_On_Rq );
    _mLgtSens_State_AR.LgtSens_Night.phys = getValue( HMI_LgtSens_Night );
    _mLgtSens_State_AR.LgtSens_Night2.phys = getValue( HMI_LgtSens_Night2 );
    _mLgtSens_State_AR.LgtSens_Night3.phys = getValue( HMI_LgtSens_Night3 );
    _mLgtSens_State_AR.LgtSens_SNA.phys = getValue( HMI_LgtSens_SNA );
    _mLgtSens_State_AR.LgtSens_Tunnel.phys = getValue( HMI_LgtSens_Tunnel );
    _mLgtSens_State_AR.LgtSens_Twlgt.phys = getValue( HMI_LgtSens_Twlgt );
    _mLgtSens_State_AR.SunInsty_Actv.phys = getValue( HMI_SunInsty_Actv );
    _mLgtSens_State_AR.SunInsty_FL.phys = getValue( HMI_SunInsty_FL );
    _mLgtSens_State_AR.SunInsty_Flt.phys = getValue( HMI_SunInsty_Flt );
    _mLgtSens_State_AR.SunInsty_FR.phys = getValue( HMI_SunInsty_FR );
}
/*@@end*/

/*@@caplFunc:LgtSens_State_AR_output():*/
LgtSens_State_AR_output()
{
    output( _mLgtSens_State_AR );
}
/*@@end*/

/*@@caplFunc:LgtSens_State_AR_saveEnvVars(dword):*/
LgtSens_State_AR_saveEnvVars( dword hFile )
{
    filePutString("\n// Knoten EIS: LgtSens_State_AR\n", 30, hFile );
    snprintf( buffer, elcount( buffer ), "0.0000 HMI__STMSG_LgtSens_State_AR := %X\n", getValue( HMI__STMSG_LgtSens_State_AR ) );    filePutString( buffer, elcount( buffer ), hFile );
    snprintf( buffer, elcount( buffer ), "0.0000 HMI__STMSGT_LgtSens_State_AR := %X\n", getValue( HMI__STMSGT_LgtSens_State_AR ) );    filePutString( buffer, elcount( buffer ), hFile );
    snprintf( buffer, elcount( buffer ), "0.0000 HMI_HUD_Sens_Actv := %X\n", getValue( HMI_HUD_Sens_Actv ) );    filePutString( buffer, elcount( buffer ), hFile );
    snprintf( buffer, elcount( buffer ), "0.0000 HMI_HUD_Sens_Init := %X\n", getValue( HMI_HUD_Sens_Init ) );    filePutString( buffer, elcount( buffer ), hFile );
    snprintf( buffer, elcount( buffer ), "0.0000 HMI_HUD_Sens_Value := %X\n", getValue( HMI_HUD_Sens_Value ) );    filePutString( buffer, elcount( buffer ), hFile );
    snprintf( buffer, elcount( buffer ), "0.0000 HMI_HUD_Sens_Variant := %X\n", getValue( HMI_HUD_Sens_Variant ) );    filePutString( buffer, elcount( buffer ), hFile );
    snprintf( buffer, elcount( buffer ), "0.0000 HMI_HUD_SensCode_Flt := %X\n", getValue( HMI_HUD_SensCode_Flt ) );    filePutString( buffer, elcount( buffer ), hFile );
    snprintf( buffer, elcount( buffer ), "0.0000 HMI_HUD_SensInt_Flt := %X\n", getValue( HMI_HUD_SensInt_Flt ) );    filePutString( buffer, elcount( buffer ), hFile );
    snprintf( buffer, elcount( buffer ), "0.0000 HMI_LgtSens_Flt := %X\n", getValue( HMI_LgtSens_Flt ) );    filePutString( buffer, elcount( buffer ), hFile );
    snprintf( buffer, elcount( buffer ), "0.0000 HMI_LgtSens_LoBm_On_Rq := %X\n", getValue( HMI_LgtSens_LoBm_On_Rq ) );    filePutString( buffer, elcount( buffer ), hFile );
    snprintf( buffer, elcount( buffer ), "0.0000 HMI_LgtSens_Night := %X\n", getValue( HMI_LgtSens_Night ) );    filePutString( buffer, elcount( buffer ), hFile );
    snprintf( buffer, elcount( buffer ), "0.0000 HMI_LgtSens_Night2 := %X\n", getValue( HMI_LgtSens_Night2 ) );    filePutString( buffer, elcount( buffer ), hFile );
    snprintf( buffer, elcount( buffer ), "0.0000 HMI_LgtSens_Night3 := %X\n", getValue( HMI_LgtSens_Night3 ) );    filePutString( buffer, elcount( buffer ), hFile );
    snprintf( buffer, elcount( buffer ), "0.0000 HMI_LgtSens_SNA := %X\n", getValue( HMI_LgtSens_SNA ) );    filePutString( buffer, elcount( buffer ), hFile );
    snprintf( buffer, elcount( buffer ), "0.0000 HMI_LgtSens_Tunnel := %X\n", getValue( HMI_LgtSens_Tunnel ) );    filePutString( buffer, elcount( buffer ), hFile );
    snprintf( buffer, elcount( buffer ), "0.0000 HMI_LgtSens_Twlgt := %X\n", getValue( HMI_LgtSens_Twlgt ) );    filePutString( buffer, elcount( buffer ), hFile );
    snprintf( buffer, elcount( buffer ), "0.0000 HMI_SunInsty_Actv := %X\n", getValue( HMI_SunInsty_Actv ) );    filePutString( buffer, elcount( buffer ), hFile );
    snprintf( buffer, elcount( buffer ), "0.0000 HMI_SunInsty_FL := %X\n", getValue( HMI_SunInsty_FL ) );    filePutString( buffer, elcount( buffer ), hFile );
    snprintf( buffer, elcount( buffer ), "0.0000 HMI_SunInsty_Flt := %X\n", getValue( HMI_SunInsty_Flt ) );    filePutString( buffer, elcount( buffer ), hFile );
    snprintf( buffer, elcount( buffer ), "0.0000 HMI_SunInsty_FR := %X\n", getValue( HMI_SunInsty_FR ) );    filePutString( buffer, elcount( buffer ), hFile );
}
/*@@end*/

/*@@timer:_tLgtSens_State_AR:*/
on timer _tLgtSens_State_AR
{
    putValue( HMI__STMSG_LgtSens_State_AR, 0 );
}
/*@@end*/

/*@@envVar:HMI__STMSG_LgtSens_State_AR:*/
on EnvVar HMI__STMSG_LgtSens_State_AR
{
    long tDelay;
    if( getValue( this ) == 2 )
    {
        tDelay = getValue( HMI__STMSGT_LgtSens_State_AR );
        if( tDelay > 0)    
            setTimer( _tLgtSens_State_AR, tDelay );
        else
            putValue( HMI__STMSG_LgtSens_State_AR, 0 );
    }
}
/*@@end*/

/*@@envVar:HMI_HUD_Sens_Actv:*/
on EnvVar HMI_HUD_Sens_Actv
{
    _mLgtSens_State_AR.HUD_Sens_Actv.phys = getValue(this);
    _LgtSens_State_AR_SpontanFlag = 1;
}
/*@@end*/

/*@@envVar:HMI_HUD_Sens_Init:*/
on EnvVar HMI_HUD_Sens_Init
{
    _mLgtSens_State_AR.HUD_Sens_Init.phys = getValue(this);
    _LgtSens_State_AR_SpontanFlag = 1;
}
/*@@end*/

/*@@envVar:HMI_HUD_Sens_Value:*/
on EnvVar HMI_HUD_Sens_Value
{
    _mLgtSens_State_AR.HUD_Sens_Value.phys = getValue(this);
    _LgtSens_State_AR_SpontanFlag = 1;
}
/*@@end*/

/*@@envVar:HMI_HUD_Sens_Variant:*/
on EnvVar HMI_HUD_Sens_Variant
{
    _mLgtSens_State_AR.HUD_Sens_Variant.phys = getValue(this);
    _LgtSens_State_AR_SpontanFlag = 1;
}
/*@@end*/

/*@@envVar:HMI_HUD_SensCode_Flt:*/
on EnvVar HMI_HUD_SensCode_Flt
{
    _mLgtSens_State_AR.HUD_SensCode_Flt.phys = getValue(this);
    _LgtSens_State_AR_SpontanFlag = 1;
}
/*@@end*/

/*@@envVar:HMI_HUD_SensInt_Flt:*/
on EnvVar HMI_HUD_SensInt_Flt
{
    _mLgtSens_State_AR.HUD_SensInt_Flt.phys = getValue(this);
    _LgtSens_State_AR_SpontanFlag = 1;
}
/*@@end*/

/*@@envVar:HMI_LgtSens_Flt:*/
on EnvVar HMI_LgtSens_Flt
{
    _mLgtSens_State_AR.LgtSens_Flt.phys = getValue(this);
    _LgtSens_State_AR_SpontanFlag = 1;
}
/*@@end*/

/*@@envVar:HMI_LgtSens_LoBm_On_Rq:*/
on EnvVar HMI_LgtSens_LoBm_On_Rq
{
    _mLgtSens_State_AR.LgtSens_LoBm_On_Rq.phys = getValue(this);
    _LgtSens_State_AR_SpontanFlag = 1;
}
/*@@end*/

/*@@envVar:HMI_LgtSens_Night:*/
on EnvVar HMI_LgtSens_Night
{
     _mLgtSens_State_AR.LgtSens_Night.phys = getValue(this);
    _LgtSens_State_AR_SpontanFlag = 1;
}
/*@@end*/

/*@@envVar:HMI_LgtSens_Night2:*/
on EnvVar HMI_LgtSens_Night2
{
    _mLgtSens_State_AR.LgtSens_Night2.phys = getValue(this);
    _LgtSens_State_AR_SpontanFlag = 1;
}
/*@@end*/

/*@@envVar:HMI_LgtSens_Night3:*/
on EnvVar HMI_LgtSens_Night3
{
    _mLgtSens_State_AR.LgtSens_Night3.phys = getValue(this);
    _LgtSens_State_AR_SpontanFlag = 1;
}
/*@@end*/

/*@@envVar:HMI_LgtSens_SNA:*/
on EnvVar HMI_LgtSens_SNA
{
    _mLgtSens_State_AR.LgtSens_SNA.phys = getValue(this);
    _LgtSens_State_AR_SpontanFlag = 1;
}
/*@@end*/

/*@@envVar:HMI_LgtSens_Tunnel:*/
on EnvVar HMI_LgtSens_Tunnel
{
    _mLgtSens_State_AR.LgtSens_Tunnel.phys = getValue(this);
    _LgtSens_State_AR_SpontanFlag = 1;
}
/*@@end*/

/*@@envVar:HMI_LgtSens_Twlgt:*/
on EnvVar HMI_LgtSens_Twlgt
{
    _mLgtSens_State_AR.LgtSens_Twlgt.phys = getValue(this);
    _LgtSens_State_AR_SpontanFlag = 1;
}
/*@@end*/

/*@@envVar:HMI_SunInsty_Actv:*/
on EnvVar HMI_SunInsty_Actv
{
    _mLgtSens_State_AR.SunInsty_Actv.phys = getValue(this);
    _LgtSens_State_AR_SpontanFlag = 1;
}
/*@@end*/

/*@@envVar:HMI_SunInsty_FL:*/
on EnvVar HMI_SunInsty_FL
{
    _mLgtSens_State_AR.SunInsty_FL.phys = getValue(this);
    _LgtSens_State_AR_SpontanFlag = 1;
}
/*@@end*/

/*@@envVar:HMI_SunInsty_Flt:*/
on EnvVar HMI_SunInsty_Flt
{
    _mLgtSens_State_AR.SunInsty_Flt.phys = getValue(this);
    _LgtSens_State_AR_SpontanFlag = 1;
}
/*@@end*/

/*@@envVar:HMI_SunInsty_FR:*/
on EnvVar HMI_SunInsty_FR
{
    _mLgtSens_State_AR.SunInsty_FR.phys = getValue(this);
    _LgtSens_State_AR_SpontanFlag = 1;
}
/*@@end*/

/*@@caplFunc:MCMS_FL_AR_check_output():*/
MCMS_FL_AR_check_output()
{
    if( !getValue( HMI__STMSG_MCMS_FL_AR ) )
    {
        // Botschaft MCMS_FL_AR ID: 793 --- Sendeart 5 cyclicAndSpontanWithDelay --- 
        _MCMS_FL_AR_Cnt--;
        if( _MCMS_FL_AR_Cnt < 1 )
        {
            MCMS_FL_AR_output(); // Nachricht wg. abgelaufenem Zyklus ausgeben
            _MCMS_FL_AR_Cnt = _MCMS_FL_AR_CycleCount; // Zyklus-Zähler zurücksetzen
            _MCMS_FL_AR_SpontanFlag = 0; // Spontan-Flag zurücksetzen
        }
        else if( _MCMS_FL_AR_SpontanFlag )
        {
            MCMS_FL_AR_output(); // Nachricht wg. spontaner Änderung ausgeben
            _MCMS_FL_AR_SpontanFlag = 0; // Spontan-Flag zurücksetzen
        }
    }
}
/*@@end*/

/*@@caplFunc:MCMS_FL_AR_init():*/
MCMS_FL_AR_init()
{   /* Botschaft MCMS_FL_AR ID: 793 --- Sendeart 5 cyclicAndSpontanWithDelay --- 
BA_ "ApplMessage" BO_ 793 0;
BA_ "NmAsrMessage" BO_ 793 0;
BA_ "GenMsgMinAcceptLength" BO_ 793 8;
BA_ "GenMsgILSupport" BO_ 793 1;
BA_ "DiagState" BO_ 793 0;
BA_ "DiagRequest" BO_ 793 0;
BA_ "DiagResponse" BO_ 793 0;
BA_ "GenMsgStartValue" BO_ 793 "0";
BA_ "GenMsgDelayTime" BO_ 793 5;
BA_ "GenMsgNrOfRepetitions" BO_ 793 0;
BA_ "GenMsgCycleTime" BO_ 793 1000;
BA_ "GenMsgSendType" BO_ 793 5;
    */
    _MCMS_FL_AR_Timebase =           c_tDBKomTimer_20ms;
    _MCMS_FL_AR_CycleCount =        1000 / _MCMS_FL_AR_Timebase;
    _MCMS_FL_AR_StartDelay =           0 / _MCMS_FL_AR_Timebase;
    _MCMS_FL_AR_Cnt = _MCMS_FL_AR_StartDelay;
    _MCMS_FL_AR_SpontanFlag = 0;

    putValue( HMI__STMSGSD_MCMS_FL_AR, _MCMS_FL_AR_StartDelay * _MCMS_FL_AR_Timebase );

    _mMCMS_FL_AR.HotStn_FL_On_Rq.phys = getValue( HMI_HotStn_FL_On_Rq );
    _mMCMS_FL_AR.MCMS_ActvComf_FL_Stat.phys = getValue( HMI_MCMS_ActvComf_FL_Stat );
    _mMCMS_FL_AR.MCMS_ActvComfProg_FL_Stat.phys = getValue( HMI_MCMS_ActvComfProg_FL_Stat );
    _mMCMS_FL_AR.MCMS_FL_On.phys = getValue( HMI_MCMS_FL_On );
    _mMCMS_FL_AR.MCMS_LumPad_FL.phys = getValue( HMI_MCMS_LumPad_FL );
    _mMCMS_FL_AR.MCMS_LumPosn_FL.phys = getValue( HMI_MCMS_LumPosn_FL );
    _mMCMS_FL_AR.MCMS_Pmp_FL_Rq.phys = getValue( HMI_MCMS_Pmp_FL_Rq );
    _mMCMS_FL_AR.MCMS_SdRstPad_FL.phys = getValue( HMI_MCMS_SdRstPad_FL );
    _mMCMS_FL_AR.MCMS_SeatPad_FL.phys = getValue( HMI_MCMS_SeatPad_FL );
    _mMCMS_FL_AR.MCMS_ShldrPad_FL.phys = getValue( HMI_MCMS_ShldrPad_FL );
}
/*@@end*/

/*@@caplFunc:MCMS_FL_AR_output():*/
MCMS_FL_AR_output(void)
{
    output( _mMCMS_FL_AR );
}
/*@@end*/

/*@@caplFunc:MCMS_FL_AR_saveEnvVars(dword):*/
MCMS_FL_AR_saveEnvVars( dword hFile )
{
    filePutString("\n// Knoten EIS: MCMS_FL_AR\n", 24, hFile );
    snprintf( buffer, elcount( buffer ), "0.0000 HMI__STMSG_MCMS_FL := %X\n", getValue( HMI__STMSG_MCMS_FL_AR ) );        filePutString( buffer, elcount( buffer ), hFile );
    snprintf( buffer, elcount( buffer ), "0.0000 HMI__STMSGT_MCMS_FL := %X\n", getValue( HMI__STMSGT_MCMS_FL_AR ) );        filePutString( buffer, elcount( buffer ), hFile );
    snprintf( buffer, elcount( buffer ), "0.0000 HMI_HotStn_FL_On_Rq := %X\n", getValue( HMI_HotStn_FL_On_Rq ) );        filePutString( buffer, elcount( buffer ), hFile );
    snprintf( buffer, elcount( buffer ), "0.0000 HMI_MCMS_ActvComf_FL_Stat := %X\n", getValue( HMI_MCMS_ActvComf_FL_Stat ) );        filePutString( buffer, elcount( buffer ), hFile );
    snprintf( buffer, elcount( buffer ), "0.0000 HMI_MCMS_ActvComfProg_FL_Stat := %X\n", getValue( HMI_MCMS_ActvComfProg_FL_Stat ) );        filePutString( buffer, elcount( buffer ), hFile );
    snprintf( buffer, elcount( buffer ), "0.0000 HMI_MCMS_FL_On := %X\n", getValue( HMI_MCMS_FL_On ) );        filePutString( buffer, elcount( buffer ), hFile );
    snprintf( buffer, elcount( buffer ), "0.0000 HMI_MCMS_LumPad_FL := %X\n", getValue( HMI_MCMS_LumPad_FL ) );        filePutString( buffer, elcount( buffer ), hFile );
    snprintf( buffer, elcount( buffer ), "0.0000 HMI_MCMS_LumPosn_FL := %X\n", getValue( HMI_MCMS_LumPosn_FL ) );        filePutString( buffer, elcount( buffer ), hFile );
    snprintf( buffer, elcount( buffer ), "0.0000 HMI_MCMS_Pmp_FL_Rq := %X\n", getValue( HMI_MCMS_Pmp_FL_Rq ) );        filePutString( buffer, elcount( buffer ), hFile );
    snprintf( buffer, elcount( buffer ), "0.0000 HMI_MCMS_SdRstPad_FL := %X\n", getValue( HMI_MCMS_SdRstPad_FL ) );        filePutString( buffer, elcount( buffer ), hFile );
    snprintf( buffer, elcount( buffer ), "0.0000 HMI_MCMS_SeatPad_FL := %X\n", getValue( HMI_MCMS_SeatPad_FL ) );        filePutString( buffer, elcount( buffer ), hFile );
    snprintf( buffer, elcount( buffer ), "0.0000 HMI_MCMS_ShldrPad_FL := %X\n", getValue( HMI_MCMS_ShldrPad_FL ) );        filePutString( buffer, elcount( buffer ), hFile );
}
/*@@end*/

/*@@timer:_tMCMS_FL_AR:*/
on timer _tMCMS_FL_AR
{
    putValue( HMI__STMSG_MCMS_FL_AR, 0 );
}
/*@@end*/

/*@@envVar:HMI__STMSG_MCMS_FL_AR:*/
on EnvVar HMI__STMSG_MCMS_FL_AR
{
    long tDelay;
    if( getValue( this ) == 2 )
    {
        tDelay = getValue( HMI__STMSGT_MCMS_FL_AR );
        if( tDelay > 0)    
            setTimer( _tMCMS_FL_AR, tDelay );
        else
            putValue( HMI__STMSG_MCMS_FL_AR, 0 );
    }
}
/*@@end*/

/*@@envVar:HMI_HotStn_FL_On_Rq:*/
on EnvVar HMI_HotStn_FL_On_Rq
{
    _mMCMS_FL_AR.HotStn_FL_On_Rq.phys = getValue(this);
    _MCMS_FL_AR_SpontanFlag = 1;
}
/*@@end*/

/*@@envVar:HMI_MCMS_ActvComf_FL_Stat:*/
on EnvVar HMI_MCMS_ActvComf_FL_Stat
{
    _mMCMS_FL_AR.MCMS_ActvComf_FL_Stat.phys = getValue(this);
    _MCMS_FL_AR_SpontanFlag = 1;
}
/*@@end*/

/*@@envVar:HMI_MCMS_ActvComfProg_FL_Stat:*/
on EnvVar HMI_MCMS_ActvComfProg_FL_Stat
{
    _mMCMS_FL_AR.MCMS_ActvComfProg_FL_Stat.phys = getValue(this);
    _MCMS_FL_AR_SpontanFlag = 1;
}
/*@@end*/

/*@@envVar:HMI_MCMS_FL_On:*/
on EnvVar HMI_MCMS_FL_On
{
    _mMCMS_FL_AR.MCMS_FL_On.phys = getValue(this);
    _MCMS_FL_AR_SpontanFlag = 1;
}
/*@@end*/

/*@@envVar:HMI_MCMS_LumPad_FL:*/
on EnvVar HMI_MCMS_LumPad_FL
{
    _mMCMS_FL_AR.MCMS_LumPad_FL.phys = getValue(this);
    _MCMS_FL_AR_SpontanFlag = 1;
}
/*@@end*/

/*@@envVar:HMI_MCMS_LumPosn_FL:*/
on EnvVar HMI_MCMS_LumPosn_FL
{
    _mMCMS_FL_AR.MCMS_LumPosn_FL.phys = getValue(this);
    _MCMS_FL_AR_SpontanFlag = 1;
}
/*@@end*/

/*@@envVar:HMI_MCMS_Pmp_FL_Rq:*/
on EnvVar HMI_MCMS_Pmp_FL_Rq
{
    _mMCMS_FL_AR.MCMS_Pmp_FL_Rq.phys = getValue(this);
    _MCMS_FL_AR_SpontanFlag = 1;
}
/*@@end*/

/*@@envVar:HMI_MCMS_SdRstPad_FL:*/
on EnvVar HMI_MCMS_SdRstPad_FL
{
    _mMCMS_FL_AR.MCMS_SdRstPad_FL.phys = getValue(this);
    _MCMS_FL_AR_SpontanFlag = 1;
}
/*@@end*/

/*@@envVar:HMI_MCMS_SeatPad_FL:*/
on EnvVar HMI_MCMS_SeatPad_FL
{
    _mMCMS_FL_AR.MCMS_SeatPad_FL.phys = getValue(this);
    _MCMS_FL_AR_SpontanFlag = 1;
}
/*@@end*/

/*@@envVar:HMI_MCMS_ShldrPad_FL:*/
on EnvVar HMI_MCMS_ShldrPad_FL
{
    _mMCMS_FL_AR.MCMS_ShldrPad_FL.phys = getValue(this);
    _MCMS_FL_AR_SpontanFlag = 1;
}
/*@@end*/

/*@@caplFunc:MCMS_FL_Stat_AR_check_output():*/
MCMS_FL_Stat_AR_check_output()
{
    if( !getValue( HMI__STMSG_MCMS_FL_Stat_AR ) )
    {
        // Botschaft MCMS_FL_Stat_AR ID: 795 --- Sendeart 5 cyclicAndSpontanWithDelay --- 
        _MCMS_FL_Stat_AR_Cnt--;
        if( _MCMS_FL_Stat_AR_Cnt < 1 )
        {
            MCMS_FL_Stat_AR_output(); // Nachricht wg. abgelaufenem Zyklus ausgeben
            _MCMS_FL_Stat_AR_Cnt = _MCMS_FL_Stat_AR_CycleCount; // Zyklus-Zähler zurücksetzen
            _MCMS_FL_Stat_AR_SpontanFlag = 0; // Spontan-Flag zurücksetzen
        }
        else if( _MCMS_FL_Stat_AR_SpontanFlag )
        {
            MCMS_FL_Stat_AR_output(); // Nachricht wg. spontaner Änderung ausgeben
            _MCMS_FL_Stat_AR_SpontanFlag = 0; // Spontan-Flag zurücksetzen
        }
    }
}
/*@@end*/

/*@@caplFunc:MCMS_FL_Stat_AR_init():*/
MCMS_FL_Stat_AR_init()
{   /* Botschaft MCMS_FL_Stat_AR ID: 795 --- Sendeart 5 cyclicAndSpontanWithDelay --- 
BA_ "ApplMessage" BO_ 795 0;
BA_ "NmAsrMessage" BO_ 795 0;
BA_ "GenMsgMinAcceptLength" BO_ 795 8;
BA_ "GenMsgILSupport" BO_ 795 1;
BA_ "DiagState" BO_ 795 0;
BA_ "DiagRequest" BO_ 795 0;
BA_ "DiagResponse" BO_ 795 0;
BA_ "GenMsgStartValue" BO_ 795 "0";
BA_ "GenMsgDelayTime" BO_ 795 5;
BA_ "GenMsgNrOfRepetitions" BO_ 795 0;
BA_ "GenMsgCycleTime" BO_ 795 1000;
BA_ "GenMsgSendType" BO_ 795 5;
    */
    _MCMS_FL_Stat_AR_Timebase =           c_tDBKomTimer_20ms;
    _MCMS_FL_Stat_AR_CycleCount =       1000 / _MCMS_FL_Stat_AR_Timebase;
    _MCMS_FL_Stat_AR_StartDelay =          0 / _MCMS_FL_Stat_AR_Timebase;
    _MCMS_FL_Stat_AR_Cnt = _MCMS_FL_Stat_AR_StartDelay;
    _MCMS_FL_Stat_AR_SpontanFlag = 0;

    putValue( HMI__STMSGSD_MCMS_FL_Stat_AR, _MCMS_FL_Stat_AR_StartDelay * _MCMS_FL_Stat_AR_Timebase );

    _mMCMS_FL_Stat_AR.MCMS_AmbPress_FL.phys = getValue( HMI_MCMS_AmbPress_FL );
    _mMCMS_FL_Stat_AR.MCMS_DrvDynSeat_FL_Actv.phys = getValue( HMI_MCMS_DrvDynSeat_FL_Actv );
    _mMCMS_FL_Stat_AR.MCMS_DrvDynSeatMd_FL_Stat.phys = getValue( HMI_MCMS_DrvDynSeatMd_FL_Stat );
    _mMCMS_FL_Stat_AR.MCMS_HotStnInsty_FL_Stat.phys = getValue( HMI_MCMS_HotStnInsty_FL_Stat );
    _mMCMS_FL_Stat_AR.MCMS_LumPad_FL_Stat.phys = getValue( HMI_MCMS_LumPad_FL_Stat );
    _mMCMS_FL_Stat_AR.MCMS_LumPosn_FL_Stat.phys = getValue( HMI_MCMS_LumPosn_FL_Stat );
    _mMCMS_FL_Stat_AR.MCMS_Mass_FL_On.phys = getValue( HMI_MCMS_Mass_FL_On );
    _mMCMS_FL_Stat_AR.MCMS_MassAdj_FL_Stat_V3.phys = getValue( HMI_MCMS_MassAdj_FL_Stat_V3 );
    _mMCMS_FL_Stat_AR.MCMS_MassInsty_FL_Stat.phys = getValue( HMI_MCMS_MassInsty_FL_Stat );
    _mMCMS_FL_Stat_AR.MCMS_SdRstPad_FL_Stat.phys = getValue( HMI_MCMS_SdRstPad_FL_Stat );
    _mMCMS_FL_Stat_AR.MCMS_SeatPad_FL_Stat.phys = getValue( HMI_MCMS_SeatPad_FL_Stat );
    _mMCMS_FL_Stat_AR.MCMS_ShldrPad_FL_Stat.phys = getValue( HMI_MCMS_ShldrPad_FL_Stat );
}
/*@@end*/

/*@@caplFunc:MCMS_FL_Stat_AR_output():*/
MCMS_FL_Stat_AR_output(void)
{
    output( _mMCMS_FL_Stat_AR );
}
/*@@end*/

/*@@caplFunc:MCMS_FL_Stat_AR_saveEnvVars(dword):*/
MCMS_FL_Stat_AR_saveEnvVars( dword hFile )
{
    filePutString("\n// Knoten EIS: MCMS_FL_Stat_AR\n", 29, hFile );
    snprintf( buffer, elcount( buffer ), "0.0000 HMI__STMSG_MCMS_FL_Stat := %X\n", getValue( HMI__STMSG_MCMS_FL_Stat_AR ) );        filePutString( buffer, elcount( buffer ), hFile );
    snprintf( buffer, elcount( buffer ), "0.0000 HMI__STMSGT_MCMS_FL_Stat := %X\n", getValue( HMI__STMSGT_MCMS_FL_Stat_AR ) );        filePutString( buffer, elcount( buffer ), hFile );
    snprintf( buffer, elcount( buffer ), "0.0000 HMI_MCMS_AmbPress_FL := %X\n", getValue( HMI_MCMS_AmbPress_FL ) );        filePutString( buffer, elcount( buffer ), hFile );
    snprintf( buffer, elcount( buffer ), "0.0000 HMI_MCMS_DrvDynSeat_FL_Actv := %X\n", getValue( HMI_MCMS_DrvDynSeat_FL_Actv ) );        filePutString( buffer, elcount( buffer ), hFile );
    snprintf( buffer, elcount( buffer ), "0.0000 HMI_MCMS_DrvDynSeatMd_FL_Stat := %X\n", getValue( HMI_MCMS_DrvDynSeatMd_FL_Stat ) );        filePutString( buffer, elcount( buffer ), hFile );
    snprintf( buffer, elcount( buffer ), "0.0000 HMI_MCMS_HotStnInsty_FL_Stat := %X\n", getValue( HMI_MCMS_HotStnInsty_FL_Stat ) );        filePutString( buffer, elcount( buffer ), hFile );
    snprintf( buffer, elcount( buffer ), "0.0000 HMI_MCMS_LumPad_FL_Stat := %X\n", getValue( HMI_MCMS_LumPad_FL_Stat ) );        filePutString( buffer, elcount( buffer ), hFile );
    snprintf( buffer, elcount( buffer ), "0.0000 HMI_MCMS_LumPosn_FL_Stat := %X\n", getValue( HMI_MCMS_LumPosn_FL_Stat ) );        filePutString( buffer, elcount( buffer ), hFile );
    snprintf( buffer, elcount( buffer ), "0.0000 HMI_MCMS_Mass_FL_On := %X\n", getValue( HMI_MCMS_Mass_FL_On ) );        filePutString( buffer, elcount( buffer ), hFile );
    snprintf( buffer, elcount( buffer ), "0.0000 HMI_MCMS_MassAdj_FL_Stat_V3 := %X\n", getValue( HMI_MCMS_MassAdj_FL_Stat_V3 ) );        filePutString( buffer, elcount( buffer ), hFile );
    snprintf( buffer, elcount( buffer ), "0.0000 HMI_MCMS_MassInsty_FL_Stat := %X\n", getValue( HMI_MCMS_MassInsty_FL_Stat ) );        filePutString( buffer, elcount( buffer ), hFile );
    snprintf( buffer, elcount( buffer ), "0.0000 HMI_MCMS_SdRstPad_FL_Stat := %X\n", getValue( HMI_MCMS_SdRstPad_FL_Stat ) );        filePutString( buffer, elcount( buffer ), hFile );
    snprintf( buffer, elcount( buffer ), "0.0000 HMI_MCMS_SeatPad_FL_Stat := %X\n", getValue( HMI_MCMS_SeatPad_FL_Stat ) );        filePutString( buffer, elcount( buffer ), hFile );
    snprintf( buffer, elcount( buffer ), "0.0000 HMI_MCMS_ShldrPad_FL_Stat := %X\n", getValue( HMI_MCMS_ShldrPad_FL_Stat ) );        filePutString( buffer, elcount( buffer ), hFile );
}
/*@@end*/

/*@@timer:_tMCMS_FL_Stat_AR:*/
on timer _tMCMS_FL_Stat_AR
{
    putValue( HMI__STMSG_MCMS_FL_Stat_AR, 0 );
}
/*@@end*/

/*@@envVar:HMI__STMSG_MCMS_FL_Stat_AR:*/
on EnvVar HMI__STMSG_MCMS_FL_Stat_AR
{
    long tDelay;
    if( getValue( this ) == 2 )
    {
        tDelay = getValue( HMI__STMSGT_MCMS_FL_Stat_AR );
        if( tDelay > 0)    
            setTimer( _tMCMS_FL_Stat_AR, tDelay );
        else
            putValue( HMI__STMSG_MCMS_FL_Stat_AR, 0 );
    }
}
/*@@end*/

/*@@envVar:HMI_MCMS_AmbPress_FL:*/
on EnvVar HMI_MCMS_AmbPress_FL
{
    _mMCMS_FL_Stat_AR.MCMS_AmbPress_FL.phys = getValue(this);
    _MCMS_FL_Stat_AR_SpontanFlag = 1;
}
/*@@end*/

/*@@envVar:HMI_MCMS_DrvDynSeat_FL_Actv:*/
on EnvVar HMI_MCMS_DrvDynSeat_FL_Actv
{
    _mMCMS_FL_Stat_AR.MCMS_DrvDynSeat_FL_Actv.phys = getValue(this);
    _MCMS_FL_Stat_AR_SpontanFlag = 1;
}
/*@@end*/

/*@@envVar:HMI_MCMS_DrvDynSeatMd_FL_Stat:*/
on EnvVar HMI_MCMS_DrvDynSeatMd_FL_Stat
{
    _mMCMS_FL_Stat_AR.MCMS_DrvDynSeatMd_FL_Stat.phys = getValue(this);
    _MCMS_FL_Stat_AR_SpontanFlag = 1;
}
/*@@end*/

/*@@envVar:HMI_MCMS_HotStnInsty_FL_Stat:*/
on EnvVar HMI_MCMS_HotStnInsty_FL_Stat
{
    _mMCMS_FL_Stat_AR.MCMS_HotStnInsty_FL_Stat.phys = getValue(this);
    _MCMS_FL_Stat_AR_SpontanFlag = 1;
}
/*@@end*/

/*@@envVar:HMI_MCMS_LumPad_FL_Stat:*/
on EnvVar HMI_MCMS_LumPad_FL_Stat
{
    _mMCMS_FL_Stat_AR.MCMS_LumPad_FL_Stat.phys = getValue(this);
    _MCMS_FL_Stat_AR_SpontanFlag = 1;
}
/*@@end*/

/*@@envVar:HMI_MCMS_LumPosn_FL_Stat:*/
on EnvVar HMI_MCMS_LumPosn_FL_Stat
{
    _mMCMS_FL_Stat_AR.MCMS_LumPosn_FL_Stat.phys = getValue(this);
    _MCMS_FL_Stat_AR_SpontanFlag = 1;
}
/*@@end*/

/*@@envVar:HMI_MCMS_Mass_FL_On:*/
on EnvVar HMI_MCMS_Mass_FL_On
{
    _mMCMS_FL_Stat_AR.MCMS_Mass_FL_On.phys = getValue(this);
    _MCMS_FL_Stat_AR_SpontanFlag = 1;
}
/*@@end*/

/*@@envVar:HMI_MCMS_MassAdj_FL_Stat_V3:*/
on EnvVar HMI_MCMS_MassAdj_FL_Stat_V3
{
    _mMCMS_FL_Stat_AR.MCMS_MassAdj_FL_Stat_V3.phys = getValue(this);
    _MCMS_FL_Stat_AR_SpontanFlag = 1;
}
/*@@end*/

/*@@envVar:HMI_MCMS_MassInsty_FL_Stat:*/
on EnvVar HMI_MCMS_MassInsty_FL_Stat
{
    _mMCMS_FL_Stat_AR.MCMS_MassInsty_FL_Stat.phys = getValue(this);
    _MCMS_FL_Stat_AR_SpontanFlag = 1;
}
/*@@end*/

/*@@envVar:HMI_MCMS_SdRstPad_FL_Stat:*/
on EnvVar HMI_MCMS_SdRstPad_FL_Stat
{
    _mMCMS_FL_Stat_AR.MCMS_SdRstPad_FL_Stat.phys = getValue(this);
    _MCMS_FL_Stat_AR_SpontanFlag = 1;
}
/*@@end*/

/*@@envVar:HMI_MCMS_SeatPad_FL_Stat:*/
on EnvVar HMI_MCMS_SeatPad_FL_Stat
{
    _mMCMS_FL_Stat_AR.MCMS_SeatPad_FL_Stat.phys = getValue(this);
    _MCMS_FL_Stat_AR_SpontanFlag = 1;
}
/*@@end*/

/*@@envVar:HMI_MCMS_ShldrPad_FL_Stat:*/
on EnvVar HMI_MCMS_ShldrPad_FL_Stat
{
    _mMCMS_FL_Stat_AR.MCMS_ShldrPad_FL_Stat.phys = getValue(this);
    _MCMS_FL_Stat_AR_SpontanFlag = 1;
}
/*@@end*/

/*@@caplFunc:MCMS_FR_AR_check_output():*/
MCMS_FR_AR_check_output()
{
    if( !getValue( HMI__STMSG_MCMS_FR_AR ) )
    {
        // Botschaft MCMS_FR_AR ID: 799 --- Sendeart 5 cyclicAndSpontanWithDelay --- 
        _MCMS_FR_AR_Cnt--;
        if( _MCMS_FR_AR_Cnt < 1 )
        {
            MCMS_FR_AR_output(); // Nachricht wg. abgelaufenem Zyklus ausgeben
            _MCMS_FR_AR_Cnt = _MCMS_FR_AR_CycleCount; // Zyklus-Zähler zurücksetzen
            _MCMS_FR_AR_SpontanFlag = 0; // Spontan-Flag zurücksetzen
        }
        else if( _MCMS_FR_AR_SpontanFlag )
        {
            MCMS_FR_AR_output(); // Nachricht wg. spontaner Änderung ausgeben
            _MCMS_FR_AR_SpontanFlag = 0; // Spontan-Flag zurücksetzen
        }
    }
}
/*@@end*/

/*@@caplFunc:MCMS_FR_AR_init():*/
MCMS_FR_AR_init()
{   /* Botschaft MCMS_FR_AR ID: 799 --- Sendeart 5 cyclicAndSpontanWithDelay --- 
BA_ "ApplMessage" BO_ 799 0;
BA_ "NmAsrMessage" BO_ 799 0;
BA_ "GenMsgMinAcceptLength" BO_ 799 8;
BA_ "GenMsgILSupport" BO_ 799 1;
BA_ "DiagState" BO_ 799 0;
BA_ "DiagRequest" BO_ 799 0;
BA_ "DiagResponse" BO_ 799 0;
BA_ "GenMsgStartValue" BO_ 799 "0";
BA_ "GenMsgDelayTime" BO_ 799 5;
BA_ "GenMsgNrOfRepetitions" BO_ 799 0;
BA_ "GenMsgCycleTime" BO_ 799 1000;
BA_ "GenMsgSendType" BO_ 799 5;
    */
    _MCMS_FR_AR_Timebase =           c_tDBKomTimer_20ms;
    _MCMS_FR_AR_CycleCount =       1000 / _MCMS_FR_AR_Timebase;
    _MCMS_FR_AR_StartDelay =          0 / _MCMS_FR_AR_Timebase;
    _MCMS_FR_AR_Cnt = _MCMS_FR_AR_StartDelay;
    _MCMS_FR_AR_SpontanFlag = 0;

    putValue( HMI__STMSGSD_MCMS_FR_AR, _MCMS_FR_AR_StartDelay * _MCMS_FR_AR_Timebase );

    _mMCMS_FR_AR.HotStn_FR_On_Rq.phys = getValue( HMI_HotStn_FR_On_Rq );
    _mMCMS_FR_AR.MCMS_ActvComf_FR_Stat.phys = getValue( HMI_MCMS_ActvComf_FR_Stat );
    _mMCMS_FR_AR.MCMS_ActvComfProg_FR_Stat.phys = getValue( HMI_MCMS_ActvComfProg_FR_Stat );
    _mMCMS_FR_AR.MCMS_FR_On.phys = getValue( HMI_MCMS_FR_On );
    _mMCMS_FR_AR.MCMS_LumPad_FR.phys = getValue( HMI_MCMS_LumPad_FR );
    _mMCMS_FR_AR.MCMS_LumPosn_FR.phys = getValue( HMI_MCMS_LumPosn_FR );
    _mMCMS_FR_AR.MCMS_Pmp_FR_Rq.phys = getValue( HMI_MCMS_Pmp_FR_Rq );
    _mMCMS_FR_AR.MCMS_SdRstPad_FR.phys = getValue( HMI_MCMS_SdRstPad_FR );
    _mMCMS_FR_AR.MCMS_SeatPad_FR.phys = getValue( HMI_MCMS_SeatPad_FR );
    _mMCMS_FR_AR.MCMS_ShldrPad_FR.phys = getValue( HMI_MCMS_ShldrPad_FR );
}
/*@@end*/

/*@@caplFunc:MCMS_FR_AR_output():*/
MCMS_FR_AR_output(void)
{
    output( _mMCMS_FR_AR );
}
/*@@end*/

/*@@caplFunc:MCMS_FR_AR_saveEnvVars(dword):*/
MCMS_FR_AR_saveEnvVars( dword hFile )
{
    filePutString("\n// Knoten EIS: MCMS_FR_AR\n", 24, hFile );
    snprintf( buffer, elcount( buffer ), "0.0000 HMI__STMSG_MCMS_FR := %X\n", getValue( HMI__STMSG_MCMS_FR_AR ) );        filePutString( buffer, elcount( buffer ), hFile );
    snprintf( buffer, elcount( buffer ), "0.0000 HMI__STMSGT_MCMS_FR := %X\n", getValue( HMI__STMSGT_MCMS_FR_AR ) );        filePutString( buffer, elcount( buffer ), hFile );
    snprintf( buffer, elcount( buffer ), "0.0000 HMI_HotStn_FR_On_Rq := %X\n", getValue( HMI_HotStn_FR_On_Rq ) );        filePutString( buffer, elcount( buffer ), hFile );
    snprintf( buffer, elcount( buffer ), "0.0000 HMI_MCMS_ActvComf_FR_Stat := %X\n", getValue( HMI_MCMS_ActvComf_FR_Stat ) );        filePutString( buffer, elcount( buffer ), hFile );
    snprintf( buffer, elcount( buffer ), "0.0000 HMI_MCMS_ActvComfProg_FR_Stat := %X\n", getValue( HMI_MCMS_ActvComfProg_FR_Stat ) );        filePutString( buffer, elcount( buffer ), hFile );
    snprintf( buffer, elcount( buffer ), "0.0000 HMI_MCMS_FR_On := %X\n", getValue( HMI_MCMS_FR_On ) );        filePutString( buffer, elcount( buffer ), hFile );
    snprintf( buffer, elcount( buffer ), "0.0000 HMI_MCMS_LumPad_FR := %X\n", getValue( HMI_MCMS_LumPad_FR ) );        filePutString( buffer, elcount( buffer ), hFile );
    snprintf( buffer, elcount( buffer ), "0.0000 HMI_MCMS_LumPosn_FR := %X\n", getValue( HMI_MCMS_LumPosn_FR ) );        filePutString( buffer, elcount( buffer ), hFile );
    snprintf( buffer, elcount( buffer ), "0.0000 HMI_MCMS_Pmp_FR_Rq := %X\n", getValue( HMI_MCMS_Pmp_FR_Rq ) );        filePutString( buffer, elcount( buffer ), hFile );
    snprintf( buffer, elcount( buffer ), "0.0000 HMI_MCMS_SdRstPad_FR := %X\n", getValue( HMI_MCMS_SdRstPad_FR ) );        filePutString( buffer, elcount( buffer ), hFile );
    snprintf( buffer, elcount( buffer ), "0.0000 HMI_MCMS_SeatPad_FR := %X\n", getValue( HMI_MCMS_SeatPad_FR ) );        filePutString( buffer, elcount( buffer ), hFile );
    snprintf( buffer, elcount( buffer ), "0.0000 HMI_MCMS_ShldrPad_FR := %X\n", getValue( HMI_MCMS_ShldrPad_FR ) );        filePutString( buffer, elcount( buffer ), hFile );
}
/*@@end*/

/*@@timer:_tMCMS_FR_AR:*/
on timer _tMCMS_FR_AR
{
    putValue( HMI__STMSG_MCMS_FR_AR, 0 );
}
/*@@end*/

/*@@envVar:HMI__STMSG_MCMS_FR_AR:*/
on EnvVar HMI__STMSG_MCMS_FR_AR
{
    long tDelay;
    if( getValue( this ) == 2 )
    {
        tDelay = getValue( HMI__STMSGT_MCMS_FR_AR );
        if( tDelay > 0)    
            setTimer( _tMCMS_FR_AR, tDelay );
        else
            putValue( HMI__STMSG_MCMS_FR_AR, 0 );
    }
}
/*@@end*/

/*@@envVar:HMI_HotStn_FR_On_Rq:*/
on EnvVar HMI_HotStn_FR_On_Rq
{
    _mMCMS_FR_AR.HotStn_FR_On_Rq.phys = getValue(this);
    _MCMS_FR_AR_SpontanFlag = 1;
}
/*@@end*/

/*@@envVar:HMI_MCMS_ActvComf_FR_Stat:*/
on EnvVar HMI_MCMS_ActvComf_FR_Stat
{
    _mMCMS_FR_AR.MCMS_ActvComf_FR_Stat.phys = getValue(this);
    _MCMS_FR_AR_SpontanFlag = 1;
}
/*@@end*/

/*@@envVar:HMI_MCMS_ActvComfProg_FR_Stat:*/
on EnvVar HMI_MCMS_ActvComfProg_FR_Stat
{
    _mMCMS_FR_AR.MCMS_ActvComfProg_FR_Stat.phys = getValue(this);
    _MCMS_FR_AR_SpontanFlag = 1;
}
/*@@end*/

/*@@envVar:HMI_MCMS_FR_On:*/
on EnvVar HMI_MCMS_FR_On
{
    _mMCMS_FR_AR.MCMS_FR_On.phys = getValue(this);
    _MCMS_FR_AR_SpontanFlag = 1;
}
/*@@end*/

/*@@envVar:HMI_MCMS_LumPad_FR:*/
on EnvVar HMI_MCMS_LumPad_FR
{
    _mMCMS_FR_AR.MCMS_LumPad_FR.phys = getValue(this);
    _MCMS_FR_AR_SpontanFlag = 1;
}
/*@@end*/

/*@@envVar:HMI_MCMS_LumPosn_FR:*/
on EnvVar HMI_MCMS_LumPosn_FR
{
    _mMCMS_FR_AR.MCMS_LumPosn_FR.phys = getValue(this);
    _MCMS_FR_AR_SpontanFlag = 1;
}
/*@@end*/

/*@@envVar:HMI_MCMS_Pmp_FR_Rq:*/
on EnvVar HMI_MCMS_Pmp_FR_Rq
{
    _mMCMS_FR_AR.MCMS_Pmp_FR_Rq.phys = getValue(this);
    _MCMS_FR_AR_SpontanFlag = 1;
}
/*@@end*/

/*@@envVar:HMI_MCMS_SdRstPad_FR:*/
on EnvVar HMI_MCMS_SdRstPad_FR
{
    _mMCMS_FR_AR.MCMS_SdRstPad_FR.phys = getValue(this);
    _MCMS_FR_AR_SpontanFlag = 1;
}
/*@@end*/

/*@@envVar:HMI_MCMS_SeatPad_FR:*/
on EnvVar HMI_MCMS_SeatPad_FR
{
    _mMCMS_FR_AR.MCMS_SeatPad_FR.phys = getValue(this);
    _MCMS_FR_AR_SpontanFlag = 1;
}
/*@@end*/

/*@@envVar:HMI_MCMS_ShldrPad_FR:*/
on EnvVar HMI_MCMS_ShldrPad_FR
{
    _mMCMS_FR_AR.MCMS_ShldrPad_FR.phys = getValue(this);
    _MCMS_FR_AR_SpontanFlag = 1;
}
/*@@end*/

/*@@caplFunc:MCMS_FR_Stat_AR_check_output():*/
MCMS_FR_Stat_AR_check_output()
{
    if( !getValue( HMI__STMSG_MCMS_FR_Stat_AR ) )
    {
        // Botschaft MCMS_FR_Stat_AR ID: 801 --- Sendeart 5 cyclicAndSpontanWithDelay --- 
        _MCMS_FR_Stat_AR_Cnt--;
        if( _MCMS_FR_Stat_AR_Cnt < 1 )
        {
            MCMS_FR_Stat_AR_output(); // Nachricht wg. abgelaufenem Zyklus ausgeben
            _MCMS_FR_Stat_AR_Cnt = _MCMS_FR_Stat_AR_CycleCount; // Zyklus-Zähler zurücksetzen
            _MCMS_FR_Stat_AR_SpontanFlag = 0; // Spontan-Flag zurücksetzen
        }
        else if( _MCMS_FR_Stat_AR_SpontanFlag )
        {
            MCMS_FR_Stat_AR_output(); // Nachricht wg. spontaner Änderung ausgeben
            _MCMS_FR_Stat_AR_SpontanFlag = 0; // Spontan-Flag zurücksetzen
        }
    }
}
/*@@end*/

/*@@caplFunc:MCMS_FR_Stat_AR_init():*/
MCMS_FR_Stat_AR_init()
{   /* Botschaft MCMS_FR_Stat_AR ID: 801 --- Sendeart 5 cyclicAndSpontanWithDelay --- 
BA_ "ApplMessage" BO_ 801 0;
BA_ "NmAsrMessage" BO_ 801 0;
BA_ "GenMsgMinAcceptLength" BO_ 801 8;
BA_ "GenMsgILSupport" BO_ 801 1;
BA_ "DiagState" BO_ 801 0;
BA_ "DiagRequest" BO_ 801 0;
BA_ "DiagResponse" BO_ 801 0;
BA_ "GenMsgStartValue" BO_ 801 "0";
BA_ "GenMsgDelayTime" BO_ 801 5;
BA_ "GenMsgNrOfRepetitions" BO_ 801 0;
BA_ "GenMsgCycleTime" BO_ 801 1000;
BA_ "GenMsgSendType" BO_ 801 5;
    */
    _MCMS_FR_Stat_AR_Timebase =           c_tDBKomTimer_20ms;
    _MCMS_FR_Stat_AR_CycleCount =       1000 / _MCMS_FR_Stat_AR_Timebase;
    _MCMS_FR_Stat_AR_StartDelay =          0 / _MCMS_FR_Stat_AR_Timebase;
    _MCMS_FR_Stat_AR_Cnt = _MCMS_FR_Stat_AR_StartDelay;
    _MCMS_FR_Stat_AR_SpontanFlag = 0;

    putValue( HMI__STMSGSD_MCMS_FR_Stat_AR, _MCMS_FR_Stat_AR_StartDelay * _MCMS_FR_Stat_AR_Timebase );

    _mMCMS_FR_Stat_AR.MCMS_AmbPress_FR.phys = getValue( HMI_MCMS_AmbPress_FR );
    _mMCMS_FR_Stat_AR.MCMS_DrvDynSeat_FR_Actv.phys = getValue( HMI_MCMS_DrvDynSeat_FR_Actv );
    _mMCMS_FR_Stat_AR.MCMS_DrvDynSeatMd_FR_Stat.phys = getValue( HMI_MCMS_DrvDynSeatMd_FR_Stat );
    _mMCMS_FR_Stat_AR.MCMS_HotStnInsty_FR_Stat.phys = getValue( HMI_MCMS_HotStnInsty_FR_Stat );
    _mMCMS_FR_Stat_AR.MCMS_LumPad_FR_Stat.phys = getValue( HMI_MCMS_LumPad_FR_Stat );
    _mMCMS_FR_Stat_AR.MCMS_LumPosn_FR_Stat.phys = getValue( HMI_MCMS_LumPosn_FR_Stat );
    _mMCMS_FR_Stat_AR.MCMS_Mass_FR_On.phys = getValue( HMI_MCMS_Mass_FR_On );
    _mMCMS_FR_Stat_AR.MCMS_MassAdj_FR_Stat_V3.phys = getValue( HMI_MCMS_MassAdj_FR_Stat_V3 );
    _mMCMS_FR_Stat_AR.MCMS_MassInsty_FR_Stat.phys = getValue( HMI_MCMS_MassInsty_FR_Stat );
    _mMCMS_FR_Stat_AR.MCMS_SdRstPad_FR_Stat.phys = getValue( HMI_MCMS_SdRstPad_FR_Stat );
    _mMCMS_FR_Stat_AR.MCMS_SeatPad_FR_Stat.phys = getValue( HMI_MCMS_SeatPad_FR_Stat );
    _mMCMS_FR_Stat_AR.MCMS_ShldrPad_FR_Stat.phys = getValue( HMI_MCMS_ShldrPad_FR_Stat );
}
/*@@end*/

/*@@caplFunc:MCMS_FR_Stat_AR_output():*/
MCMS_FR_Stat_AR_output(void)
{
    output( _mMCMS_FR_Stat_AR );
}
/*@@end*/

/*@@caplFunc:MCMS_FR_Stat_AR_saveEnvVars(dword):*/
MCMS_FR_Stat_AR_saveEnvVars( dword hFile )
{
    filePutString("\n// Knoten EIS: MCMS_FR_Stat_AR\n", 29, hFile );
    snprintf( buffer, elcount( buffer ), "0.0000 HMI__STMSG_MCMS_FR_Stat := %X\n", getValue( HMI__STMSG_MCMS_FR_Stat_AR ) );        filePutString( buffer, elcount( buffer ), hFile );
    snprintf( buffer, elcount( buffer ), "0.0000 HMI__STMSGT_MCMS_FR_Stat := %X\n", getValue( HMI__STMSGT_MCMS_FR_Stat_AR ) );        filePutString( buffer, elcount( buffer ), hFile );
    snprintf( buffer, elcount( buffer ), "0.0000 HMI_MCMS_AmbPress_FR := %X\n", getValue( HMI_MCMS_AmbPress_FR ) );        filePutString( buffer, elcount( buffer ), hFile );
    snprintf( buffer, elcount( buffer ), "0.0000 HMI_MCMS_DrvDynSeat_FR_Actv := %X\n", getValue( HMI_MCMS_DrvDynSeat_FR_Actv ) );        filePutString( buffer, elcount( buffer ), hFile );
    snprintf( buffer, elcount( buffer ), "0.0000 HMI_MCMS_DrvDynSeatMd_FR_Stat := %X\n", getValue( HMI_MCMS_DrvDynSeatMd_FR_Stat ) );        filePutString( buffer, elcount( buffer ), hFile );
    snprintf( buffer, elcount( buffer ), "0.0000 HMI_MCMS_HotStnInsty_FR_Stat := %X\n", getValue( HMI_MCMS_HotStnInsty_FR_Stat ) );        filePutString( buffer, elcount( buffer ), hFile );
    snprintf( buffer, elcount( buffer ), "0.0000 HMI_MCMS_LumPad_FR_Stat := %X\n", getValue( HMI_MCMS_LumPad_FR_Stat ) );        filePutString( buffer, elcount( buffer ), hFile );
    snprintf( buffer, elcount( buffer ), "0.0000 HMI_MCMS_LumPosn_FR_Stat := %X\n", getValue( HMI_MCMS_LumPosn_FR_Stat ) );        filePutString( buffer, elcount( buffer ), hFile );
    snprintf( buffer, elcount( buffer ), "0.0000 HMI_MCMS_Mass_FR_On := %X\n", getValue( HMI_MCMS_Mass_FR_On ) );        filePutString( buffer, elcount( buffer ), hFile );
    snprintf( buffer, elcount( buffer ), "0.0000 HMI_MCMS_MassAdj_FR_Stat_V3 := %X\n", getValue( HMI_MCMS_MassAdj_FR_Stat_V3 ) );        filePutString( buffer, elcount( buffer ), hFile );
    snprintf( buffer, elcount( buffer ), "0.0000 HMI_MCMS_MassInsty_FR_Stat := %X\n", getValue( HMI_MCMS_MassInsty_FR_Stat ) );        filePutString( buffer, elcount( buffer ), hFile );
    snprintf( buffer, elcount( buffer ), "0.0000 HMI_MCMS_SdRstPad_FR_Stat := %X\n", getValue( HMI_MCMS_SdRstPad_FR_Stat ) );        filePutString( buffer, elcount( buffer ), hFile );
    snprintf( buffer, elcount( buffer ), "0.0000 HMI_MCMS_SeatPad_FR_Stat := %X\n", getValue( HMI_MCMS_SeatPad_FR_Stat ) );        filePutString( buffer, elcount( buffer ), hFile );
    snprintf( buffer, elcount( buffer ), "0.0000 HMI_MCMS_ShldrPad_FR_Stat := %X\n", getValue( HMI_MCMS_ShldrPad_FR_Stat ) );        filePutString( buffer, elcount( buffer ), hFile );
}
/*@@end*/

/*@@timer:_tMCMS_FR_Stat_AR:*/
on timer _tMCMS_FR_Stat_AR
{
    putValue( HMI__STMSG_MCMS_FR_Stat_AR, 0 );
}
/*@@end*/

/*@@envVar:HMI__STMSG_MCMS_FR_Stat_AR:*/
on EnvVar HMI__STMSG_MCMS_FR_Stat_AR
{
    long tDelay;
    if( getValue( this ) == 2 )
    {
        tDelay = getValue( HMI__STMSGT_MCMS_FR_Stat_AR );
        if( tDelay > 0)    
            setTimer( _tMCMS_FR_Stat_AR, tDelay );
        else
            putValue( HMI__STMSG_MCMS_FR_Stat_AR, 0 );
    }
}
/*@@end*/

/*@@envVar:HMI_MCMS_AmbPress_FR:*/
on EnvVar HMI_MCMS_AmbPress_FR
{
    _mMCMS_FR_Stat_AR.MCMS_AmbPress_FR.phys = getValue(this);
    _MCMS_FR_Stat_AR_SpontanFlag = 1;
}
/*@@end*/

/*@@envVar:HMI_MCMS_DrvDynSeat_FR_Actv:*/
on EnvVar HMI_MCMS_DrvDynSeat_FR_Actv
{
    _mMCMS_FR_Stat_AR.MCMS_DrvDynSeat_FR_Actv.phys = getValue(this);
    _MCMS_FR_Stat_AR_SpontanFlag = 1;
}
/*@@end*/

/*@@envVar:HMI_MCMS_DrvDynSeatMd_FR_Stat:*/
on EnvVar HMI_MCMS_DrvDynSeatMd_FR_Stat
{
    _mMCMS_FR_Stat_AR.MCMS_DrvDynSeatMd_FR_Stat.phys = getValue(this);
    _MCMS_FR_Stat_AR_SpontanFlag = 1;
}
/*@@end*/

/*@@envVar:HMI_MCMS_HotStnInsty_FR_Stat:*/
on EnvVar HMI_MCMS_HotStnInsty_FR_Stat
{
    _mMCMS_FR_Stat_AR.MCMS_HotStnInsty_FR_Stat.phys = getValue(this);
    _MCMS_FR_Stat_AR_SpontanFlag = 1;
}
/*@@end*/

/*@@envVar:HMI_MCMS_LumPad_FR_Stat:*/
on EnvVar HMI_MCMS_LumPad_FR_Stat
{
    _mMCMS_FR_Stat_AR.MCMS_LumPad_FR_Stat.phys = getValue(this);
    _MCMS_FR_Stat_AR_SpontanFlag = 1;
}
/*@@end*/

/*@@envVar:HMI_MCMS_LumPosn_FR_Stat:*/
on EnvVar HMI_MCMS_LumPosn_FR_Stat
{
    _mMCMS_FR_Stat_AR.MCMS_LumPosn_FR_Stat.phys = getValue(this);
    _MCMS_FR_Stat_AR_SpontanFlag = 1;
}
/*@@end*/

/*@@envVar:HMI_MCMS_Mass_FR_On:*/
on EnvVar HMI_MCMS_Mass_FR_On
{
    _mMCMS_FR_Stat_AR.MCMS_Mass_FR_On.phys = getValue(this);
    _MCMS_FR_Stat_AR_SpontanFlag = 1;
}
/*@@end*/

/*@@envVar:HMI_MCMS_MassAdj_FR_Stat_V3:*/
on EnvVar HMI_MCMS_MassAdj_FR_Stat_V3
{
    _mMCMS_FR_Stat_AR.MCMS_MassAdj_FR_Stat_V3.phys = getValue(this);
    _MCMS_FR_Stat_AR_SpontanFlag = 1;
}
/*@@end*/

/*@@envVar:HMI_MCMS_MassInsty_FR_Stat:*/
on EnvVar HMI_MCMS_MassInsty_FR_Stat
{
    _mMCMS_FR_Stat_AR.MCMS_MassInsty_FR_Stat.phys = getValue(this);
    _MCMS_FR_Stat_AR_SpontanFlag = 1;
}
/*@@end*/

/*@@envVar:HMI_MCMS_SdRstPad_FR_Stat:*/
on EnvVar HMI_MCMS_SdRstPad_FR_Stat
{
    _mMCMS_FR_Stat_AR.MCMS_SdRstPad_FR_Stat.phys = getValue(this);
    _MCMS_FR_Stat_AR_SpontanFlag = 1;
}
/*@@end*/

/*@@envVar:HMI_MCMS_SeatPad_FR_Stat:*/
on EnvVar HMI_MCMS_SeatPad_FR_Stat
{
    _mMCMS_FR_Stat_AR.MCMS_SeatPad_FR_Stat.phys = getValue(this);
    _MCMS_FR_Stat_AR_SpontanFlag = 1;
}
/*@@end*/

/*@@envVar:HMI_MCMS_ShldrPad_FR_Stat:*/
on EnvVar HMI_MCMS_ShldrPad_FR_Stat
{
    _mMCMS_FR_Stat_AR.MCMS_ShldrPad_FR_Stat.phys = getValue(this);
    _MCMS_FR_Stat_AR_SpontanFlag = 1;
}
/*@@end*/

/*@@caplFunc:MCMS_RL_AR_check_output():*/
MCMS_RL_AR_check_output()
{
    if( !getValue( HMI__STMSG_MCMS_RL_AR ) )
    {
        // Botschaft MCMS_RL_AR ID: 807 --- Sendeart 5 cyclicAndSpontanWithDelay --- 
        _MCMS_RL_AR_Cnt--;
        if( _MCMS_RL_AR_Cnt < 1 )
        {
            MCMS_RL_AR_output(); // Nachricht wg. abgelaufenem Zyklus ausgeben
            _MCMS_RL_AR_Cnt = _MCMS_RL_AR_CycleCount; // Zyklus-Zähler zurücksetzen
            _MCMS_RL_AR_SpontanFlag = 0; // Spontan-Flag zurücksetzen
        }
        else if( _MCMS_RL_AR_SpontanFlag )
        {
            MCMS_RL_AR_output(); // Nachricht wg. spontaner Änderung ausgeben
            _MCMS_RL_AR_SpontanFlag = 0; // Spontan-Flag zurücksetzen
        }
    }
}
/*@@end*/

/*@@caplFunc:MCMS_RL_AR_init():*/
MCMS_RL_AR_init()
{   /* Botschaft MCMS_RL_AR ID: 807 --- Sendeart 5 cyclicAndSpontanWithDelay --- 
BA_ "ApplMessage" BO_ 807 0;
BA_ "NmAsrMessage" BO_ 807 0;
BA_ "GenMsgMinAcceptLength" BO_ 807 8;
BA_ "GenMsgILSupport" BO_ 807 1;
BA_ "DiagState" BO_ 807 0;
BA_ "DiagRequest" BO_ 807 0;
BA_ "DiagResponse" BO_ 807 0;
BA_ "GenMsgStartValue" BO_ 807 "0";
BA_ "GenMsgDelayTime" BO_ 807 5;
BA_ "GenMsgNrOfRepetitions" BO_ 807 0;
BA_ "GenMsgCycleTime" BO_ 807 1000;
BA_ "GenMsgSendType" BO_ 807 5;
    */
    _MCMS_RL_AR_Timebase =           c_tDBKomTimer_20ms;
    _MCMS_RL_AR_CycleCount =      1000 / _MCMS_RL_AR_Timebase;
    _MCMS_RL_AR_StartDelay =         0 / _MCMS_RL_AR_Timebase;
    _MCMS_RL_AR_Cnt = _MCMS_RL_AR_StartDelay;
    _MCMS_RL_AR_SpontanFlag = 0;

    putValue( HMI__STMSGSD_MCMS_RL_AR, _MCMS_RL_AR_StartDelay * _MCMS_RL_AR_Timebase );

    _mMCMS_RL_AR.HotStn_RL_On_Rq.phys = getValue( HMI_HotStn_RL_On_Rq );
    _mMCMS_RL_AR.MCMS_ActvComf_RL_Stat.phys = getValue( HMI_MCMS_ActvComf_RL_Stat );
    _mMCMS_RL_AR.MCMS_ActvComfProg_RL_Stat.phys = getValue( HMI_MCMS_ActvComfProg_RL_Stat );
    _mMCMS_RL_AR.MCMS_LumPad_RL.phys = getValue( HMI_MCMS_LumPad_RL );
    _mMCMS_RL_AR.MCMS_LumPosn_RL.phys = getValue( HMI_MCMS_LumPosn_RL );
    _mMCMS_RL_AR.MCMS_Pmp_RL_Rq.phys = getValue( HMI_MCMS_Pmp_RL_Rq );
    _mMCMS_RL_AR.MCMS_RL_On.phys = getValue( HMI_MCMS_RL_On );
    _mMCMS_RL_AR.MCMS_SdRstPad_RL.phys = getValue( HMI_MCMS_SdRstPad_RL );
}
/*@@end*/

/*@@caplFunc:MCMS_RL_AR_output():*/
MCMS_RL_AR_output(void)
{
    output( _mMCMS_RL_AR );
}
/*@@end*/

/*@@caplFunc:MCMS_RL_AR_saveEnvVars(dword):*/
MCMS_RL_AR_saveEnvVars( dword hFile )
{
    filePutString("\n// Knoten EIS: MCMS_RL_AR\n", 24, hFile );
    snprintf( buffer, elcount( buffer ), "0.0000 HMI__STMSG_MCMS_RL := %X\n", getValue( HMI__STMSG_MCMS_RL_AR ) );        filePutString( buffer, elcount( buffer ), hFile );
    snprintf( buffer, elcount( buffer ), "0.0000 HMI__STMSGT_MCMS_RL := %X\n", getValue( HMI__STMSGT_MCMS_RL_AR ) );        filePutString( buffer, elcount( buffer ), hFile );
    snprintf( buffer, elcount( buffer ), "0.0000 HMI_HotStn_RL_On_Rq := %X\n", getValue( HMI_HotStn_RL_On_Rq ) );        filePutString( buffer, elcount( buffer ), hFile );
    snprintf( buffer, elcount( buffer ), "0.0000 HMI_MCMS_ActvComf_RL_Stat := %X\n", getValue( HMI_MCMS_ActvComf_RL_Stat ) );        filePutString( buffer, elcount( buffer ), hFile );
    snprintf( buffer, elcount( buffer ), "0.0000 HMI_MCMS_ActvComfProg_RL_Stat := %X\n", getValue( HMI_MCMS_ActvComfProg_RL_Stat ) );        filePutString( buffer, elcount( buffer ), hFile );
    snprintf( buffer, elcount( buffer ), "0.0000 HMI_MCMS_LumPad_RL := %X\n", getValue( HMI_MCMS_LumPad_RL ) );        filePutString( buffer, elcount( buffer ), hFile );
    snprintf( buffer, elcount( buffer ), "0.0000 HMI_MCMS_LumPosn_RL := %X\n", getValue( HMI_MCMS_LumPosn_RL ) );        filePutString( buffer, elcount( buffer ), hFile );
    snprintf( buffer, elcount( buffer ), "0.0000 HMI_MCMS_Pmp_RL_Rq := %X\n", getValue( HMI_MCMS_Pmp_RL_Rq ) );        filePutString( buffer, elcount( buffer ), hFile );
    snprintf( buffer, elcount( buffer ), "0.0000 HMI_MCMS_RL_On := %X\n", getValue( HMI_MCMS_RL_On ) );        filePutString( buffer, elcount( buffer ), hFile );
    snprintf( buffer, elcount( buffer ), "0.0000 HMI_MCMS_SdRstPad_RL := %X\n", getValue( HMI_MCMS_SdRstPad_RL ) );        filePutString( buffer, elcount( buffer ), hFile );
}
/*@@end*/

/*@@timer:_tMCMS_RL_AR:*/
on timer _tMCMS_RL_AR
{
    putValue( HMI__STMSG_MCMS_RL_AR, 0 );
}
/*@@end*/

/*@@envVar:HMI__STMSG_MCMS_RL_AR:*/
on EnvVar HMI__STMSG_MCMS_RL_AR
{
    long tDelay;
    if( getValue( this ) == 2 )
    {
        tDelay = getValue( HMI__STMSGT_MCMS_RL_AR );
        if( tDelay > 0)    
            setTimer( _tMCMS_RL_AR, tDelay );
        else
            putValue( HMI__STMSG_MCMS_RL_AR, 0 );
    }
}
/*@@end*/

/*@@envVar:HMI_HotStn_RL_On_Rq:*/
on EnvVar HMI_HotStn_RL_On_Rq
{
    _mMCMS_RL_AR.HotStn_RL_On_Rq.phys = getValue(this);
    _MCMS_RL_AR_SpontanFlag = 1;
}
/*@@end*/

/*@@envVar:HMI_MCMS_ActvComf_RL_Stat:*/
on EnvVar HMI_MCMS_ActvComf_RL_Stat
{
    _mMCMS_RL_AR.MCMS_ActvComf_RL_Stat.phys = getValue(this);
    _MCMS_RL_AR_SpontanFlag = 1;
}
/*@@end*/

/*@@envVar:HMI_MCMS_ActvComfProg_RL_Stat:*/
on EnvVar HMI_MCMS_ActvComfProg_RL_Stat
{
    _mMCMS_RL_AR.MCMS_ActvComfProg_RL_Stat.phys = getValue(this);
    _MCMS_RL_AR_SpontanFlag = 1;
}
/*@@end*/

/*@@envVar:HMI_MCMS_LumPad_RL:*/
on EnvVar HMI_MCMS_LumPad_RL
{
    _mMCMS_RL_AR.MCMS_LumPad_RL.phys = getValue(this);
    _MCMS_RL_AR_SpontanFlag = 1;
}
/*@@end*/

/*@@envVar:HMI_MCMS_LumPosn_RL:*/
on EnvVar HMI_MCMS_LumPosn_RL
{
    _mMCMS_RL_AR.MCMS_LumPosn_RL.phys = getValue(this);
    _MCMS_RL_AR_SpontanFlag = 1;
}
/*@@end*/

/*@@envVar:HMI_MCMS_Pmp_RL_Rq:*/
on EnvVar HMI_MCMS_Pmp_RL_Rq
{
    _mMCMS_RL_AR.MCMS_Pmp_RL_Rq.phys = getValue(this);
    _MCMS_RL_AR_SpontanFlag = 1;
}
/*@@end*/

/*@@envVar:HMI_MCMS_RL_On:*/
on EnvVar HMI_MCMS_RL_On
{
    _mMCMS_RL_AR.MCMS_RL_On.phys = getValue(this);
    _MCMS_RL_AR_SpontanFlag = 1;
}
/*@@end*/

/*@@envVar:HMI_MCMS_SdRstPad_RL:*/
on EnvVar HMI_MCMS_SdRstPad_RL
{
    _mMCMS_RL_AR.MCMS_SdRstPad_RL.phys = getValue(this);
    _MCMS_RL_AR_SpontanFlag = 1;
}
/*@@end*/

/*@@caplFunc:MCMS_RL_Stat_AR_check_output():*/
MCMS_RL_Stat_AR_check_output()
{
    if( !getValue( HMI__STMSG_MCMS_RL_Stat_AR ) )
    {
        // Botschaft MCMS_RL_Stat_AR ID: 809 --- Sendeart 5 cyclicAndSpontanWithDelay --- 
        _MCMS_RL_Stat_AR_Cnt--;
        if( _MCMS_RL_Stat_AR_Cnt < 1 )
        {
            MCMS_RL_Stat_AR_output(); // Nachricht wg. abgelaufenem Zyklus ausgeben
            _MCMS_RL_Stat_AR_Cnt = _MCMS_RL_Stat_AR_CycleCount; // Zyklus-Zähler zurücksetzen
            _MCMS_RL_Stat_AR_SpontanFlag = 0; // Spontan-Flag zurücksetzen
        }
        else if( _MCMS_RL_Stat_AR_SpontanFlag )
        {
            MCMS_RL_Stat_AR_output(); // Nachricht wg. spontaner Änderung ausgeben
            _MCMS_RL_Stat_AR_SpontanFlag = 0; // Spontan-Flag zurücksetzen
        }
    }
}
/*@@end*/

/*@@caplFunc:MCMS_RL_Stat_AR_init():*/
MCMS_RL_Stat_AR_init()
{   /* Botschaft MCMS_RL_Stat_AR ID: 809 --- Sendeart 5 cyclicAndSpontanWithDelay --- 
BA_ "ApplMessage" BO_ 809 0;
BA_ "NmAsrMessage" BO_ 809 0;
BA_ "GenMsgMinAcceptLength" BO_ 809 8;
BA_ "GenMsgILSupport" BO_ 809 1;
BA_ "DiagState" BO_ 809 0;
BA_ "DiagRequest" BO_ 809 0;
BA_ "DiagResponse" BO_ 809 0;
BA_ "GenMsgStartValue" BO_ 809 "0";
BA_ "GenMsgDelayTime" BO_ 809 5;
BA_ "GenMsgNrOfRepetitions" BO_ 809 0;
BA_ "GenMsgCycleTime" BO_ 809 1000;
BA_ "GenMsgSendType" BO_ 809 5;
    */
    _MCMS_RL_Stat_AR_Timebase =           c_tDBKomTimer_20ms;
    _MCMS_RL_Stat_AR_CycleCount =        1000 / _MCMS_RL_Stat_AR_Timebase;
    _MCMS_RL_Stat_AR_StartDelay =           0 / _MCMS_RL_Stat_AR_Timebase;
    _MCMS_RL_Stat_AR_Cnt = _MCMS_RL_Stat_AR_StartDelay;
    _MCMS_RL_Stat_AR_SpontanFlag = 0;

    putValue( HMI__STMSGSD_MCMS_RL_Stat_AR, _MCMS_RL_Stat_AR_StartDelay * _MCMS_RL_Stat_AR_Timebase );

    _mMCMS_RL_Stat_AR.MCMS_AmbPress_RL.phys = getValue( HMI_MCMS_AmbPress_RL );
    _mMCMS_RL_Stat_AR.MCMS_HotStnInsty_RL_Stat.phys = getValue( HMI_MCMS_HotStnInsty_RL_Stat );
    _mMCMS_RL_Stat_AR.MCMS_LumPad_RL_Stat.phys = getValue( HMI_MCMS_LumPad_RL_Stat );
    _mMCMS_RL_Stat_AR.MCMS_LumPosn_RL_Stat.phys = getValue( HMI_MCMS_LumPosn_RL_Stat );
    _mMCMS_RL_Stat_AR.MCMS_Mass_RL_On.phys = getValue( HMI_MCMS_Mass_RL_On );
    _mMCMS_RL_Stat_AR.MCMS_MassAdj_RL_Stat_V3.phys = getValue( HMI_MCMS_MassAdj_RL_Stat_V3 );
    _mMCMS_RL_Stat_AR.MCMS_MassInsty_RL_Stat.phys = getValue( HMI_MCMS_MassInsty_RL_Stat );
    _mMCMS_RL_Stat_AR.MCMS_SdRstPad_RL_Stat.phys = getValue( HMI_MCMS_SdRstPad_RL_Stat );
}
/*@@end*/

/*@@caplFunc:MCMS_RL_Stat_AR_output():*/
MCMS_RL_Stat_AR_output(void)
{
    output( _mMCMS_RL_Stat_AR );
}
/*@@end*/

/*@@caplFunc:MCMS_RL_Stat_AR_saveEnvVars(dword):*/
MCMS_RL_Stat_AR_saveEnvVars( dword hFile )
{
    filePutString("\n// Knoten EIS: MCMS_RL_Stat_AR\n", 29, hFile );
    snprintf( buffer, elcount( buffer ), "0.0000 HMI__STMSG_MCMS_RL_Stat := %X\n", getValue( HMI__STMSG_MCMS_RL_Stat_AR ) );        filePutString( buffer, elcount( buffer ), hFile );
    snprintf( buffer, elcount( buffer ), "0.0000 HMI__STMSGT_MCMS_RL_Stat := %X\n", getValue( HMI__STMSGT_MCMS_RL_Stat_AR ) );        filePutString( buffer, elcount( buffer ), hFile );
    snprintf( buffer, elcount( buffer ), "0.0000 HMI_MCMS_AmbPress_RL := %X\n", getValue( HMI_MCMS_AmbPress_RL ) );        filePutString( buffer, elcount( buffer ), hFile );
    snprintf( buffer, elcount( buffer ), "0.0000 HMI_MCMS_HotStnInsty_RL_Stat := %X\n", getValue( HMI_MCMS_HotStnInsty_RL_Stat ) );        filePutString( buffer, elcount( buffer ), hFile );
    snprintf( buffer, elcount( buffer ), "0.0000 HMI_MCMS_LumPad_RL_Stat := %X\n", getValue( HMI_MCMS_LumPad_RL_Stat ) );        filePutString( buffer, elcount( buffer ), hFile );
    snprintf( buffer, elcount( buffer ), "0.0000 HMI_MCMS_LumPosn_RL_Stat := %X\n", getValue( HMI_MCMS_LumPosn_RL_Stat ) );        filePutString( buffer, elcount( buffer ), hFile );
    snprintf( buffer, elcount( buffer ), "0.0000 HMI_MCMS_Mass_RL_On := %X\n", getValue( HMI_MCMS_Mass_RL_On ) );        filePutString( buffer, elcount( buffer ), hFile );
    snprintf( buffer, elcount( buffer ), "0.0000 HMI_MCMS_MassAdj_RL_Stat_V3 := %X\n", getValue( HMI_MCMS_MassAdj_RL_Stat_V3 ) );        filePutString( buffer, elcount( buffer ), hFile );
    snprintf( buffer, elcount( buffer ), "0.0000 HMI_MCMS_MassInsty_RL_Stat := %X\n", getValue( HMI_MCMS_MassInsty_RL_Stat ) );        filePutString( buffer, elcount( buffer ), hFile );
    snprintf( buffer, elcount( buffer ), "0.0000 HMI_MCMS_SdRstPad_RL_Stat := %X\n", getValue( HMI_MCMS_SdRstPad_RL_Stat ) );        filePutString( buffer, elcount( buffer ), hFile );
}
/*@@end*/

/*@@timer:_tMCMS_RL_Stat_AR:*/
on timer _tMCMS_RL_Stat_AR
{
    putValue( HMI__STMSG_MCMS_RL_Stat_AR, 0 );
}
/*@@end*/

/*@@envVar:HMI__STMSG_MCMS_RL_Stat_AR:*/
on EnvVar HMI__STMSG_MCMS_RL_Stat_AR
{
    long tDelay;
    if( getValue( this ) == 2 )
    {
        tDelay = getValue( HMI__STMSGT_MCMS_RL_Stat_AR );
        if( tDelay > 0)    
            setTimer( _tMCMS_RL_Stat_AR, tDelay );
        else
            putValue( HMI__STMSG_MCMS_RL_Stat_AR, 0 );
    }
}
/*@@end*/

/*@@envVar:HMI_MCMS_AmbPress_RL:*/
on EnvVar HMI_MCMS_AmbPress_RL
{
    _mMCMS_RL_Stat_AR.MCMS_AmbPress_RL.phys = getValue(this);
    _MCMS_RL_Stat_AR_SpontanFlag = 1;
}
/*@@end*/

/*@@envVar:HMI_MCMS_HotStnInsty_RL_Stat:*/
on EnvVar HMI_MCMS_HotStnInsty_RL_Stat
{
    _mMCMS_RL_Stat_AR.MCMS_HotStnInsty_RL_Stat.phys = getValue(this);
    _MCMS_RL_Stat_AR_SpontanFlag = 1;
}
/*@@end*/

/*@@envVar:HMI_MCMS_LumPad_RL_Stat:*/
on EnvVar HMI_MCMS_LumPad_RL_Stat
{
    _mMCMS_RL_Stat_AR.MCMS_LumPad_RL_Stat.phys = getValue(this);
    _MCMS_RL_Stat_AR_SpontanFlag = 1;
}
/*@@end*/

/*@@envVar:HMI_MCMS_LumPosn_RL_Stat:*/
on EnvVar HMI_MCMS_LumPosn_RL_Stat
{
    _mMCMS_RL_Stat_AR.MCMS_LumPosn_RL_Stat.phys = getValue(this);
    _MCMS_RL_Stat_AR_SpontanFlag = 1;
}
/*@@end*/

/*@@envVar:HMI_MCMS_Mass_RL_On:*/
on EnvVar HMI_MCMS_Mass_RL_On
{
    _mMCMS_RL_Stat_AR.MCMS_Mass_RL_On.phys = getValue(this);
    _MCMS_RL_Stat_AR_SpontanFlag = 1;
}
/*@@end*/

/*@@envVar:HMI_MCMS_MassAdj_RL_Stat_V3:*/
on EnvVar HMI_MCMS_MassAdj_RL_Stat_V3
{
    _mMCMS_RL_Stat_AR.MCMS_MassAdj_RL_Stat_V3.phys = getValue(this);
    _MCMS_RL_Stat_AR_SpontanFlag = 1;
}
/*@@end*/

/*@@envVar:HMI_MCMS_MassInsty_RL_Stat:*/
on EnvVar HMI_MCMS_MassInsty_RL_Stat
{
    _mMCMS_RL_Stat_AR.MCMS_MassInsty_RL_Stat.phys = getValue(this);
    _MCMS_RL_Stat_AR_SpontanFlag = 1;
}
/*@@end*/

/*@@envVar:HMI_MCMS_SdRstPad_RL_Stat:*/
on EnvVar HMI_MCMS_SdRstPad_RL_Stat
{
    _mMCMS_RL_Stat_AR.MCMS_SdRstPad_RL_Stat.phys = getValue(this);
    _MCMS_RL_Stat_AR_SpontanFlag = 1;
}
/*@@end*/

/*@@caplFunc:MCMS_RR_AR_check_output():*/
MCMS_RR_AR_check_output()
{
    if( !getValue( HMI__STMSG_MCMS_RR_AR ) )
    {
        // Botschaft MCMS_RR_AR ID: 813 --- Sendeart 5 cyclicAndSpontanWithDelay --- 
        _MCMS_RR_AR_Cnt--;
        if( _MCMS_RR_AR_Cnt < 1 )
        {
            MCMS_RR_AR_output(); // Nachricht wg. abgelaufenem Zyklus ausgeben
            _MCMS_RR_AR_Cnt = _MCMS_RR_AR_CycleCount; // Zyklus-Zähler zurücksetzen
            _MCMS_RR_AR_SpontanFlag = 0; // Spontan-Flag zurücksetzen
        }
        else if( _MCMS_RR_AR_SpontanFlag )
        {
            MCMS_RR_AR_output(); // Nachricht wg. spontaner Änderung ausgeben
            _MCMS_RR_AR_SpontanFlag = 0; // Spontan-Flag zurücksetzen
        }
    }
}
/*@@end*/

/*@@caplFunc:MCMS_RR_AR_init():*/
MCMS_RR_AR_init()
{   /* Botschaft MCMS_RR_AR ID: 813 --- Sendeart 5 cyclicAndSpontanWithDelay --- 
BA_ "ApplMessage" BO_ 813 0;
BA_ "NmAsrMessage" BO_ 813 0;
BA_ "GenMsgMinAcceptLength" BO_ 813 8;
BA_ "GenMsgILSupport" BO_ 813 1;
BA_ "DiagState" BO_ 813 0;
BA_ "DiagRequest" BO_ 813 0;
BA_ "DiagResponse" BO_ 813 0;
BA_ "GenMsgStartValue" BO_ 813 "0";
BA_ "GenMsgDelayTime" BO_ 813 5;
BA_ "GenMsgNrOfRepetitions" BO_ 813 0;
BA_ "GenMsgCycleTime" BO_ 813 1000;
BA_ "GenMsgSendType" BO_ 813 5;
    */
    _MCMS_RR_AR_Timebase =           c_tDBKomTimer_20ms;
    _MCMS_RR_AR_CycleCount =       1000 / _MCMS_RR_AR_Timebase;
    _MCMS_RR_AR_StartDelay =          0 / _MCMS_RR_AR_Timebase;
    _MCMS_RR_AR_Cnt = _MCMS_RR_AR_StartDelay;
    _MCMS_RR_AR_SpontanFlag = 0;

    putValue( HMI__STMSGSD_MCMS_RR_AR, _MCMS_RR_AR_StartDelay * _MCMS_RR_AR_Timebase );

    _mMCMS_RR_AR.HotStn_RR_On_Rq.phys = getValue( HMI_HotStn_RR_On_Rq );
    _mMCMS_RR_AR.MCMS_ActvComf_RR_Stat.phys = getValue( HMI_MCMS_ActvComf_RR_Stat );
    _mMCMS_RR_AR.MCMS_ActvComfProg_RR_Stat.phys = getValue( HMI_MCMS_ActvComfProg_RR_Stat );
    _mMCMS_RR_AR.MCMS_LumPad_RR.phys = getValue( HMI_MCMS_LumPad_RR );
    _mMCMS_RR_AR.MCMS_LumPosn_RR.phys = getValue( HMI_MCMS_LumPosn_RR );
    _mMCMS_RR_AR.MCMS_Pmp_RR_Rq.phys = getValue( HMI_MCMS_Pmp_RR_Rq );
    _mMCMS_RR_AR.MCMS_RR_On.phys = getValue( HMI_MCMS_RR_On );
    _mMCMS_RR_AR.MCMS_SdRstPad_RR.phys = getValue( HMI_MCMS_SdRstPad_RR );
}
/*@@end*/

/*@@caplFunc:MCMS_RR_AR_output():*/
MCMS_RR_AR_output(void)
{
    output( _mMCMS_RR_AR );
}
/*@@end*/

/*@@caplFunc:MCMS_RR_AR_saveEnvVars(dword):*/
MCMS_RR_AR_saveEnvVars( dword hFile )
{
    filePutString("\n// Knoten EIS: MCMS_RR_AR\n", 24, hFile );
    snprintf( buffer, elcount( buffer ), "0.0000 HMI__STMSG_MCMS_RR := %X\n", getValue( HMI__STMSG_MCMS_RR_AR ) );        filePutString( buffer, elcount( buffer ), hFile );
    snprintf( buffer, elcount( buffer ), "0.0000 HMI__STMSGT_MCMS_RR := %X\n", getValue( HMI__STMSGT_MCMS_RR_AR ) );        filePutString( buffer, elcount( buffer ), hFile );
    snprintf( buffer, elcount( buffer ), "0.0000 HMI_HotStn_RR_On_Rq := %X\n", getValue( HMI_HotStn_RR_On_Rq ) );        filePutString( buffer, elcount( buffer ), hFile );
    snprintf( buffer, elcount( buffer ), "0.0000 HMI_MCMS_ActvComf_RR_Stat := %X\n", getValue( HMI_MCMS_ActvComf_RR_Stat ) );        filePutString( buffer, elcount( buffer ), hFile );
    snprintf( buffer, elcount( buffer ), "0.0000 HMI_MCMS_ActvComfProg_RR_Stat := %X\n", getValue( HMI_MCMS_ActvComfProg_RR_Stat ) );        filePutString( buffer, elcount( buffer ), hFile );
    snprintf( buffer, elcount( buffer ), "0.0000 HMI_MCMS_LumPad_RR := %X\n", getValue( HMI_MCMS_LumPad_RR ) );        filePutString( buffer, elcount( buffer ), hFile );
    snprintf( buffer, elcount( buffer ), "0.0000 HMI_MCMS_LumPosn_RR := %X\n", getValue( HMI_MCMS_LumPosn_RR ) );        filePutString( buffer, elcount( buffer ), hFile );
    snprintf( buffer, elcount( buffer ), "0.0000 HMI_MCMS_Pmp_RR_Rq := %X\n", getValue( HMI_MCMS_Pmp_RR_Rq ) );        filePutString( buffer, elcount( buffer ), hFile );
    snprintf( buffer, elcount( buffer ), "0.0000 HMI_MCMS_RR_On := %X\n", getValue( HMI_MCMS_RR_On ) );        filePutString( buffer, elcount( buffer ), hFile );
    snprintf( buffer, elcount( buffer ), "0.0000 HMI_MCMS_SdRstPad_RR := %X\n", getValue( HMI_MCMS_SdRstPad_RR ) );        filePutString( buffer, elcount( buffer ), hFile );
}
/*@@end*/

/*@@timer:_tMCMS_RR_AR:*/
on timer _tMCMS_RR_AR
{
    putValue( HMI__STMSG_MCMS_RR_AR, 0 );
}
/*@@end*/

/*@@envVar:HMI__STMSG_MCMS_RR_AR:*/
on EnvVar HMI__STMSG_MCMS_RR_AR
{
    long tDelay;
    if( getValue( this ) == 2 )
    {
        tDelay = getValue( HMI__STMSGT_MCMS_RR_AR );
        if( tDelay > 0)    
            setTimer( _tMCMS_RR_AR, tDelay );
        else
            putValue( HMI__STMSG_MCMS_RR_AR, 0 );
    }
}
/*@@end*/

/*@@envVar:HMI_HotStn_RR_On_Rq:*/
on EnvVar HMI_HotStn_RR_On_Rq
{
    _mMCMS_RR_AR.HotStn_RR_On_Rq.phys = getValue(this);
    _MCMS_RR_AR_SpontanFlag = 1;
}
/*@@end*/

/*@@envVar:HMI_MCMS_ActvComf_RR_Stat:*/
on EnvVar HMI_MCMS_ActvComf_RR_Stat
{
    _mMCMS_RR_AR.MCMS_ActvComf_RR_Stat.phys = getValue(this);
    _MCMS_RR_AR_SpontanFlag = 1;
}
/*@@end*/

/*@@envVar:HMI_MCMS_ActvComfProg_RR_Stat:*/
on EnvVar HMI_MCMS_ActvComfProg_RR_Stat
{
    _mMCMS_RR_AR.MCMS_ActvComfProg_RR_Stat.phys = getValue(this);
    _MCMS_RR_AR_SpontanFlag = 1;
}
/*@@end*/

/*@@envVar:HMI_MCMS_LumPad_RR:*/
on EnvVar HMI_MCMS_LumPad_RR
{
    _mMCMS_RR_AR.MCMS_LumPad_RR.phys = getValue(this);
    _MCMS_RR_AR_SpontanFlag = 1;
}
/*@@end*/

/*@@envVar:HMI_MCMS_LumPosn_RR:*/
on EnvVar HMI_MCMS_LumPosn_RR
{
    _mMCMS_RR_AR.MCMS_LumPosn_RR.phys = getValue(this);
    _MCMS_RR_AR_SpontanFlag = 1;
}
/*@@end*/

/*@@envVar:HMI_MCMS_Pmp_RR_Rq:*/
on EnvVar HMI_MCMS_Pmp_RR_Rq
{
    _mMCMS_RR_AR.MCMS_Pmp_RR_Rq.phys = getValue(this);
    _MCMS_RR_AR_SpontanFlag = 1;
}
/*@@end*/

/*@@envVar:HMI_MCMS_RR_On:*/
on EnvVar HMI_MCMS_RR_On
{
    _mMCMS_RR_AR.MCMS_RR_On.phys = getValue(this);
    _MCMS_RR_AR_SpontanFlag = 1;
}
/*@@end*/

/*@@envVar:HMI_MCMS_SdRstPad_RR:*/
on EnvVar HMI_MCMS_SdRstPad_RR
{
    _mMCMS_RR_AR.MCMS_SdRstPad_RR.phys = getValue(this);
    _MCMS_RR_AR_SpontanFlag = 1;
}
/*@@end*/

/*@@caplFunc:MCMS_RR_Stat_AR_check_output():*/
MCMS_RR_Stat_AR_check_output()
{
    if( !getValue( HMI__STMSG_MCMS_RR_Stat_AR ) )
    {
        // Botschaft MCMS_RR_Stat_AR ID: 815 --- Sendeart 5 cyclicAndSpontanWithDelay --- 
        _MCMS_RR_Stat_AR_Cnt--;
        if( _MCMS_RR_Stat_AR_Cnt < 1 )
        {
            MCMS_RR_Stat_AR_output(); // Nachricht wg. abgelaufenem Zyklus ausgeben
            _MCMS_RR_Stat_AR_Cnt = _MCMS_RR_Stat_AR_CycleCount; // Zyklus-Zähler zurücksetzen
            _MCMS_RR_Stat_AR_SpontanFlag = 0; // Spontan-Flag zurücksetzen
        }
        else if( _MCMS_RR_Stat_AR_SpontanFlag )
        {
            MCMS_RR_Stat_AR_output(); // Nachricht wg. spontaner Änderung ausgeben
            _MCMS_RR_Stat_AR_SpontanFlag = 0; // Spontan-Flag zurücksetzen
        }
    }
}
/*@@end*/

/*@@caplFunc:MCMS_RR_Stat_AR_init():*/
MCMS_RR_Stat_AR_init()
{   /* Botschaft MCMS_RR_Stat_AR ID: 815 --- Sendeart 5 cyclicAndSpontanWithDelay --- 
BA_ "ApplMessage" BO_ 815 0;
BA_ "NmAsrMessage" BO_ 815 0;
BA_ "GenMsgMinAcceptLength" BO_ 815 8;
BA_ "GenMsgILSupport" BO_ 815 1;
BA_ "DiagState" BO_ 815 0;
BA_ "DiagRequest" BO_ 815 0;
BA_ "DiagResponse" BO_ 815 0;
BA_ "GenMsgStartValue" BO_ 815 "0";
BA_ "GenMsgDelayTime" BO_ 815 5;
BA_ "GenMsgNrOfRepetitions" BO_ 815 0;
BA_ "GenMsgCycleTime" BO_ 815 1000;
BA_ "GenMsgSendType" BO_ 815 5;
    */
    _MCMS_RR_Stat_AR_Timebase =           c_tDBKomTimer_20ms;
    _MCMS_RR_Stat_AR_CycleCount =       1000 / _MCMS_RR_Stat_AR_Timebase;
    _MCMS_RR_Stat_AR_StartDelay =          0 / _MCMS_RR_Stat_AR_Timebase;
    _MCMS_RR_Stat_AR_Cnt = _MCMS_RR_Stat_AR_StartDelay;
    _MCMS_RR_Stat_AR_SpontanFlag = 0;

    putValue( HMI__STMSGSD_MCMS_RR_Stat_AR, _MCMS_RR_Stat_AR_StartDelay * _MCMS_RR_Stat_AR_Timebase );

    _mMCMS_RR_Stat_AR.MCMS_AmbPress_RR.phys = getValue( HMI_MCMS_AmbPress_RR );
    _mMCMS_RR_Stat_AR.MCMS_HotStnInsty_RR_Stat.phys = getValue( HMI_MCMS_HotStnInsty_RR_Stat );
    _mMCMS_RR_Stat_AR.MCMS_LumPad_RR_Stat.phys = getValue( HMI_MCMS_LumPad_RR_Stat );
    _mMCMS_RR_Stat_AR.MCMS_LumPosn_RR_Stat.phys = getValue( HMI_MCMS_LumPosn_RR_Stat );
    _mMCMS_RR_Stat_AR.MCMS_Mass_RR_On.phys = getValue( HMI_MCMS_Mass_RR_On );
    _mMCMS_RR_Stat_AR.MCMS_MassAdj_RR_Stat_V3.phys = getValue( HMI_MCMS_MassAdj_RR_Stat_V3 );
    _mMCMS_RR_Stat_AR.MCMS_MassInsty_RR_Stat.phys = getValue( HMI_MCMS_MassInsty_RR_Stat );
    _mMCMS_RR_Stat_AR.MCMS_SdRstPad_RR_Stat.phys = getValue( HMI_MCMS_SdRstPad_RR_Stat );
}
/*@@end*/

/*@@caplFunc:MCMS_RR_Stat_AR_output():*/
MCMS_RR_Stat_AR_output(void)
{
    output( _mMCMS_RR_Stat_AR );
}
/*@@end*/

/*@@caplFunc:MCMS_RR_Stat_AR_saveEnvVars(dword):*/
MCMS_RR_Stat_AR_saveEnvVars( dword hFile )
{
    filePutString("\n// Knoten EIS: MCMS_RR_Stat_AR\n", 29, hFile );
    snprintf( buffer, elcount( buffer ), "0.0000 HMI__STMSG_MCMS_RR_Stat := %X\n", getValue( HMI__STMSG_MCMS_RR_Stat_AR ) );        filePutString( buffer, elcount( buffer ), hFile );
    snprintf( buffer, elcount( buffer ), "0.0000 HMI__STMSGT_MCMS_RR_Stat := %X\n", getValue( HMI__STMSGT_MCMS_RR_Stat_AR ) );        filePutString( buffer, elcount( buffer ), hFile );
    snprintf( buffer, elcount( buffer ), "0.0000 HMI_MCMS_AmbPress_RR := %X\n", getValue( HMI_MCMS_AmbPress_RR ) );        filePutString( buffer, elcount( buffer ), hFile );
    snprintf( buffer, elcount( buffer ), "0.0000 HMI_MCMS_HotStnInsty_RR_Stat := %X\n", getValue( HMI_MCMS_HotStnInsty_RR_Stat ) );        filePutString( buffer, elcount( buffer ), hFile );
    snprintf( buffer, elcount( buffer ), "0.0000 HMI_MCMS_LumPad_RR_Stat := %X\n", getValue( HMI_MCMS_LumPad_RR_Stat ) );        filePutString( buffer, elcount( buffer ), hFile );
    snprintf( buffer, elcount( buffer ), "0.0000 HMI_MCMS_LumPosn_RR_Stat := %X\n", getValue( HMI_MCMS_LumPosn_RR_Stat ) );        filePutString( buffer, elcount( buffer ), hFile );
    snprintf( buffer, elcount( buffer ), "0.0000 HMI_MCMS_Mass_RR_On := %X\n", getValue( HMI_MCMS_Mass_RR_On ) );        filePutString( buffer, elcount( buffer ), hFile );
    snprintf( buffer, elcount( buffer ), "0.0000 HMI_MCMS_MassAdj_RR_Stat_V3 := %X\n", getValue( HMI_MCMS_MassAdj_RR_Stat_V3 ) );        filePutString( buffer, elcount( buffer ), hFile );
    snprintf( buffer, elcount( buffer ), "0.0000 HMI_MCMS_MassInsty_RR_Stat := %X\n", getValue( HMI_MCMS_MassInsty_RR_Stat ) );        filePutString( buffer, elcount( buffer ), hFile );
    snprintf( buffer, elcount( buffer ), "0.0000 HMI_MCMS_SdRstPad_RR_Stat := %X\n", getValue( HMI_MCMS_SdRstPad_RR_Stat ) );        filePutString( buffer, elcount( buffer ), hFile );
}
/*@@end*/

/*@@timer:_tMCMS_RR_Stat_AR:*/
on timer _tMCMS_RR_Stat_AR
{
    putValue( HMI__STMSG_MCMS_RR_Stat_AR, 0 );
}
/*@@end*/

/*@@envVar:HMI__STMSG_MCMS_RR_Stat_AR:*/
on EnvVar HMI__STMSG_MCMS_RR_Stat_AR
{
    long tDelay;
    if( getValue( this ) == 2 )
    {
        tDelay = getValue( HMI__STMSGT_MCMS_RR_Stat_AR );
        if( tDelay > 0)    
            setTimer( _tMCMS_RR_Stat_AR, tDelay );
        else
            putValue( HMI__STMSG_MCMS_RR_Stat_AR, 0 );
    }
}
/*@@end*/

/*@@envVar:HMI_MCMS_AmbPress_RR:*/
on EnvVar HMI_MCMS_AmbPress_RR
{
    _mMCMS_RR_Stat_AR.MCMS_AmbPress_RR.phys = getValue(this);
    _MCMS_RR_Stat_AR_SpontanFlag = 1;
}
/*@@end*/

/*@@envVar:HMI_MCMS_HotStnInsty_RR_Stat:*/
on EnvVar HMI_MCMS_HotStnInsty_RR_Stat
{
    _mMCMS_RR_Stat_AR.MCMS_HotStnInsty_RR_Stat.phys = getValue(this);
    _MCMS_RR_Stat_AR_SpontanFlag = 1;
}
/*@@end*/

/*@@envVar:HMI_MCMS_LumPosn_RR_Stat:*/
on EnvVar HMI_MCMS_LumPosn_RR_Stat
{
    _mMCMS_RR_Stat_AR.MCMS_LumPosn_RR_Stat.phys = getValue(this);
    _MCMS_RR_Stat_AR_SpontanFlag = 1;
}
/*@@end*/

/*@@envVar:HMI_MCMS_LumPad_RR_Stat:*/
on EnvVar HMI_MCMS_LumPad_RR_Stat
{
    _mMCMS_RR_Stat_AR.MCMS_LumPad_RR_Stat.phys = getValue(this);
    _MCMS_RR_Stat_AR_SpontanFlag = 1;
}
/*@@end*/

/*@@envVar:HMI_MCMS_Mass_RR_On:*/
on EnvVar HMI_MCMS_Mass_RR_On
{
    _mMCMS_RR_Stat_AR.MCMS_Mass_RR_On.phys = getValue(this);
    _MCMS_RR_Stat_AR_SpontanFlag = 1;
}
/*@@end*/

/*@@envVar:HMI_MCMS_MassAdj_RR_Stat_V3:*/
on EnvVar HMI_MCMS_MassAdj_RR_Stat_V3
{
    _mMCMS_RR_Stat_AR.MCMS_MassAdj_RR_Stat_V3.phys = getValue(this);
    _MCMS_RR_Stat_AR_SpontanFlag = 1;
}
/*@@end*/

/*@@envVar:HMI_MCMS_MassInsty_RR_Stat:*/
on EnvVar HMI_MCMS_MassInsty_RR_Stat
{
    _mMCMS_RR_Stat_AR.MCMS_MassInsty_RR_Stat.phys = getValue(this);
    _MCMS_RR_Stat_AR_SpontanFlag = 1;
}
/*@@end*/

/*@@envVar:HMI_MCMS_SdRstPad_RR_Stat:*/
on EnvVar HMI_MCMS_SdRstPad_RR_Stat
{
    _mMCMS_RR_Stat_AR.MCMS_SdRstPad_RR_Stat.phys = getValue(this);
    _MCMS_RR_Stat_AR_SpontanFlag = 1;
}
/*@@end*/

/*@@caplFunc:OffRoad_Disp_Rq_AR_check_output():*/
OffRoad_Disp_Rq_AR_check_output()
{
    if( !getValue( HMI__STMSG_OffRoad_Disp_Rq_AR ) )
    {
        // Botschaft OffRoad_Disp_Rq_AR ID: 918 --- Sendeart 0 cyclicX --- 
        _OffRoad_Disp_Rq_AR_Cnt--;
        if( _OffRoad_Disp_Rq_AR_Cnt < 1 )
        {
            OffRoad_Disp_Rq_AR_output(); // Nachricht wg. abgelaufenem Zyklus ausgeben
            _OffRoad_Disp_Rq_AR_Cnt = _OffRoad_Disp_Rq_AR_CycleCount; // Zyklus-Zähler zurücksetzen
        }
    }
}
/*@@end*/

/*@@caplFunc:OffRoad_Disp_Rq_AR_init():*/
OffRoad_Disp_Rq_AR_init()
{   /* Botschaft OffRoad_Disp_Rq_AR ID: 918 --- Sendeart 0 cyclicX --- 
BA_ "ApplMessage" BO_ 918 0;
BA_ "NmAsrMessage" BO_ 918 0;
BA_ "GenMsgMinAcceptLength" BO_ 918 8;
BA_ "GenMsgILSupport" BO_ 918 1;
BA_ "DiagState" BO_ 918 0;
BA_ "DiagRequest" BO_ 918 0;
BA_ "DiagResponse" BO_ 918 0;
BA_ "GenMsgStartValue" BO_ 918 "0";
BA_ "GenMsgCycleTime" BO_ 918 100;
BA_ "GenMsgSendType" BO_ 918 0;
    */
    _OffRoad_Disp_Rq_AR_Timebase =           c_tDBKomTimer_20ms;
    _OffRoad_Disp_Rq_AR_CycleCount =        100 / _OffRoad_Disp_Rq_AR_Timebase;
    _OffRoad_Disp_Rq_AR_StartDelay =          0 / _OffRoad_Disp_Rq_AR_Timebase;
    _OffRoad_Disp_Rq_AR_Cnt = _OffRoad_Disp_Rq_AR_StartDelay;
    _OffRoad_Disp_Rq_AR_SpontanFlag = 0;

    putValue( HMI__STMSGSD_OffRoad_Disp_Rq_AR, _OffRoad_Disp_Rq_AR_StartDelay * _OffRoad_Disp_Rq_AR_Timebase );

    _mOffRoad_Disp_Rq_AR.OffRoadDisp_Bar0_Actv.phys = getValue( HMI_OffRoadDisp_Bar0_Actv );
    _mOffRoad_Disp_Rq_AR.OffRoadDisp_Bar1_Actv.phys = getValue( HMI_OffRoadDisp_Bar1_Actv );
    _mOffRoad_Disp_Rq_AR.OffRoadDisp_Bar2_Actv.phys = getValue( HMI_OffRoadDisp_Bar2_Actv );
    _mOffRoad_Disp_Rq_AR.OffRoadDisp_Bar3_Actv.phys = getValue( HMI_OffRoadDisp_Bar3_Actv );
    _mOffRoad_Disp_Rq_AR.OffRoadDisp_RedNum.phys = getValue( HMI_OffRoadDisp_RedNum );
    _mOffRoad_Disp_Rq_AR.OffRoadDisp_SportBar_Actv.phys = getValue( HMI_OffRoadDisp_SportBar_Actv );
    _mOffRoad_Disp_Rq_AR.VehLvl_Bmpr_Disp_Rq.phys = getValue( HMI_VehLvl_Bmpr_Disp_Rq );
    _mOffRoad_Disp_Rq_AR.VehLvl_FL_Disp_Rq.phys = getValue( HMI_VehLvl_FL_Disp_Rq );
    _mOffRoad_Disp_Rq_AR.VehLvl_FR_Disp_Rq.phys = getValue( HMI_VehLvl_FR_Disp_Rq );
    _mOffRoad_Disp_Rq_AR.VehLvl_RL_Disp_Rq.phys = getValue( HMI_VehLvl_RL_Disp_Rq );
    _mOffRoad_Disp_Rq_AR.VehLvl_RR_Disp_Rq.phys = getValue( HMI_VehLvl_RR_Disp_Rq );
}
/*@@end*/

/*@@caplFunc:OffRoad_Disp_Rq_AR_output():*/
OffRoad_Disp_Rq_AR_output(void)
{
    output( _mOffRoad_Disp_Rq_AR );
}
/*@@end*/

/*@@caplFunc:OffRoad_Disp_Rq_AR_saveEnvVars(dword):*/
OffRoad_Disp_Rq_AR_saveEnvVars( dword hFile )
{
    filePutString("\n// Knoten EIS: OffRoad_Disp_Rq_AR\n", 33, hFile );
    snprintf( buffer, elcount( buffer ), "0.0000 HMI__STMSG_OffRoad_Disp_Rq_AR := %X\n", getValue( HMI__STMSG_OffRoad_Disp_Rq_AR ) );    filePutString( buffer, elcount( buffer ), hFile );
    snprintf( buffer, elcount( buffer ), "0.0000 HMI__STMSGT_OffRoad_Disp_Rq_AR := %X\n", getValue( HMI__STMSGT_OffRoad_Disp_Rq_AR ) );    filePutString( buffer, elcount( buffer ), hFile );
    snprintf( buffer, elcount( buffer ), "0.0000 HMI_OffRoadDisp_Bar0_Actv := %X\n", getValue( HMI_OffRoadDisp_Bar0_Actv ) );    filePutString( buffer, elcount( buffer ), hFile );
    snprintf( buffer, elcount( buffer ), "0.0000 HMI_OffRoadDisp_Bar1_Actv := %X\n", getValue( HMI_OffRoadDisp_Bar1_Actv ) );    filePutString( buffer, elcount( buffer ), hFile );
    snprintf( buffer, elcount( buffer ), "0.0000 HMI_OffRoadDisp_Bar2_Actv := %X\n", getValue( HMI_OffRoadDisp_Bar2_Actv ) );    filePutString( buffer, elcount( buffer ), hFile );
    snprintf( buffer, elcount( buffer ), "0.0000 HMI_OffRoadDisp_Bar3_Actv := %X\n", getValue( HMI_OffRoadDisp_Bar3_Actv ) );    filePutString( buffer, elcount( buffer ), hFile );
    snprintf( buffer, elcount( buffer ), "0.0000 HMI_OffRoadDisp_RedNum := %X\n", getValue( HMI_OffRoadDisp_RedNum ) );    filePutString( buffer, elcount( buffer ), hFile );
    snprintf( buffer, elcount( buffer ), "0.0000 HMI_OffRoadDisp_SportBar_Actv := %X\n", getValue( HMI_OffRoadDisp_SportBar_Actv ) );    filePutString( buffer, elcount( buffer ), hFile );
    snprintf( buffer, elcount( buffer ), "0.0000 HMI_VehLvl_Bmpr_Disp_Rq := %X\n", getValue( HMI_VehLvl_Bmpr_Disp_Rq ) );    filePutString( buffer, elcount( buffer ), hFile );
    snprintf( buffer, elcount( buffer ), "0.0000 HMI_VehLvl_FL_Disp_Rq := %X\n", getValue( HMI_VehLvl_FL_Disp_Rq ) );    filePutString( buffer, elcount( buffer ), hFile );
    snprintf( buffer, elcount( buffer ), "0.0000 HMI_VehLvl_FR_Disp_Rq := %X\n", getValue( HMI_VehLvl_FR_Disp_Rq ) );    filePutString( buffer, elcount( buffer ), hFile );
    snprintf( buffer, elcount( buffer ), "0.0000 HMI_VehLvl_RL_Disp_Rq := %X\n", getValue( HMI_VehLvl_RL_Disp_Rq ) );    filePutString( buffer, elcount( buffer ), hFile );
    snprintf( buffer, elcount( buffer ), "0.0000 HMI_VehLvl_RR_Disp_Rq := %X\n", getValue( HMI_VehLvl_RR_Disp_Rq ) );    filePutString( buffer, elcount( buffer ), hFile );
}
/*@@end*/

/*@@timer:_tOffRoad_Disp_Rq_AR:*/
on timer _tOffRoad_Disp_Rq_AR
{
    putValue( HMI__STMSG_OffRoad_Disp_Rq_AR, 0 );
}
/*@@end*/

/*@@envVar:HMI__STMSG_OffRoad_Disp_Rq_AR:*/
on EnvVar HMI__STMSG_OffRoad_Disp_Rq_AR
{
    long tDelay;
    if( getValue( this ) == 2 )
    {
        tDelay = getValue( HMI__STMSGT_OffRoad_Disp_Rq_AR );
        if( tDelay > 0)    
            setTimer( _tOffRoad_Disp_Rq_AR, tDelay );
        else
            putValue( HMI__STMSG_OffRoad_Disp_Rq_AR, 0 );
    }
}
/*@@end*/

/*@@envVar:HMI_OffRoadDisp_Bar0_Actv:*/
on EnvVar HMI_OffRoadDisp_Bar0_Actv
{
    _mOffRoad_Disp_Rq_AR.OffRoadDisp_Bar0_Actv.phys = getValue(this);
}
/*@@end*/

/*@@envVar:HMI_OffRoadDisp_Bar1_Actv:*/
on EnvVar HMI_OffRoadDisp_Bar1_Actv
{
    _mOffRoad_Disp_Rq_AR.OffRoadDisp_Bar1_Actv.phys = getValue(this);
}
/*@@end*/

/*@@envVar:HMI_OffRoadDisp_Bar2_Actv:*/
on EnvVar HMI_OffRoadDisp_Bar2_Actv
{
    _mOffRoad_Disp_Rq_AR.OffRoadDisp_Bar2_Actv.phys = getValue(this);
}
/*@@end*/

/*@@envVar:HMI_OffRoadDisp_Bar3_Actv:*/
on EnvVar HMI_OffRoadDisp_Bar3_Actv
{
    _mOffRoad_Disp_Rq_AR.OffRoadDisp_Bar3_Actv.phys = getValue(this);
}
/*@@end*/

/*@@envVar:HMI_OffRoadDisp_RedNum:*/
on EnvVar HMI_OffRoadDisp_RedNum
{
    _mOffRoad_Disp_Rq_AR.OffRoadDisp_RedNum.phys = getValue(this);
}
/*@@end*/

/*@@envVar:HMI_OffRoadDisp_SportBar_Actv:*/
on EnvVar HMI_OffRoadDisp_SportBar_Actv
{
    _mOffRoad_Disp_Rq_AR.OffRoadDisp_SportBar_Actv.phys = getValue(this);
}
/*@@end*/

/*@@envVar:HMI_VehLvl_Bmpr_Disp_Rq:*/
on EnvVar HMI_VehLvl_Bmpr_Disp_Rq
{
    _mOffRoad_Disp_Rq_AR.VehLvl_Bmpr_Disp_Rq.phys = getValue(this);
}
/*@@end*/

/*@@envVar:HMI_VehLvl_FL_Disp_Rq:*/
on EnvVar HMI_VehLvl_FL_Disp_Rq
{
    _mOffRoad_Disp_Rq_AR.VehLvl_FL_Disp_Rq.phys = getValue(this);
}
/*@@end*/

/*@@envVar:HMI_VehLvl_FR_Disp_Rq:*/
on EnvVar HMI_VehLvl_FR_Disp_Rq
{
    _mOffRoad_Disp_Rq_AR.VehLvl_FR_Disp_Rq.phys = getValue(this);
}
/*@@end*/

/*@@envVar:HMI_VehLvl_RL_Disp_Rq:*/
on EnvVar HMI_VehLvl_RL_Disp_Rq
{
    _mOffRoad_Disp_Rq_AR.VehLvl_RL_Disp_Rq.phys = getValue(this);
}
/*@@end*/

/*@@envVar:HMI_VehLvl_RR_Disp_Rq:*/
on EnvVar HMI_VehLvl_RR_Disp_Rq
{
    _mOffRoad_Disp_Rq_AR.VehLvl_RR_Disp_Rq.phys = getValue(this);
}
/*@@end*/

/*@@caplFunc:Park_Disp_Rq_AR_check_output():*/
Park_Disp_Rq_AR_check_output()
{
    if( !getValue( HMI__STMSG_Park_Disp_Rq_AR ) )
    {
        // Botschaft Park_Disp_Rq_AR ID: 393 --- Sendeart 5 cyclicAndSpontanWithDelay --- 
        _Park_Disp_Rq_AR_Cnt--;
        if( _Park_Disp_Rq_AR_Cnt < 1 )
        {
            Park_Disp_Rq_AR_output(); // Nachricht wg. abgelaufenem Zyklus ausgeben
            _Park_Disp_Rq_AR_Cnt = _Park_Disp_Rq_AR_CycleCount; // Zyklus-Zähler zurücksetzen
            _Park_Disp_Rq_AR_SpontanFlag = 0; // Spontan-Flag zurücksetzen
        }
        else if( _Park_Disp_Rq_AR_SpontanFlag)
        {
            Park_Disp_Rq_AR_output(); // Nachricht wg. spontaner Änderung ausgeben
            _Park_Disp_Rq_AR_SpontanFlag = 0; // Spontan-Flag zurücksetzen
        }
    }
}
/*@@end*/

/*@@caplFunc:Park_Disp_Rq_AR_init():*/
Park_Disp_Rq_AR_init()
{   /* Botschaft Park_Disp_Rq_AR ID: 393 --- Sendeart 5 cyclicAndSpontanWithDelay --- 
BA_ "ApplMessage" BO_ 393 0;
BA_ "NmAsrMessage" BO_ 393 0;
BA_ "GenMsgMinAcceptLength" BO_ 393 8;
BA_ "GenMsgILSupport" BO_ 393 1;
BA_ "DiagState" BO_ 393 0;
BA_ "DiagRequest" BO_ 393 0;
BA_ "DiagResponse" BO_ 393 0;
BA_ "GenMsgStartValue" BO_ 393 "0";
BA_ "GenMsgDelayTime" BO_ 393 40;
BA_ "GenMsgNrOfRepetitions" BO_ 393 0;
BA_ "GenMsgCycleTime" BO_ 393 200;
BA_ "GenMsgSendType" BO_ 393 5;
    */
    _Park_Disp_Rq_AR_Timebase =           c_tDBKomTimer_20ms;
    _Park_Disp_Rq_AR_CycleCount =       200 / _Park_Disp_Rq_AR_Timebase;
    _Park_Disp_Rq_AR_StartDelay =         0 / _Park_Disp_Rq_AR_Timebase;
    _Park_Disp_Rq_AR_MinDelay =          40 / _Park_Disp_Rq_AR_Timebase;
    _Park_Disp_Rq_AR_Cnt = _Park_Disp_Rq_AR_StartDelay;
    _Park_Disp_Rq_AR_SpontanFlag = 0;
    _Park_Disp_Rq_AR_DelayCnt = 0;

    putValue( HMI__STMSGSD_Park_Disp_Rq_AR, _Park_Disp_Rq_AR_StartDelay * _Park_Disp_Rq_AR_Timebase );

    _mPark_Disp_Rq_AR.Park_IconDisp_Rq.phys = getValue( HMI_Park_IconDisp_Rq );
    _mPark_Disp_Rq_AR.Park_Sound_Rq.phys = getValue( HMI_Park_Sound_Rq );
    _mPark_Disp_Rq_AR.Park_Warn1_Disp_Rq.phys = getValue( HMI_Park_Warn1_Disp_Rq );
 //   _mPark_Disp_Rq_AR.Rsrv0_Park_Disp_Rq.phys = getValue( HMI_Rsrv0_Park_Disp_Rq );
    _mPark_Disp_Rq_AR.Rsrv1_Park_Disp_Rq.phys = getValue( HMI_Rsrv1_Park_Disp_Rq );
    _mPark_Disp_Rq_AR.Rsrv2_Park_Disp_Rq.phys = getValue( HMI_Rsrv2_Park_Disp_Rq );
    _mPark_Disp_Rq_AR.Rsrv3_Park_Disp_Rq.phys = getValue( HMI_Rsrv3_Park_Disp_Rq );
    _mPark_Disp_Rq_AR.Rsrv4_Park_Disp_Rq.phys = getValue( HMI_Rsrv4_Park_Disp_Rq );
}
/*@@end*/

/*@@caplFunc:Park_Disp_Rq_AR_output():*/
void Park_Disp_Rq_AR_output(void)
{
    byte crc;
    byte SQC_help;
    byte dataId = 0x31;

    if( !getValue( HMI_SQC_Park_Disp_Rq_Auto ) )
    {
        // berechne message counter
        SQC_help = getValue( HMI_SQC_Park_Disp_Rq );
        if( SQC_help >= 15 ) SQC_help = 0;
        else SQC_help++;
        putValue( HMI_SQC_Park_Disp_Rq, SQC_help );
        _mPark_Disp_Rq_AR.SQC_Park_Disp_Rq = SQC_help;
    }
    else
          _mPark_Disp_Rq_AR.SQC_Park_Disp_Rq = getValue( HMI_SQC_Park_Disp_Rq );

    if( getValue( HMI_CRC_Park_Disp_Rq_Profile_02 ) )
    {
        if( !getValue( HMI_CRC_Park_Disp_Rq_Auto ) )
        {   // CRC according Profile_02 ( W213 )
            // berechne crc
            crc = 0xFF;
//          crc = crctable_profile02[ crc ^ _mPark_Disp_Rq_AR.byte( 0 ) ];  CRC
            crc = crctable_profile02[ crc ^ _mPark_Disp_Rq_AR.byte( 1 )];
            crc = crctable_profile02[ crc ^ _mPark_Disp_Rq_AR.byte( 2 )];
            crc = crctable_profile02[ crc ^ _mPark_Disp_Rq_AR.byte( 3 )];
            crc = crctable_profile02[ crc ^ _mPark_Disp_Rq_AR.byte( 4 )];
            crc = crctable_profile02[ crc ^ _mPark_Disp_Rq_AR.byte( 5 )];
            crc = crctable_profile02[ crc ^ _mPark_Disp_Rq_AR.byte( 6 )];
            crc = crctable_profile02[ crc ^ _mPark_Disp_Rq_AR.byte( 7 )];
            crc = crctable_profile02[ crc ^ _Park_Disp_Rq_AR_CRC_Offset[ _mPark_Disp_Rq_AR.SQC_Park_Disp_Rq ] ]; // load offset
            crc = (crc ^ 0xFF);
            if( getValue(  HMI_CRC_Park_Disp_Rq_Invalid ) )
                crc++;
            _mPark_Disp_Rq_AR.CRC_Park_Disp_Rq = crc;
            putValue( HMI_CRC_Park_Disp_Rq, crc );
        }
        else
              _mPark_Disp_Rq_AR.CRC_Park_Disp_Rq = getValue( HMI_CRC_Park_Disp_Rq );
    }
    else
    {
        if( !getValue( HMI_CRC_Park_Disp_Rq_Auto ) )
        {   // CRC according to SAE1850 ( W222 )
            // berechne crc
            crc = 0xFF;
//            crc = crctable[crc ^ _mPark_Disp_Rq_AR.byte( 0 )];  CRC
            crc = crctable[crc ^ _mPark_Disp_Rq_AR.byte( 1 )];
            crc = crctable[crc ^ _mPark_Disp_Rq_AR.byte( 2 )];
            crc = crctable[crc ^ _mPark_Disp_Rq_AR.byte( 3 )];
            crc = crctable[crc ^ _mPark_Disp_Rq_AR.byte( 4 )];
            crc = crctable[crc ^ _mPark_Disp_Rq_AR.byte( 5 )];
            crc = crctable[crc ^ _mPark_Disp_Rq_AR.byte( 6 )];
            crc = crctable[crc ^ _mPark_Disp_Rq_AR.byte( 7 )];
            crc = crctable[crc ^ dataId];
            crc = (crc ^ 0xFF);
            if( getValue(  HMI_CRC_Park_Disp_Rq_Invalid ) )
                crc++;
            _mPark_Disp_Rq_AR.CRC_Park_Disp_Rq = crc;
            putValue( HMI_CRC_Park_Disp_Rq, crc );
        }
        else
              _mPark_Disp_Rq_AR.CRC_Park_Disp_Rq = getValue( HMI_CRC_Park_Disp_Rq );
    }
    output( _mPark_Disp_Rq_AR );
}
/*@@end*/

/*@@caplFunc:Park_Disp_Rq_AR_saveEnvVars(dword):*/
Park_Disp_Rq_AR_saveEnvVars( dword hFile )
{
    filePutString("\n// Knoten EIS: Park_Disp_Rq_AR\n", 33, hFile );
    snprintf( buffer, elcount( buffer ), "0.0000 HMI__STMSG_Park_Disp_Rq_AR := %X\n", getValue( HMI__STMSG_Park_Disp_Rq_AR ) );    filePutString( buffer, elcount( buffer ), hFile );
    snprintf( buffer, elcount( buffer ), "0.0000 HMI__STMSGT_Park_Disp_Rq_AR := %X\n", getValue( HMI__STMSGT_Park_Disp_Rq_AR ) );    filePutString( buffer, elcount( buffer ), hFile );
    snprintf( buffer, elcount( buffer ), "0.0000 HMI_CRC_Park_Disp_Rq := %X\n", getValue( HMI_CRC_Park_Disp_Rq ) );    filePutString( buffer, elcount( buffer ), hFile );
    snprintf( buffer, elcount( buffer ), "0.0000 HMI_CRC_Park_Disp_Rq_Auto := %X\n", getValue( HMI_CRC_Park_Disp_Rq_Auto ) );    filePutString( buffer, elcount( buffer ), hFile );
    snprintf( buffer, elcount( buffer ), "0.0000 HMI_Park_IconDisp_Rq := %X\n", getValue( HMI_Park_IconDisp_Rq ) );    filePutString( buffer, elcount( buffer ), hFile );
    snprintf( buffer, elcount( buffer ), "0.0000 HMI_Park_Sound_Rq := %X\n", getValue( HMI_Park_Sound_Rq ) );    filePutString( buffer, elcount( buffer ), hFile );
    snprintf( buffer, elcount( buffer ), "0.0000 HMI_Park_Warn1_Disp_Rq := %X\n", getValue( HMI_Park_Warn1_Disp_Rq ) );    filePutString( buffer, elcount( buffer ), hFile );
//    snprintf( buffer, elcount( buffer ), "0.0000 HMI_Rsrv0_Park_Disp_Rq := %X\n", getValue( HMI_Rsrv0_Park_Disp_Rq ) );    filePutString( buffer, elcount( buffer ), hFile );
    snprintf( buffer, elcount( buffer ), "0.0000 HMI_Rsrv1_Park_Disp_Rq := %X\n", getValue( HMI_Rsrv1_Park_Disp_Rq ) );    filePutString( buffer, elcount( buffer ), hFile );
    snprintf( buffer, elcount( buffer ), "0.0000 HMI_Rsrv2_Park_Disp_Rq := %X\n", getValue( HMI_Rsrv2_Park_Disp_Rq ) );    filePutString( buffer, elcount( buffer ), hFile );
    snprintf( buffer, elcount( buffer ), "0.0000 HMI_Rsrv3_Park_Disp_Rq := %X\n", getValue( HMI_Rsrv3_Park_Disp_Rq ) );    filePutString( buffer, elcount( buffer ), hFile );
    snprintf( buffer, elcount( buffer ), "0.0000 HMI_Rsrv4_Park_Disp_Rq := %X\n", getValue( HMI_Rsrv4_Park_Disp_Rq ) );    filePutString( buffer, elcount( buffer ), hFile );
    snprintf( buffer, elcount( buffer ), "0.0000 HMI_SQC_Park_Disp_Rq := %X\n", getValue( HMI_SQC_Park_Disp_Rq ) );    filePutString( buffer, elcount( buffer ), hFile );
    snprintf( buffer, elcount( buffer ), "0.0000 HMI_SQC_Park_Disp_Rq_Auto := %X\n", getValue( HMI_SQC_Park_Disp_Rq_Auto ) );    filePutString( buffer, elcount( buffer ), hFile );
}
/*@@end*/

/*@@timer:_tPark_Disp_Rq_AR:*/
on timer _tPark_Disp_Rq_AR
{
    putValue( HMI__STMSG_Park_Disp_Rq_AR, 0 );
}
/*@@end*/

/*@@envVar:HMI__STMSG_Park_Disp_Rq_AR:*/
on EnvVar HMI__STMSG_Park_Disp_Rq_AR
{
    long tDelay;
    if( getValue( this ) == 2 )
    {
        tDelay = getValue( HMI__STMSGT_Park_Disp_Rq_AR );
        if( tDelay > 0 )
            setTimer( _tPark_Disp_Rq_AR, tDelay );
        else
            putValue( HMI__STMSG_Park_Disp_Rq_AR, 0 );
    }
}
/*@@end*/

/*@@envVar:HMI__AUTOMSG_Park_Disp_Rq_AR:*/
on EnvVar HMI__AUTOMSG_Park_Disp_Rq_AR
{
    if( getValue( this ) )
    {
        putValue( HMI_PARK_Hitch_Instrct_Disp_Rq, 0 );
        putValue( HMI_PARK_Hitch_KinkAngl, 0 );
        putValue( HMI_PARK_Hitch_KinkAngl_Rng, 0 );
        putValue( HMI_Park_IconDisp_Rq, 0 );
        putValue( HMI_PARK_Pilot_Md, 0 );
        putValue( HMI_Park_Sound_Rq, 0 );
        putValue( HMI_Park_Warn1_Disp_Rq, 0 );
        putValue( HMI_Rsrv1_Park_Disp_Rq, 7 );
        putValue( HMI_Rsrv2_Park_Disp_Rq, 7 );
        putValue( HMI_Rsrv3_Park_Disp_Rq, 7 );
        putValue( HMI_Rsrv4_Park_Disp_Rq, 7 );
        _mPark_Disp_Rq_AR.PARK_Hitch_Instrct_Disp_Rq.phys =   getValue( HMI_PARK_Hitch_Instrct_Disp_Rq );
        _mPark_Disp_Rq_AR.PARK_Hitch_KinkAngl.phys =   getValue( HMI_PARK_Hitch_KinkAngl );
        _mPark_Disp_Rq_AR.PARK_Hitch_KinkAngl_Rng.phys =   getValue( HMI_PARK_Hitch_KinkAngl_Rng );
        _mPark_Disp_Rq_AR.Park_IconDisp_Rq.phys =   getValue( HMI_Park_IconDisp_Rq );
        _mPark_Disp_Rq_AR.PARK_Pilot_Md.phys =   getValue( HMI_PARK_Pilot_Md );
        _mPark_Disp_Rq_AR.Park_Sound_Rq.phys =      getValue( HMI_Park_Sound_Rq );
        _mPark_Disp_Rq_AR.Park_Warn1_Disp_Rq.phys = getValue( HMI_Park_Warn1_Disp_Rq );
        _mPark_Disp_Rq_AR.Rsrv1_Park_Disp_Rq.phys = getValue( HMI_Rsrv1_Park_Disp_Rq );
        _mPark_Disp_Rq_AR.Rsrv2_Park_Disp_Rq.phys = getValue( HMI_Rsrv2_Park_Disp_Rq );
        _mPark_Disp_Rq_AR.Rsrv3_Park_Disp_Rq.phys = getValue( HMI_Rsrv3_Park_Disp_Rq );
        _mPark_Disp_Rq_AR.Rsrv4_Park_Disp_Rq.phys = getValue( HMI_Rsrv4_Park_Disp_Rq );
        _Park_Disp_Rq_AR_SpontanFlag = 1;
    }
}
/*@@end*/

/*@@envVar:HMI__TRIGMSG_Park_Disp_Rq_AR:*/
on EnvVar HMI__TRIGMSG_Park_Disp_Rq_AR
{
    if( getValue( this ) )
    {
        _mPark_Disp_Rq_AR.PARK_Hitch_Instrct_Disp_Rq.phys =   getValue( HMI_PARK_Hitch_Instrct_Disp_Rq );
        _mPark_Disp_Rq_AR.PARK_Hitch_KinkAngl.phys =   getValue( HMI_PARK_Hitch_KinkAngl );
        _mPark_Disp_Rq_AR.PARK_Hitch_KinkAngl_Rng.phys =   getValue( HMI_PARK_Hitch_KinkAngl_Rng );
        _mPark_Disp_Rq_AR.Park_IconDisp_Rq.phys =   getValue( HMI_Park_IconDisp_Rq );
        _mPark_Disp_Rq_AR.PARK_Pilot_Md.phys =   getValue( HMI_PARK_Pilot_Md );
        _mPark_Disp_Rq_AR.Park_Sound_Rq.phys =      getValue( HMI_Park_Sound_Rq );
        _mPark_Disp_Rq_AR.Park_Warn1_Disp_Rq.phys = getValue( HMI_Park_Warn1_Disp_Rq );
        _mPark_Disp_Rq_AR.Rsrv1_Park_Disp_Rq.phys = getValue( HMI_Rsrv1_Park_Disp_Rq );
        _mPark_Disp_Rq_AR.Rsrv2_Park_Disp_Rq.phys = getValue( HMI_Rsrv2_Park_Disp_Rq );
        _mPark_Disp_Rq_AR.Rsrv3_Park_Disp_Rq.phys = getValue( HMI_Rsrv3_Park_Disp_Rq );
        _mPark_Disp_Rq_AR.Rsrv4_Park_Disp_Rq.phys = getValue( HMI_Rsrv4_Park_Disp_Rq );
        _Park_Disp_Rq_AR_SpontanFlag = 1;
    }
}
/*@@end*/

/*@@envVar:HMI_PARK_Hitch_Instrct_Disp_Rq:*/
on envVar HMI_PARK_Hitch_Instrct_Disp_Rq
{
    if( getValue( HMI__AUTOMSG_Park_Disp_Rq_AR ) == cAUTO )
    {
        _mPark_Disp_Rq_AR.PARK_Hitch_Instrct_Disp_Rq.phys = getValue(this);
        _Park_Disp_Rq_AR_SpontanFlag = 1;
    }
}
/*@@end*/

/*@@envVar:HMI_PARK_Hitch_KinkAngl:*/
on envVar HMI_PARK_Hitch_KinkAngl
{
    if( getValue( HMI__AUTOMSG_Park_Disp_Rq_AR ) == cAUTO )
    {
        _mPark_Disp_Rq_AR.PARK_Hitch_KinkAngl.phys = getValue(this);
        _Park_Disp_Rq_AR_SpontanFlag = 1;
    }
}
/*@@end*/

/*@@envVar:HMI_PARK_Hitch_KinkAngl_Rng:*/
on envVar HMI_PARK_Hitch_KinkAngl_Rng
{
    if( getValue( HMI__AUTOMSG_Park_Disp_Rq_AR ) == cAUTO )
    {
        _mPark_Disp_Rq_AR.PARK_Hitch_KinkAngl_Rng.phys = getValue(this);
        _Park_Disp_Rq_AR_SpontanFlag = 1;
    }
}
/*@@end*/

/*@@envVar:HMI_Park_IconDisp_Rq:*/
on envVar HMI_Park_IconDisp_Rq
{
    if( getValue( HMI__AUTOMSG_Park_Disp_Rq_AR ) == cAUTO )
    {
        _mPark_Disp_Rq_AR.Park_IconDisp_Rq.phys = getValue(this);
        _Park_Disp_Rq_AR_SpontanFlag = 1;
    }
}
/*@@end*/

/*@@envVar:HMI_PARK_Pilot_Md:*/
on envVar HMI_PARK_Pilot_Md
{
    if( getValue( HMI__AUTOMSG_Park_Disp_Rq_AR ) == cAUTO )
    {
        _mPark_Disp_Rq_AR.PARK_Pilot_Md.phys = getValue(this);
        _Park_Disp_Rq_AR_SpontanFlag = 1;
    }
}
/*@@end*/

/*@@envVar:HMI_Park_Sound_Rq:*/
on envVar HMI_Park_Sound_Rq
{
    if( getValue( HMI__AUTOMSG_Park_Disp_Rq_AR ) == cAUTO )
    {
        _mPark_Disp_Rq_AR.Park_Sound_Rq.phys = getValue(this);
        _Park_Disp_Rq_AR_SpontanFlag = 1;
    }
}
/*@@end*/

/*@@envVar:HMI_Park_Warn1_Disp_Rq:*/
on envVar HMI_Park_Warn1_Disp_Rq
{
    if( getValue( HMI__AUTOMSG_Park_Disp_Rq_AR ) == cAUTO )
    {
        _mPark_Disp_Rq_AR.Park_Warn1_Disp_Rq.phys = getValue(this);
        _Park_Disp_Rq_AR_SpontanFlag = 1;
    }
}
/*@@end*/

/*@@envVar:HMI_Rsrv1_Park_Disp_Rq:*/
on envVar HMI_Rsrv1_Park_Disp_Rq
{
    if( getValue( HMI__AUTOMSG_Park_Disp_Rq_AR ) == cAUTO )
    {
        _mPark_Disp_Rq_AR.Rsrv1_Park_Disp_Rq.phys = getValue(this);
        _Park_Disp_Rq_AR_SpontanFlag = 1;
    }
}
/*@@end*/

/*@@envVar:HMI_Rsrv2_Park_Disp_Rq:*/
on envVar HMI_Rsrv2_Park_Disp_Rq
{
    if( getValue( HMI__AUTOMSG_Park_Disp_Rq_AR ) == cAUTO )
    {
        _mPark_Disp_Rq_AR.Rsrv2_Park_Disp_Rq.phys = getValue(this);
        _Park_Disp_Rq_AR_SpontanFlag = 1;
    }
}
/*@@end*/

/*@@envVar:HMI_Rsrv3_Park_Disp_Rq:*/
on envVar HMI_Rsrv3_Park_Disp_Rq
{
    if( getValue( HMI__AUTOMSG_Park_Disp_Rq_AR ) == cAUTO )
    {
        _mPark_Disp_Rq_AR.Rsrv3_Park_Disp_Rq.phys = getValue(this);
        _Park_Disp_Rq_AR_SpontanFlag = 1;
    }
}
/*@@end*/

/*@@envVar:HMI_Rsrv4_Park_Disp_Rq:*/
on envVar HMI_Rsrv4_Park_Disp_Rq
{
    if( getValue( HMI__AUTOMSG_Park_Disp_Rq_AR ) == cAUTO )
    {
        _mPark_Disp_Rq_AR.Rsrv4_Park_Disp_Rq.phys = getValue(this);
        _Park_Disp_Rq_AR_SpontanFlag = 1;
    }
}
/*@@end*/

/*@@caplFunc:Park_Set_Stat_AR_check_output():*/
Park_Set_Stat_AR_check_output()
{
    if( !getValue( HMI__STMSG_Park_Set_Stat_AR ) )
    {
        // Botschaft Park_Set_Stat_AR ID: 1092 --- Sendeart 5 cyclicAndSpontanWithDelay --- 
        if( _Park_Set_Stat_AR_DelayCnt > 0) _Park_Set_Stat_AR_DelayCnt--; // Mindestsendeabstand
        _Park_Set_Stat_AR_Cnt--;
        if( _Park_Set_Stat_AR_Cnt < 1 )
        {
            if( _Park_Set_Stat_AR_DelayCnt < 1 )
            {
                // Nachricht wg. abgelaufenem Zyklus ausgeben (Mindestsendeabstand eingehalten)
                Park_Set_Stat_AR_output();
                _Park_Set_Stat_AR_SpontanFlag = 0; // Spontan-Flag zurücksetzen
                _Park_Set_Stat_AR_DelayCnt = _Park_Set_Stat_AR_MinDelay;
            }
            else
            {
                // Spontanflag setzen damit nach Ablauf Mindestsendeabstand gesendet wird
                 _Park_Set_Stat_AR_SpontanFlag = 1;
            }
            _Park_Set_Stat_AR_Cnt = _Park_Set_Stat_AR_CycleCount; // Zyklus-Zähler zurücksetzen
        }
        else if( _Park_Set_Stat_AR_SpontanFlag)
        {
            if( _Park_Set_Stat_AR_DelayCnt < 1 )
            {
                // Nachricht wg. spontaner Änderung ausgeben (Mindestsendeabstand eingehalten)
                Park_Set_Stat_AR_output();
                _Park_Set_Stat_AR_SpontanFlag = 0; // Spontan-Flag zurücksetzen
                _Park_Set_Stat_AR_DelayCnt = _Park_Set_Stat_AR_MinDelay;
            }
        }
    }
}
/*@@end*/

/*@@caplFunc:Park_Set_Stat_AR_init():*/
Park_Set_Stat_AR_init()
{   /* Botschaft Park_Set_Stat_AR ID: 1092 --- Sendeart 5 cyclicAndSpontanWithDelay --- 
BA_ "ApplMessage" BO_ 1092 0;
BA_ "NmAsrMessage" BO_ 1092 0;
BA_ "GenMsgMinAcceptLength" BO_ 1092 8;
BA_ "GenMsgILSupport" BO_ 1092 1;
BA_ "DiagState" BO_ 1092 0;
BA_ "DiagRequest" BO_ 1092 0;
BA_ "DiagResponse" BO_ 1092 0;
BA_ "GenMsgStartValue" BO_ 1092 "0";
BA_ "GenMsgDelayTime" BO_ 1092 100;
BA_ "GenMsgNrOfRepetitions" BO_ 1092 0;
BA_ "GenMsgCycleTime" BO_ 1092 500;
BA_ "GenMsgSendType" BO_ 1092 5;
    */
    _Park_Set_Stat_AR_Timebase =                c_tDBKomTimer_20ms;
    _Park_Set_Stat_AR_CycleCount =             500 / _Park_Set_Stat_AR_Timebase;
    _Park_Set_Stat_AR_StartDelay =               0 / _Park_Set_Stat_AR_Timebase;
    _Park_Set_Stat_AR_MinDelay =               100 / _Park_Set_Stat_AR_Timebase;
    _Park_Set_Stat_AR_Cnt = _Park_Set_Stat_AR_StartDelay;
    _Park_Set_Stat_AR_SpontanFlag = 0;
    _Park_Set_Stat_AR_DelayCnt = 0;

    putValue( HMI__STMSGSD_Park_Set_Stat_AR, _Park_Set_Stat_AR_StartDelay * _Park_Set_Stat_AR_Timebase );

    _mPark_Set_Stat_AR.Park_AccelMd_Stat.phys = getValue( HMI_Park_AccelMd_Stat );
    _mPark_Set_Stat_AR.Park_Attenuat_Rq.phys = getValue( HMI_Park_Attenuat_Rq );
    _mPark_Set_Stat_AR.Park_AttenuatMd_Stat.phys = getValue( HMI_Park_AttenuatMd_Stat );
    _mPark_Set_Stat_AR.Park_BrkMd_Stat.phys = getValue( HMI_Park_BrkMd_Stat );
    _mPark_Set_Stat_AR.Park_CTA_Md_Stat.phys = getValue( HMI_Park_CTA_Md_Stat );
    _mPark_Set_Stat_AR.Park_ObjDtctMd_Stat.phys = getValue( HMI_Park_ObjDtctMd_Stat );
    _mPark_Set_Stat_AR.Park_RevGrMd_Stat.phys = getValue( HMI_Park_RevGrMd_Stat );
    _mPark_Set_Stat_AR.Park_Sonar_Ft_Md_Stat.phys = getValue( HMI_Park_Sonar_Ft_Md_Stat );
    _mPark_Set_Stat_AR.Park_Sonar_R_Md_Stat.phys = getValue( HMI_Park_Sonar_R_Md_Stat );
    _mPark_Set_Stat_AR.Park_StMd_Stat.phys = getValue( HMI_Park_StMd_Stat );
    _mPark_Set_Stat_AR.Park_StyleMd_State.phys = getValue( HMI_Park_StyleMd_State );
    _mPark_Set_Stat_AR.Park_WarnFreq_Ft_Stat.phys = getValue( HMI_Park_WarnFreq_Ft_Stat );
    _mPark_Set_Stat_AR.Park_WarnFreq_R_Stat.phys = getValue( HMI_Park_WarnFreq_R_Stat );
    _mPark_Set_Stat_AR.Park_WarnVol_Ft_Stat.phys = getValue( HMI_Park_WarnVol_Ft_Stat );
    _mPark_Set_Stat_AR.Park_WarnVol_R_Stat.phys = getValue( HMI_Park_WarnVol_R_Stat );
}
/*@@end*/

/*@@caplFunc:Park_Set_Stat_AR_output():*/
Park_Set_Stat_AR_output(void)
{
    output( _mPark_Set_Stat_AR );
}
/*@@end*/

/*@@caplFunc:Park_Set_Stat_AR_saveEnvVars(dword):*/
Park_Set_Stat_AR_saveEnvVars( dword hFile )
{
    filePutString("\n// Knoten EIS: Park_Set_Stat_AR\n", 28, hFile );
    snprintf( buffer, elcount( buffer ), "0.0000 HMI__STMSG_Park_Set_Stat_AR := %X\n", getValue( HMI__STMSG_Park_Set_Stat_AR ) );        filePutString( buffer, elcount( buffer ), hFile );
    snprintf( buffer, elcount( buffer ), "0.0000 HMI__STMSGT_Park_Set_Stat_AR := %X\n", getValue( HMI__STMSGT_Park_Set_Stat_AR ) );        filePutString( buffer, elcount( buffer ), hFile );
    snprintf( buffer, elcount( buffer ), "0.0000 HMI_Park_AccelMd_Stat := %X\n", getValue( HMI_Park_AccelMd_Stat ) );        filePutString( buffer, elcount( buffer ), hFile );
    snprintf( buffer, elcount( buffer ), "0.0000 HMI_Park_Attenuat_Rq := %X\n", getValue( HMI_Park_Attenuat_Rq ) );        filePutString( buffer, elcount( buffer ), hFile );
    snprintf( buffer, elcount( buffer ), "0.0000 HMI_Park_AttenuatMd_Stat := %X\n", getValue( HMI_Park_AttenuatMd_Stat ) );        filePutString( buffer, elcount( buffer ), hFile );
    snprintf( buffer, elcount( buffer ), "0.0000 HMI_Park_BrkMd_Stat := %X\n", getValue( HMI_Park_BrkMd_Stat ) );        filePutString( buffer, elcount( buffer ), hFile );
    snprintf( buffer, elcount( buffer ), "0.0000 HMI_Park_CTA_Md_Stat := %X\n", getValue( HMI_Park_CTA_Md_Stat ) );        filePutString( buffer, elcount( buffer ), hFile );
    snprintf( buffer, elcount( buffer ), "0.0000 HMI_Park_ObjDtctMd_Stat := %X\n", getValue( HMI_Park_ObjDtctMd_Stat ) );        filePutString( buffer, elcount( buffer ), hFile );
    snprintf( buffer, elcount( buffer ), "0.0000 HMI_Park_RevGrMd_Stat := %X\n", getValue( HMI_Park_RevGrMd_Stat ) );        filePutString( buffer, elcount( buffer ), hFile );
    snprintf( buffer, elcount( buffer ), "0.0000 HMI_Park_Sonar_Ft_Md_Stat := %X\n", getValue( HMI_Park_Sonar_Ft_Md_Stat ) );        filePutString( buffer, elcount( buffer ), hFile );
    snprintf( buffer, elcount( buffer ), "0.0000 HMI_Park_Sonar_R_Md_Stat := %X\n", getValue( HMI_Park_Sonar_R_Md_Stat ) );        filePutString( buffer, elcount( buffer ), hFile );
    snprintf( buffer, elcount( buffer ), "0.0000 HMI_Park_StMd_Stat := %X\n", getValue( HMI_Park_StMd_Stat ) );        filePutString( buffer, elcount( buffer ), hFile );
    snprintf( buffer, elcount( buffer ), "0.0000 HMI_Park_StyleMd_State := %X\n", getValue( HMI_Park_StyleMd_State ) );        filePutString( buffer, elcount( buffer ), hFile );
    snprintf( buffer, elcount( buffer ), "0.0000 HMI_Park_WarnFreq_Ft_Stat := %X\n", getValue( HMI_Park_WarnFreq_Ft_Stat ) );        filePutString( buffer, elcount( buffer ), hFile );
    snprintf( buffer, elcount( buffer ), "0.0000 HMI_Park_WarnFreq_R_Stat := %X\n", getValue( HMI_Park_WarnFreq_R_Stat ) );        filePutString( buffer, elcount( buffer ), hFile );
    snprintf( buffer, elcount( buffer ), "0.0000 HMI_Park_WarnVol_Ft_Stat := %X\n", getValue( HMI_Park_WarnVol_Ft_Stat ) );        filePutString( buffer, elcount( buffer ), hFile );
    snprintf( buffer, elcount( buffer ), "0.0000 HMI_Park_WarnVol_R_Stat := %X\n", getValue( HMI_Park_WarnVol_R_Stat ) );        filePutString( buffer, elcount( buffer ), hFile );
}
/*@@end*/

/*@@timer:_tPark_Set_Stat_AR:*/
on timer _tPark_Set_Stat_AR
{
    putValue( HMI__STMSG_Park_Set_Stat_AR, 0 );
}
/*@@end*/

/*@@envVar:HMI__STMSG_Park_Set_Stat_AR:*/
on EnvVar HMI__STMSG_Park_Set_Stat_AR
{
    long tDelay;
    if( getValue( this ) == 2 )
    {
        tDelay = getValue( HMI__STMSGT_Park_Set_Stat_AR );
        if( tDelay > 0)    
            setTimer( _tPark_Set_Stat_AR, tDelay );
        else
            putValue( HMI__STMSG_Park_Set_Stat_AR, 0 );
    }
}
/*@@end*/

/*@@envVar:HMI_Park_AccelMd_Stat:*/
on EnvVar HMI_Park_AccelMd_Stat
{
    _mPark_Set_Stat_AR.Park_AccelMd_Stat.phys = getValue(this);
    _Park_Set_Stat_AR_SpontanFlag = 1;
}
/*@@end*/

/*@@envVar:HMI_Park_Attenuat_Rq:*/
on EnvVar HMI_Park_Attenuat_Rq
{
    _mPark_Set_Stat_AR.Park_Attenuat_Rq.phys = getValue(this);
    _Park_Set_Stat_AR_SpontanFlag = 1;
}
/*@@end*/

/*@@envVar:HMI_Park_AttenuatMd_Stat:*/
on EnvVar HMI_Park_AttenuatMd_Stat
{
    _mPark_Set_Stat_AR.Park_AttenuatMd_Stat.phys = getValue(this);
    _Park_Set_Stat_AR_SpontanFlag = 1;
}
/*@@end*/

/*@@envVar:HMI_Park_BrkMd_Stat:*/
on EnvVar HMI_Park_BrkMd_Stat
{
    _mPark_Set_Stat_AR.Park_BrkMd_Stat.phys = getValue(this);
    _Park_Set_Stat_AR_SpontanFlag = 1;
}
/*@@end*/

/*@@envVar:HMI_Park_CTA_Md_Stat:*/
on EnvVar HMI_Park_CTA_Md_Stat
{
    _mPark_Set_Stat_AR.Park_CTA_Md_Stat.phys = getValue(this);
    _Park_Set_Stat_AR_SpontanFlag = 1;
}
/*@@end*/

/*@@envVar:HMI_Park_ObjDtctMd_Stat:*/
on EnvVar HMI_Park_ObjDtctMd_Stat
{
    _mPark_Set_Stat_AR.Park_ObjDtctMd_Stat.phys = getValue(this);
    _Park_Set_Stat_AR_SpontanFlag = 1;
}
/*@@end*/

/*@@envVar:HMI_Park_RevGrMd_Stat:*/
on EnvVar HMI_Park_RevGrMd_Stat
{
    _mPark_Set_Stat_AR.Park_RevGrMd_Stat.phys = getValue(this);
    _Park_Set_Stat_AR_SpontanFlag = 1;
}
/*@@end*/

/*@@envVar:HMI_Park_Sonar_Ft_Md_Stat:*/
on EnvVar HMI_Park_Sonar_Ft_Md_Stat
{
    _mPark_Set_Stat_AR.Park_Sonar_Ft_Md_Stat.phys = getValue(this);
    _Park_Set_Stat_AR_SpontanFlag = 1;
}
/*@@end*/

/*@@envVar:HMI_Park_Sonar_R_Md_Stat:*/
on EnvVar HMI_Park_Sonar_R_Md_Stat
{
    _mPark_Set_Stat_AR.Park_Sonar_R_Md_Stat.phys = getValue(this);
    _Park_Set_Stat_AR_SpontanFlag = 1;
}
/*@@end*/

/*@@envVar:HMI_Park_StMd_Stat:*/
on EnvVar HMI_Park_StMd_Stat
{
    _mPark_Set_Stat_AR.Park_StMd_Stat.phys = getValue(this);
    _Park_Set_Stat_AR_SpontanFlag = 1;
}
/*@@end*/

/*@@envVar:HMI_Park_StyleMd_State:*/
on EnvVar HMI_Park_StyleMd_State
{
    _mPark_Set_Stat_AR.Park_StyleMd_State.phys = getValue(this);
    _Park_Set_Stat_AR_SpontanFlag = 1;
}
/*@@end*/

/*@@envVar:HMI_Park_WarnFreq_Ft_Stat:*/
on EnvVar HMI_Park_WarnFreq_Ft_Stat
{
    _mPark_Set_Stat_AR.Park_WarnFreq_Ft_Stat.phys = getValue(this);
    _Park_Set_Stat_AR_SpontanFlag = 1;
}
/*@@end*/

/*@@envVar:HMI_Park_WarnFreq_R_Stat:*/
on EnvVar HMI_Park_WarnFreq_R_Stat
{
    _mPark_Set_Stat_AR.Park_WarnFreq_R_Stat.phys = getValue(this);
    _Park_Set_Stat_AR_SpontanFlag = 1;
}
/*@@end*/

/*@@envVar:HMI_Park_WarnVol_Ft_Stat:*/
on EnvVar HMI_Park_WarnVol_Ft_Stat
{
    _mPark_Set_Stat_AR.Park_WarnVol_Ft_Stat.phys = getValue(this);
    _Park_Set_Stat_AR_SpontanFlag = 1;
}
/*@@end*/

/*@@envVar:HMI_Park_WarnVol_R_Stat:*/
on EnvVar HMI_Park_WarnVol_R_Stat
{
    _mPark_Set_Stat_AR.Park_WarnVol_R_Stat.phys = getValue(this);
    _Park_Set_Stat_AR_SpontanFlag = 1;
}
/*@@end*/

/*@@caplFunc:ParkSpaceMeas_Stat_AR_check_output():*/
ParkSpaceMeas_Stat_AR_check_output()
{
    if( !getValue( HMI__STMSG_ParkSpaceMeas_Stat_AR ) )
    {
        // Botschaft ParkSpaceMeas_Stat_AR ID: 675 --- Sendeart 5 cyclicAndSpontanWithDelay --- 
        if( _ParkSpaceMeas_Stat_AR_DelayCnt > 0) _ParkSpaceMeas_Stat_AR_DelayCnt--; // Mindestsendeabstand
        _ParkSpaceMeas_Stat_AR_Cnt--;
        if( _ParkSpaceMeas_Stat_AR_Cnt < 1 )
        {
            if( _ParkSpaceMeas_Stat_AR_DelayCnt < 1 )
            {
                ParkSpaceMeas_Stat_AR_output(); // Nachricht wg. abgelaufenem Zyklus ausgeben (Mindestsendeabstand eingehalten)
                _ParkSpaceMeas_Stat_AR_SpontanFlag = 0; // Spontan-Flag zurücksetzen
                _ParkSpaceMeas_Stat_AR_DelayCnt = _ParkSpaceMeas_Stat_AR_MinDelay;
            }
            else
            {
                // Spontanflag setzen damit nach Ablauf Mindestsendeabstand gesendet wird
                 _ParkSpaceMeas_Stat_AR_SpontanFlag = 1;
            }
            _ParkSpaceMeas_Stat_AR_Cnt = _ParkSpaceMeas_Stat_AR_CycleCount; // Zyklus-Zähler zurücksetzen
        }
        else if( _ParkSpaceMeas_Stat_AR_SpontanFlag)
        {
            if( _ParkSpaceMeas_Stat_AR_DelayCnt < 1 )
            {
                ParkSpaceMeas_Stat_AR_output(); // Nachricht wg. spontaner Änderung ausgeben (Mindestsendeabstand eingehalten)
                _ParkSpaceMeas_Stat_AR_SpontanFlag = 0; // Spontan-Flag zurücksetzen
                _ParkSpaceMeas_Stat_AR_DelayCnt = _ParkSpaceMeas_Stat_AR_MinDelay;
            }
        }
    }
}
/*@@end*/

/*@@caplFunc:ParkSpaceMeas_Stat_AR_init():*/
ParkSpaceMeas_Stat_AR_init()
{   /* Botschaft ParkSpaceMeas_Stat_AR ID: 675 --- Sendeart 5 cyclicAndSpontanWithDelay --- 
BA_ "ApplMessage" BO_ 675 0;
BA_ "NmAsrMessage" BO_ 675 0;
BA_ "GenMsgMinAcceptLength" BO_ 675 8;
BA_ "GenMsgILSupport" BO_ 675 1;
BA_ "DiagState" BO_ 675 0;
BA_ "DiagRequest" BO_ 675 0;
BA_ "DiagResponse" BO_ 675 0;
BA_ "GenMsgStartValue" BO_ 675 "0";
BA_ "GenMsgDelayTime" BO_ 675 100;
BA_ "GenMsgNrOfRepetitions" BO_ 675 0;
BA_ "GenMsgCycleTime" BO_ 675 1000;
BA_ "GenMsgSendType" BO_ 675 5;
    */
    _ParkSpaceMeas_Stat_AR_Timebase =           c_tDBKomTimer_20ms;
    _ParkSpaceMeas_Stat_AR_CycleCount =      1000 / _ParkSpaceMeas_Stat_AR_Timebase;
    _ParkSpaceMeas_Stat_AR_StartDelay =         0 / _ParkSpaceMeas_Stat_AR_Timebase;
    _ParkSpaceMeas_Stat_AR_MinDelay =         100 / _ParkSpaceMeas_Stat_AR_Timebase;
    _ParkSpaceMeas_Stat_AR_Cnt = _ParkSpaceMeas_Stat_AR_StartDelay;
    _ParkSpaceMeas_Stat_AR_SpontanFlag = 0;
    _ParkSpaceMeas_Stat_AR_DelayCnt = 0;

    putValue( HMI__STMSGSD_ParkSpaceMeas_Stat_AR, _ParkSpaceMeas_Stat_AR_StartDelay * _ParkSpaceMeas_Stat_AR_Timebase );

    _mParkSpaceMeas_Stat_AR.ParkSeg_F_InnerLt_ObstclDist.phys = getValue( HMI_ParkSeg_F_InnerLt_ObstclDist );
    _mParkSpaceMeas_Stat_AR.ParkSeg_F_InnerRt_ObstclDist.phys = getValue( HMI_ParkSeg_F_InnerRt_ObstclDist );
    _mParkSpaceMeas_Stat_AR.ParkSeg_F_OuterLt_ObstclDist.phys = getValue( HMI_ParkSeg_F_OuterLt_ObstclDist );
    _mParkSpaceMeas_Stat_AR.ParkSeg_F_OuterRt_ObstclDist.phys = getValue( HMI_ParkSeg_F_OuterRt_ObstclDist );
    _mParkSpaceMeas_Stat_AR.ParkSeg_R_InnerLt_ObstclDist.phys = getValue( HMI_ParkSeg_R_InnerLt_ObstclDist );
    _mParkSpaceMeas_Stat_AR.ParkSeg_R_InnerRt_ObstclDist.phys = getValue( HMI_ParkSeg_R_InnerRt_ObstclDist );
    _mParkSpaceMeas_Stat_AR.ParkSeg_R_OuterLt_ObstclDist.phys = getValue( HMI_ParkSeg_R_OuterLt_ObstclDist );
    _mParkSpaceMeas_Stat_AR.ParkSeg_R_OuterRt_ObstclDist.phys = getValue( HMI_ParkSeg_R_OuterRt_ObstclDist );
    _mParkSpaceMeas_Stat_AR.ParkSpace_FL_ObstclDist.phys = getValue( HMI_ParkSpace_FL_ObstclDist );
    _mParkSpaceMeas_Stat_AR.ParkSpace_FR_ObstclDist.phys = getValue( HMI_ParkSpace_FR_ObstclDist );
    _mParkSpaceMeas_Stat_AR.ParkSpace_RL_ObstclDist.phys = getValue( HMI_ParkSpace_RL_ObstclDist );
    _mParkSpaceMeas_Stat_AR.ParkSpace_RR_ObstclDist.phys = getValue( HMI_ParkSpace_RR_ObstclDist );
    _mParkSpaceMeas_Stat_AR.ParkSpaceMeas_F_Actv.phys = getValue( HMI_ParkSpaceMeas_F_Actv );
    _mParkSpaceMeas_Stat_AR.ParkSpaceMeas_R_Actv.phys = getValue( HMI_ParkSpaceMeas_R_Actv );
    _mParkSpaceMeas_Stat_AR.ParkSys_Flt.phys = getValue( HMI_ParkSys_Flt );
}
/*@@end*/

/*@@caplFunc:ParkSpaceMeas_Stat_AR_output():*/
ParkSpaceMeas_Stat_AR_output()
{
    output( _mParkSpaceMeas_Stat_AR );
}
/*@@end*/

/*@@caplFunc:ParkSpaceMeas_Stat_AR_saveEnvVars(dword):*/
ParkSpaceMeas_Stat_AR_saveEnvVars( dword hFile )
{
    filePutString("\n// Knoten EIS: ParkSpaceMeas_Stat_AR\n", 25, hFile );
    snprintf( buffer, elcount( buffer ), "0.0000 HMI__STMSG_ParkSpaceMeas_Stat_AR := %X\n", getValue( HMI__STMSG_ParkSpaceMeas_Stat_AR ) );    filePutString( buffer, elcount( buffer ), hFile );
    snprintf( buffer, elcount( buffer ), "0.0000 HMI__STMSGT_ParkSpaceMeas_Stat_AR := %X\n", getValue( HMI__STMSGT_ParkSpaceMeas_Stat_AR ) );    filePutString( buffer, elcount( buffer ), hFile );
    snprintf( buffer, elcount( buffer ), "0.0000 HMI_ParkSeg_F_InnerLt_ObstclDist := %X\n", getValue( HMI_ParkSeg_F_InnerLt_ObstclDist ) );    filePutString( buffer, elcount( buffer ), hFile );
    snprintf( buffer, elcount( buffer ), "0.0000 HMI_ParkSeg_F_InnerRt_ObstclDist := %X\n", getValue( HMI_ParkSeg_F_InnerRt_ObstclDist ) );    filePutString( buffer, elcount( buffer ), hFile );
    snprintf( buffer, elcount( buffer ), "0.0000 HMI_ParkSeg_F_OuterLt_ObstclDist := %X\n", getValue( HMI_ParkSeg_F_OuterLt_ObstclDist ) );    filePutString( buffer, elcount( buffer ), hFile );
    snprintf( buffer, elcount( buffer ), "0.0000 HMI_ParkSeg_F_OuterRt_ObstclDist := %X\n", getValue( HMI_ParkSeg_F_OuterRt_ObstclDist ) );    filePutString( buffer, elcount( buffer ), hFile );
    snprintf( buffer, elcount( buffer ), "0.0000 HMI_ParkSeg_R_InnerLt_ObstclDist := %X\n", getValue( HMI_ParkSeg_R_InnerLt_ObstclDist ) );    filePutString( buffer, elcount( buffer ), hFile );
    snprintf( buffer, elcount( buffer ), "0.0000 HMI_ParkSeg_R_InnerRt_ObstclDist := %X\n", getValue( HMI_ParkSeg_R_InnerRt_ObstclDist ) );    filePutString( buffer, elcount( buffer ), hFile );
    snprintf( buffer, elcount( buffer ), "0.0000 HMI_ParkSeg_R_OuterLt_ObstclDist := %X\n", getValue( HMI_ParkSeg_R_OuterLt_ObstclDist ) );    filePutString( buffer, elcount( buffer ), hFile );
    snprintf( buffer, elcount( buffer ), "0.0000 HMI_ParkSeg_R_OuterRt_ObstclDist := %X\n", getValue( HMI_ParkSeg_R_OuterRt_ObstclDist ) );    filePutString( buffer, elcount( buffer ), hFile );
    snprintf( buffer, elcount( buffer ), "0.0000 HMI_ParkSpace_FL_ObstclDist := %X\n", getValue( HMI_ParkSpace_FL_ObstclDist ) );    filePutString( buffer, elcount( buffer ), hFile );
    snprintf( buffer, elcount( buffer ), "0.0000 HMI_ParkSpace_FR_ObstclDist := %X\n", getValue( HMI_ParkSpace_FR_ObstclDist ) );    filePutString( buffer, elcount( buffer ), hFile );
    snprintf( buffer, elcount( buffer ), "0.0000 HMI_ParkSpace_RL_ObstclDist := %X\n", getValue( HMI_ParkSpace_RL_ObstclDist ) );    filePutString( buffer, elcount( buffer ), hFile );
    snprintf( buffer, elcount( buffer ), "0.0000 HMI_ParkSpace_RR_ObstclDist := %X\n", getValue( HMI_ParkSpace_RR_ObstclDist ) );    filePutString( buffer, elcount( buffer ), hFile );
    snprintf( buffer, elcount( buffer ), "0.0000 HMI_ParkSpaceMeas_F_Actv := %X\n", getValue( HMI_ParkSpaceMeas_F_Actv ) );    filePutString( buffer, elcount( buffer ), hFile );
    snprintf( buffer, elcount( buffer ), "0.0000 HMI_ParkSpaceMeas_R_Actv := %X\n", getValue( HMI_ParkSpaceMeas_R_Actv ) );    filePutString( buffer, elcount( buffer ), hFile );
    snprintf( buffer, elcount( buffer ), "0.0000 HMI_ParkSys_Flt := %X\n", getValue( HMI_ParkSys_Flt ) );    filePutString( buffer, elcount( buffer ), hFile );
}
/*@@end*/

/*@@timer:_tParkSpaceMeas_Stat_AR:*/
on timer _tParkSpaceMeas_Stat_AR
{
    putValue( HMI__STMSG_ParkSpaceMeas_Stat_AR, 0 );
}
/*@@end*/

/*@@envVar:HMI__STMSG_ParkSpaceMeas_Stat_AR:*/
on EnvVar HMI__STMSG_ParkSpaceMeas_Stat_AR
{
    long tDelay;
    if( getValue( this ) == 2 )
    {
        tDelay = getValue( HMI__STMSGT_ParkSpaceMeas_Stat_AR );
        if( tDelay > 0)    
            setTimer( _tParkSpaceMeas_Stat_AR, tDelay );
        else
            putValue( HMI__STMSG_ParkSpaceMeas_Stat_AR, 0 );
    }
}
/*@@end*/

/*@@caplFunc:ParkWarn_AR_check_output():*/
ParkWarn_AR_check_output()
{
    if( !getValue( HMI__STMSG_ParkWarn_AR ) )
    {
        // Botschaft ParkWarn_AR ID: 1075 --- Sendeart 5 cyclicAndSpontanWithDelay --- 
        _ParkWarn_AR_Cnt--;
        if( _ParkWarn_AR_Cnt < 1 )
        {
            ParkWarn_AR_output(); // Nachricht wg. abgelaufenem Zyklus ausgeben
            _ParkWarn_AR_Cnt = _ParkWarn_AR_CycleCount; // Zyklus-Zähler zurücksetzen
            _ParkWarn_AR_SpontanFlag = 0; // Spontan-Flag zurücksetzen
        }
        else if( _ParkWarn_AR_SpontanFlag)
        {
            ParkWarn_AR_output(); // Nachricht wg. spontaner Änderung ausgeben
            _ParkWarn_AR_SpontanFlag = 0; // Spontan-Flag zurücksetzen
        }
    }
}
/*@@end*/

/*@@caplFunc:ParkWarn_AR_init():*/
ParkWarn_AR_init()
{   /* Botschaft ParkWarn_AR ID: 1075 --- Sendeart 5 cyclicAndSpontanWithDelay --- 
BA_ "ApplMessage" BO_ 1075 0;
BA_ "NmAsrMessage" BO_ 1075 0;
BA_ "GenMsgMinAcceptLength" BO_ 1075 8;
BA_ "GenMsgILSupport" BO_ 1075 1;
BA_ "DiagState" BO_ 1075 0;
BA_ "DiagRequest" BO_ 1075 0;
BA_ "DiagResponse" BO_ 1075 0;
BA_ "GenMsgStartValue" BO_ 1075 "0";
BA_ "GenMsgDelayTime" BO_ 1075 20;
BA_ "GenMsgNrOfRepetitions" BO_ 1075 0;
BA_ "GenMsgCycleTime" BO_ 1075 200;
BA_ "GenMsgSendType" BO_ 1075 5;
    */
    _ParkWarn_AR_Timebase =           c_tDBKomTimer_20ms;
    _ParkWarn_AR_CycleCount =        200 / _ParkWarn_AR_Timebase;
    _ParkWarn_AR_StartDelay =          0 / _ParkWarn_AR_Timebase;
    _ParkWarn_AR_Cnt = _ParkWarn_AR_StartDelay;
    _ParkWarn_AR_SpontanFlag = 0;

    putValue( HMI__STMSGSD_ParkWarn_AR, _ParkWarn_AR_StartDelay * _ParkWarn_AR_Timebase );

    _mParkWarn_AR.AcustWarn_Actv_PARK.phys = getValue( HMI_AcustWarn_Actv_PARK );
    _mParkWarn_AR.Park_Off.phys = getValue( HMI_Park_Off );
    _mParkWarn_AR.PARK_TP_Flt.phys = getValue( HMI_PARK_TP_Flt );
    _mParkWarn_AR.ParkSideProt_Lt_Warn_Rq.phys = getValue( HMI_ParkSideProt_Lt_Warn_Rq );
    _mParkWarn_AR.ParkSideProt_Rt_Warn_Rq.phys = getValue( HMI_ParkSideProt_Rt_Warn_Rq );
    _mParkWarn_AR.ParkSwLED_Rq.phys = getValue( HMI_ParkSwLED_Rq );
    _mParkWarn_AR.ParkWarnElem_FL_Stat.phys = getValue( HMI_ParkWarnElem_FL_Stat );
    _mParkWarn_AR.ParkWarnElem_FR_Stat.phys = getValue( HMI_ParkWarnElem_FR_Stat );
    _mParkWarn_AR.ParkWarnElem_RL_Stat.phys = getValue( HMI_ParkWarnElem_RL_Stat );
    _mParkWarn_AR.ParkWarnElem_RR_Stat.phys = getValue( HMI_ParkWarnElem_RR_Stat );
    _mParkWarn_AR.ParkWarnFreq_Ft.phys = getValue( HMI_ParkWarnFreq_Ft );
    _mParkWarn_AR.ParkWarnFreq_R.phys = getValue( HMI_ParkWarnFreq_R );
    _mParkWarn_AR.ParkWarnSnd_FL.phys = getValue( HMI_ParkWarnSnd_FL );
    _mParkWarn_AR.ParkWarnSnd_FR.phys = getValue( HMI_ParkWarnSnd_FR );
    _mParkWarn_AR.ParkWarnSnd_Ft_Rq.phys = getValue( HMI_ParkWarnSnd_Ft_Rq );
    _mParkWarn_AR.ParkWarnSnd_R_Rq.phys = getValue( HMI_ParkWarnSnd_R_Rq );
    _mParkWarn_AR.ParkWarnSnd_RL.phys = getValue( HMI_ParkWarnSnd_RL );
    _mParkWarn_AR.ParkWarnSnd_RR.phys = getValue( HMI_ParkWarnSnd_RR );
    _mParkWarn_AR.ParkWarnVol_Ft.phys = getValue( HMI_ParkWarnVol_Ft );
    _mParkWarn_AR.ParkWarnVol_R.phys = getValue( HMI_ParkWarnVol_R );
}
/*@@end*/

/*@@caplFunc:ParkWarn_AR_output():*/
ParkWarn_AR_output(void)
{
    output( _mParkWarn_AR );
}
/*@@end*/

/*@@caplFunc:ParkWarn_AR_saveEnvVars(dword):*/
ParkWarn_AR_saveEnvVars( dword hFile )
{
    filePutString("\n// Knoten EIS: ParkWarn_AR\n", 25, hFile );
    snprintf( buffer, elcount( buffer ), "0.0000 HMI__STMSG_ParkWarn := %X\n", getValue( HMI__STMSG_ParkWarn_AR ) );    filePutString( buffer, elcount( buffer ), hFile );
    snprintf( buffer, elcount( buffer ), "0.0000 HMI__STMSGT_ParkWarn := %X\n", getValue( HMI__STMSGT_ParkWarn_AR ) );    filePutString( buffer, elcount( buffer ), hFile );
    snprintf( buffer, elcount( buffer ), "0.0000 HMI_AcustWarn_Actv_PARK := %X\n", getValue( HMI_AcustWarn_Actv_PARK ) );    filePutString( buffer, elcount( buffer ), hFile );
    snprintf( buffer, elcount( buffer ), "0.0000 HMI_Park_Off := %X\n", getValue( HMI_Park_Off ) );    filePutString( buffer, elcount( buffer ), hFile );
    snprintf( buffer, elcount( buffer ), "0.0000 HMI_PARK_TP_Flt := %X\n", getValue( HMI_PARK_TP_Flt ) );    filePutString( buffer, elcount( buffer ), hFile );
    snprintf( buffer, elcount( buffer ), "0.0000 HMI_ParkSideProt_Lt_Warn_Rq := %X\n", getValue( HMI_ParkSideProt_Lt_Warn_Rq ) );    filePutString( buffer, elcount( buffer ), hFile );
    snprintf( buffer, elcount( buffer ), "0.0000 HMI_ParkSideProt_Rt_Warn_Rq := %X\n", getValue( HMI_ParkSideProt_Rt_Warn_Rq ) );    filePutString( buffer, elcount( buffer ), hFile );
    snprintf( buffer, elcount( buffer ), "0.0000 HMI_ParkSwLED_Rq := %X\n", getValue( HMI_ParkSwLED_Rq ) );    filePutString( buffer, elcount( buffer ), hFile );
    snprintf( buffer, elcount( buffer ), "0.0000 HMI_ParkWarnElem_FL_Stat := %X\n", getValue( HMI_ParkWarnElem_FL_Stat ) );    filePutString( buffer, elcount( buffer ), hFile );
    snprintf( buffer, elcount( buffer ), "0.0000 HMI_ParkWarnElem_FR_Stat := %X\n", getValue( HMI_ParkWarnElem_FR_Stat ) );    filePutString( buffer, elcount( buffer ), hFile );
    snprintf( buffer, elcount( buffer ), "0.0000 HMI_ParkWarnElem_RL_Stat := %X\n", getValue( HMI_ParkWarnElem_RL_Stat ) );    filePutString( buffer, elcount( buffer ), hFile );
    snprintf( buffer, elcount( buffer ), "0.0000 HMI_ParkWarnElem_RR_Stat := %X\n", getValue( HMI_ParkWarnElem_RR_Stat ) );    filePutString( buffer, elcount( buffer ), hFile );
    snprintf( buffer, elcount( buffer ), "0.0000 HMI_ParkWarnFreq_Ft := %X\n", getValue( HMI_ParkWarnFreq_Ft ) );    filePutString( buffer, elcount( buffer ), hFile );
    snprintf( buffer, elcount( buffer ), "0.0000 HMI_ParkWarnFreq_R := %X\n", getValue( HMI_ParkWarnFreq_R ) );    filePutString( buffer, elcount( buffer ), hFile );
    snprintf( buffer, elcount( buffer ), "0.0000 HMI_ParkWarnSnd_FL := %X\n", getValue( HMI_ParkWarnSnd_FL ) );    filePutString( buffer, elcount( buffer ), hFile );
    snprintf( buffer, elcount( buffer ), "0.0000 HMI_ParkWarnSnd_FR := %X\n", getValue( HMI_ParkWarnSnd_FR ) );    filePutString( buffer, elcount( buffer ), hFile );
    snprintf( buffer, elcount( buffer ), "0.0000 HMI_ParkWarnSnd_Ft_Rq := %X\n", getValue( HMI_ParkWarnSnd_Ft_Rq ) );    filePutString( buffer, elcount( buffer ), hFile );
    snprintf( buffer, elcount( buffer ), "0.0000 HMI_ParkWarnSnd_R_Rq := %X\n", getValue( HMI_ParkWarnSnd_R_Rq ) );    filePutString( buffer, elcount( buffer ), hFile );
    snprintf( buffer, elcount( buffer ), "0.0000 HMI_ParkWarnSnd_RL := %X\n", getValue( HMI_ParkWarnSnd_RL ) );    filePutString( buffer, elcount( buffer ), hFile );
    snprintf( buffer, elcount( buffer ), "0.0000 HMI_ParkWarnSnd_RR := %X\n", getValue( HMI_ParkWarnSnd_RR ) );    filePutString( buffer, elcount( buffer ), hFile );
    snprintf( buffer, elcount( buffer ), "0.0000 HMI_ParkWarnVol_Ft := %X\n", getValue( HMI_ParkWarnVol_Ft ) );    filePutString( buffer, elcount( buffer ), hFile );
    snprintf( buffer, elcount( buffer ), "0.0000 HMI_ParkWarnVol_R := %X\n", getValue( HMI_ParkWarnVol_R ) );    filePutString( buffer, elcount( buffer ), hFile );
}
/*@@end*/

/*@@timer:_tParkWarn_AR:*/
on timer _tParkWarn_AR
{
    putValue( HMI__STMSG_ParkWarn_AR, 0 );
}
/*@@end*/

/*@@envVar:HMI__STMSG_ParkWarn_AR:*/
on EnvVar HMI__STMSG_ParkWarn_AR
{
    long tDelay;
    if( getValue( this ) == 2 )
    {
        tDelay = getValue( HMI__STMSGT_ParkWarn_AR );
        if( tDelay > 0)    
            setTimer( _tParkWarn_AR, tDelay );
        else
            putValue( HMI__STMSG_ParkWarn_AR, 0 );
    }
}
/*@@end*/

/*@@envVar:HMI_AcustWarn_Actv_PARK:*/
on EnvVar HMI_AcustWarn_Actv_PARK
{
    _mParkWarn_AR.AcustWarn_Actv_PARK.phys = getValue(this);
    _ParkWarn_AR_SpontanFlag = 1;
}
/*@@end*/

/*@@envVar:HMI_Park_Off:*/
on EnvVar HMI_Park_Off
{
    _mParkWarn_AR.Park_Off.phys = getValue(this);
    _ParkWarn_AR_SpontanFlag = 1;
}
/*@@end*/

/*@@envVar:HMI_PARK_TP_Flt:*/
on EnvVar HMI_PARK_TP_Flt
{
    _mParkWarn_AR.PARK_TP_Flt.phys = getValue(this);
    _ParkWarn_AR_SpontanFlag = 1;
}
/*@@end*/

/*@@envVar:HMI_ParkSideProt_Lt_Warn_Rq:*/
on EnvVar HMI_ParkSideProt_Lt_Warn_Rq
{
    _mParkWarn_AR.ParkSideProt_Lt_Warn_Rq.phys = getValue(this);
    _ParkWarn_AR_SpontanFlag = 1;
}
/*@@end*/

/*@@envVar:HMI_ParkSideProt_Rt_Warn_Rq:*/
on EnvVar HMI_ParkSideProt_Rt_Warn_Rq
{
    _mParkWarn_AR.ParkSideProt_Rt_Warn_Rq.phys = getValue(this);
    _ParkWarn_AR_SpontanFlag = 1;
}
/*@@end*/

/*@@envVar:HMI_ParkSwLED_Rq:*/
on EnvVar HMI_ParkSwLED_Rq
{
    _mParkWarn_AR.ParkSwLED_Rq.phys = getValue(this);
    _ParkWarn_AR_SpontanFlag = 1;
}
/*@@end*/

/*@@envVar:HMI_ParkWarnElem_FL_Stat:*/
on EnvVar HMI_ParkWarnElem_FL_Stat
{
    _mParkWarn_AR.ParkWarnElem_FL_Stat.phys = getValue(this);
    _ParkWarn_AR_SpontanFlag = 1;
}
/*@@end*/

/*@@envVar:HMI_ParkWarnElem_FR_Stat:*/
on EnvVar HMI_ParkWarnElem_FR_Stat
{
    _mParkWarn_AR.ParkWarnElem_FR_Stat.phys = getValue(this);
    _ParkWarn_AR_SpontanFlag = 1;
}
/*@@end*/

/*@@envVar:HMI_ParkWarnElem_RL_Stat:*/
on EnvVar HMI_ParkWarnElem_RL_Stat
{
    _mParkWarn_AR.ParkWarnElem_RL_Stat.phys = getValue(this);
    _ParkWarn_AR_SpontanFlag = 1;
}
/*@@end*/

/*@@envVar:HMI_ParkWarnElem_RR_Stat:*/
on EnvVar HMI_ParkWarnElem_RR_Stat
{
    _mParkWarn_AR.ParkWarnElem_RR_Stat.phys = getValue(this);
    _ParkWarn_AR_SpontanFlag = 1;
}
/*@@end*/

/*@@envVar:HMI_ParkWarnFreq_Ft:*/
on EnvVar HMI_ParkWarnFreq_Ft
{
    _mParkWarn_AR.ParkWarnFreq_Ft.phys = getValue(this);
    _ParkWarn_AR_SpontanFlag = 1;
}
/*@@end*/

/*@@envVar:HMI_ParkWarnFreq_R:*/
on EnvVar HMI_ParkWarnFreq_R
{
    _mParkWarn_AR.ParkWarnFreq_R.phys = getValue(this);
    _ParkWarn_AR_SpontanFlag = 1;
}
/*@@end*/

/*@@envVar:HMI_ParkWarnSnd_FL:*/
on envVar HMI_ParkWarnSnd_FL
{
    _mParkWarn_AR.ParkWarnSnd_FL.phys = getValue(this);
    _ParkWarn_AR_SpontanFlag = 1;
}
/*@@end*/

/*@@envVar:HMI_ParkWarnSnd_FR:*/
on envVar HMI_ParkWarnSnd_FR
{
    _mParkWarn_AR.ParkWarnSnd_FR.phys = getValue(this);
    _ParkWarn_AR_SpontanFlag = 1;
}
/*@@end*/

/*@@envVar:HMI_ParkWarnSnd_Ft_Rq:*/
on envVar HMI_ParkWarnSnd_Ft_Rq
{
    _mParkWarn_AR.ParkWarnSnd_Ft_Rq.phys = getValue(this);
    _ParkWarn_AR_SpontanFlag = 1;
}
/*@@end*/

/*@@envVar:HMI_ParkWarnSnd_R_Rq:*/
on envVar HMI_ParkWarnSnd_R_Rq
{
    _mParkWarn_AR.ParkWarnSnd_R_Rq.phys = getValue(this);
    _ParkWarn_AR_SpontanFlag = 1;
}
/*@@end*/

/*@@envVar:HMI_ParkWarnSnd_RL:*/
on envVar HMI_ParkWarnSnd_RL
{
    _mParkWarn_AR.ParkWarnSnd_RL.phys = getValue(this);
    _ParkWarn_AR_SpontanFlag = 1;
}
/*@@end*/

/*@@envVar:HMI_ParkWarnSnd_RR:*/
on envVar HMI_ParkWarnSnd_RR
{
    _mParkWarn_AR.ParkWarnSnd_RR.phys = getValue(this);
    _ParkWarn_AR_SpontanFlag = 1;
}
/*@@end*/

/*@@envVar:HMI_ParkWarnVol_Ft:*/
on envVar HMI_ParkWarnVol_Ft
{
    _mParkWarn_AR.ParkWarnVol_Ft.phys = getValue(this);
    _ParkWarn_AR_SpontanFlag = 1;
}
/*@@end*/

/*@@envVar:HMI_ParkWarnVol_R:*/
on envVar HMI_ParkWarnVol_R
{
    _mParkWarn_AR.ParkWarnVol_R.phys = getValue(this);
    _ParkWarn_AR_SpontanFlag = 1;
}
/*@@end*/

/*@@caplFunc:PERIPHERY_HMI_R1_AR_check_output():*/
PERIPHERY_HMI_R1_AR_check_output()
{
    if( !getValue( HMI__STMSG_PERIPHERY_HMI_R1_AR ) )
    {
        // Botschaft PERIPHERY_HMI_R1_AR ID: 611 --- Sendeart 5 cyclicAndSpontanWithDelay --- 
        _PERIPHERY_HMI_R1_AR_Cnt--;
        if( _PERIPHERY_HMI_R1_AR_Cnt < 1 )
        {
            PERIPHERY_HMI_R1_AR_output(); // Nachricht wg. abgelaufenem Zyklus ausgeben
            _PERIPHERY_HMI_R1_AR_Cnt = _PERIPHERY_HMI_R1_AR_CycleCount; // Zyklus-Zähler zurücksetzen
            _PERIPHERY_HMI_R1_AR_SpontanFlag = 0; // Spontan-Flag zurücksetzen
        }
        else if( _PERIPHERY_HMI_R1_AR_SpontanFlag )
        {
            PERIPHERY_HMI_R1_AR_output(); // Nachricht wg. spontaner Änderung ausgeben
            _PERIPHERY_HMI_R1_AR_SpontanFlag = 0; // Spontan-Flag zurücksetzen
        }
    }
}
/*@@end*/

/*@@caplFunc:PERIPHERY_HMI_R1_AR_init():*/
PERIPHERY_HMI_R1_AR_init()
{   /* Botschaft PERIPHERY_HMI_R1_AR ID: 611 --- Sendeart 5 cyclicAndSpontanWithDelay --- 
BA_ "ApplMessage" BO_ 611 0;
BA_ "NmAsrMessage" BO_ 611 0;
BA_ "GenMsgMinAcceptLength" BO_ 611 8;
BA_ "GenMsgILSupport" BO_ 611 1;
BA_ "DiagState" BO_ 611 0;
BA_ "DiagRequest" BO_ 611 0;
BA_ "DiagResponse" BO_ 611 0;
BA_ "GenMsgStartValue" BO_ 611 "0";
BA_ "GenMsgStartDelayTime" BO_ 611 90;
BA_ "GenMsgDelayTime" BO_ 611 5;
BA_ "GenMsgNrOfRepetitions" BO_ 611 0;
BA_ "GenMsgCycleTime" BO_ 611 200;
BA_ "GenMsgSendType" BO_ 611 5;
    */
    _PERIPHERY_HMI_R1_AR_Timebase =           c_tDBKomTimer_20ms;
    _PERIPHERY_HMI_R1_AR_CycleCount =       200 / _PERIPHERY_HMI_R1_AR_Timebase;
    _PERIPHERY_HMI_R1_AR_StartDelay =        90 / _PERIPHERY_HMI_R1_AR_Timebase;
    _PERIPHERY_HMI_R1_AR_Cnt = _PERIPHERY_HMI_R1_AR_StartDelay;
    _PERIPHERY_HMI_R1_AR_SpontanFlag = 0;

    putValue( HMI__STMSGSD_PERIPHERY_HMI_R1_AR, _PERIPHERY_HMI_R1_AR_StartDelay * _PERIPHERY_HMI_R1_AR_Timebase );

    _mPERIPHERY_HMI_R1_AR.AFS_Md_Cfg_Stat.phys = getValue( HMI_AFS_Md_Cfg_Stat );
    _mPERIPHERY_HMI_R1_AR.AFS_Md_Cfg_Stat_UB.phys = getValue( HMI_AFS_Md_Cfg_Stat_UB );
    _mPERIPHERY_HMI_R1_AR.HLM_LT_Msg2_Disp_Rq_UB.phys = getValue( HMI_HLM_LT_Msg2_Disp_Rq_UB );
    _mPERIPHERY_HMI_R1_AR.HLM_LT_Msg2_Disp_Rq.phys = getValue( HMI_HLM_LT_Msg2_Disp_Rq );
    _mPERIPHERY_HMI_R1_AR.HLM_LT_Msg4_Disp_Rq_UB.phys = getValue( HMI_HLM_LT_Msg4_Disp_Rq_UB );
    _mPERIPHERY_HMI_R1_AR.HLM_LT_Msg4_Disp_Rq.phys = getValue( HMI_HLM_LT_Msg4_Disp_Rq );
    _mPERIPHERY_HMI_R1_AR.HLM_LT_Msg5_Disp_Rq_UB.phys = getValue( HMI_HLM_LT_Msg5_Disp_Rq_UB );
    _mPERIPHERY_HMI_R1_AR.HLM_LT_Msg5_Disp_Rq.phys = getValue( HMI_HLM_LT_Msg5_Disp_Rq );
    _mPERIPHERY_HMI_R1_AR.HLM_LT_Msg6_Disp_Rq_UB.phys = getValue( HMI_HLM_LT_Msg6_Disp_Rq_UB );
    _mPERIPHERY_HMI_R1_AR.HLM_LT_Msg6_Disp_Rq.phys = getValue( HMI_HLM_LT_Msg6_Disp_Rq );
    _mPERIPHERY_HMI_R1_AR.HLM_RT_Msg4_Disp_Rq_UB.phys = getValue( HMI_HLM_RT_Msg4_Disp_Rq_UB );
    _mPERIPHERY_HMI_R1_AR.HLM_RT_Msg4_Disp_Rq.phys = getValue( HMI_HLM_RT_Msg4_Disp_Rq );
    _mPERIPHERY_HMI_R1_AR.IHC_Lgt_Stat_HLI_UB.phys = getValue( HMI_IHC_Lgt_Stat_HLI_UB );
    _mPERIPHERY_HMI_R1_AR.IHC_Stat_HLM_LT.phys = getValue( HMI_IHC_Stat_HLM_LT );
    _mPERIPHERY_HMI_R1_AR.ILS_TouristMd_Cfg_Stat.phys = getValue( HMI_ILS_TouristMd_Cfg_Stat );
    _mPERIPHERY_HMI_R1_AR.ILS_TouristMd_Cfg_Stat_UB.phys = getValue( HMI_ILS_TouristMd_Cfg_Stat_UB );
}
/*@@end*/

/*@@caplFunc:PERIPHERY_HMI_R1_AR_output():*/
PERIPHERY_HMI_R1_AR_output(void)
{
    output( _mPERIPHERY_HMI_R1_AR );
}
/*@@end*/

/*@@caplFunc:PERIPHERY_HMI_R1_AR_saveEnvVars(dword):*/
PERIPHERY_HMI_R1_AR_saveEnvVars( dword hFile )
{
    filePutString("\n// Knoten EIS: PERIPHERY_HMI_R1_AR\n", 29, hFile );
    snprintf( buffer, elcount( buffer ), "0.0000 HMI__STMSG_PERIPHERY_HMI_R1_AR := %X\n", getValue( HMI__STMSG_PERIPHERY_HMI_R1_AR ) );        filePutString( buffer, elcount( buffer ), hFile );
    snprintf( buffer, elcount( buffer ), "0.0000 HMI__STMSGT_PERIPHERY_HMI_R1_AR := %X\n", getValue( HMI__STMSGT_PERIPHERY_HMI_R1_AR ) );        filePutString( buffer, elcount( buffer ), hFile );
    snprintf( buffer, elcount( buffer ), "0.0000 HMI_AFS_Md_Cfg_Stat := %X\n", getValue( HMI_AFS_Md_Cfg_Stat ) );        filePutString( buffer, elcount( buffer ), hFile );
    snprintf( buffer, elcount( buffer ), "0.0000 HMI_AFS_Md_Cfg_Stat_UB := %X\n", getValue( HMI_AFS_Md_Cfg_Stat_UB ) );        filePutString( buffer, elcount( buffer ), hFile );
    snprintf( buffer, elcount( buffer ), "0.0000 HMI_HLM_LT_Msg2_Disp_Rq_UB := %X\n", getValue( HMI_HLM_LT_Msg2_Disp_Rq_UB ) );        filePutString( buffer, elcount( buffer ), hFile );
    snprintf( buffer, elcount( buffer ), "0.0000 HMI_HLM_LT_Msg2_Disp_Rq := %X\n", getValue( HMI_HLM_LT_Msg2_Disp_Rq ) );        filePutString( buffer, elcount( buffer ), hFile );
    snprintf( buffer, elcount( buffer ), "0.0000 HMI_HLM_LT_Msg4_Disp_Rq_UB := %X\n", getValue( HMI_HLM_LT_Msg4_Disp_Rq_UB ) );        filePutString( buffer, elcount( buffer ), hFile );
    snprintf( buffer, elcount( buffer ), "0.0000 HMI_HLM_LT_Msg4_Disp_Rq := %X\n", getValue( HMI_HLM_LT_Msg4_Disp_Rq ) );        filePutString( buffer, elcount( buffer ), hFile );
    snprintf( buffer, elcount( buffer ), "0.0000 HMI_HLM_LT_Msg5_Disp_Rq_UB := %X\n", getValue( HMI_HLM_LT_Msg5_Disp_Rq_UB ) );        filePutString( buffer, elcount( buffer ), hFile );
    snprintf( buffer, elcount( buffer ), "0.0000 HMI_HLM_LT_Msg5_Disp_Rq := %X\n", getValue( HMI_HLM_LT_Msg5_Disp_Rq ) );        filePutString( buffer, elcount( buffer ), hFile );
    snprintf( buffer, elcount( buffer ), "0.0000 HMI_HLM_LT_Msg6_Disp_Rq_UB := %X\n", getValue( HMI_HLM_LT_Msg6_Disp_Rq_UB ) );        filePutString( buffer, elcount( buffer ), hFile );
    snprintf( buffer, elcount( buffer ), "0.0000 HMI_HLM_LT_Msg6_Disp_Rq := %X\n", getValue( HMI_HLM_LT_Msg6_Disp_Rq ) );        filePutString( buffer, elcount( buffer ), hFile );
    snprintf( buffer, elcount( buffer ), "0.0000 HMI_HLM_RT_Msg4_Disp_Rq_UB := %X\n", getValue( HMI_HLM_RT_Msg4_Disp_Rq_UB ) );        filePutString( buffer, elcount( buffer ), hFile );
    snprintf( buffer, elcount( buffer ), "0.0000 HMI_HLM_RT_Msg4_Disp_Rq := %X\n", getValue( HMI_HLM_RT_Msg4_Disp_Rq ) );        filePutString( buffer, elcount( buffer ), hFile );
    snprintf( buffer, elcount( buffer ), "0.0000 HMI_IHC_Lgt_Stat_HLI_UB := %X\n", getValue( HMI_IHC_Lgt_Stat_HLI_UB ) );        filePutString( buffer, elcount( buffer ), hFile );
    snprintf( buffer, elcount( buffer ), "0.0000 HMI_IHC_Stat_HLM_LT := %X\n", getValue( HMI_IHC_Stat_HLM_LT ) );        filePutString( buffer, elcount( buffer ), hFile );
    snprintf( buffer, elcount( buffer ), "0.0000 HMI_ILS_TouristMd_Cfg_Stat := %X\n", getValue( HMI_ILS_TouristMd_Cfg_Stat ) );        filePutString( buffer, elcount( buffer ), hFile );
    snprintf( buffer, elcount( buffer ), "0.0000 HMI_ILS_TouristMd_Cfg_Stat_UB := %X\n", getValue( HMI_ILS_TouristMd_Cfg_Stat_UB ) );        filePutString( buffer, elcount( buffer ), hFile );
}
/*@@end*/

/*@@timer:_tPERIPHERY_HMI_R1_AR:*/
on timer _tPERIPHERY_HMI_R1_AR
{
    putValue( HMI__STMSG_PERIPHERY_HMI_R1_AR, 0 );
}
/*@@end*/

/*@@envVar:HMI__STMSG_PERIPHERY_HMI_R1_AR:*/
on EnvVar HMI__STMSG_PERIPHERY_HMI_R1_AR
{
    long tDelay;
    if( getValue( this ) == 2 )
    {
        tDelay = getValue( HMI__STMSGT_PERIPHERY_HMI_R1_AR );
        if( tDelay > 0)    
            setTimer( _tPERIPHERY_HMI_R1_AR, tDelay );
        else
            putValue( HMI__STMSG_PERIPHERY_HMI_R1_AR, 0 );
    }
}
/*@@end*/

/*@@envVar:HMI_AFS_Md_Cfg_Stat:*/
on envVar HMI_AFS_Md_Cfg_Stat
{
    _mPERIPHERY_HMI_R1_AR.AFS_Md_Cfg_Stat.phys = getValue(this);
    _PERIPHERY_HMI_R1_AR_SpontanFlag = 1;
}
/*@@end*/

/*@@envVar:HMI_AFS_Md_Cfg_Stat_UB:*/
on envVar HMI_AFS_Md_Cfg_Stat_UB
{
    _mPERIPHERY_HMI_R1_AR.AFS_Md_Cfg_Stat_UB.phys = getValue(this);
    _PERIPHERY_HMI_R1_AR_SpontanFlag = 1;
}
/*@@end*/

/*@@envVar:HMI_HLM_LT_Msg2_Disp_Rq_UB:*/
on envVar HMI_HLM_LT_Msg2_Disp_Rq_UB
{
    _mPERIPHERY_HMI_R1_AR.HLM_LT_Msg2_Disp_Rq_UB.phys = getValue(this);
    _PERIPHERY_HMI_R1_AR_SpontanFlag = 1;
}
/*@@end*/

/*@@envVar:HMI_HLM_LT_Msg2_Disp_Rq:*/
on envVar HMI_HLM_LT_Msg2_Disp_Rq
{
    _mPERIPHERY_HMI_R1_AR.HLM_LT_Msg2_Disp_Rq.phys = getValue(this);
    _PERIPHERY_HMI_R1_AR_SpontanFlag = 1;
}
/*@@end*/

/*@@envVar:HMI_HLM_LT_Msg4_Disp_Rq_UB:*/
on envVar HMI_HLM_LT_Msg4_Disp_Rq_UB
{
    _mPERIPHERY_HMI_R1_AR.HLM_LT_Msg4_Disp_Rq_UB.phys = getValue(this);
    _PERIPHERY_HMI_R1_AR_SpontanFlag = 1;
}
/*@@end*/

/*@@envVar:HMI_HLM_LT_Msg4_Disp_Rq:*/
on envVar HMI_HLM_LT_Msg4_Disp_Rq
{
    _mPERIPHERY_HMI_R1_AR.HLM_LT_Msg4_Disp_Rq.phys = getValue(this);
    _PERIPHERY_HMI_R1_AR_SpontanFlag = 1;
}
/*@@end*/

/*@@envVar:HMI_HLM_LT_Msg5_Disp_Rq_UB:*/
on envVar HMI_HLM_LT_Msg5_Disp_Rq_UB
{
    _mPERIPHERY_HMI_R1_AR.HLM_LT_Msg5_Disp_Rq_UB.phys = getValue(this);
    _PERIPHERY_HMI_R1_AR_SpontanFlag = 1;
}
/*@@end*/

/*@@envVar:HMI_HLM_LT_Msg5_Disp_Rq:*/
on envVar HMI_HLM_LT_Msg5_Disp_Rq
{
    _mPERIPHERY_HMI_R1_AR.HLM_LT_Msg5_Disp_Rq.phys = getValue(this);
    _PERIPHERY_HMI_R1_AR_SpontanFlag = 1;
}
/*@@end*/

/*@@envVar:HMI_HLM_LT_Msg6_Disp_Rq_UB:*/
on envVar HMI_HLM_LT_Msg6_Disp_Rq_UB
{
    _mPERIPHERY_HMI_R1_AR.HLM_LT_Msg6_Disp_Rq_UB.phys = getValue(this);
    _PERIPHERY_HMI_R1_AR_SpontanFlag = 1;
}
/*@@end*/

/*@@envVar:HMI_HLM_LT_Msg6_Disp_Rq:*/
on envVar HMI_HLM_LT_Msg6_Disp_Rq
{
    _mPERIPHERY_HMI_R1_AR.HLM_LT_Msg6_Disp_Rq.phys = getValue(this);
    _PERIPHERY_HMI_R1_AR_SpontanFlag = 1;
}
/*@@end*/

/*@@envVar:HMI_HLM_RT_Msg4_Disp_Rq_UB:*/
on envVar HMI_HLM_RT_Msg4_Disp_Rq_UB
{
    _mPERIPHERY_HMI_R1_AR.HLM_RT_Msg4_Disp_Rq_UB.phys = getValue(this);
    _PERIPHERY_HMI_R1_AR_SpontanFlag = 1;
}
/*@@end*/

/*@@envVar:HMI_HLM_RT_Msg4_Disp_Rq:*/
on envVar HMI_HLM_RT_Msg4_Disp_Rq
{
    _mPERIPHERY_HMI_R1_AR.HLM_RT_Msg4_Disp_Rq.phys = getValue(this);
    _PERIPHERY_HMI_R1_AR_SpontanFlag = 1;
}
/*@@end*/

/*@@envVar:HMI_IHC_Lgt_Stat_HLI_UB:*/
on envVar HMI_IHC_Lgt_Stat_HLI_UB
{
    _mPERIPHERY_HMI_R1_AR.IHC_Lgt_Stat_HLI_UB.phys = getValue(this);
    _PERIPHERY_HMI_R1_AR_SpontanFlag = 1;
}
/*@@end*/

/*@@envVar:HMI_IHC_Stat_HLM_LT:*/
on envVar HMI_IHC_Stat_HLM_LT
{
    _mPERIPHERY_HMI_R1_AR.IHC_Stat_HLM_LT.phys = getValue(this);
    _PERIPHERY_HMI_R1_AR_SpontanFlag = 1;
}
/*@@end*/

/*@@envVar:HMI_ILS_TouristMd_Cfg_Stat:*/
on envVar HMI_ILS_TouristMd_Cfg_Stat
{
    _mPERIPHERY_HMI_R1_AR.ILS_TouristMd_Cfg_Stat.phys = getValue(this);
    _PERIPHERY_HMI_R1_AR_SpontanFlag = 1;
}
/*@@end*/

/*@@envVar:HMI_ILS_TouristMd_Cfg_Stat_UB:*/
on envVar HMI_ILS_TouristMd_Cfg_Stat_UB
{
    _mPERIPHERY_HMI_R1_AR.ILS_TouristMd_Cfg_Stat_UB.phys = getValue(this);
    _PERIPHERY_HMI_R1_AR_SpontanFlag = 1;
}
/*@@end*/

/*@@caplFunc:PN14_Disp_Rq_AR_check_output():*/
PN14_Disp_Rq_AR_check_output()
{
    if( !getValue( HMI__STMSG_PN14_Disp_Rq_AR ) )
    {
        // Botschaft PN14_Disp_Rq_AR ID: 833 --- Sendeart 5 cyclicAndSpontanWithDelay --- 
        if( _PN14_Disp_Rq_AR_DelayCnt > 0) _PN14_Disp_Rq_AR_DelayCnt--; // Mindestsendeabstand
        _PN14_Disp_Rq_AR_Cnt--;
        if( _PN14_Disp_Rq_AR_Cnt < 1 )
        {
            if( _PN14_Disp_Rq_AR_DelayCnt < 1 )
            {
                PN14_Disp_Rq_AR_output(); // Nachricht wg. abgelaufenem Zyklus ausgeben (Mindestsendeabstand eingehalten)
                _PN14_Disp_Rq_AR_SpontanFlag = 0; // Spontan-Flag zurücksetzen
                _PN14_Disp_Rq_AR_DelayCnt = _PN14_Disp_Rq_AR_MinDelay;
            }
            else
            {
                // Spontanflag setzen damit nach Ablauf Mindestsendeabstand gesendet wird
                 _PN14_Disp_Rq_AR_SpontanFlag = 1;
            }
            _PN14_Disp_Rq_AR_Cnt = _PN14_Disp_Rq_AR_CycleCount; // Zyklus-Zähler zurücksetzen
        }
        else if( _PN14_Disp_Rq_AR_SpontanFlag)
        {
            if( _PN14_Disp_Rq_AR_DelayCnt < 1 )
            {
                PN14_Disp_Rq_AR_output(); // Nachricht wg. spontaner Änderung ausgeben (Mindestsendeabstand eingehalten)
                _PN14_Disp_Rq_AR_SpontanFlag = 0; // Spontan-Flag zurücksetzen
                _PN14_Disp_Rq_AR_DelayCnt = _PN14_Disp_Rq_AR_MinDelay;
            }
        }
    }
}
/*@@end*/

/*@@caplFunc:PN14_Disp_Rq_AR_init():*/
PN14_Disp_Rq_AR_init()
{   /* Botschaft PN14_Disp_Rq_AR ID: 833 --- Sendeart 5 cyclicAndSpontanWithDelay --- 
BA_ "ApplMessage" BO_ 833 0;
BA_ "NmAsrMessage" BO_ 833 0;
BA_ "GenMsgMinAcceptLength" BO_ 833 8;
BA_ "GenMsgILSupport" BO_ 833 1;
BA_ "DiagState" BO_ 833 0;
BA_ "DiagRequest" BO_ 833 0;
BA_ "DiagResponse" BO_ 833 0;
BA_ "GenMsgStartValue" BO_ 833 "0";
BA_ "GenMsgDelayTime" BO_ 833 200;
BA_ "GenMsgNrOfRepetitions" BO_ 833 0;
BA_ "GenMsgCycleTime" BO_ 833 1000;
BA_ "GenMsgSendType" BO_ 833 5;
    */
    _PN14_Disp_Rq_AR_Timebase =           c_tDBKomTimer_20ms;
    _PN14_Disp_Rq_AR_CycleCount =      1000 / _PN14_Disp_Rq_AR_Timebase;
    _PN14_Disp_Rq_AR_StartDelay =         0 / _PN14_Disp_Rq_AR_Timebase;
    _PN14_Disp_Rq_AR_MinDelay =         200 / _PN14_Disp_Rq_AR_Timebase;
    _PN14_Disp_Rq_AR_Cnt = _PN14_Disp_Rq_AR_StartDelay;
    _PN14_Disp_Rq_AR_SpontanFlag = 0;
    _PN14_Disp_Rq_AR_DelayCnt = 0;

    putValue( HMI__STMSGSD_PN14_Disp_Rq_AR, _PN14_Disp_Rq_AR_StartDelay * _PN14_Disp_Rq_AR_Timebase );

    _mPN14_Disp_Rq_AR.PN14_EOL_Disp_Rq.phys = getValue( HMI_PN14_EOL_Disp_Rq );
    _mPN14_Disp_Rq_AR.PN14_Msg1_Disp_Rq.phys = getValue( HMI_PN14_Msg1_Disp_Rq );
    _mPN14_Disp_Rq_AR.PN14_Msg2_Disp_Rq.phys = getValue( HMI_PN14_Msg2_Disp_Rq );
    _mPN14_Disp_Rq_AR.PN14_Msg6_Disp_Rq.phys = getValue( HMI_PN14_Msg6_Disp_Rq );
    _mPN14_Disp_Rq_AR.PN14_Msg7_Disp_Rq.phys = getValue( HMI_PN14_Msg7_Disp_Rq );
    _mPN14_Disp_Rq_AR.PN14_Msg8_Disp_Rq.phys = getValue( HMI_PN14_Msg8_Disp_Rq );
    _mPN14_Disp_Rq_AR.PN14_ProdMdDisp_Rq.phys = getValue( HMI_PN14_ProdMdDisp_Rq );
    _mPN14_Disp_Rq_AR.PN14_SupBat_Curr_Extd.phys = getValue( HMI_PN14_SupBat_Curr_Extd );
    _mPN14_Disp_Rq_AR.PN14_SupBat_State.phys = getValue( HMI_PN14_SupBat_State );
    _mPN14_Disp_Rq_AR.PN14_SupBat_Temp.phys = getValue( HMI_PN14_SupBat_Temp );
    _mPN14_Disp_Rq_AR.PN14_TransMd_RemTm.phys = getValue( HMI_PN14_TransMd_RemTm );
    _mPN14_Disp_Rq_AR.PN14_TransMdDisp_Rq.phys = getValue( HMI_PN14_TransMdDisp_Rq );
}
/*@@end*/

/*@@caplFunc:PN14_Disp_Rq_AR_output():*/
PN14_Disp_Rq_AR_output()
{
    output( _mPN14_Disp_Rq_AR );
}
/*@@end*/

/*@@caplFunc:PN14_Disp_Rq_AR_saveEnvVars(dword):*/
void PN14_Disp_Rq_AR_saveEnvVars( dword hFile )
{
    filePutString("\n// Knoten EIS: PN14_Disp_Rq_AR\n", 33, hFile );
    snprintf( buffer, elcount( buffer ), "0.0000 HMI__STMSG_PN14_Disp_Rq_AR := %X\n", getValue( HMI__STMSG_PN14_Disp_Rq_AR ) );        filePutString( buffer, elcount( buffer ), hFile );
    snprintf( buffer, elcount( buffer ), "0.0000 HMI__STMSGT_PN14_Disp_Rq_AR := %X\n", getValue( HMI__STMSGT_PN14_Disp_Rq_AR ) );        filePutString( buffer, elcount( buffer ), hFile );
    snprintf( buffer, elcount( buffer ), "0.0000 HMI_PN14_EOL_Disp_Rq := %X\n", getValue( HMI_PN14_EOL_Disp_Rq ) );        filePutString( buffer, elcount( buffer ), hFile );
    snprintf( buffer, elcount( buffer ), "0.0000 HMI_PN14_Msg1_Disp_Rq := %X\n", getValue( HMI_PN14_Msg1_Disp_Rq ) );        filePutString( buffer, elcount( buffer ), hFile );
    snprintf( buffer, elcount( buffer ), "0.0000 HMI_PN14_Msg2_Disp_Rq := %X\n", getValue( HMI_PN14_Msg2_Disp_Rq ) );        filePutString( buffer, elcount( buffer ), hFile );
    snprintf( buffer, elcount( buffer ), "0.0000 HMI_PN14_Msg6_Disp_Rq := %X\n", getValue( HMI_PN14_Msg6_Disp_Rq ) );        filePutString( buffer, elcount( buffer ), hFile );
    snprintf( buffer, elcount( buffer ), "0.0000 HMI_PN14_Msg7_Disp_Rq := %X\n", getValue( HMI_PN14_Msg7_Disp_Rq ) );        filePutString( buffer, elcount( buffer ), hFile );
    snprintf( buffer, elcount( buffer ), "0.0000 HMI_PN14_Msg8_Disp_Rq := %X\n", getValue( HMI_PN14_Msg8_Disp_Rq ) );        filePutString( buffer, elcount( buffer ), hFile );
    snprintf( buffer, elcount( buffer ), "0.0000 HMI_PN14_ProdMdDisp_Rq := %X\n", getValue( HMI_PN14_ProdMdDisp_Rq ) );        filePutString( buffer, elcount( buffer ), hFile );
    snprintf( buffer, elcount( buffer ), "0.0000 HMI_PN14_SupBat_Curr_Extd := %X\n", getValue( HMI_PN14_SupBat_Curr_Extd ) );        filePutString( buffer, elcount( buffer ), hFile );
    snprintf( buffer, elcount( buffer ), "0.0000 HMI_PN14_SupBat_State := %X\n", getValue( HMI_PN14_SupBat_State ) );        filePutString( buffer, elcount( buffer ), hFile );
    snprintf( buffer, elcount( buffer ), "0.0000 HMI_PN14_SupBat_Temp := %X\n", getValue( HMI_PN14_SupBat_Temp ) );        filePutString( buffer, elcount( buffer ), hFile );
    snprintf( buffer, elcount( buffer ), "0.0000 HMI_PN14_TransMd_RemTm := %X\n", getValue( HMI_PN14_TransMd_RemTm ) );        filePutString( buffer, elcount( buffer ), hFile );
    snprintf( buffer, elcount( buffer ), "0.0000 HMI_PN14_TransMdDisp_Rq := %X\n", getValue( HMI_PN14_TransMdDisp_Rq ) );        filePutString( buffer, elcount( buffer ), hFile );
}
/*@@end*/

/*@@timer:_tPN14_Disp_Rq_AR:*/
on timer _tPN14_Disp_Rq_AR
{
    putValue( HMI__STMSG_PN14_Disp_Rq_AR, 0 );
}
/*@@end*/

/*@@envVar:HMI__STMSG_PN14_Disp_Rq_AR:*/
on EnvVar HMI__STMSG_PN14_Disp_Rq_AR
{
    long tDelay;
    if( getValue( this ) == 2 )
    {
        tDelay = getValue( HMI__STMSGT_PN14_Disp_Rq_AR );
        if( tDelay > 0)    
            setTimer( _tPN14_Disp_Rq_AR, tDelay );
        else
            putValue( HMI__STMSG_PN14_Disp_Rq_AR, 0 );
    }
}
/*@@end*/

/*@@envVar:HMI_PN14_EOL_Disp_Rq:*/
on EnvVar HMI_PN14_EOL_Disp_Rq
{
    _mPN14_Disp_Rq_AR.PN14_EOL_Disp_Rq.phys = getValue(this);
    _PN14_Disp_Rq_AR_SpontanFlag = 1;
}
/*@@end*/

/*@@envVar:HMI_PN14_Msg1_Disp_Rq:*/
on EnvVar HMI_PN14_Msg1_Disp_Rq
{
    _mPN14_Disp_Rq_AR.PN14_Msg1_Disp_Rq.phys = getValue(this);
    _PN14_Disp_Rq_AR_SpontanFlag = 1;
}
/*@@end*/

/*@@envVar:HMI_PN14_Msg2_Disp_Rq:*/
on EnvVar HMI_PN14_Msg2_Disp_Rq
{
    _mPN14_Disp_Rq_AR.PN14_Msg2_Disp_Rq.phys = getValue(this);
    _PN14_Disp_Rq_AR_SpontanFlag = 1;
}
/*@@end*/

/*@@envVar:HMI_PN14_Msg6_Disp_Rq:*/
on EnvVar HMI_PN14_Msg6_Disp_Rq
{
    _mPN14_Disp_Rq_AR.PN14_Msg6_Disp_Rq.phys = getValue(this);
    _PN14_Disp_Rq_AR_SpontanFlag = 1;
}
/*@@end*/

/*@@envVar:HMI_PN14_Msg7_Disp_Rq:*/
on EnvVar HMI_PN14_Msg7_Disp_Rq
{
    _mPN14_Disp_Rq_AR.PN14_Msg7_Disp_Rq.phys = getValue(this);
    _PN14_Disp_Rq_AR_SpontanFlag = 1;
}
/*@@end*/

/*@@envVar:HMI_PN14_Msg8_Disp_Rq:*/
on EnvVar HMI_PN14_Msg8_Disp_Rq
{
    _mPN14_Disp_Rq_AR.PN14_Msg8_Disp_Rq.phys = getValue(this);
    _PN14_Disp_Rq_AR_SpontanFlag = 1;
}
/*@@end*/

/*@@envVar:HMI_PN14_ProdMdDisp_Rq:*/
on EnvVar HMI_PN14_ProdMdDisp_Rq
{
    _mPN14_Disp_Rq_AR.PN14_ProdMdDisp_Rq.phys = getValue(this);
    _PN14_Disp_Rq_AR_SpontanFlag = 1;
}
/*@@end*/

/*@@envVar:HMI_PN14_SupBat_Curr_Extd:*/
on EnvVar HMI_PN14_SupBat_Curr_Extd
{
    _mPN14_Disp_Rq_AR.PN14_SupBat_Curr_Extd.phys = getValue(this);
    _PN14_Disp_Rq_AR_SpontanFlag = 1;
}
/*@@end*/

/*@@envVar:HMI_PN14_SupBat_State:*/
on EnvVar HMI_PN14_SupBat_State
{
    _mPN14_Disp_Rq_AR.PN14_SupBat_State.phys = getValue(this);
    _PN14_Disp_Rq_AR_SpontanFlag = 1;
}
/*@@end*/

/*@@envVar:HMI_PN14_SupBat_Temp:*/
on EnvVar HMI_PN14_SupBat_Temp
{
    _mPN14_Disp_Rq_AR.PN14_SupBat_Temp.phys = getValue(this);
    _PN14_Disp_Rq_AR_SpontanFlag = 1;
}
/*@@end*/

/*@@envVar:HMI_PN14_TransMd_RemTm:*/
on EnvVar HMI_PN14_TransMd_RemTm
{
    _mPN14_Disp_Rq_AR.PN14_TransMd_RemTm.phys = getValue(this);
    _PN14_Disp_Rq_AR_SpontanFlag = 1;
}
/*@@end*/

/*@@envVar:HMI_PN14_TransMdDisp_Rq:*/
on EnvVar HMI_PN14_TransMdDisp_Rq
{
    _mPN14_Disp_Rq_AR.PN14_TransMdDisp_Rq.phys = getValue(this);
    _PN14_Disp_Rq_AR_SpontanFlag = 1;
}
/*@@end*/

/*@@caplFunc:PN14_Disp_Rq2_AR_check_output():*/
PN14_Disp_Rq2_AR_check_output()
{
    if( !getValue( HMI__STMSG_PN14_Disp_Rq2_AR ) )
    {
        // Botschaft PN14_Disp_Rq2_AR ID: 834 --- Sendeart 5 cyclicAndSpontanWithDelay
        _PN14_Disp_Rq2_AR_Cnt--;
        if( _PN14_Disp_Rq2_AR_Cnt < 1 )
        {
            PN14_Disp_Rq2_AR_output(); // Nachricht wg. abgelaufenem Zyklus ausgeben
            _PN14_Disp_Rq2_AR_Cnt = _PN14_Disp_Rq2_AR_CycleCount; // Zyklus-Zähler zurücksetzen
            _PN14_Disp_Rq2_AR_SpontanFlag = 0; // Spontan-Flag zurücksetzen
        }
        else if( _PN14_Disp_Rq2_AR_SpontanFlag)
        {
            PN14_Disp_Rq2_AR_output(); // Nachricht wg. spontaner Änderung ausgeben
            _PN14_Disp_Rq2_AR_SpontanFlag = 0; // Spontan-Flag zurücksetzen
        }
    }
}
/*@@end*/

/*@@caplFunc:PN14_Disp_Rq2_AR_init():*/
PN14_Disp_Rq2_AR_init()
{   /* Botschaft PN14_Disp_Rq2_AR ID: 834 --- Sendeart 5 cyclicAndSpontanWithDelay --- 
BA_ "ApplMessage" BO_ 834 0;
BA_ "NmAsrMessage" BO_ 834 0;
BA_ "GenMsgMinAcceptLength" BO_ 834 8;
BA_ "GenMsgILSupport" BO_ 834 1;
BA_ "DiagState" BO_ 834 0;
BA_ "DiagRequest" BO_ 834 0;
BA_ "DiagResponse" BO_ 834 0;
BA_ "GenMsgStartValue" BO_ 834 "0";
BA_ "GenMsgDelayTime" BO_ 834 200;
BA_ "GenMsgNrOfRepetitions" BO_ 834 0;
BA_ "GenMsgCycleTime" BO_ 834 1000;
BA_ "GenMsgSendType" BO_ 834 5;
    */
    _PN14_Disp_Rq2_AR_Timebase =      c_tDBKomTimer_20ms;
    _PN14_Disp_Rq2_AR_CycleCount =   1000 / _PN14_Disp_Rq2_AR_Timebase;
    _PN14_Disp_Rq2_AR_StartDelay =      0 / _PN14_Disp_Rq2_AR_Timebase;
    _PN14_Disp_Rq2_AR_MinDelay =      200 / _PN14_Disp_Rq2_AR_Timebase;
    _PN14_Disp_Rq2_AR_Cnt = _PN14_Disp_Rq2_AR_StartDelay;
    _PN14_Disp_Rq2_AR_SpontanFlag = 0;
    _PN14_Disp_Rq2_AR_DelayCnt = 0;

    putValue( HMI__STMSGSD_PN14_Disp_Rq2_AR, _PN14_Disp_Rq2_AR_StartDelay * _PN14_Disp_Rq2_AR_Timebase );

    _PN14_Disp_Rq2_AR_Cnt = 10;
    _PN14_Disp_Rq2_AR_SpontanFlag = 0;
    _mPN14_Disp_Rq2_AR.PN14_WarnIcon1_Disp_Rq.phys = getValue( HMI_PN14_WarnIcon1_Disp_Rq );
    _mPN14_Disp_Rq2_AR.Rsrv1_PN14_Disp_Rq2.phys = getValue( HMI_Rsrv1_PN14_Disp_Rq2 );
    _mPN14_Disp_Rq2_AR.PN14_Disp_Rq2_UB.phys = getValue( HMI_PN14_Disp_Rq2_UB );
}
/*@@end*/

/*@@caplFunc:PN14_Disp_Rq2_AR_output():*/
void PN14_Disp_Rq2_AR_output(void)
{
    byte crc;
    byte SQC_help;

    if( !getValue( HMI_SQC_PN14_Disp_Rq2_Auto ) )
    {
        // berechne message counter
        SQC_help = getValue( HMI_SQC_PN14_Disp_Rq2 );
        if( SQC_help >= 15 ) SQC_help = 0;
        else SQC_help++;
        putValue( HMI_SQC_PN14_Disp_Rq2, SQC_help );
        _mPN14_Disp_Rq2_AR.SQC_PN14_Disp_Rq2 = SQC_help;
    }
    else
          _mPN14_Disp_Rq2_AR.SQC_PN14_Disp_Rq2 = getValue( HMI_SQC_PN14_Disp_Rq2 );

    if( getValue( HMI_CRC_PN14_Disp_Rq2_Profile_02 ) )
    {
        if( !getValue( HMI_CRC_PN14_Disp_Rq2_Auto ) )
        {   // CRC according Profile_02 ( W213 )
            // berechne crc
            crc = 0xFF;
//            crc = crctable_profile02[ crc ^ _mPN14_Disp_Rq2_AR.byte( 0 ) ];  CRC
            crc = crctable_profile02[ crc ^ _mPN14_Disp_Rq2_AR.byte( 1 ) ];
//            crc = crctable_profile02[ crc ^ _mPN14_Disp_Rq2_AR.byte( 2 ) ];
//            crc = crctable_profile02[ crc ^ _mPN14_Disp_Rq2_AR.byte( 3 ) ];
//            crc = crctable_profile02[ crc ^ _mPN14_Disp_Rq2_AR.byte( 4 ) ];
//            crc = crctable_profile02[ crc ^ _mPN14_Disp_Rq2_AR.byte( 5 ) ];
//            crc = crctable_profile02[ crc ^ _mPN14_Disp_Rq2_AR.byte( 6 ) ];
//            crc = crctable_profile02[ crc ^ _mPN14_Disp_Rq2_AR.byte( 7 ) ];
            crc = crctable_profile02[ crc ^ _PN14_Disp_Rq2_AR_CRC_Offset[ _mPN14_Disp_Rq2_AR.SQC_PN14_Disp_Rq2 ] ]; // load offset
            crc = (crc ^ 0xFF);
            if( getValue(  HMI_CRC_PN14_Disp_Rq2_Invalid ) )
                crc++;
            _mPN14_Disp_Rq2_AR.CRC_PN14_Disp_Rq2 = crc;
            putValue( HMI_CRC_PN14_Disp_Rq2, crc );
        }
        else
            _mPN14_Disp_Rq2_AR.CRC_PN14_Disp_Rq2 = getValue( HMI_CRC_PN14_Disp_Rq2 );
    }
    output( _mPN14_Disp_Rq2_AR );
}
/*@@end*/

/*@@caplFunc:PN14_Disp_Rq2_AR_saveEnvVars(dword):*/
void PN14_Disp_Rq2_AR_saveEnvVars( dword hFile )
{
    filePutString("\n// Knoten EIS: PN14_Disp_Rq2_AR\n", 33, hFile );
    snprintf( buffer, elcount( buffer ), "0.0000 HMI__STMSG_PN14_Disp_Rq2_AR := %X\n", getValue( HMI__STMSG_PN14_Disp_Rq2_AR ) );        filePutString( buffer, elcount( buffer ), hFile );
    snprintf( buffer, elcount( buffer ), "0.0000 HMI__STMSGT_PN14_Disp_Rq2_AR := %X\n", getValue( HMI__STMSGT_PN14_Disp_Rq2_AR ) );        filePutString( buffer, elcount( buffer ), hFile );
    snprintf( buffer, elcount( buffer ), "0.0000 HMI_CRC_PN14_Disp_Rq2 := %X\n", getValue( HMI_CRC_PN14_Disp_Rq2 ) );        filePutString( buffer, elcount( buffer ), hFile );
    snprintf( buffer, elcount( buffer ), "0.0000 HMI_CRC_PN14_Disp_Rq2_Auto := %X\n", getValue( HMI_CRC_PN14_Disp_Rq2_Auto ) );        filePutString( buffer, elcount( buffer ), hFile );
    snprintf( buffer, elcount( buffer ), "0.0000 HMI_PN14_WarnIcon1_Disp_Rq := %X\n", getValue( HMI_PN14_WarnIcon1_Disp_Rq ) );        filePutString( buffer, elcount( buffer ), hFile );
    snprintf( buffer, elcount( buffer ), "0.0000 HMI_SQC_PN14_Disp_Rq2 := %X\n", getValue( HMI_SQC_PN14_Disp_Rq2 ) );        filePutString( buffer, elcount( buffer ), hFile );
    snprintf( buffer, elcount( buffer ), "0.0000 HMI_SQC_PN14_Disp_Rq2_Auto := %X\n", getValue( HMI_SQC_PN14_Disp_Rq2_Auto ) );        filePutString( buffer, elcount( buffer ), hFile );
    snprintf( buffer, elcount( buffer ), "0.0000 HMI_Rsrv1_PN14_Disp_Rq2 := %X\n", getValue( HMI_Rsrv1_PN14_Disp_Rq2 ) );        filePutString( buffer, elcount( buffer ), hFile );
    snprintf( buffer, elcount( buffer ), "0.0000 HMI_PN14_Disp_Rq2_UB := %X\n", getValue( HMI_PN14_Disp_Rq2_UB ) );        filePutString( buffer, elcount( buffer ), hFile );
}
/*@@end*/

/*@@timer:_tPN14_Disp_Rq2_AR:*/
on timer _tPN14_Disp_Rq2_AR
{
    putValue( HMI__STMSG_PN14_Disp_Rq2_AR, 0 );
}
/*@@end*/

/*@@envVar:HMI__STMSG_PN14_Disp_Rq2_AR:*/
on EnvVar HMI__STMSG_PN14_Disp_Rq2_AR
{
    long tDelay;
    if( getValue( this ) == 2 )
    {
        tDelay = getValue( HMI__STMSGT_PN14_Disp_Rq2_AR );
        if( tDelay > 0)    
            setTimer( _tPN14_Disp_Rq2_AR, tDelay );
        else
            putValue( HMI__STMSG_PN14_Disp_Rq2_AR, 0 );
    }
}
/*@@end*/

/*@@envVar:HMI_PN14_WarnIcon1_Disp_Rq:*/
on EnvVar HMI_PN14_WarnIcon1_Disp_Rq
{
    _mPN14_Disp_Rq2_AR.PN14_WarnIcon1_Disp_Rq.phys = getValue(this);
    _PN14_Disp_Rq2_AR_SpontanFlag = 1;
}
/*@@end*/

/*@@envVar:HMI_Rsrv1_PN14_Disp_Rq2:*/
on EnvVar HMI_Rsrv1_PN14_Disp_Rq2
{
    _mPN14_Disp_Rq2_AR.Rsrv1_PN14_Disp_Rq2.phys = getValue(this);
    _PN14_Disp_Rq2_AR_SpontanFlag = 1;
}
/*@@end*/

/*@@envVar:HMI_PN14_Disp_Rq2_UB:*/
on EnvVar HMI_PN14_Disp_Rq2_UB
{
    _mPN14_Disp_Rq2_AR.PN14_Disp_Rq2_UB.phys = getValue(this);
    _PN14_Disp_Rq2_AR_SpontanFlag = 1;
}
/*@@end*/

/*@@caplFunc:PN14_Stat_AR_check_output():*/
PN14_Stat_AR_check_output()
{
    if( !getValue( HMI__STMSG_PN14_Stat_AR ) )
    {
        // Botschaft PN14_Stat_AR ID: 290 --- Sendeart 5 cyclicAndSpontanWithDelay --- 
        _PN14_Stat_AR_Cnt--;
        if( _PN14_Stat_AR_Cnt < 1 )
        {
            PN14_Stat_AR_output(); // Nachricht wg. abgelaufenem Zyklus ausgeben
            _PN14_Stat_AR_Cnt = _PN14_Stat_AR_CycleCount; // Zyklus-Zähler zurücksetzen
            _PN14_Stat_AR_SpontanFlag = 0; // Spontan-Flag zurücksetzen
        }
        else if( _PN14_Stat_AR_SpontanFlag )
        {
            PN14_Stat_AR_output(); // Nachricht wg. spontaner Änderung ausgeben
            _PN14_Stat_AR_SpontanFlag = 0; // Spontan-Flag zurücksetzen
        }
    }
}
/*@@end*/

/*@@caplFunc:PN14_Stat_AR_init():*/
PN14_Stat_AR_init()
{   /* Botschaft PN14_Stat_AR ID: 290 --- Sendeart 5 cyclicAndSpontanWithDelay --- 
BA_ "ApplMessage" BO_ 290 0;
BA_ "NmAsrMessage" BO_ 290 0;
BA_ "GenMsgMinAcceptLength" BO_ 290 8;
BA_ "GenMsgILSupport" BO_ 290 1;
BA_ "DiagState" BO_ 290 0;
BA_ "DiagRequest" BO_ 290 0;
BA_ "DiagResponse" BO_ 290 0;
BA_ "GenMsgStartValue" BO_ 290 "0";
BA_ "GenMsgDelayTime" BO_ 290 5;
BA_ "GenMsgNrOfRepetitions" BO_ 290 0;
BA_ "GenMsgCycleTime" BO_ 290 100;
BA_ "GenMsgSendType" BO_ 290 5;
    */
    _PN14_Stat_AR_Timebase =           c_tDBKomTimer_20ms;
    _PN14_Stat_AR_CycleCount =        100 / _PN14_Stat_AR_Timebase;
    _PN14_Stat_AR_StartDelay =          0 / _PN14_Stat_AR_Timebase;
    _PN14_Stat_AR_Cnt = _PN14_Stat_AR_StartDelay;
    _PN14_Stat_AR_SpontanFlag = 0;

    putValue( HMI__STMSGSD_PN14_Stat_AR, _PN14_Stat_AR_StartDelay * _PN14_Stat_AR_Timebase );

    _mPN14_Stat_AR.DPM_ExtMd_Enbl_Rq.phys = getValue( HMI_DPM_ExtMd_Enbl_Rq );
    _mPN14_Stat_AR.DPM_MdLmt_Rq.phys = getValue( HMI_DPM_MdLmt_Rq );
    _mPN14_Stat_AR.LHC_CoolBox_R_Rq.phys = getValue( HMI_LHC_CoolBox_R_Rq );
    _mPN14_Stat_AR.LHC_EBL_Rq.phys = getValue( HMI_LHC_EBL_Rq );
    _mPN14_Stat_AR.LHC_EngFan_50_Rq.phys = getValue( HMI_LHC_EngFan_50_Rq );
    _mPN14_Stat_AR.LHC_ICH_Rq.phys = getValue( HMI_LHC_ICH_Rq );
    _mPN14_Stat_AR.LHC_IntFan_F_50_Rq.phys = getValue( HMI_LHC_IntFan_F_50_Rq );
    _mPN14_Stat_AR.LHC_IntFan_R_0_Rq.phys = getValue( HMI_LHC_IntFan_R_0_Rq );
    _mPN14_Stat_AR.LHC_IntFan_R_50_Rq.phys = getValue( HMI_LHC_IntFan_R_50_Rq );
    _mPN14_Stat_AR.LHC_MirrHt_Rq.phys = getValue( HMI_LHC_MirrHt_Rq );
    _mPN14_Stat_AR.LHC_PkLmp_Rq.phys = getValue( HMI_LHC_PkLmp_Rq );
    _mPN14_Stat_AR.LHC_PosnLmp_Rq.phys = getValue( HMI_LHC_PosnLmp_Rq );
    _mPN14_Stat_AR.LHC_PT_Stg1_Rq.phys = getValue( HMI_LHC_PT_Stg1_Rq );
    _mPN14_Stat_AR.LHC_PT_Stg2_Rq.phys = getValue( HMI_LHC_PT_Stg2_Rq );
    _mPN14_Stat_AR.LHC_PTC1_Rq.phys = getValue( HMI_LHC_PTC1_Rq );
    _mPN14_Stat_AR.LHC_PTC2_Rq.phys = getValue( HMI_LHC_PTC2_Rq );
    _mPN14_Stat_AR.LHC_PTC3_Rq.phys = getValue( HMI_LHC_PTC3_Rq );
    _mPN14_Stat_AR.LHC_PTC4_Rq.phys = getValue( HMI_LHC_PTC4_Rq );
    _mPN14_Stat_AR.LHC_PTC5_Rq.phys = getValue( HMI_LHC_PTC5_Rq );
    _mPN14_Stat_AR.LHC_PTC6_Rq.phys = getValue( HMI_LHC_PTC6_Rq );
    _mPN14_Stat_AR.LHC_RHU_Rq.phys = getValue( HMI_LHC_RHU_Rq );
    _mPN14_Stat_AR.LHC_SeatHtStg1_Rq.phys = getValue( HMI_LHC_SeatHtStg1_Rq );
    _mPN14_Stat_AR.LHC_SeatHtStg2_Rq.phys = getValue( HMI_LHC_SeatHtStg2_Rq );
    _mPN14_Stat_AR.LHC_SeatHtStg3_Rq.phys = getValue( HMI_LHC_SeatHtStg3_Rq );
    _mPN14_Stat_AR.LHC_SeatVn_Rq.phys = getValue( HMI_LHC_SeatVn_Rq );
    _mPN14_Stat_AR.LHC_StW_Ht_Rq.phys = getValue( HMI_LHC_StW_Ht_Rq );
    _mPN14_Stat_AR.LHC_Taxi_Rq.phys = getValue( HMI_LHC_Taxi_Rq );
    _mPN14_Stat_AR.LHC_Tlm_Rq.phys = getValue( HMI_LHC_Tlm_Rq );
    _mPN14_Stat_AR.LHC_TrkSock_Rq.phys = getValue( HMI_LHC_TrkSock_Rq );
    _mPN14_Stat_AR.LHC_TrlrSock_Rq.phys = getValue( HMI_LHC_TrlrSock_Rq );
    _mPN14_Stat_AR.LHC_WprPkHt_Rq.phys = getValue( HMI_LHC_WprPkHt_Rq );
    _mPN14_Stat_AR.LHC_WShHt_50_Rq.phys = getValue( HMI_LHC_WShHt_50_Rq );
    _mPN14_Stat_AR.LHC_WShHt_Rq.phys = getValue( HMI_LHC_WShHt_Rq );
    _mPN14_Stat_AR.PN14_eHeV_Enbl.phys  = getValue( HMI_PN14_eHeV_Enbl );
    _mPN14_Stat_AR.PN14_LHC_Actv.phys = getValue( HMI_PN14_LHC_Actv );
    _mPN14_Stat_AR.PN14_SupBat_Curr.phys = getValue( HMI_PN14_SupBat_Curr );
    _mPN14_Stat_AR.PN14_SupBat_Volt.phys = getValue( HMI_PN14_SupBat_Volt );
    _mPN14_Stat_AR.PN14_SupBatCutSw_Stat.phys = getValue( HMI_PN14_SupBatCutSw_Stat );
    _mPN14_Stat_AR.PN14_TransMd_Stat.phys = getValue( HMI_PN14_TransMd_Stat );
    _mPN14_Stat_AR.PN14_TransMd_Updt_Rq.phys = getValue( HMI_PN14_TransMd_Updt_Rq );
    _mPN14_Stat_AR.SSA_EngRestart_Actv.phys = getValue( HMI_SSA_EngRestart_Actv );
}
/*@@end*/

/*@@caplFunc:PN14_Stat_AR_output():*/
PN14_Stat_AR_output(void)
{
    output( _mPN14_Stat_AR );
}
/*@@end*/

/*@@caplFunc:PN14_Stat_AR_saveEnvVars(dword):*/
PN14_Stat_AR_saveEnvVars( dword hFile )
{
    filePutString("\n// Knoten EIS: PN14_Stat\n", 26, hFile );
    snprintf( buffer, elcount( buffer ), "0.0000 HMI__STMSG_PN14_Stat_AR := %X\n", getValue( HMI__STMSG_PN14_Stat_AR ) );        filePutString( buffer, elcount( buffer ), hFile );
    snprintf( buffer, elcount( buffer ), "0.0000 HMI__STMSGT_PN14_Stat_AR := %X\n", getValue( HMI__STMSGT_PN14_Stat_AR ) );        filePutString( buffer, elcount( buffer ), hFile );
    snprintf( buffer, elcount( buffer ), "0.0000 HMI_DPM_ExtMd_Enbl_Rq := %X\n", getValue( HMI_DPM_ExtMd_Enbl_Rq ) );        filePutString( buffer, elcount( buffer ), hFile );
    snprintf( buffer, elcount( buffer ), "0.0000 HMI_DPM_MdLmt_Rq := %X\n", getValue( HMI_DPM_MdLmt_Rq ) );        filePutString( buffer, elcount( buffer ), hFile );
    snprintf( buffer, elcount( buffer ), "0.0000 HMI_LHC_CoolBox_R_Rq := %X\n", getValue( HMI_LHC_CoolBox_R_Rq ) );        filePutString( buffer, elcount( buffer ), hFile );
    snprintf( buffer, elcount( buffer ), "0.0000 HMI_LHC_EBL_Rq := %X\n", getValue( HMI_LHC_EBL_Rq ) );        filePutString( buffer, elcount( buffer ), hFile );
    snprintf( buffer, elcount( buffer ), "0.0000 HMI_LHC_EngFan_50_Rq := %X\n", getValue( HMI_LHC_EngFan_50_Rq ) );        filePutString( buffer, elcount( buffer ), hFile );
    snprintf( buffer, elcount( buffer ), "0.0000 HMI_LHC_ICH_Rq := %X\n", getValue( HMI_LHC_ICH_Rq ) );        filePutString( buffer, elcount( buffer ), hFile );
    snprintf( buffer, elcount( buffer ), "0.0000 HMI_LHC_IntFan_F_50_Rq := %X\n", getValue( HMI_LHC_IntFan_F_50_Rq ) );        filePutString( buffer, elcount( buffer ), hFile );
    snprintf( buffer, elcount( buffer ), "0.0000 HMI_LHC_IntFan_R_0_Rq := %X\n", getValue( HMI_LHC_IntFan_R_0_Rq ) );        filePutString( buffer, elcount( buffer ), hFile );
    snprintf( buffer, elcount( buffer ), "0.0000 HMI_LHC_IntFan_R_50_Rq := %X\n", getValue( HMI_LHC_IntFan_R_50_Rq ) );        filePutString( buffer, elcount( buffer ), hFile );
    snprintf( buffer, elcount( buffer ), "0.0000 HMI_LHC_MirrHt_Rq := %X\n", getValue( HMI_LHC_MirrHt_Rq ) );        filePutString( buffer, elcount( buffer ), hFile );
    snprintf( buffer, elcount( buffer ), "0.0000 HMI_LHC_PkLmp_Rq := %X\n", getValue( HMI_LHC_PkLmp_Rq ) );        filePutString( buffer, elcount( buffer ), hFile );
    snprintf( buffer, elcount( buffer ), "0.0000 HMI_LHC_PosnLmp_Rq := %X\n", getValue( HMI_LHC_PosnLmp_Rq ) );        filePutString( buffer, elcount( buffer ), hFile );
    snprintf( buffer, elcount( buffer ), "0.0000 HMI_LHC_PT_Stg1_Rq := %X\n", getValue( HMI_LHC_PT_Stg1_Rq ) );        filePutString( buffer, elcount( buffer ), hFile );
    snprintf( buffer, elcount( buffer ), "0.0000 HMI_LHC_PT_Stg2_Rq := %X\n", getValue( HMI_LHC_PT_Stg2_Rq ) );        filePutString( buffer, elcount( buffer ), hFile );
    snprintf( buffer, elcount( buffer ), "0.0000 HMI_LHC_PTC1_Rq := %X\n", getValue( HMI_LHC_PTC1_Rq ) );        filePutString( buffer, elcount( buffer ), hFile );
    snprintf( buffer, elcount( buffer ), "0.0000 HMI_LHC_PTC2_Rq := %X\n", getValue( HMI_LHC_PTC2_Rq ) );        filePutString( buffer, elcount( buffer ), hFile );
    snprintf( buffer, elcount( buffer ), "0.0000 HMI_LHC_PTC3_Rq := %X\n", getValue( HMI_LHC_PTC3_Rq ) );        filePutString( buffer, elcount( buffer ), hFile );
    snprintf( buffer, elcount( buffer ), "0.0000 HMI_LHC_PTC4_Rq := %X\n", getValue( HMI_LHC_PTC4_Rq ) );        filePutString( buffer, elcount( buffer ), hFile );
    snprintf( buffer, elcount( buffer ), "0.0000 HMI_LHC_PTC5_Rq := %X\n", getValue( HMI_LHC_PTC5_Rq ) );        filePutString( buffer, elcount( buffer ), hFile );
    snprintf( buffer, elcount( buffer ), "0.0000 HMI_LHC_PTC6_Rq := %X\n", getValue( HMI_LHC_PTC6_Rq ) );        filePutString( buffer, elcount( buffer ), hFile );
    snprintf( buffer, elcount( buffer ), "0.0000 HMI_LHC_RHU_Rq := %X\n", getValue( HMI_LHC_RHU_Rq ) );        filePutString( buffer, elcount( buffer ), hFile );
    snprintf( buffer, elcount( buffer ), "0.0000 HMI_LHC_SeatHtStg1_Rq := %X\n", getValue( HMI_LHC_SeatHtStg1_Rq ) );        filePutString( buffer, elcount( buffer ), hFile );
    snprintf( buffer, elcount( buffer ), "0.0000 HMI_LHC_SeatHtStg2_Rq := %X\n", getValue( HMI_LHC_SeatHtStg2_Rq ) );        filePutString( buffer, elcount( buffer ), hFile );
    snprintf( buffer, elcount( buffer ), "0.0000 HMI_LHC_SeatHtStg3_Rq := %X\n", getValue( HMI_LHC_SeatHtStg3_Rq ) );        filePutString( buffer, elcount( buffer ), hFile );
    snprintf( buffer, elcount( buffer ), "0.0000 HMI_LHC_SeatVn_Rq := %X\n", getValue( HMI_LHC_SeatVn_Rq ) );        filePutString( buffer, elcount( buffer ), hFile );
    snprintf( buffer, elcount( buffer ), "0.0000 HMI_LHC_StW_Ht_Rq := %X\n", getValue( HMI_LHC_StW_Ht_Rq ) );        filePutString( buffer, elcount( buffer ), hFile );
    snprintf( buffer, elcount( buffer ), "0.0000 HMI_LHC_Taxi_Rq := %X\n", getValue( HMI_LHC_Taxi_Rq ) );        filePutString( buffer, elcount( buffer ), hFile );
    snprintf( buffer, elcount( buffer ), "0.0000 HMI_LHC_Tlm_Rq := %X\n", getValue( HMI_LHC_Tlm_Rq ) );        filePutString( buffer, elcount( buffer ), hFile );
    snprintf( buffer, elcount( buffer ), "0.0000 HMI_LHC_TrkSock_Rq := %X\n", getValue( HMI_LHC_TrkSock_Rq ) );        filePutString( buffer, elcount( buffer ), hFile );
    snprintf( buffer, elcount( buffer ), "0.0000 HMI_LHC_TrlrSock_Rq := %X\n", getValue( HMI_LHC_TrlrSock_Rq ) );        filePutString( buffer, elcount( buffer ), hFile );
    snprintf( buffer, elcount( buffer ), "0.0000 HMI_LHC_WprPkHt_Rq := %X\n", getValue( HMI_LHC_WprPkHt_Rq ) );        filePutString( buffer, elcount( buffer ), hFile );
    snprintf( buffer, elcount( buffer ), "0.0000 HMI_LHC_WShHt_50_Rq := %X\n", getValue( HMI_LHC_WShHt_50_Rq ) );        filePutString( buffer, elcount( buffer ), hFile );
    snprintf( buffer, elcount( buffer ), "0.0000 HMI_LHC_WShHt_Rq := %X\n", getValue( HMI_LHC_WShHt_Rq ) );        filePutString( buffer, elcount( buffer ), hFile );
    snprintf( buffer, elcount( buffer ), "0.0000 HMI_PN14_LHC_Actv := %X\n", getValue( HMI_PN14_LHC_Actv ) );        filePutString( buffer, elcount( buffer ), hFile );
    snprintf( buffer, elcount( buffer ), "0.0000 HMI_PN14_SupBat_Curr := %X\n", getValue( HMI_PN14_SupBat_Curr ) );        filePutString( buffer, elcount( buffer ), hFile );
    snprintf( buffer, elcount( buffer ), "0.0000 HMI_PN14_SupBat_Volt := %X\n", getValue( HMI_PN14_SupBat_Volt ) );        filePutString( buffer, elcount( buffer ), hFile );
    snprintf( buffer, elcount( buffer ), "0.0000 HMI_PN14_SupBatCutSw_Stat := %X\n", getValue( HMI_PN14_SupBatCutSw_Stat ) );        filePutString( buffer, elcount( buffer ), hFile );
    snprintf( buffer, elcount( buffer ), "0.0000 HMI_PN14_TransMd_Stat := %X\n", getValue( HMI_PN14_TransMd_Stat ) );        filePutString( buffer, elcount( buffer ), hFile );
    snprintf( buffer, elcount( buffer ), "0.0000 HMI_PN14_TransMd_Updt_Rq := %X\n", getValue( HMI_PN14_TransMd_Updt_Rq ) );        filePutString( buffer, elcount( buffer ), hFile );
    snprintf( buffer, elcount( buffer ), "0.0000 HMI_SSA_EngRestart_Actv := %X\n", getValue( HMI_SSA_EngRestart_Actv ) );        filePutString( buffer, elcount( buffer ), hFile );
}
/*@@end*/

/*@@timer:_tPN14_Stat_AR:*/
on timer _tPN14_Stat_AR
{
    putValue( HMI__STMSG_PN14_Stat_AR, 0 );
}
/*@@end*/

/*@@envVar:HMI__STMSG_PN14_Stat_AR:*/
on EnvVar HMI__STMSG_PN14_Stat_AR
{
    long tDelay;
    if( getValue( this ) == 2 )
    {
        tDelay = getValue( HMI__STMSGT_PN14_Stat_AR );
        if( tDelay > 0)    
            setTimer( _tPN14_Stat_AR, tDelay );
        else
            putValue( HMI__STMSG_PN14_Stat_AR, 0 );
    }
}
/*@@end*/

/*@@envVar:HMI_DPM_ExtMd_Enbl_Rq:*/
on EnvVar HMI_DPM_ExtMd_Enbl_Rq
{
    _mPN14_Stat_AR.DPM_ExtMd_Enbl_Rq.phys = getValue(this);
    _PN14_Stat_AR_SpontanFlag = 1;
}
/*@@end*/

/*@@envVar:HMI_DPM_MdLmt_Rq:*/
on EnvVar HMI_DPM_MdLmt_Rq
{
    _mPN14_Stat_AR.DPM_MdLmt_Rq.phys = getValue(this);
    _PN14_Stat_AR_SpontanFlag = 1;
}
/*@@end*/

/*@@envVar:HMI_LHC_CoolBox_R_Rq:*/
on EnvVar HMI_LHC_CoolBox_R_Rq
{
    _mPN14_Stat_AR.LHC_CoolBox_R_Rq.phys = getValue(this);
    _PN14_Stat_AR_SpontanFlag = 1;
}
/*@@end*/

/*@@envVar:HMI_LHC_EBL_Rq:*/
on EnvVar HMI_LHC_EBL_Rq
{
    _mPN14_Stat_AR.LHC_EBL_Rq.phys = getValue(this);
    _PN14_Stat_AR_SpontanFlag = 1;
}
/*@@end*/

/*@@envVar:HMI_LHC_EngFan_50_Rq:*/
on EnvVar HMI_LHC_EngFan_50_Rq
{
    _mPN14_Stat_AR.LHC_EngFan_50_Rq.phys = getValue(this);
    _PN14_Stat_AR_SpontanFlag = 1;
}
/*@@end*/

/*@@envVar:HMI_LHC_ICH_Rq:*/
on EnvVar HMI_LHC_ICH_Rq
{
    _mPN14_Stat_AR.LHC_ICH_Rq.phys = getValue(this);
    _PN14_Stat_AR_SpontanFlag = 1;
}
/*@@end*/

/*@@envVar:HMI_LHC_IntFan_F_50_Rq:*/
on EnvVar HMI_LHC_IntFan_F_50_Rq
{
    _mPN14_Stat_AR.LHC_IntFan_F_50_Rq.phys = getValue(this);
    _PN14_Stat_AR_SpontanFlag = 1;
}
/*@@end*/

/*@@envVar:HMI_LHC_IntFan_R_0_Rq:*/
on EnvVar HMI_LHC_IntFan_R_0_Rq
{
    _mPN14_Stat_AR.LHC_IntFan_R_0_Rq.phys = getValue(this);
    _PN14_Stat_AR_SpontanFlag = 1;
}
/*@@end*/

/*@@envVar:HMI_LHC_IntFan_R_50_Rq:*/
on EnvVar HMI_LHC_IntFan_R_50_Rq
{
    _mPN14_Stat_AR.LHC_IntFan_R_50_Rq.phys = getValue(this);
    _PN14_Stat_AR_SpontanFlag = 1;
}
/*@@end*/

/*@@envVar:HMI_LHC_MirrHt_Rq:*/
on EnvVar HMI_LHC_MirrHt_Rq
{
    _mPN14_Stat_AR.LHC_MirrHt_Rq.phys = getValue(this);
    _PN14_Stat_AR_SpontanFlag = 1;
}
/*@@end*/

/*@@envVar:HMI_LHC_PkLmp_Rq:*/
on EnvVar HMI_LHC_PkLmp_Rq
{
    _mPN14_Stat_AR.LHC_PkLmp_Rq.phys = getValue(this);
    _PN14_Stat_AR_SpontanFlag = 1;
}
/*@@end*/

/*@@envVar:HMI_LHC_PosnLmp_Rq:*/
on EnvVar HMI_LHC_PosnLmp_Rq
{
    _mPN14_Stat_AR.LHC_PosnLmp_Rq.phys = getValue(this);
    _PN14_Stat_AR_SpontanFlag = 1;
}
/*@@end*/

/*@@envVar:HMI_LHC_PT_Stg1_Rq:*/
on EnvVar HMI_LHC_PT_Stg1_Rq
{
    _mPN14_Stat_AR.LHC_PT_Stg1_Rq.phys = getValue(this);
    _PN14_Stat_AR_SpontanFlag = 1;
}
/*@@end*/

/*@@envVar:HMI_LHC_PT_Stg2_Rq:*/
on EnvVar HMI_LHC_PT_Stg2_Rq
{
    _mPN14_Stat_AR.LHC_PT_Stg2_Rq.phys = getValue(this);
    _PN14_Stat_AR_SpontanFlag = 1;
}
/*@@end*/

/*@@envVar:HMI_LHC_PTC1_Rq:*/
on EnvVar HMI_LHC_PTC1_Rq
{
    _mPN14_Stat_AR.LHC_PTC1_Rq.phys = getValue(this);
    _PN14_Stat_AR_SpontanFlag = 1;
}
/*@@end*/

/*@@envVar:HMI_LHC_PTC2_Rq:*/
on EnvVar HMI_LHC_PTC2_Rq
{
    _mPN14_Stat_AR.LHC_PTC2_Rq.phys = getValue(this);
    _PN14_Stat_AR_SpontanFlag = 1;
}
/*@@end*/

/*@@envVar:HMI_LHC_PTC3_Rq:*/
on EnvVar HMI_LHC_PTC3_Rq
{
    _mPN14_Stat_AR.LHC_PTC3_Rq.phys = getValue(this);
    _PN14_Stat_AR_SpontanFlag = 1;
}
/*@@end*/

/*@@envVar:HMI_LHC_PTC4_Rq:*/
on EnvVar HMI_LHC_PTC4_Rq
{
    _mPN14_Stat_AR.LHC_PTC4_Rq.phys = getValue(this);
    _PN14_Stat_AR_SpontanFlag = 1;
}
/*@@end*/

/*@@envVar:HMI_LHC_PTC5_Rq:*/
on EnvVar HMI_LHC_PTC5_Rq
{
    _mPN14_Stat_AR.LHC_PTC5_Rq.phys = getValue(this);
    _PN14_Stat_AR_SpontanFlag = 1;
}
/*@@end*/

/*@@envVar:HMI_LHC_PTC6_Rq:*/
on EnvVar HMI_LHC_PTC6_Rq
{
    _mPN14_Stat_AR.LHC_PTC6_Rq.phys = getValue(this);
    _PN14_Stat_AR_SpontanFlag = 1;
}
/*@@end*/

/*@@envVar:HMI_LHC_RHU_Rq:*/
on EnvVar HMI_LHC_RHU_Rq
{
    _mPN14_Stat_AR.LHC_RHU_Rq.phys = getValue(this);
    _PN14_Stat_AR_SpontanFlag = 1;
}
/*@@end*/

/*@@envVar:HMI_LHC_SeatHtStg1_Rq:*/
on EnvVar HMI_LHC_SeatHtStg1_Rq
{
    _mPN14_Stat_AR.LHC_SeatHtStg1_Rq.phys = getValue(this);
    _PN14_Stat_AR_SpontanFlag = 1;
}
/*@@end*/

/*@@envVar:HMI_LHC_SeatHtStg2_Rq:*/
on EnvVar HMI_LHC_SeatHtStg2_Rq
{
    _mPN14_Stat_AR.LHC_SeatHtStg2_Rq.phys = getValue(this);
    _PN14_Stat_AR_SpontanFlag = 1;
}
/*@@end*/

/*@@envVar:HMI_LHC_SeatHtStg3_Rq:*/
on EnvVar HMI_LHC_SeatHtStg3_Rq
{
    _mPN14_Stat_AR.LHC_SeatHtStg3_Rq.phys = getValue(this);
    _PN14_Stat_AR_SpontanFlag = 1;
}
/*@@end*/

/*@@envVar:HMI_LHC_SeatVn_Rq:*/
on EnvVar HMI_LHC_SeatVn_Rq
{
    _mPN14_Stat_AR.LHC_SeatVn_Rq.phys = getValue(this);
    _PN14_Stat_AR_SpontanFlag = 1;
}
/*@@end*/

/*@@envVar:HMI_LHC_StW_Ht_Rq:*/
on EnvVar HMI_LHC_StW_Ht_Rq
{
    _mPN14_Stat_AR.LHC_StW_Ht_Rq.phys = getValue(this);
    _PN14_Stat_AR_SpontanFlag = 1;
}
/*@@end*/

/*@@envVar:HMI_LHC_Taxi_Rq:*/
on EnvVar HMI_LHC_Taxi_Rq
{
    _mPN14_Stat_AR.LHC_Taxi_Rq.phys = getValue(this);
    _PN14_Stat_AR_SpontanFlag = 1;
}
/*@@end*/

/*@@envVar:HMI_LHC_Tlm_Rq:*/
on EnvVar HMI_LHC_Tlm_Rq
{
    _mPN14_Stat_AR.LHC_Tlm_Rq.phys = getValue(this);
    _PN14_Stat_AR_SpontanFlag = 1;
}
/*@@end*/

/*@@envVar:HMI_LHC_TrkSock_Rq:*/
on EnvVar HMI_LHC_TrkSock_Rq
{
    _mPN14_Stat_AR.LHC_TrkSock_Rq.phys = getValue(this);
    _PN14_Stat_AR_SpontanFlag = 1;
}
/*@@end*/

/*@@envVar:HMI_LHC_TrlrSock_Rq:*/
on EnvVar HMI_LHC_TrlrSock_Rq
{
    _mPN14_Stat_AR.LHC_TrlrSock_Rq.phys = getValue(this);
    _PN14_Stat_AR_SpontanFlag = 1;
}
/*@@end*/

/*@@envVar:HMI_LHC_WprPkHt_Rq:*/
on EnvVar HMI_LHC_WprPkHt_Rq
{
    _mPN14_Stat_AR.LHC_WprPkHt_Rq.phys = getValue(this);
    _PN14_Stat_AR_SpontanFlag = 1;
}
/*@@end*/

/*@@envVar:HMI_LHC_WShHt_50_Rq:*/
on EnvVar HMI_LHC_WShHt_50_Rq
{
    _mPN14_Stat_AR.LHC_WShHt_50_Rq.phys = getValue(this);
    _PN14_Stat_AR_SpontanFlag = 1;
}
/*@@end*/

/*@@envVar:HMI_LHC_WShHt_Rq:*/
on EnvVar HMI_LHC_WShHt_Rq
{
    _mPN14_Stat_AR.LHC_WShHt_Rq.phys = getValue(this);
    _PN14_Stat_AR_SpontanFlag = 1;
}
/*@@end*/

/*@@envVar:HMI_PN14_eHeV_Enbl:*/
on EnvVar HMI_PN14_eHeV_Enbl
{
    _mPN14_Stat_AR.PN14_eHeV_Enbl.phys = getValue(this);
    _PN14_Stat_AR_SpontanFlag = 1;
}
/*@@end*/

/*@@envVar:HMI_PN14_LHC_Actv:*/
on EnvVar HMI_PN14_LHC_Actv
{
    _mPN14_Stat_AR.PN14_LHC_Actv.phys = getValue(this);
    _PN14_Stat_AR_SpontanFlag = 1;
}
/*@@end*/

/*@@envVar:HMI_PN14_SupBat_Curr:*/
on EnvVar HMI_PN14_SupBat_Curr
{
    _mPN14_Stat_AR.PN14_SupBat_Curr.phys = getValue(this);
    _PN14_Stat_AR_SpontanFlag = 1;
}
/*@@end*/

/*@@envVar:HMI_PN14_SupBat_Volt:*/
on EnvVar HMI_PN14_SupBat_Volt
{
    _mPN14_Stat_AR.PN14_SupBat_Volt.phys = getValue(this);
    _PN14_Stat_AR_SpontanFlag = 1;
}
/*@@end*/

/*@@envVar:HMI_PN14_SupBatCutSw_Stat:*/
on EnvVar HMI_PN14_SupBatCutSw_Stat
{
    _mPN14_Stat_AR.PN14_SupBatCutSw_Stat.phys = getValue(this);
    _PN14_Stat_AR_SpontanFlag = 1;
}
/*@@end*/

/*@@envVar:HMI_PN14_TransMd_Stat:*/
on EnvVar HMI_PN14_TransMd_Stat
{
    _mPN14_Stat_AR.PN14_TransMd_Stat.phys = getValue(this);
    _PN14_Stat_AR_SpontanFlag = 1;
}
/*@@end*/

/*@@envVar:HMI_PN14_TransMd_Updt_Rq:*/
on EnvVar HMI_PN14_TransMd_Updt_Rq
{
    _mPN14_Stat_AR.PN14_TransMd_Updt_Rq.phys = getValue(this);
    _PN14_Stat_AR_SpontanFlag = 1;
}
/*@@end*/

/*@@envVar:HMI_SSA_EngRestart_Actv:*/
on envVar HMI_SSA_EngRestart_Actv
{
    _mPN14_Stat_AR.SSA_EngRestart_Actv.phys = getValue(this);
    _PN14_Stat_AR_SpontanFlag = 1;
}
/*@@end*/

/*@@caplFunc:PN48_Disp_Rq_AR_check_output():*/
PN48_Disp_Rq_AR_check_output()
{
    if( !getValue( HMI__STMSG_PN48_Disp_Rq_AR ) )
    {
        // Botschaft PN48_Disp_Rq_AR ID: 868 --- Sendeart cyclic --- 
        if( _PN48_Disp_Rq_AR_DelayCnt > 0) _PN48_Disp_Rq_AR_DelayCnt--; // Mindestsendeabstand
        _PN48_Disp_Rq_AR_Cnt--;
        if( _PN48_Disp_Rq_AR_Cnt < 1 )
        {
            if( _PN48_Disp_Rq_AR_DelayCnt < 1 )
            {
                // Nachricht wg. abgelaufenem Zyklus ausgeben (Mindestsendeabstand eingehalten)
                PN48_Disp_Rq_AR_output();
                _PN48_Disp_Rq_AR_SpontanFlag = 0; // Spontan-Flag zurücksetzen
                _PN48_Disp_Rq_AR_DelayCnt = _PN48_Disp_Rq_AR_MinDelay;
            }
            else
            {
                // Spontanflag setzen damit nach Ablauf Mindestsendeabstand gesendet wird
                 _PN48_Disp_Rq_AR_SpontanFlag = 1;
            }
            _PN48_Disp_Rq_AR_Cnt = _PN48_Disp_Rq_AR_CycleCount; // Zyklus-Zähler zurücksetzen
        }
        else if( _PN48_Disp_Rq_AR_SpontanFlag)
        {
            if( _PN48_Disp_Rq_AR_DelayCnt < 1 )
            {
                // Nachricht wg. spontaner Änderung ausgeben (Mindestsendeabstand eingehalten)
                PN48_Disp_Rq_AR_output();
                _PN48_Disp_Rq_AR_SpontanFlag = 0; // Spontan-Flag zurücksetzen
                _PN48_Disp_Rq_AR_DelayCnt = _PN48_Disp_Rq_AR_MinDelay;
            }
        }
    }
}
/*@@end*/

/*@@caplFunc:PN48_Disp_Rq_AR_init():*/
PN48_Disp_Rq_AR_init()
{   /* Botschaft PN48_Disp_Rq_AR ID: 868 --- Sendeart 5 cyclicAndSpontanWithDelay --- 
BA_ "ApplMessage" BO_ 868 0;
BA_ "NmAsrMessage" BO_ 868 0;
BA_ "GenMsgMinAcceptLength" BO_ 868 8;
BA_ "GenMsgILSupport" BO_ 868 1;
BA_ "DiagState" BO_ 868 0;
BA_ "DiagRequest" BO_ 868 0;
BA_ "DiagResponse" BO_ 868 0;
BA_ "GenMsgStartValue" BO_ 868 "0";
BA_ "GenMsgDelayTime" BO_ 868 50;
BA_ "GenMsgNrOfRepetitions" BO_ 868 0;
BA_ "GenMsgCycleTime" BO_ 868 1000;
BA_ "GenMsgSendType" BO_ 868 5;
    */
    _PN48_Disp_Rq_AR_Timebase             = c_tDBKomTimer_5ms;
    _PN48_Disp_Rq_AR_CycleCount =       1000 / _PN48_Disp_Rq_AR_Timebase;
    _PN48_Disp_Rq_AR_MinDelay =           50 / _PN48_Disp_Rq_AR_Timebase;
    _PN48_Disp_Rq_AR_StartDelay =          0 / _PN48_Disp_Rq_AR_Timebase;
    _PN48_Disp_Rq_AR_Cnt = _PN48_Disp_Rq_AR_MinDelay;
    _PN48_Disp_Rq_AR_SpontanFlag = 0;
    _PN48_Disp_Rq_AR_DelayCnt = 0;

    putValue( HMI__STMSGSD_PN14_Stat_AR, _PN14_Stat_AR_StartDelay * _PN48_Disp_Rq_AR_Timebase );

    _mPN48_Disp_Rq_AR.PN48_Msg1_Disp_Rq.phys = getValue( HMI_PN48_Msg1_Disp_Rq );
    _mPN48_Disp_Rq_AR.PN48_Msg2_Disp_Rq.phys = getValue( HMI_PN48_Msg2_Disp_Rq );
    _mPN48_Disp_Rq_AR.PN48_Msg3_Disp_Rq.phys = getValue( HMI_PN48_Msg3_Disp_Rq );
}
/*@@end*/

/*@@caplFunc:PN48_Disp_Rq_AR_output():*/
PN48_Disp_Rq_AR_output()
{
    output( _mPN48_Disp_Rq_AR );
}
/*@@end*/

/*@@caplFunc:PN48_Disp_Rq_AR_saveEnvVars(dword):*/
PN48_Disp_Rq_AR_saveEnvVars( dword hFile )
{
    filePutString("\n// Knoten EIS: PN48_Disp_Rq_AR\n", 26, hFile );
    snprintf( buffer, elcount( buffer ), "0.0000 HMI__STMSG_PN48_Disp_Rq_AR := %X\n", getValue( HMI__STMSG_PN48_Disp_Rq_AR ) );    filePutString( buffer, elcount( buffer ), hFile );
    snprintf( buffer, elcount( buffer ), "0.0000 HMI__STMSGT_PN48_Disp_Rq_AR := %X\n", getValue( HMI__STMSGT_PN48_Disp_Rq_AR ) );    filePutString( buffer, elcount( buffer ), hFile );
    snprintf( buffer, elcount( buffer ), "0.0000 HMI_PN48_Msg1_Disp_Rq := %X\n", getValue( HMI_PN48_Msg1_Disp_Rq ) );    filePutString( buffer, elcount( buffer ), hFile );
    snprintf( buffer, elcount( buffer ), "0.0000 HMI_PN48_Msg2_Disp_Rq := %X\n", getValue( HMI_PN48_Msg2_Disp_Rq ) );    filePutString( buffer, elcount( buffer ), hFile );
    snprintf( buffer, elcount( buffer ), "0.0000 HMI_PN48_Msg3_Disp_Rq := %X\n", getValue( HMI_PN48_Msg3_Disp_Rq ) );    filePutString( buffer, elcount( buffer ), hFile );
}
/*@@end*/

/*@@timer:_tPN48_Disp_Rq_AR:*/
on timer _tPN48_Disp_Rq_AR
{
    putValue( HMI__STMSG_PN48_Disp_Rq_AR, 0 );
}
/*@@end*/

/*@@envVar:HMI__STMSG_PN48_Disp_Rq_AR:*/
on EnvVar HMI__STMSG_PN48_Disp_Rq_AR
{
    long tDelay;
    if( getValue( this ) == 2 )
    {
        tDelay = getValue( HMI__STMSGT_PN48_Disp_Rq_AR );
        if( tDelay > 0)    
            setTimer( _tPN48_Disp_Rq_AR, tDelay );
        else
            putValue( HMI__STMSG_PN48_Disp_Rq_AR, 0 );
    }
}
/*@@end*/

/*@@envVar:HMI_PN48_Msg1_Disp_Rq:*/
on EnvVar HMI_PN48_Msg1_Disp_Rq
{
    _mPN48_Disp_Rq_AR.PN48_Msg1_Disp_Rq.phys = getValue(this);
    _PN48_Disp_Rq_AR_SpontanFlag = 1;
}
/*@@end*/

/*@@envVar:HMI_PN48_Msg2_Disp_Rq:*/
on EnvVar HMI_PN48_Msg2_Disp_Rq
{
    _mPN48_Disp_Rq_AR.PN48_Msg2_Disp_Rq.phys = getValue(this);
    _PN48_Disp_Rq_AR_SpontanFlag = 1;
}
/*@@end*/

/*@@envVar:HMI_PN48_Msg3_Disp_Rq:*/
on EnvVar HMI_PN48_Msg3_Disp_Rq
{
    _mPN48_Disp_Rq_AR.PN48_Msg3_Disp_Rq.phys = getValue(this);
    _PN48_Disp_Rq_AR_SpontanFlag = 1;
}
/*@@end*/

/*@@caplFunc:PnHt_Stat_AR_check_output():*/
PnHt_Stat_AR_check_output()
{
    if( !getValue( HMI__STMSG_PnHt_Stat_AR ) )
    {
        // Botschaft PnHt_Stat_AR ID: 905 --- Sendeart 5 cyclicAndSpontanWithDelay --- 
        _PnHt_Stat_AR_Cnt--;
        if( _PnHt_Stat_AR_Cnt < 1 )
        {
            PnHt_Stat_AR_output(); // Nachricht wg. abgelaufenem Zyklus ausgeben
            _PnHt_Stat_AR_Cnt = _PnHt_Stat_AR_CycleCount; // Zyklus-Zähler zurücksetzen
            _PnHt_Stat_AR_SpontanFlag = 0; // Spontan-Flag zurücksetzen
        }
        else if( _PnHt_Stat_AR_SpontanFlag)
        {
            PnHt_Stat_AR_output(); // Nachricht wg. spontaner Änderung ausgeben
            _PnHt_Stat_AR_SpontanFlag = 0; // Spontan-Flag zurücksetzen
        }
    }
}
/*@@end*/

/*@@caplFunc:PnHt_Stat_AR_init():*/
PnHt_Stat_AR_init()
{   /* Botschaft PnHt_Stat_AR ID: 905 --- Sendeart 5 cyclicAndSpontanWithDelay --- 
BA_ "ApplMessage" BO_ 905 0;
BA_ "NmAsrMessage" BO_ 905 0;
BA_ "GenMsgMinAcceptLength" BO_ 905 2;
BA_ "GenMsgILSupport" BO_ 905 1;
BA_ "DiagState" BO_ 905 0;
BA_ "DiagRequest" BO_ 905 0;
BA_ "DiagResponse" BO_ 905 0;
BA_ "GenMsgStartValue" BO_ 905 "0";
BA_ "GenMsgDelayTime" BO_ 905 5;
BA_ "GenMsgNrOfRepetitions" BO_ 905 0;
BA_ "GenMsgCycleTime" BO_ 905 1000;
BA_ "GenMsgSendType" BO_ 905 5;
    */
    _PnHt_Stat_AR_Timebase =           c_tDBKomTimer_20ms;
    _PnHt_Stat_AR_CycleCount =       1000 / _PnHt_Stat_AR_Timebase;
    _PnHt_Stat_AR_StartDelay =          0 / _PnHt_Stat_AR_Timebase;
    _PnHt_Stat_AR_Cnt = _PnHt_Stat_AR_StartDelay;
    _PnHt_Stat_AR_SpontanFlag = 0;

    putValue( HMI__STMSGSD_PnHt_Stat_AR, _PnHt_Stat_AR_StartDelay * _PnHt_Stat_AR_Timebase );

    _mPnHt_Stat_AR.PnHt_CenCnsl_Ft_Actv.phys = getValue( HMI_PnHt_CenCnsl_Ft_Actv );
    _mPnHt_Stat_AR.PnHt_CenCnsl_R_Actv.phys = getValue( HMI_PnHt_CenCnsl_R_Actv );
    _mPnHt_Stat_AR.PnHt_Door_FL_Actv.phys = getValue( HMI_PnHt_Door_FL_Actv );
    _mPnHt_Stat_AR.PnHt_Door_FR_Actv.phys = getValue( HMI_PnHt_Door_FR_Actv );
    _mPnHt_Stat_AR.PnHt_Door_RL_Actv.phys = getValue( HMI_PnHt_Door_RL_Actv );
    _mPnHt_Stat_AR.PnHt_Door_RR_Actv.phys = getValue( HMI_PnHt_Door_RR_Actv );
    _mPnHt_Stat_AR.PnHt_PreCond2_Actv.phys = getValue( HMI_PnHt_PreCond2_Actv );
}
/*@@end*/

/*@@caplFunc:PnHt_Stat_AR_output():*/
PnHt_Stat_AR_output(void)
{
    output( _mPnHt_Stat_AR );
}
/*@@end*/

/*@@caplFunc:PnHt_Stat_AR_saveEnvVars(dword):*/
PnHt_Stat_AR_saveEnvVars( dword hFile )
{
    filePutString("\n// Knoten EIS: PnHt_Stat_AR\n", 26, hFile );
    snprintf( buffer, elcount( buffer ), "0.0000 HMI__STMSG_PnHt_Stat := %X\n", getValue( HMI__STMSG_PnHt_Stat_AR ) );    filePutString( buffer, elcount( buffer ), hFile );
    snprintf( buffer, elcount( buffer ), "0.0000 HMI__STMSGT_PnHt_Stat := %X\n", getValue( HMI__STMSGT_PnHt_Stat_AR ) );    filePutString( buffer, elcount( buffer ), hFile );
    snprintf( buffer, elcount( buffer ), "0.0000 HMI_PnHt_CenCnsl_Ft_Actv := %X\n", getValue( HMI_PnHt_CenCnsl_Ft_Actv ) );    filePutString( buffer, elcount( buffer ), hFile );
    snprintf( buffer, elcount( buffer ), "0.0000 HMI_PnHt_CenCnsl_R_Actv := %X\n", getValue( HMI_PnHt_CenCnsl_R_Actv ) );    filePutString( buffer, elcount( buffer ), hFile );
    snprintf( buffer, elcount( buffer ), "0.0000 HMI_PnHt_Door_FL_Actv := %X\n", getValue( HMI_PnHt_Door_FL_Actv ) );    filePutString( buffer, elcount( buffer ), hFile );
    snprintf( buffer, elcount( buffer ), "0.0000 HMI_PnHt_Door_FR_Actv := %X\n", getValue( HMI_PnHt_Door_FR_Actv ) );    filePutString( buffer, elcount( buffer ), hFile );
    snprintf( buffer, elcount( buffer ), "0.0000 HMI_PnHt_Door_RL_Actv := %X\n", getValue( HMI_PnHt_Door_RL_Actv ) );    filePutString( buffer, elcount( buffer ), hFile );
    snprintf( buffer, elcount( buffer ), "0.0000 HMI_PnHt_Door_RR_Actv := %X\n", getValue( HMI_PnHt_Door_RR_Actv ) );    filePutString( buffer, elcount( buffer ), hFile );
    snprintf( buffer, elcount( buffer ), "0.0000 HMI_PnHt_PreCond2_Actv := %X\n", getValue( HMI_PnHt_PreCond2_Actv ) );    filePutString( buffer, elcount( buffer ), hFile );
}
/*@@end*/

/*@@timer:_tPnHt_Stat_AR:*/
on timer _tPnHt_Stat_AR
{
    putValue( HMI__STMSG_PnHt_Stat_AR, 0 );
}
/*@@end*/

/*@@envVar:HMI__STMSG_PnHt_Stat_AR:*/
on EnvVar HMI__STMSG_PnHt_Stat_AR
{
    long tDelay;
    if( getValue( this ) == 2 )
    {
        tDelay = getValue( HMI__STMSGT_PnHt_Stat_AR );
        if( tDelay > 0)    
            setTimer( _tPnHt_Stat_AR, tDelay );
        else
            putValue( HMI__STMSG_PnHt_Stat_AR, 0 );
    }
}
/*@@end*/

/*@@envVar:HMI_PnHt_CenCnsl_Ft_Actv:*/
on EnvVar HMI_PnHt_CenCnsl_Ft_Actv
{
    _mPnHt_Stat_AR.PnHt_CenCnsl_Ft_Actv.phys = getValue(this);
    _PnHt_Stat_AR_SpontanFlag = 1;
}
/*@@end*/

/*@@envVar:HMI_PnHt_CenCnsl_R_Actv:*/
on EnvVar HMI_PnHt_CenCnsl_R_Actv
{
    _mPnHt_Stat_AR.PnHt_CenCnsl_R_Actv.phys = getValue(this);
    _PnHt_Stat_AR_SpontanFlag = 1;
}
/*@@end*/

/*@@envVar:HMI_PnHt_Door_FL_Actv:*/
on EnvVar HMI_PnHt_Door_FL_Actv
{
    _mPnHt_Stat_AR.PnHt_Door_FL_Actv.phys = getValue(this);
    _PnHt_Stat_AR_SpontanFlag = 1;
}
/*@@end*/

/*@@envVar:HMI_PnHt_Door_FR_Actv:*/
on EnvVar HMI_PnHt_Door_FR_Actv
{
    _mPnHt_Stat_AR.PnHt_Door_FR_Actv.phys = getValue(this);
    _PnHt_Stat_AR_SpontanFlag = 1;
}
/*@@end*/

/*@@envVar:HMI_PnHt_Door_RL_Actv:*/
on EnvVar HMI_PnHt_Door_RL_Actv
{
    _mPnHt_Stat_AR.PnHt_Door_RL_Actv.phys = getValue(this);
    _PnHt_Stat_AR_SpontanFlag = 1;
}
/*@@end*/

/*@@envVar:HMI_PnHt_Door_RR_Actv:*/
on EnvVar HMI_PnHt_Door_RR_Actv
{
    _mPnHt_Stat_AR.PnHt_Door_RR_Actv.phys = getValue(this);
    _PnHt_Stat_AR_SpontanFlag = 1;
}
/*@@end*/

/*@@envVar:HMI_PnHt_PreCond2_Actv:*/
on EnvVar HMI_PnHt_PreCond2_Actv
{
    _mPnHt_Stat_AR.PnHt_PreCond2_Actv.phys = getValue(this);
    _PnHt_Stat_AR_SpontanFlag = 1;
}
/*@@end*/

/*@@caplFunc:PNHV_EnergyMngmnt_Disp_Rq_AR_check_output():*/
PNHV_EnergyMngmnt_Disp_Rq_AR_check_output()
{
    if( !getValue( HMI__STMSG_PNHV_EnergyMngmnt_Disp_Rq_AR ) )
    {
        // Botschaft PNHV_EnergyMngmnt_Disp_Rq_AR ID: 1061 --- Sendeart 5 cyclicAndSpontanWithDelay --- 
        _PNHV_EnergyMngmnt_Disp_Rq_AR_Cnt--;
        if( _PNHV_EnergyMngmnt_Disp_Rq_AR_Cnt < 1 )
        {
            PNHV_EnergyMngmnt_Disp_Rq_AR_output(); // Nachricht wg. abgelaufenem Zyklus ausgeben
            _PNHV_EnergyMngmnt_Disp_Rq_AR_Cnt = _PNHV_EnergyMngmnt_Disp_Rq_AR_CycleCount; // Zyklus-Zähler zurücksetzen
            _PNHV_EnergyMngmnt_Disp_Rq_AR_SpontanFlag = 0; // Spontan-Flag zurücksetzen
        }
        else if( _PNHV_EnergyMngmnt_Disp_Rq_AR_SpontanFlag)
        {
            PNHV_EnergyMngmnt_Disp_Rq_AR_output(); // Nachricht wg. spontaner Änderung ausgeben
            _PNHV_EnergyMngmnt_Disp_Rq_AR_SpontanFlag = 0; // Spontan-Flag zurücksetzen
        }
    }
}
/*@@end*/

/*@@caplFunc:PNHV_EnergyMngmnt_Disp_Rq_AR_init():*/
PNHV_EnergyMngmnt_Disp_Rq_AR_init()
{   /* Botschaft PNHV_EnergyMngmnt_Disp_Rq_AR ID: 1061 --- Sendeart 5 cyclicAndSpontanWithDelay --- 
BA_ "ApplMessage" BO_ 1061 0;
BA_ "NmAsrMessage" BO_ 1061 0;
BA_ "GenMsgMinAcceptLength" BO_ 1061 8;
BA_ "GenMsgILSupport" BO_ 1061 1;
BA_ "DiagState" BO_ 1061 0;
BA_ "DiagRequest" BO_ 1061 0;
BA_ "DiagResponse" BO_ 1061 0;
BA_ "GenMsgStartValue" BO_ 1061 "0";
BA_ "GenMsgDelayTime" BO_ 1061 100;
BA_ "GenMsgNrOfRepetition" BO_ 1061 0;
BA_ "GenMsgCycleTime" BO_ 1061 1000;
BA_ "GenMsgSendType" BO_ 1061 5;
    */
    _PNHV_EnergyMngmnt_Disp_Rq_AR_Timebase =           c_tDBKomTimer_20ms;
    _PNHV_EnergyMngmnt_Disp_Rq_AR_CycleCount =         100 / _PNHV_EnergyMngmnt_Disp_Rq_AR_Timebase;
    _PNHV_EnergyMngmnt_Disp_Rq_AR_StartDelay =           0 / _PNHV_EnergyMngmnt_Disp_Rq_AR_Timebase;
    _PNHV_EnergyMngmnt_Disp_Rq_AR_Cnt = _PNHV_EnergyMngmnt_Disp_Rq_AR_StartDelay;
    _PNHV_EnergyMngmnt_Disp_Rq_AR_SpontanFlag = 0;

    putValue( HMI__STMSGSD_PNHV_EnergyMngmnt_Disp_Rq_AR, _PNHV_EnergyMngmnt_Disp_Rq_AR_StartDelay *_PNHV_EnergyMngmnt_Disp_Rq_AR_Timebase );

    _mPNHV_EnergyMngmnt_Disp_Rq_AR.PNHV_ChrgEnergyFlow_Disp_Rq.phys = getValue( HMI_PNHV_ChrgEnergyFlow_Disp_Rq );
    _mPNHV_EnergyMngmnt_Disp_Rq_AR.PNHV_ChrgIcon_Disp_Rq.phys = getValue( HMI_PNHV_ChrgIcon_Disp_Rq );
    _mPNHV_EnergyMngmnt_Disp_Rq_AR.PNHV_ChrgPwr_Disp_Rq.phys = getValue( HMI_PNHV_ChrgPwr_Disp_Rq );
    _mPNHV_EnergyMngmnt_Disp_Rq_AR.PNHV_ChrgSrc_Type_Disp_Rq.phys = getValue( HMI_PNHV_ChrgSrc_Type_Disp_Rq );
    _mPNHV_EnergyMngmnt_Disp_Rq_AR.PNHV_ChrgStatInfo_Disp_Rq.phys = getValue( HMI_PNHV_ChrgStatInfo_Disp_Rq );
    _mPNHV_EnergyMngmnt_Disp_Rq_AR.PNHV_ConChrgPlug_MsgDisp_Rq.phys = getValue( HMI_PNHV_ConChrgPlug_MsgDisp_Rq );
    _mPNHV_EnergyMngmnt_Disp_Rq_AR.PNHV_EOC_Tm_Hour_Disp_Rq.phys = getValue( HMI_PNHV_EOC_Tm_Hour_Disp_Rq );
    _mPNHV_EnergyMngmnt_Disp_Rq_AR.PNHV_EOC_Tm_Minute_Disp_Rq.phys = getValue( HMI_PNHV_EOC_Tm_Minute_Disp_Rq );
    _mPNHV_EnergyMngmnt_Disp_Rq_AR.PNHV_EOC_Tm_WeekDay_Disp_Rq.phys = getValue( HMI_PNHV_EOC_Tm_WeekDay_Disp_Rq );
    _mPNHV_EnergyMngmnt_Disp_Rq_AR.PNHV_IC_Disp_On_Rq.phys = getValue( HMI_PNHV_IC_Disp_On_Rq );
}
/*@@end*/

/*@@caplFunc:PNHV_EnergyMngmnt_Disp_Rq_AR_output():*/
PNHV_EnergyMngmnt_Disp_Rq_AR_output(void)
{
    output( _mPNHV_EnergyMngmnt_Disp_Rq_AR );
}
/*@@end*/

/*@@caplFunc:PNHV_EnergyMngmnt_Disp_Rq_AR_saveEnvVars(dword):*/
PNHV_EnergyMngmnt_Disp_Rq_AR_saveEnvVars( dword hFile )
{
    filePutString("\n// Knoten EIS: PNHV_EnergyMngmnt_Disp_Rq_AR\n", 33, hFile );
    snprintf( buffer, elcount( buffer ), "0.0000 HMI__STMSG_PNHV_EnergyMngmnt_Disp_Rq_AR := %X\n", getValue( HMI__STMSG_PNHV_EnergyMngmnt_Disp_Rq_AR ) );    filePutString( buffer, elcount( buffer ), hFile );
    snprintf( buffer, elcount( buffer ), "0.0000 HMI__STMSGT_PNHV_EnergyMngmnt_Disp_Rq_AR := %X\n", getValue( HMI__STMSGT_PNHV_EnergyMngmnt_Disp_Rq_AR ) );    filePutString( buffer, elcount( buffer ), hFile );
    snprintf( buffer, elcount( buffer ), "0.0000 HMI_PNHV_ChrgEnergyFlow_Disp_Rq := %X\n", getValue( HMI_PNHV_ChrgEnergyFlow_Disp_Rq ) );    filePutString( buffer, elcount( buffer ), hFile );
    snprintf( buffer, elcount( buffer ), "0.0000 HMI_PNHV_ChrgIcon_Disp_Rq := %X\n", getValue( HMI_PNHV_ChrgIcon_Disp_Rq ) );    filePutString( buffer, elcount( buffer ), hFile );
    snprintf( buffer, elcount( buffer ), "0.0000 HMI_PNHV_ChrgPwr_Disp_Rq := %X\n", getValue( HMI_PNHV_ChrgPwr_Disp_Rq ) );    filePutString( buffer, elcount( buffer ), hFile );
    snprintf( buffer, elcount( buffer ), "0.0000 HMI_PNHV_ChrgSrc_Type_Disp_Rq := %X\n", getValue( HMI_PNHV_ChrgSrc_Type_Disp_Rq ) );    filePutString( buffer, elcount( buffer ), hFile );
    snprintf( buffer, elcount( buffer ), "0.0000 HMI_PNHV_ChrgStatInfo_Disp_Rq := %X\n", getValue( HMI_PNHV_ChrgStatInfo_Disp_Rq ) );    filePutString( buffer, elcount( buffer ), hFile );
    snprintf( buffer, elcount( buffer ), "0.0000 HMI_PNHV_ConChrgPlug_MsgDisp_Rq := %X\n", getValue( HMI_PNHV_ConChrgPlug_MsgDisp_Rq ) );    filePutString( buffer, elcount( buffer ), hFile );
    snprintf( buffer, elcount( buffer ), "0.0000 HMI_PNHV_EOC_Tm_Hour_Disp_Rq := %X\n", getValue( HMI_PNHV_EOC_Tm_Hour_Disp_Rq ) );    filePutString( buffer, elcount( buffer ), hFile );
    snprintf( buffer, elcount( buffer ), "0.0000 HMI_PNHV_EOC_Tm_Minute_Disp_Rq := %X\n", getValue( HMI_PNHV_EOC_Tm_Minute_Disp_Rq ) );    filePutString( buffer, elcount( buffer ), hFile );
    snprintf( buffer, elcount( buffer ), "0.0000 HMI_PNHV_EOC_Tm_WeekDay_Disp_Rq := %X\n", getValue( HMI_PNHV_EOC_Tm_WeekDay_Disp_Rq ) );    filePutString( buffer, elcount( buffer ), hFile );
    snprintf( buffer, elcount( buffer ), "0.0000 HMI_PNHV_IC_Disp_On_Rq := %X\n", getValue( HMI_PNHV_IC_Disp_On_Rq ) );    filePutString( buffer, elcount( buffer ), hFile );
}
/*@@end*/

/*@@timer:_tPNHV_EnergyMngmnt_Disp_Rq_AR:*/
on timer _tPNHV_EnergyMngmnt_Disp_Rq_AR
{
    putValue( HMI__STMSG_PNHV_EnergyMngmnt_Disp_Rq_AR, 0 );
}
/*@@end*/

/*@@envVar:HMI__STMSG_PNHV_EnergyMngmnt_Disp_Rq_AR:*/
on EnvVar HMI__STMSG_PNHV_EnergyMngmnt_Disp_Rq_AR
{
    long tDelay;
    if( getValue( this ) == 2 )
    {
        tDelay = getValue( HMI__STMSGT_PNHV_EnergyMngmnt_Disp_Rq_AR );
        if( tDelay > 0)    
            setTimer( _tPNHV_EnergyMngmnt_Disp_Rq_AR, tDelay );
        else
            putValue( HMI__STMSG_PNHV_EnergyMngmnt_Disp_Rq_AR, 0 );
    }
}
/*@@end*/

/*@@envVar:HMI_PNHV_ChrgEnergyFlow_Disp_Rq:*/
on EnvVar HMI_PNHV_ChrgEnergyFlow_Disp_Rq
{
    _mPNHV_EnergyMngmnt_Disp_Rq_AR.PNHV_ChrgEnergyFlow_Disp_Rq.phys = getValue(this);
    _PNHV_EnergyMngmnt_Disp_Rq_AR_SpontanFlag = 1;
}
/*@@end*/

/*@@envVar:HMI_PNHV_ChrgIcon_Disp_Rq:*/
on EnvVar HMI_PNHV_ChrgIcon_Disp_Rq
{
    _mPNHV_EnergyMngmnt_Disp_Rq_AR.PNHV_ChrgIcon_Disp_Rq.phys = getValue(this);
    _PNHV_EnergyMngmnt_Disp_Rq_AR_SpontanFlag = 1;
}
/*@@end*/

/*@@envVar:HMI_PNHV_ChrgPwr_Disp_Rq:*/
on EnvVar HMI_PNHV_ChrgPwr_Disp_Rq
{
    _mPNHV_EnergyMngmnt_Disp_Rq_AR.PNHV_ChrgPwr_Disp_Rq.phys = getValue(this);
    _PNHV_EnergyMngmnt_Disp_Rq_AR_SpontanFlag = 1;
}
/*@@end*/

/*@@envVar:HMI_PNHV_ChrgSrc_Type_Disp_Rq:*/
on EnvVar HMI_PNHV_ChrgSrc_Type_Disp_Rq
{
    _mPNHV_EnergyMngmnt_Disp_Rq_AR.PNHV_ChrgSrc_Type_Disp_Rq.phys = getValue(this);
    _PNHV_EnergyMngmnt_Disp_Rq_AR_SpontanFlag = 1;
}
/*@@end*/

/*@@envVar:HMI_PNHV_ChrgStatInfo_Disp_Rq:*/
on EnvVar HMI_PNHV_ChrgStatInfo_Disp_Rq
{
    _mPNHV_EnergyMngmnt_Disp_Rq_AR.PNHV_ChrgStatInfo_Disp_Rq.phys = getValue(this);
    _PNHV_EnergyMngmnt_Disp_Rq_AR_SpontanFlag = 1;
}
/*@@end*/

/*@@envVar:HMI_PNHV_ConChrgPlug_MsgDisp_Rq:*/
on EnvVar HMI_PNHV_ConChrgPlug_MsgDisp_Rq
{
    _mPNHV_EnergyMngmnt_Disp_Rq_AR.PNHV_ConChrgPlug_MsgDisp_Rq.phys = getValue(this);
    _PNHV_EnergyMngmnt_Disp_Rq_AR_SpontanFlag = 1;
}
/*@@end*/

/*@@envVar:HMI_PNHV_EOC_Tm_Hour_Disp_Rq:*/
on EnvVar HMI_PNHV_EOC_Tm_Hour_Disp_Rq
{
    _mPNHV_EnergyMngmnt_Disp_Rq_AR.PNHV_EOC_Tm_Hour_Disp_Rq.phys = getValue(this);
    _PNHV_EnergyMngmnt_Disp_Rq_AR_SpontanFlag = 1;
}
/*@@end*/

/*@@envVar:HMI_PNHV_EOC_Tm_Minute_Disp_Rq:*/
on EnvVar HMI_PNHV_EOC_Tm_Minute_Disp_Rq
{
    _mPNHV_EnergyMngmnt_Disp_Rq_AR.PNHV_EOC_Tm_Minute_Disp_Rq.phys = getValue(this);
    _PNHV_EnergyMngmnt_Disp_Rq_AR_SpontanFlag = 1;
}
/*@@end*/

/*@@envVar:HMI_PNHV_EOC_Tm_WeekDay_Disp_Rq:*/
on EnvVar HMI_PNHV_EOC_Tm_WeekDay_Disp_Rq
{
    _mPNHV_EnergyMngmnt_Disp_Rq_AR.PNHV_EOC_Tm_WeekDay_Disp_Rq.phys = getValue(this);
    _PNHV_EnergyMngmnt_Disp_Rq_AR_SpontanFlag = 1;
}
/*@@end*/

/*@@envVar:HMI_PNHV_IC_Disp_On_Rq:*/
on EnvVar HMI_PNHV_IC_Disp_On_Rq
{
    _mPNHV_EnergyMngmnt_Disp_Rq_AR.PNHV_IC_Disp_On_Rq.phys = getValue(this);
    _PNHV_EnergyMngmnt_Disp_Rq_AR_SpontanFlag = 1;
}
/*@@end*/

/*@@caplFunc:PNHV_EnergyMngmnt_Stat2_AR_check_output():*/
PNHV_EnergyMngmnt_Stat2_AR_check_output()
{
    if( !getValue( HMI__STMSG_PNHV_EnergyMngmnt_Stat2_AR ) )
    {
        // Botschaft PNHV_EnergyMngmnt_Stat2_AR ID: 339 --- Sendeart 5 cyclicAndSpontanWithDelay --- 
        _PNHV_EnergyMngmnt_Stat2_AR_Cnt--;
        if( _PNHV_EnergyMngmnt_Stat2_AR_Cnt < 1 )
        {
            PNHV_EnergyMngmnt_Stat2_AR_output(); // Nachricht wg. abgelaufenem Zyklus ausgeben
            _PNHV_EnergyMngmnt_Stat2_AR_Cnt = _PNHV_EnergyMngmnt_Stat2_AR_CycleCount; // Zyklus-Zähler zurücksetzen
            _PNHV_EnergyMngmnt_Stat2_AR_SpontanFlag = 0; // Spontan-Flag zurücksetzen
        }
        else if( _PNHV_EnergyMngmnt_Stat2_AR_SpontanFlag)
        {
            PNHV_EnergyMngmnt_Stat2_AR_output(); // Nachricht wg. spontaner Änderung ausgeben
            _PNHV_EnergyMngmnt_Stat2_AR_SpontanFlag = 0; // Spontan-Flag zurücksetzen
        }
    }
}
/*@@end*/

/*@@caplFunc:PNHV_EnergyMngmnt_Stat2_AR_init():*/
PNHV_EnergyMngmnt_Stat2_AR_init()
{   /* Botschaft PNHV_EnergyMngmnt_Stat2_AR ID: 339 --- Sendeart 5 cyclicAndSpontanWithDelay --- 
BA_ "ApplMessage" BO_ 339 0;
BA_ "NmAsrMessage" BO_ 339 0;
BA_ "GenMsgMinAcceptLength" BO_ 339 8;
BA_ "GenMsgILSupport" BO_ 339 1;
BA_ "DiagState" BO_ 339 0;
BA_ "DiagRequest" BO_ 339 0;
BA_ "DiagResponse" BO_ 339 0;
BA_ "GenMsgStartValue" BO_ 339 "0";
BA_ "GenMsgDelayTime" BO_ 339 10;
BA_ "GenMsgNrOfRepetitions" BO_ 339 0;
BA_ "GenMsgCycleTime" BO_ 339 100;
BA_ "GenMsgSendType" BO_ 339 5;
    */
    _PNHV_EnergyMngmnt_Stat2_AR_Timebase =           c_tDBKomTimer_20ms;
    _PNHV_EnergyMngmnt_Stat2_AR_CycleCount =         100 / _PNHV_EnergyMngmnt_Stat2_AR_Timebase;
    _PNHV_EnergyMngmnt_Stat2_AR_StartDelay =           0 / _PNHV_EnergyMngmnt_Stat2_AR_Timebase;
    _PNHV_EnergyMngmnt_Stat2_AR_Cnt = _PNHV_EnergyMngmnt_Stat2_AR_StartDelay;
    _PNHV_EnergyMngmnt_Stat2_AR_SpontanFlag = 0;

    putValue( HMI__STMSGSD_PNHV_EnergyMngmnt_Stat2_AR, _PNHV_EnergyMngmnt_Stat2_AR_StartDelay *_PNHV_EnergyMngmnt_Stat2_AR_Timebase );

    _mPNHV_EnergyMngmnt_Stat2_AR.DCDC_PNHV_GrndStrpFlt_Disp_Rq.phys = getValue( HMI_DCDC_PNHV_GrndStrpFlt_Disp_Rq );
    _mPNHV_EnergyMngmnt_Stat2_AR.EAC_MaxCurr.phys = getValue( HMI_EAC_MaxCurr );
    _mPNHV_EnergyMngmnt_Stat2_AR.EAC_MinVolt_V2.phys = getValue( HMI_EAC_MinVolt_V2 );
    _mPNHV_EnergyMngmnt_Stat2_AR.EMM_PosnInfo_Disp_Rq.phys = getValue( HMI_EMM_PosnInfo_Disp_Rq );
    _mPNHV_EnergyMngmnt_Stat2_AR.EMM_PosnTxt_Disp_Rq.phys = getValue( HMI_EMM_PosnTxt_Disp_Rq );
    _mPNHV_EnergyMngmnt_Stat2_AR.EMM_WPT_ManSet_Stat.phys = getValue( HMI_EMM_WPT_ManSet_Stat );
    _mPNHV_EnergyMngmnt_Stat2_AR.PNHV_Bat_Curr_Disp_Rq.phys = getValue( HMI_PNHV_Bat_Curr_Disp_Rq );
    _mPNHV_EnergyMngmnt_Stat2_AR.PNHV_Bat_VoltMax_Disp_Rq.phys = getValue( HMI_PNHV_Bat_VoltMax_Disp_Rq );
    _mPNHV_EnergyMngmnt_Stat2_AR.PNHV_VoltDn_Disp_Rq.phys = getValue( HMI_PNHV_VoltDn_Disp_Rq );
    _mPNHV_EnergyMngmnt_Stat2_AR.Term61_Actv_UB.phys = getValue( HMI_Term61_Actv_UB );
    _mPNHV_EnergyMngmnt_Stat2_AR.Term61_Actv.phys = getValue( HMI_Term61_Actv );
}
/*@@end*/

/*@@caplFunc:PNHV_EnergyMngmnt_Stat2_AR_output():*/
PNHV_EnergyMngmnt_Stat2_AR_output(void)
{
    output( _mPNHV_EnergyMngmnt_Stat2_AR );
}
/*@@end*/

/*@@caplFunc:PNHV_EnergyMngmnt_Stat2_AR_saveEnvVars(dword):*/
PNHV_EnergyMngmnt_Stat2_AR_saveEnvVars( dword hFile )
{
    filePutString("\n// Knoten EIS: PNHV_EnergyMngmnt_Stat2_AR\n", 33, hFile );
    snprintf( buffer, elcount( buffer ), "0.0000 HMI__STMSG_PNHV_EnergyMngmnt_Stat2_AR := %X\n", getValue( HMI__STMSG_PNHV_EnergyMngmnt_Stat2_AR ) );    filePutString( buffer, elcount( buffer ), hFile );
    snprintf( buffer, elcount( buffer ), "0.0000 HMI__STMSGT_PNHV_EnergyMngmnt_Stat2_AR := %X\n", getValue( HMI__STMSGT_PNHV_EnergyMngmnt_Stat2_AR ) );    filePutString( buffer, elcount( buffer ), hFile );
    snprintf( buffer, elcount( buffer ), "0.0000 HMI_DCDC_PNHV_GrndStrpFlt_Disp_Rq := %X\n", getValue( HMI_DCDC_PNHV_GrndStrpFlt_Disp_Rq ) );    filePutString( buffer, elcount( buffer ), hFile );
    snprintf( buffer, elcount( buffer ), "0.0000 HMI_EAC_MaxCurr := %X\n", getValue( HMI_EAC_MaxCurr ) );    filePutString( buffer, elcount( buffer ), hFile );
    snprintf( buffer, elcount( buffer ), "0.0000 HMI_EAC_MinVolt_V2 := %X\n", getValue( HMI_EAC_MinVolt_V2 ) );    filePutString( buffer, elcount( buffer ), hFile );
    snprintf( buffer, elcount( buffer ), "0.0000 HMI_EMM_PosnInfo_Disp_Rq := %X\n", getValue( HMI_EMM_PosnInfo_Disp_Rq ) );    filePutString( buffer, elcount( buffer ), hFile );
    snprintf( buffer, elcount( buffer ), "0.0000 HMI_EMM_PosnTxt_Disp_Rq := %X\n", getValue( HMI_EMM_PosnTxt_Disp_Rq ) );    filePutString( buffer, elcount( buffer ), hFile );
    snprintf( buffer, elcount( buffer ), "0.0000 HMI_EMM_WPT_ManSet_Stat := %X\n", getValue( HMI_EMM_WPT_ManSet_Stat ) );    filePutString( buffer, elcount( buffer ), hFile );
    snprintf( buffer, elcount( buffer ), "0.0000 HMI_PNHV_Bat_Curr_Disp_Rq := %X\n", getValue( HMI_PNHV_Bat_Curr_Disp_Rq ) );    filePutString( buffer, elcount( buffer ), hFile );
    snprintf( buffer, elcount( buffer ), "0.0000 HMI_PNHV_Bat_VoltMax_Disp_Rq := %X\n", getValue( HMI_PNHV_Bat_VoltMax_Disp_Rq ) );    filePutString( buffer, elcount( buffer ), hFile );
    snprintf( buffer, elcount( buffer ), "0.0000 HMI_PNHV_VoltDn_Disp_Rq := %X\n", getValue( HMI_PNHV_VoltDn_Disp_Rq ) );    filePutString( buffer, elcount( buffer ), hFile );
    snprintf( buffer, elcount( buffer ), "0.0000 HMI_Term61_Actv := %X\n", getValue( HMI_Term61_Actv ) );    filePutString( buffer, elcount( buffer ), hFile );
    snprintf( buffer, elcount( buffer ), "0.0000 HMI_Term61_Actv_UB := %X\n", getValue( HMI_Term61_Actv_UB ) );    filePutString( buffer, elcount( buffer ), hFile );
}
/*@@end*/

/*@@timer:_tPNHV_EnergyMngmnt_Stat2_AR:*/
on timer _tPNHV_EnergyMngmnt_Stat2_AR
{
    putValue( HMI__STMSG_PNHV_EnergyMngmnt_Stat2_AR, 0 );
}
/*@@end*/

/*@@envVar:HMI__STMSG_PNHV_EnergyMngmnt_Stat2_AR:*/
on EnvVar HMI__STMSG_PNHV_EnergyMngmnt_Stat2_AR
{
    long tDelay;
    if( getValue( this ) == 2 )
    {
        tDelay = getValue( HMI__STMSGT_PNHV_EnergyMngmnt_Stat2_AR );
        if( tDelay > 0)    
            setTimer( _tPNHV_EnergyMngmnt_Stat2_AR, tDelay );
        else
            putValue( HMI__STMSG_PNHV_EnergyMngmnt_Stat2_AR, 0 );
    }
}
/*@@end*/

/*@@envVar:HMI_DCDC_PNHV_GrndStrpFlt_Disp_Rq:*/
on EnvVar HMI_DCDC_PNHV_GrndStrpFlt_Disp_Rq
{
    _mPNHV_EnergyMngmnt_Stat2_AR.DCDC_PNHV_GrndStrpFlt_Disp_Rq.phys = getValue(this);
    _PNHV_EnergyMngmnt_Stat2_AR_SpontanFlag = 1;
}
/*@@end*/

/*@@envVar:HMI_EAC_MaxCurr:*/
on EnvVar HMI_EAC_MaxCurr
{
    _mPNHV_EnergyMngmnt_Stat2_AR.EAC_MaxCurr.phys = getValue(this);
    _PNHV_EnergyMngmnt_Stat2_AR_SpontanFlag = 1;
}
/*@@end*/

/*@@envVar:HMI_EAC_MinVolt_V2:*/
on EnvVar HMI_EAC_MinVolt_V2
{
    _mPNHV_EnergyMngmnt_Stat2_AR.EAC_MinVolt_V2.phys = getValue(this);
    _PNHV_EnergyMngmnt_Stat2_AR_SpontanFlag = 1;
}
/*@@end*/

/*@@envVar:HMI_EMM_PosnInfo_Disp_Rq:*/
on EnvVar HMI_EMM_PosnInfo_Disp_Rq
{
    _mPNHV_EnergyMngmnt_Stat2_AR.EMM_PosnInfo_Disp_Rq.phys = getValue(this);
    _PNHV_EnergyMngmnt_Stat2_AR_SpontanFlag = 1;
}
/*@@end*/

/*@@envVar:HMI_EMM_PosnTxt_Disp_Rq:*/
on EnvVar HMI_EMM_PosnTxt_Disp_Rq
{
    _mPNHV_EnergyMngmnt_Stat2_AR.EMM_PosnTxt_Disp_Rq.phys = getValue(this);
    _PNHV_EnergyMngmnt_Stat2_AR_SpontanFlag = 1;
}
/*@@end*/

/*@@envVar:HMI_EMM_WPT_ManSet_Stat:*/
on EnvVar HMI_EMM_WPT_ManSet_Stat
{
    _mPNHV_EnergyMngmnt_Stat2_AR.EMM_WPT_ManSet_Stat.phys = getValue(this);
    _PNHV_EnergyMngmnt_Stat2_AR_SpontanFlag = 1;
}
/*@@end*/

/*@@envVar:HMI_PNHV_Bat_Curr_Disp_Rq:*/
on EnvVar HMI_PNHV_Bat_Curr_Disp_Rq
{
    _mPNHV_EnergyMngmnt_Stat2_AR.PNHV_Bat_Curr_Disp_Rq.phys = getValue(this);
    _PNHV_EnergyMngmnt_Stat2_AR_SpontanFlag = 1;
}
/*@@end*/

/*@@envVar:HMI_PNHV_Bat_VoltMax_Disp_Rq:*/
on EnvVar HMI_PNHV_Bat_VoltMax_Disp_Rq
{
    _mPNHV_EnergyMngmnt_Stat2_AR.PNHV_Bat_VoltMax_Disp_Rq.phys = getValue(this);
    _PNHV_EnergyMngmnt_Stat2_AR_SpontanFlag = 1;
}
/*@@end*/

/*@@envVar:HMI_PNHV_VoltDn_Disp_Rq:*/
on EnvVar HMI_PNHV_VoltDn_Disp_Rq
{
    _mPNHV_EnergyMngmnt_Stat2_AR.PNHV_VoltDn_Disp_Rq.phys = getValue(this);
    _PNHV_EnergyMngmnt_Stat2_AR_SpontanFlag = 1;
}
/*@@end*/

/*@@envVar:HMI_Term61_Actv:*/
on EnvVar HMI_Term61_Actv
{
    _mPNHV_EnergyMngmnt_Stat2_AR.Term61_Actv.phys = getValue(this);
    _PNHV_EnergyMngmnt_Stat2_AR_SpontanFlag = 1;
}
/*@@end*/

/*@@envVar:HMI_Term61_Actv_UB:*/
on EnvVar HMI_Term61_Actv_UB
{
    _mPNHV_EnergyMngmnt_Stat2_AR.Term61_Actv_UB.phys = getValue(this);
    _PNHV_EnergyMngmnt_Stat2_AR_SpontanFlag = 1;
}
/*@@end*/

/*@@caplFunc:PNHV_EnergyMngmntSet_Rs1_AR_check_output():*/
PNHV_EnergyMngmntSet_Rs1_AR_check_output()
{
    if( !getValue( HMI__STMSG_PNHV_EnergyMngmntSet_Rs1_AR ) )
    {
        // Botschaft PNHV_EnergyMngmntSet_Rs1_AR ID: 1155 --- Sendeart 5 cyclicAndSpontanWithDelay --- 
        if( _PNHV_EnergyMngmntSet_Rs1_AR_DelayCnt > 0) _PNHV_EnergyMngmntSet_Rs1_AR_DelayCnt--; // Mindestsendeabstand
        _PNHV_EnergyMngmntSet_Rs1_AR_Cnt--;
        if( _PNHV_EnergyMngmntSet_Rs1_AR_Cnt < 1 )
        {
            if( _PNHV_EnergyMngmntSet_Rs1_AR_DelayCnt < 1 )
            {
                PNHV_EnergyMngmntSet_Rs1_AR_output(); // Nachricht wg. abgelaufenem Zyklus ausgeben (Mindestsendeabstand eingehalten)
                _PNHV_EnergyMngmntSet_Rs1_AR_SpontanFlag = 0; // Spontan-Flag zurücksetzen
                _PNHV_EnergyMngmntSet_Rs1_AR_DelayCnt = _PNHV_EnergyMngmntSet_Rs1_AR_MinDelay;
            }
            else
            {
                // Spontanflag setzen damit nach Ablauf Mindestsendeabstand gesendet wird
                 _PNHV_EnergyMngmntSet_Rs1_AR_SpontanFlag = 1;
            }
            _PNHV_EnergyMngmntSet_Rs1_AR_Cnt = _PNHV_EnergyMngmntSet_Rs1_AR_CycleCount; // Zyklus-Zähler zurücksetzen
        }
        else if( _PNHV_EnergyMngmntSet_Rs1_AR_SpontanFlag)
        {
            if( _PNHV_EnergyMngmntSet_Rs1_AR_DelayCnt < 1 )
            {
                PNHV_EnergyMngmntSet_Rs1_AR_output(); // Nachricht wg. spontaner Änderung ausgeben (Mindestsendeabstand eingehalten)
                _PNHV_EnergyMngmntSet_Rs1_AR_SpontanFlag = 0; // Spontan-Flag zurücksetzen
                _PNHV_EnergyMngmntSet_Rs1_AR_DelayCnt = _PNHV_EnergyMngmntSet_Rs1_AR_MinDelay;
            }
        }
    }
}
/*@@end*/

/*@@caplFunc:PNHV_EnergyMngmntSet_Rs1_AR_init():*/
PNHV_EnergyMngmntSet_Rs1_AR_init()
{   /* Botschaft PNHV_EnergyMngmntSet_Rs1_AR ID: 1155 --- Sendeart 5 cyclicAndSpontanWithDelay --- 
BA_ "ApplMessage" BO_ 1155 0;
BA_ "NmAsrMessage" BO_ 1155 0;
BA_ "GenMsgMinAcceptLength" BO_ 1155 8;
BA_ "GenMsgILSupport" BO_ 1155 1;
BA_ "DiagState" BO_ 1155 0;
BA_ "DiagRequest" BO_ 1155 0;
BA_ "DiagResponse" BO_ 1155 0;
BA_ "GenMsgStartValue" BO_ 1155 "0";
BA_ "GenMsgDelayTime" BO_ 1155 100;
BA_ "GenMsgNrOfRepetitions" BO_ 1155 0;
BA_ "GenMsgCycleTime" BO_ 1155 1000;
BA_ "GenMsgSendType" BO_ 1155 5;
    */
    _PNHV_EnergyMngmntSet_Rs1_AR_Timebase =           c_tDBKomTimer_20ms;
    _PNHV_EnergyMngmntSet_Rs1_AR_CycleCount =       1000 / _PNHV_EnergyMngmntSet_Rs1_AR_Timebase;
    _PNHV_EnergyMngmntSet_Rs1_AR_StartDelay =          0 / _PNHV_EnergyMngmntSet_Rs1_AR_Timebase;
    _PNHV_EnergyMngmntSet_Rs1_AR_MinDelay =          100 / _PNHV_EnergyMngmntSet_Rs1_AR_Timebase;
    _PNHV_EnergyMngmntSet_Rs1_AR_Cnt = _PNHV_EnergyMngmntSet_Rs1_AR_StartDelay;
    _PNHV_EnergyMngmntSet_Rs1_AR_SpontanFlag = 0;
    _PNHV_EnergyMngmntSet_Rs1_AR_DelayCnt = 0;

    putValue( HMI__STMSGSD_PNHV_EnergyMngmntSet_Rs1_AR, _PNHV_EnergyMngmntSet_Rs1_AR_StartDelay * _PNHV_EnergyMngmntSet_Rs1_AR_Timebase );

    _mPNHV_EnergyMngmntSet_Rs1_AR.HDC_IHS_Disp_Rq.phys = getValue( HMI_HDC_IHS_Disp_Rq );
    _mPNHV_EnergyMngmntSet_Rs1_AR.HPPRM_EffDisp_Rq.phys = getValue( HMI_HPPRM_EffDisp_Rq );
    _mPNHV_EnergyMngmntSet_Rs1_AR.HPPRM_IconDisp_Rq.phys = getValue( HMI_HPPRM_IconDisp_Rq );
    _mPNHV_EnergyMngmntSet_Rs1_AR.Hyb_Msg_Disp_Rq.phys = getValue( HMI_Hyb_Msg_Disp_Rq );
    _mPNHV_EnergyMngmntSet_Rs1_AR.PNHV_AC_Curr_Max.phys = getValue( HMI_PNHV_AC_Curr_Max );
    _mPNHV_EnergyMngmntSet_Rs1_AR.PNHV_ChrgTmDisp_WeekDay.phys = getValue( HMI_PNHV_ChrgTmDisp_WeekDay );
    _mPNHV_EnergyMngmntSet_Rs1_AR.PNHV_ConChrgPlug_Disp_Rq.phys = getValue( HMI_PNHV_ConChrgPlug_Disp_Rq );
    _mPNHV_EnergyMngmntSet_Rs1_AR.PNHV_DepTm_Actv.phys = getValue( HMI_PNHV_DepTm_Actv );
    _mPNHV_EnergyMngmntSet_Rs1_AR.PNHV_DepTm_Avl_Stat.phys = getValue( HMI_PNHV_DepTm_Avl_Stat );
    _mPNHV_EnergyMngmntSet_Rs1_AR.PNHV_DepTm_Icon_Disp_Rq.phys = getValue( HMI_PNHV_DepTm_Icon_Disp_Rq );
    _mPNHV_EnergyMngmntSet_Rs1_AR.PNHV_DepTmManSet_Hour_Stat.phys = getValue( HMI_PNHV_DepTmManSet_Hour_Stat );
    _mPNHV_EnergyMngmntSet_Rs1_AR.PNHV_DepTmManSet_Minute_Stat.phys = getValue( HMI_PNHV_DepTmManSet_Minute_Stat );
    _mPNHV_EnergyMngmntSet_Rs1_AR.PNHV_PreCond1_ManSet_Stat.phys = getValue( HMI_PNHV_PreCond1_ManSet_Stat );
    _mPNHV_EnergyMngmntSet_Rs1_AR.PNHV_PreCond2_Dur.phys = getValue( HMI_PNHV_PreCond2_Dur );
    _mPNHV_EnergyMngmntSet_Rs1_AR.PNHV_PreCond2_ManSet_Icon_Disp_Rq.phys = getValue( HMI_PNHV_PreCond2_ManSet_Icon_Disp_Rq );
    _mPNHV_EnergyMngmntSet_Rs1_AR.PNHV_PreCond2_ManSet_Stat.phys = getValue( HMI_PNHV_PreCond2_ManSet_Stat );
}
/*@@end*/

/*@@caplFunc:PNHV_EnergyMngmntSet_Rs1_AR_output():*/
PNHV_EnergyMngmntSet_Rs1_AR_output()
{
    output( _mPNHV_EnergyMngmntSet_Rs1_AR );
}
/*@@end*/

/*@@caplFunc:PNHV_EnergyMngmntSet_Rs1_AR_saveEnvVars(dword):*/
PNHV_EnergyMngmntSet_Rs1_AR_saveEnvVars( dword hFile )
{
    filePutString("\n// Knoten EIS: PNHV_EnergyMngmntSet_Rs1_AR\n", 33, hFile );
    snprintf( buffer, elcount( buffer ), "0.0000 HMI__STMSG_PNHV_EnergyMngmntSet_Rs1_AR := %X\n", getValue( HMI__STMSG_PNHV_EnergyMngmntSet_Rs1_AR ) );    filePutString( buffer, elcount( buffer ), hFile );
    snprintf( buffer, elcount( buffer ), "0.0000 HMI__STMSGT_PNHV_EnergyMngmntSet_Rs1_AR := %X\n", getValue( HMI__STMSGT_PNHV_EnergyMngmntSet_Rs1_AR ) );    filePutString( buffer, elcount( buffer ), hFile );
    snprintf( buffer, elcount( buffer ), "0.0000 HMI_HDC_IHS_Disp_Rq := %X\n", getValue( HMI_HDC_IHS_Disp_Rq ) );    filePutString( buffer, elcount( buffer ), hFile );
    snprintf( buffer, elcount( buffer ), "0.0000 HMI_HPPRM_EffDisp_Rq := %X\n", getValue( HMI_HPPRM_EffDisp_Rq ) );    filePutString( buffer, elcount( buffer ), hFile );
    snprintf( buffer, elcount( buffer ), "0.0000 HMI_HPPRM_IconDisp_Rq := %X\n", getValue( HMI_HPPRM_IconDisp_Rq ) );    filePutString( buffer, elcount( buffer ), hFile );
    snprintf( buffer, elcount( buffer ), "0.0000 HMI_Hyb_Msg_Disp_Rq := %X\n", getValue( HMI_Hyb_Msg_Disp_Rq ) );    filePutString( buffer, elcount( buffer ), hFile );
    snprintf( buffer, elcount( buffer ), "0.0000 HMI_PNHV_AC_Curr_Max := %X\n", getValue( HMI_PNHV_AC_Curr_Max ) );    filePutString( buffer, elcount( buffer ), hFile );
    snprintf( buffer, elcount( buffer ), "0.0000 HMI_PNHV_ChrgTmDisp_WeekDay := %X\n", getValue( HMI_PNHV_ChrgTmDisp_WeekDay ) );    filePutString( buffer, elcount( buffer ), hFile );
    snprintf( buffer, elcount( buffer ), "0.0000 HMI_PNHV_ConChrgPlug_Disp_Rq := %X\n", getValue( HMI_PNHV_ConChrgPlug_Disp_Rq ) );    filePutString( buffer, elcount( buffer ), hFile );
    snprintf( buffer, elcount( buffer ), "0.0000 HMI_PNHV_DepTm_Actv := %X\n", getValue( HMI_PNHV_DepTm_Actv ) );    filePutString( buffer, elcount( buffer ), hFile );
    snprintf( buffer, elcount( buffer ), "0.0000 HMI_PNHV_DepTm_Avl_Stat := %X\n", getValue( HMI_PNHV_DepTm_Avl_Stat ) );    filePutString( buffer, elcount( buffer ), hFile );
    snprintf( buffer, elcount( buffer ), "0.0000 HMI_PNHV_DepTm_Icon_Disp_Rq := %X\n", getValue( HMI_PNHV_DepTm_Icon_Disp_Rq ) );    filePutString( buffer, elcount( buffer ), hFile );
    snprintf( buffer, elcount( buffer ), "0.0000 HMI_PNHV_DepTmManSet_Hour_Stat := %X\n", getValue( HMI_PNHV_DepTmManSet_Hour_Stat ) );    filePutString( buffer, elcount( buffer ), hFile );
    snprintf( buffer, elcount( buffer ), "0.0000 HMI_PNHV_DepTmManSet_Minute_Stat := %X\n", getValue( HMI_PNHV_DepTmManSet_Minute_Stat ) );    filePutString( buffer, elcount( buffer ), hFile );
    snprintf( buffer, elcount( buffer ), "0.0000 HMI_PNHV_PreCond1_ManSet_Stat := %X\n", getValue( HMI_PNHV_PreCond1_ManSet_Stat ) );    filePutString( buffer, elcount( buffer ), hFile );
    snprintf( buffer, elcount( buffer ), "0.0000 HMI_PNHV_PreCond2_Dur := %X\n", getValue( HMI_PNHV_PreCond2_Dur ) );    filePutString( buffer, elcount( buffer ), hFile );
    snprintf( buffer, elcount( buffer ), "0.0000 HMI_PNHV_PreCond2_ManSet_Icon_Disp_Rq := %X\n", getValue( HMI_PNHV_PreCond2_ManSet_Icon_Disp_Rq ) );    filePutString( buffer, elcount( buffer ), hFile );
    snprintf( buffer, elcount( buffer ), "0.0000 HMI_PNHV_PreCond2_ManSet_Stat := %X\n", getValue( HMI_PNHV_PreCond2_ManSet_Stat ) );    filePutString( buffer, elcount( buffer ), hFile );
}
/*@@end*/

/*@@timer:_tPNHV_EnergyMngmntSet_Rs1_AR:*/
on timer _tPNHV_EnergyMngmntSet_Rs1_AR
{
    putValue( HMI__STMSG_PNHV_EnergyMngmntSet_Rs1_AR, 0 );
}
/*@@end*/

/*@@envVar:HMI__STMSG_PNHV_EnergyMngmntSet_Rs1_AR:*/
on EnvVar HMI__STMSG_PNHV_EnergyMngmntSet_Rs1_AR
{
    long tDelay;
    if( getValue( this ) == 2 )
    {
        tDelay = getValue( HMI__STMSGT_PNHV_EnergyMngmntSet_Rs1_AR );
        if( tDelay > 0)    
            setTimer( _tPNHV_EnergyMngmntSet_Rs1_AR, tDelay );
        else
            putValue( HMI__STMSG_PNHV_EnergyMngmntSet_Rs1_AR, 0 );
    }
}
/*@@end*/

/*@@envVar:HMI_HDC_IHS_Disp_Rq:*/
on EnvVar HMI_HDC_IHS_Disp_Rq 
{
    _mPNHV_EnergyMngmntSet_Rs1_AR.HDC_IHS_Disp_Rq.phys = getValue(this);
    _PNHV_EnergyMngmntSet_Rs1_AR_SpontanFlag = 1;
}
/*@@end*/

/*@@envVar:HMI_HPPRM_EffDisp_Rq:*/
on EnvVar HMI_HPPRM_EffDisp_Rq 
{
    _mPNHV_EnergyMngmntSet_Rs1_AR.HPPRM_EffDisp_Rq.phys = getValue(this);
    _PNHV_EnergyMngmntSet_Rs1_AR_SpontanFlag = 1;
}
/*@@end*/

/*@@envVar:HMI_HPPRM_IconDisp_Rq:*/
on EnvVar HMI_HPPRM_IconDisp_Rq 
{
    _mPNHV_EnergyMngmntSet_Rs1_AR.HPPRM_IconDisp_Rq.phys = getValue(this);
    _PNHV_EnergyMngmntSet_Rs1_AR_SpontanFlag = 1;
}
/*@@end*/

/*@@envVar:HMI_Hyb_Msg_Disp_Rq:*/
on EnvVar HMI_Hyb_Msg_Disp_Rq
{
    _mPNHV_EnergyMngmntSet_Rs1_AR.Hyb_Msg_Disp_Rq.phys = getValue(this);
    _PNHV_EnergyMngmntSet_Rs1_AR_SpontanFlag = 1;
}
/*@@end*/

/*@@envVar:HMI_PNHV_AC_Curr_Max:*/
on EnvVar HMI_PNHV_AC_Curr_Max
{
    _mPNHV_EnergyMngmntSet_Rs1_AR.PNHV_AC_Curr_Max.phys = getValue(this);
    _PNHV_EnergyMngmntSet_Rs1_AR_SpontanFlag = 1;
}
/*@@end*/

/*@@envVar:HMI_PNHV_ChrgTmDisp_WeekDay:*/
on EnvVar HMI_PNHV_ChrgTmDisp_WeekDay
{
    _mPNHV_EnergyMngmntSet_Rs1_AR.PNHV_ChrgTmDisp_WeekDay.phys = getValue(this);
    _PNHV_EnergyMngmntSet_Rs1_AR_SpontanFlag = 1;
}
/*@@end*/

/*@@envVar:HMI_PNHV_ConChrgPlug_Disp_Rq:*/
on EnvVar HMI_PNHV_ConChrgPlug_Disp_Rq
{
    _mPNHV_EnergyMngmntSet_Rs1_AR.PNHV_ConChrgPlug_Disp_Rq.phys = getValue(this);
    _PNHV_EnergyMngmntSet_Rs1_AR_SpontanFlag = 1;
}
/*@@end*/

/*@@envVar:HMI_PNHV_DepTm_Actv:*/
on EnvVar HMI_PNHV_DepTm_Actv
{
    _mPNHV_EnergyMngmntSet_Rs1_AR.PNHV_DepTm_Actv.phys = getValue(this);
    _PNHV_EnergyMngmntSet_Rs1_AR_SpontanFlag = 1;
}
/*@@end*/

/*@@envVar:HMI_PNHV_DepTm_Avl_Stat:*/
on EnvVar HMI_PNHV_DepTm_Avl_Stat
{
    _mPNHV_EnergyMngmntSet_Rs1_AR.PNHV_DepTm_Avl_Stat.phys = getValue(this);
    _PNHV_EnergyMngmntSet_Rs1_AR_SpontanFlag = 1;
}
/*@@end*/

/*@@envVar:HMI_PNHV_DepTm_Icon_Disp_Rq:*/
on EnvVar HMI_PNHV_DepTm_Icon_Disp_Rq
{
    _mPNHV_EnergyMngmntSet_Rs1_AR.PNHV_DepTm_Icon_Disp_Rq.phys = getValue(this);
    _PNHV_EnergyMngmntSet_Rs1_AR_SpontanFlag = 1;
}
/*@@end*/

/*@@envVar:HMI_PNHV_DepTmManSet_Hour_Stat:*/
on EnvVar HMI_PNHV_DepTmManSet_Hour_Stat
{
    _mPNHV_EnergyMngmntSet_Rs1_AR.PNHV_DepTmManSet_Hour_Stat.phys = getValue(this);
    _PNHV_EnergyMngmntSet_Rs1_AR_SpontanFlag = 1;
}
/*@@end*/

/*@@envVar:HMI_PNHV_DepTmManSet_Minute_Stat:*/
on EnvVar HMI_PNHV_DepTmManSet_Minute_Stat
{
    _mPNHV_EnergyMngmntSet_Rs1_AR.PNHV_DepTmManSet_Minute_Stat.phys = getValue(this);
    _PNHV_EnergyMngmntSet_Rs1_AR_SpontanFlag = 1;
}
/*@@end*/

/*@@envVar:HMI_PNHV_PreCond1_ManSet_Stat:*/
on EnvVar HMI_PNHV_PreCond1_ManSet_Stat
{
    _mPNHV_EnergyMngmntSet_Rs1_AR.PNHV_PreCond1_ManSet_Stat.phys = getValue(this);
    _PNHV_EnergyMngmntSet_Rs1_AR_SpontanFlag = 1;
}
/*@@end*/

/*@@envVar:HMI_PNHV_PreCond2_Dur:*/
on EnvVar HMI_PNHV_PreCond2_Dur
{
    _mPNHV_EnergyMngmntSet_Rs1_AR.PNHV_PreCond2_Dur.phys = getValue(this);
    _PNHV_EnergyMngmntSet_Rs1_AR_SpontanFlag = 1;
}
/*@@end*/

/*@@envVar:HMI_PNHV_PreCond2_ManSet_Icon_Disp_Rq:*/
on EnvVar HMI_PNHV_PreCond2_ManSet_Icon_Disp_Rq
{
    _mPNHV_EnergyMngmntSet_Rs1_AR.PNHV_PreCond2_ManSet_Icon_Disp_Rq.phys = getValue(this);
    _PNHV_EnergyMngmntSet_Rs1_AR_SpontanFlag = 1;
}
/*@@end*/

/*@@envVar:HMI_PNHV_PreCond2_ManSet_Stat:*/
on EnvVar HMI_PNHV_PreCond2_ManSet_Stat
{
    _mPNHV_EnergyMngmntSet_Rs1_AR.PNHV_PreCond2_ManSet_Stat.phys = getValue(this);
    _PNHV_EnergyMngmntSet_Rs1_AR_SpontanFlag = 1;
}
/*@@end*/

/*@@caplFunc:PNHV_EnergyMngmntSet_Rs2_AR_check_output():*/
PNHV_EnergyMngmntSet_Rs2_AR_check_output()
{
    if( !getValue( HMI__STMSG_PNHV_EnergyMngmntSet_Rs2_AR ) )
    {
        // Botschaft PNHV_EnergyMngmntSet_Rs2_AR ID: 1073 --- Sendeart 5 cyclicAndSpontanWithDelay --- 
        _PNHV_EnergyMngmntSet_Rs2_AR_Cnt--;
        if( _PNHV_EnergyMngmntSet_Rs2_AR_Cnt < 1 )
        {
            PNHV_EnergyMngmntSet_Rs2_AR_output(); // Nachricht wg. abgelaufenem Zyklus ausgeben
            _PNHV_EnergyMngmntSet_Rs2_AR_Cnt = _PNHV_EnergyMngmntSet_Rs2_AR_CycleCount; // Zyklus-Zähler zurücksetzen
            _PNHV_EnergyMngmntSet_Rs2_AR_SpontanFlag = 0; // Spontan-Flag zurücksetzen
        }
        else if( _PNHV_EnergyMngmntSet_Rs2_AR_SpontanFlag)
        {
            PNHV_EnergyMngmntSet_Rs2_AR_output(); // Nachricht wg. spontaner Änderung ausgeben
            _PNHV_EnergyMngmntSet_Rs2_AR_SpontanFlag = 0; // Spontan-Flag zurücksetzen
        }
    }
}
/*@@end*/

/*@@caplFunc:PNHV_EnergyMngmntSet_Rs2_AR_init():*/
PNHV_EnergyMngmntSet_Rs2_AR_init()
{   /* Botschaft PNHV_EnergyMngmntSet_Rs2_AR ID: 1073 --- Sendeart 5 cyclicAndSpontanWithDelay --- 
BA_ "ApplMessage" BO_ 1073 0;
BA_ "NmAsrMessage" BO_ 1073 0;
BA_ "GenMsgMinAcceptLength" BO_ 1073 8;
BA_ "GenMsgILSupport" BO_ 1073 1;
BA_ "DiagState" BO_ 1073 0;
BA_ "DiagRequest" BO_ 1073 0;
BA_ "DiagResponse" BO_ 1073 0;
BA_ "GenMsgStartValue" BO_ 1073 "0";
BA_ "GenMsgDelayTime" BO_ 1073 5;
BA_ "GenMsgNrOfRepetitions" BO_ 1073 0;
BA_ "GenMsgCycleTime" BO_ 1073 1000;
BA_ "GenMsgSendType" BO_ 1073 5;
    */
    _PNHV_EnergyMngmntSet_Rs2_AR_Timebase =           c_tDBKomTimer_20ms;
    _PNHV_EnergyMngmntSet_Rs2_AR_CycleCount =       1000 / _PNHV_EnergyMngmntSet_Rs2_AR_Timebase;
    _PNHV_EnergyMngmntSet_Rs2_AR_StartDelay =          0 / _PNHV_EnergyMngmntSet_Rs2_AR_Timebase;
    _PNHV_EnergyMngmntSet_Rs2_AR_Cnt = _PNHV_EnergyMngmntSet_Rs2_AR_StartDelay;
    _PNHV_EnergyMngmntSet_Rs2_AR_SpontanFlag = 0;

    putValue( HMI__STMSGSD_PNHV_EnergyMngmntSet_Rs2_AR, _PNHV_EnergyMngmntSet_Rs2_AR_StartDelay * _PNHV_EnergyMngmntSet_Rs2_AR_Timebase );

    _mPNHV_EnergyMngmntSet_Rs2_AR.EMM_AC_Curr_Lmt.phys = getValue( HMI_EMM_AC_Curr_Lmt );
    _mPNHV_EnergyMngmntSet_Rs2_AR.EMM_AC_MaxPwr.phys = getValue( HMI_EMM_AC_MaxPwr );
    _mPNHV_EnergyMngmntSet_Rs2_AR.PNHV_ChrgTmDisp_Hour.phys = getValue( HMI_PNHV_ChrgTmDisp_Hour );
    _mPNHV_EnergyMngmntSet_Rs2_AR.PNHV_ChrgTmDisp_Minute.phys = getValue( HMI_PNHV_ChrgTmDisp_Minute );
    _mPNHV_EnergyMngmntSet_Rs2_AR.PNHV_SOC_Max_Disp_Rq.phys = getValue( HMI_PNHV_SOC_Max_Disp_Rq );
    _mPNHV_EnergyMngmntSet_Rs2_AR.PNHV_Wakeup_Rq_CntDn.phys = getValue( HMI_PNHV_Wakeup_Rq_CntDn );
    _mPNHV_EnergyMngmntSet_Rs2_AR.PNHV_WeekDepTmTbl_ActvDay.phys = getValue( HMI_PNHV_WeekDepTmTbl_ActvDay );
    _mPNHV_EnergyMngmntSet_Rs2_AR.PNHV_WeekDepTmTbl_Avl_Stat.phys = getValue( HMI_PNHV_WeekDepTmTbl_Avl_Stat );
}
/*@@end*/

/*@@caplFunc:PNHV_EnergyMngmntSet_Rs2_AR_output():*/
PNHV_EnergyMngmntSet_Rs2_AR_output(void)
{
    output( _mPNHV_EnergyMngmntSet_Rs2_AR );
}
/*@@end*/

/*@@caplFunc:PNHV_EnergyMngmntSet_Rs2_AR_saveEnvVars(dword):*/
PNHV_EnergyMngmntSet_Rs2_AR_saveEnvVars( dword hFile )
{
    filePutString("\n// Knoten EIS: PNHV_EnergyMngmntSet_Rs2_AR\n", 33, hFile );
    snprintf( buffer, elcount( buffer ), "0.0000 HMI__STMSG_PNHV_EnergyMngmntSet_Rs2_AR := %X\n", getValue( HMI__STMSG_PNHV_EnergyMngmntSet_Rs2_AR ) );    filePutString( buffer, elcount( buffer ), hFile );
    snprintf( buffer, elcount( buffer ), "0.0000 HMI__STMSGT_PNHV_EnergyMngmntSet_Rs2_AR := %X\n", getValue( HMI__STMSGT_PNHV_EnergyMngmntSet_Rs2_AR ) );    filePutString( buffer, elcount( buffer ), hFile );
    snprintf( buffer, elcount( buffer ), "0.0000 HMI_EMM_AC_Curr_Lmt := %X\n", getValue( HMI_EMM_AC_Curr_Lmt ) );    filePutString( buffer, elcount( buffer ), hFile );
    snprintf( buffer, elcount( buffer ), "0.0000 HMI_EMM_AC_MaxPwr := %X\n", getValue( HMI_EMM_AC_MaxPwr ) );    filePutString( buffer, elcount( buffer ), hFile );
    snprintf( buffer, elcount( buffer ), "0.0000 HMI_PNHV_ChrgTmDisp_Hour := %X\n", getValue( HMI_PNHV_ChrgTmDisp_Hour ) );    filePutString( buffer, elcount( buffer ), hFile );
    snprintf( buffer, elcount( buffer ), "0.0000 HMI_PNHV_ChrgTmDisp_Minute := %X\n", getValue( HMI_PNHV_ChrgTmDisp_Minute ) );    filePutString( buffer, elcount( buffer ), hFile );
    snprintf( buffer, elcount( buffer ), "0.0000 HMI_PNHV_SOC_Max_Disp_Rq := %X\n", getValue( HMI_PNHV_SOC_Max_Disp_Rq ) );    filePutString( buffer, elcount( buffer ), hFile );
    snprintf( buffer, elcount( buffer ), "0.0000 HMI_PNHV_Wakeup_Rq_CntDn := %X\n", getValue( HMI_PNHV_Wakeup_Rq_CntDn ) );    filePutString( buffer, elcount( buffer ), hFile );
    snprintf( buffer, elcount( buffer ), "0.0000 HMI_PNHV_WeekDepTmTbl_ActvDay := %X\n", getValue( HMI_PNHV_WeekDepTmTbl_ActvDay ) );    filePutString( buffer, elcount( buffer ), hFile );
    snprintf( buffer, elcount( buffer ), "0.0000 HMI_PNHV_WeekDepTmTbl_Avl_Stat := %X\n", getValue( HMI_PNHV_WeekDepTmTbl_Avl_Stat ) );    filePutString( buffer, elcount( buffer ), hFile );
}
/*@@end*/

/*@@timer:_tPNHV_EnergyMngmntSet_Rs2_AR:*/
on timer _tPNHV_EnergyMngmntSet_Rs2_AR
{
    putValue( HMI__STMSG_PNHV_EnergyMngmntSet_Rs2_AR, 0 );
}
/*@@end*/

/*@@envVar:HMI__STMSG_PNHV_EnergyMngmntSet_Rs2_AR:*/
on EnvVar HMI__STMSG_PNHV_EnergyMngmntSet_Rs2_AR
{
    long tDelay;
    if( getValue( this ) == 2 )
    {
        tDelay = getValue( HMI__STMSGT_PNHV_EnergyMngmntSet_Rs2_AR );
        if( tDelay > 0)    
            setTimer( _tPNHV_EnergyMngmntSet_Rs2_AR, tDelay );
        else
            putValue( HMI__STMSG_PNHV_EnergyMngmntSet_Rs2_AR, 0 );
    }
}
/*@@end*/

/*@@envVar:HMI_EMM_AC_Curr_Lmt:*/
on EnvVar HMI_EMM_AC_Curr_Lmt
{
    _mPNHV_EnergyMngmntSet_Rs2_AR.EMM_AC_Curr_Lmt.phys = getValue(this);
}
/*@@end*/

/*@@envVar:HMI_EMM_AC_MaxPwr:*/
on EnvVar HMI_EMM_AC_MaxPwr
{
    _mPNHV_EnergyMngmntSet_Rs2_AR.EMM_AC_MaxPwr.phys = getValue(this);
}
/*@@end*/

/*@@envVar:HMI_PNHV_ChrgTmDisp_Hour:*/
on EnvVar HMI_PNHV_ChrgTmDisp_Hour
{
    _mPNHV_EnergyMngmntSet_Rs2_AR.PNHV_ChrgTmDisp_Hour.phys = getValue(this);
}
/*@@end*/

/*@@envVar:HMI_PNHV_ChrgTmDisp_Minute:*/
on EnvVar HMI_PNHV_ChrgTmDisp_Minute
{
    _mPNHV_EnergyMngmntSet_Rs2_AR.PNHV_ChrgTmDisp_Minute.phys = getValue(this);
}
/*@@end*/

/*@@envVar:HMI_PNHV_SOC_Max_Disp_Rq:*/
on EnvVar HMI_PNHV_SOC_Max_Disp_Rq
{
    _mPNHV_EnergyMngmntSet_Rs2_AR.PNHV_SOC_Max_Disp_Rq.phys = getValue(this);
}
/*@@end*/

/*@@envVar:HMI_PNHV_Wakeup_Rq_CntDn:*/
on EnvVar HMI_PNHV_Wakeup_Rq_CntDn
{
    _mPNHV_EnergyMngmntSet_Rs2_AR.PNHV_Wakeup_Rq_CntDn.phys = getValue(this);
}
/*@@end*/

/*@@envVar:HMI_PNHV_WeekDepTmTbl_ActvDay:*/
on EnvVar HMI_PNHV_WeekDepTmTbl_ActvDay
{
    _mPNHV_EnergyMngmntSet_Rs2_AR.PNHV_WeekDepTmTbl_ActvDay.phys = getValue(this);
}
/*@@end*/

/*@@envVar:HMI_PNHV_WeekDepTmTbl_Avl_Stat:*/
on EnvVar HMI_PNHV_WeekDepTmTbl_Avl_Stat
{
    _mPNHV_EnergyMngmntSet_Rs2_AR.PNHV_WeekDepTmTbl_Avl_Stat.phys = getValue(this);
}
/*@@end*/

/*@@caplFunc:PNHV_WeekDepTmTbl_Stat_AR_Activity(int):*/
void PNHV_WeekDepTmTbl_Stat_AR_Activity(int active)
{
      if( active)
      {
          if( _PNHV_WeekDepTmTbl_Stat_AR_SigActivity == 0)
            _PNHV_WeekDepTmTbl_Stat_AR_Cnt = 1;
        _PNHV_WeekDepTmTbl_Stat_AR_SigActivity++;
      }
      else
    {
        _PNHV_WeekDepTmTbl_Stat_AR_SigActivity--;
      }
}
/*@@end*/

/*@@caplFunc:PNHV_WeekDepTmTbl_Stat_AR_Change(int,int,int):*/
int PNHV_WeekDepTmTbl_Stat_AR_Change(int lastValue, int sigValue, int inActValue)
{
    bActiveHelper = (sigValue != inActValue);
      if( !lastValue && bActiveHelper)
        PNHV_WeekDepTmTbl_Stat_AR_Activity( 1 );
      else if( lastValue && !bActiveHelper)
        PNHV_WeekDepTmTbl_Stat_AR_Activity(0 );
    return bActiveHelper;
}
/*@@end*/

/*@@caplFunc:PNHV_WeekDepTmTbl_Stat_AR_check_output():*/
PNHV_WeekDepTmTbl_Stat_AR_check_output()
{
    if( !getValue( HMI__STMSG_PNHV_WeekDepTmTbl_Stat_AR ) )
    {
        // Botschaft PNHV_WeekDepTmTbl_Stat_AR ID: 447 --- Sendeart 2 cyclicIfActive --- 
        if( _PNHV_WeekDepTmTbl_Stat_AR_SigActivity )
            _PNHV_WeekDepTmTbl_Stat_AR_Cnt--;
        if( _PNHV_WeekDepTmTbl_Stat_AR_Cnt < 1 )
        {
            PNHV_WeekDepTmTbl_Stat_AR_output(); // Zyklus abgelaufen, Nachricht senden
            _PNHV_WeekDepTmTbl_Stat_AR_Cnt = _PNHV_WeekDepTmTbl_Stat_AR_CycleCount;
        }
    }
}
/*@@end*/

/*@@caplFunc:PNHV_WeekDepTmTbl_Stat_AR_init():*/
PNHV_WeekDepTmTbl_Stat_AR_init()
{   /* Botschaft PNHV_WeekDepTmTbl_Stat_AR ID: 447 --- Sendeart 2 cyclicIfActive --- 
BA_ "ApplMessage" BO_ 447 0;
BA_ "NmAsrMessage" BO_ 447 0;
BA_ "GenMsgMinAcceptLength" BO_ 447 8;
BA_ "GenMsgILSupport" BO_ 447 0;
BA_ "DiagState" BO_ 447 0;
BA_ "DiagRequest" BO_ 447 0;
BA_ "DiagResponse" BO_ 447 0;
BA_ "GenMsgStartValue" BO_ 447 "0";
BA_ "GenMsgStartDelayTime" BO_ 447 0;
BA_ "GenMsgDelayTime" BO_ 447 5;
BA_ "GenMsgCycleTime" BO_ 447 0;
BA_ "GenMsgCycleTimeActive" BO_ 447 60;
BA_ "GenMsgSendType" BO_ 447 2;
    */
    _PNHV_WeekDepTmTbl_Stat_AR_Timebase =           c_tDBKomTimer_5ms;
    _PNHV_WeekDepTmTbl_Stat_AR_CycleCount =       60 / _PNHV_WeekDepTmTbl_Stat_AR_Timebase;
    _PNHV_WeekDepTmTbl_Stat_AR_StartDelay =        0 / _PNHV_WeekDepTmTbl_Stat_AR_Timebase;
    _PNHV_WeekDepTmTbl_Stat_AR_Cnt = _PNHV_WeekDepTmTbl_Stat_AR_StartDelay;
    _PNHV_WeekDepTmTbl_Stat_AR_Active = 0;
    _PNHV_WeekDepTmTbl_Stat_AR_SigActivity = 0;

    putValue( HMI__STMSGSD_PNHV_WeekDepTmTbl_Stat_AR, _PNHV_WeekDepTmTbl_Stat_AR_StartDelay * _PNHV_WeekDepTmTbl_Stat_AR_Timebase );

    _mPNHV_WeekDepTmTbl_Stat_AR.PNHV_DepTm01.phys = getValue( HMI_PNHV_DepTm01 );
    _mPNHV_WeekDepTmTbl_Stat_AR.PNHV_DepTm02.phys = getValue( HMI_PNHV_DepTm02 );
    _mPNHV_WeekDepTmTbl_Stat_AR.PNHV_DepTm03.phys = getValue( HMI_PNHV_DepTm03 );
    _mPNHV_WeekDepTmTbl_Stat_AR.PNHV_DepTm04.phys = getValue( HMI_PNHV_DepTm04 );
    _mPNHV_WeekDepTmTbl_Stat_AR.PNHV_DepTm05.phys = getValue( HMI_PNHV_DepTm05 );
    _mPNHV_WeekDepTmTbl_Stat_AR.PNHV_DepTm06.phys = getValue( HMI_PNHV_DepTm06 );
    _mPNHV_WeekDepTmTbl_Stat_AR.PNHV_DepTm07.phys = getValue( HMI_PNHV_DepTm07 );
    _mPNHV_WeekDepTmTbl_Stat_AR.PNHV_DepTm08.phys = getValue( HMI_PNHV_DepTm08 );
    _mPNHV_WeekDepTmTbl_Stat_AR.PNHV_DepTm09.phys = getValue( HMI_PNHV_DepTm09 );
    _mPNHV_WeekDepTmTbl_Stat_AR.PNHV_DepTm10.phys = getValue( HMI_PNHV_DepTm10 );
    _mPNHV_WeekDepTmTbl_Stat_AR.PNHV_DepTm11.phys = getValue( HMI_PNHV_DepTm11 );
    _mPNHV_WeekDepTmTbl_Stat_AR.PNHV_DepTm12.phys = getValue( HMI_PNHV_DepTm12 );
    _mPNHV_WeekDepTmTbl_Stat_AR.PNHV_DepTm13.phys = getValue( HMI_PNHV_DepTm13 );
    _mPNHV_WeekDepTmTbl_Stat_AR.PNHV_DepTm14.phys = getValue( HMI_PNHV_DepTm14 );
    _mPNHV_WeekDepTmTbl_Stat_AR.PNHV_DepTm15.phys = getValue( HMI_PNHV_DepTm15 );
    _mPNHV_WeekDepTmTbl_Stat_AR.PNHV_DepTm16.phys = getValue( HMI_PNHV_DepTm16 );
    _mPNHV_WeekDepTmTbl_Stat_AR.PNHV_DepTm17.phys = getValue( HMI_PNHV_DepTm17 );
    _mPNHV_WeekDepTmTbl_Stat_AR.PNHV_DepTm18.phys = getValue( HMI_PNHV_DepTm18 );
    _mPNHV_WeekDepTmTbl_Stat_AR.PNHV_DepTm19.phys = getValue( HMI_PNHV_DepTm19 );
    _mPNHV_WeekDepTmTbl_Stat_AR.PNHV_DepTm20.phys = getValue( HMI_PNHV_DepTm20 );
    _mPNHV_WeekDepTmTbl_Stat_AR.PNHV_DepTm21.phys = getValue( HMI_PNHV_DepTm21 );
    _mPNHV_WeekDepTmTbl_Stat_AR.PNHV_DepTmUpdtCnt_1To4.phys = getValue( HMI_PNHV_DepTmUpdtCnt_1To4 );
    _mPNHV_WeekDepTmTbl_Stat_AR.PNHV_DepTmUpdtCnt_5To8.phys = getValue( HMI_PNHV_DepTmUpdtCnt_5To8 );
    _mPNHV_WeekDepTmTbl_Stat_AR.PNHV_DepTmUpdtCnt_9To12.phys = getValue( HMI_PNHV_DepTmUpdtCnt_9To12 );
    _mPNHV_WeekDepTmTbl_Stat_AR.PNHV_DepTmUpdtCnt_13To16.phys = getValue( HMI_PNHV_DepTmUpdtCnt_13To16 );
    _mPNHV_WeekDepTmTbl_Stat_AR.PNHV_DepTmUpdtCnt_17To20.phys = getValue( HMI_PNHV_DepTmUpdtCnt_17To20 );
    _mPNHV_WeekDepTmTbl_Stat_AR.PNHV_DepTmUpdtCnt_21.phys = getValue( HMI_PNHV_DepTmUpdtCnt_21 );
    _mPNHV_WeekDepTmTbl_Stat_AR.PNHV_WeekDepTmTbl_New.phys = getValue( HMI_PNHV_WeekDepTmTbl_New );
    _mPNHV_WeekDepTmTbl_Stat_AR.PNHV_WeekDepTmTbl_PartId.phys = getValue( HMI_PNHV_WeekDepTmTbl_PartId );
    _mPNHV_WeekDepTmTbl_Stat_AR.PNHV_WeekDepTmTbl_TxActv.phys = getValue( HMI_PNHV_WeekDepTmTbl_TxActv );
    _PNHV_WeekDepTmTbl_Stat_AR_PNHV_DepTm01_LastState = PNHV_WeekDepTmTbl_Stat_AR_Change( _PNHV_WeekDepTmTbl_Stat_AR_PNHV_DepTm01_LastState, _mPNHV_WeekDepTmTbl_Stat_AR.PNHV_DepTm01, 0);
    _PNHV_WeekDepTmTbl_Stat_AR_PNHV_DepTm02_LastState = PNHV_WeekDepTmTbl_Stat_AR_Change( _PNHV_WeekDepTmTbl_Stat_AR_PNHV_DepTm02_LastState, _mPNHV_WeekDepTmTbl_Stat_AR.PNHV_DepTm02, 0);
    _PNHV_WeekDepTmTbl_Stat_AR_PNHV_DepTm03_LastState = PNHV_WeekDepTmTbl_Stat_AR_Change( _PNHV_WeekDepTmTbl_Stat_AR_PNHV_DepTm03_LastState, _mPNHV_WeekDepTmTbl_Stat_AR.PNHV_DepTm03, 0);
    _PNHV_WeekDepTmTbl_Stat_AR_PNHV_DepTm04_LastState = PNHV_WeekDepTmTbl_Stat_AR_Change( _PNHV_WeekDepTmTbl_Stat_AR_PNHV_DepTm04_LastState, _mPNHV_WeekDepTmTbl_Stat_AR.PNHV_DepTm04, 0);
    _PNHV_WeekDepTmTbl_Stat_AR_PNHV_DepTm05_LastState = PNHV_WeekDepTmTbl_Stat_AR_Change( _PNHV_WeekDepTmTbl_Stat_AR_PNHV_DepTm05_LastState, _mPNHV_WeekDepTmTbl_Stat_AR.PNHV_DepTm05, 0);
    _PNHV_WeekDepTmTbl_Stat_AR_PNHV_DepTm06_LastState = PNHV_WeekDepTmTbl_Stat_AR_Change( _PNHV_WeekDepTmTbl_Stat_AR_PNHV_DepTm06_LastState, _mPNHV_WeekDepTmTbl_Stat_AR.PNHV_DepTm06, 0);
    _PNHV_WeekDepTmTbl_Stat_AR_PNHV_DepTm07_LastState = PNHV_WeekDepTmTbl_Stat_AR_Change( _PNHV_WeekDepTmTbl_Stat_AR_PNHV_DepTm07_LastState, _mPNHV_WeekDepTmTbl_Stat_AR.PNHV_DepTm07, 0);
    _PNHV_WeekDepTmTbl_Stat_AR_PNHV_DepTm08_LastState = PNHV_WeekDepTmTbl_Stat_AR_Change( _PNHV_WeekDepTmTbl_Stat_AR_PNHV_DepTm08_LastState, _mPNHV_WeekDepTmTbl_Stat_AR.PNHV_DepTm08, 0);
    _PNHV_WeekDepTmTbl_Stat_AR_PNHV_DepTm09_LastState = PNHV_WeekDepTmTbl_Stat_AR_Change( _PNHV_WeekDepTmTbl_Stat_AR_PNHV_DepTm09_LastState, _mPNHV_WeekDepTmTbl_Stat_AR.PNHV_DepTm09, 0);
    _PNHV_WeekDepTmTbl_Stat_AR_PNHV_DepTm10_LastState = PNHV_WeekDepTmTbl_Stat_AR_Change( _PNHV_WeekDepTmTbl_Stat_AR_PNHV_DepTm10_LastState, _mPNHV_WeekDepTmTbl_Stat_AR.PNHV_DepTm10, 0);
    _PNHV_WeekDepTmTbl_Stat_AR_PNHV_DepTm11_LastState = PNHV_WeekDepTmTbl_Stat_AR_Change( _PNHV_WeekDepTmTbl_Stat_AR_PNHV_DepTm11_LastState, _mPNHV_WeekDepTmTbl_Stat_AR.PNHV_DepTm11, 0);
    _PNHV_WeekDepTmTbl_Stat_AR_PNHV_DepTm12_LastState = PNHV_WeekDepTmTbl_Stat_AR_Change( _PNHV_WeekDepTmTbl_Stat_AR_PNHV_DepTm12_LastState, _mPNHV_WeekDepTmTbl_Stat_AR.PNHV_DepTm12, 0);
    _PNHV_WeekDepTmTbl_Stat_AR_PNHV_DepTm13_LastState = PNHV_WeekDepTmTbl_Stat_AR_Change( _PNHV_WeekDepTmTbl_Stat_AR_PNHV_DepTm13_LastState, _mPNHV_WeekDepTmTbl_Stat_AR.PNHV_DepTm13, 0);
    _PNHV_WeekDepTmTbl_Stat_AR_PNHV_DepTm14_LastState = PNHV_WeekDepTmTbl_Stat_AR_Change( _PNHV_WeekDepTmTbl_Stat_AR_PNHV_DepTm14_LastState, _mPNHV_WeekDepTmTbl_Stat_AR.PNHV_DepTm14, 0);
    _PNHV_WeekDepTmTbl_Stat_AR_PNHV_DepTm15_LastState = PNHV_WeekDepTmTbl_Stat_AR_Change( _PNHV_WeekDepTmTbl_Stat_AR_PNHV_DepTm15_LastState, _mPNHV_WeekDepTmTbl_Stat_AR.PNHV_DepTm15, 0);
    _PNHV_WeekDepTmTbl_Stat_AR_PNHV_DepTm16_LastState = PNHV_WeekDepTmTbl_Stat_AR_Change( _PNHV_WeekDepTmTbl_Stat_AR_PNHV_DepTm16_LastState, _mPNHV_WeekDepTmTbl_Stat_AR.PNHV_DepTm16, 0);
    _PNHV_WeekDepTmTbl_Stat_AR_PNHV_DepTm17_LastState = PNHV_WeekDepTmTbl_Stat_AR_Change( _PNHV_WeekDepTmTbl_Stat_AR_PNHV_DepTm17_LastState, _mPNHV_WeekDepTmTbl_Stat_AR.PNHV_DepTm17, 0);
    _PNHV_WeekDepTmTbl_Stat_AR_PNHV_DepTm18_LastState = PNHV_WeekDepTmTbl_Stat_AR_Change( _PNHV_WeekDepTmTbl_Stat_AR_PNHV_DepTm18_LastState, _mPNHV_WeekDepTmTbl_Stat_AR.PNHV_DepTm18, 0);
    _PNHV_WeekDepTmTbl_Stat_AR_PNHV_DepTm19_LastState = PNHV_WeekDepTmTbl_Stat_AR_Change( _PNHV_WeekDepTmTbl_Stat_AR_PNHV_DepTm19_LastState, _mPNHV_WeekDepTmTbl_Stat_AR.PNHV_DepTm19, 0);
    _PNHV_WeekDepTmTbl_Stat_AR_PNHV_DepTm20_LastState = PNHV_WeekDepTmTbl_Stat_AR_Change( _PNHV_WeekDepTmTbl_Stat_AR_PNHV_DepTm20_LastState, _mPNHV_WeekDepTmTbl_Stat_AR.PNHV_DepTm20, 0);
    _PNHV_WeekDepTmTbl_Stat_AR_PNHV_DepTm21_LastState = PNHV_WeekDepTmTbl_Stat_AR_Change( _PNHV_WeekDepTmTbl_Stat_AR_PNHV_DepTm21_LastState, _mPNHV_WeekDepTmTbl_Stat_AR.PNHV_DepTm21, 0);
    _PNHV_WeekDepTmTbl_Stat_AR_PNHV_DepTmUpdtCnt_1To4_LastState = PNHV_WeekDepTmTbl_Stat_AR_Change( _PNHV_WeekDepTmTbl_Stat_AR_PNHV_DepTmUpdtCnt_1To4_LastState, _mPNHV_WeekDepTmTbl_Stat_AR.PNHV_DepTmUpdtCnt_1To4, 0);
    _PNHV_WeekDepTmTbl_Stat_AR_PNHV_DepTmUpdtCnt_5To8_LastState = PNHV_WeekDepTmTbl_Stat_AR_Change( _PNHV_WeekDepTmTbl_Stat_AR_PNHV_DepTmUpdtCnt_5To8_LastState, _mPNHV_WeekDepTmTbl_Stat_AR.PNHV_DepTmUpdtCnt_5To8, 0);
    _PNHV_WeekDepTmTbl_Stat_AR_PNHV_DepTmUpdtCnt_9To12_LastState = PNHV_WeekDepTmTbl_Stat_AR_Change( _PNHV_WeekDepTmTbl_Stat_AR_PNHV_DepTmUpdtCnt_9To12_LastState, _mPNHV_WeekDepTmTbl_Stat_AR.PNHV_DepTmUpdtCnt_9To12, 0);
    _PNHV_WeekDepTmTbl_Stat_AR_PNHV_DepTmUpdtCnt_13To16_LastState = PNHV_WeekDepTmTbl_Stat_AR_Change( _PNHV_WeekDepTmTbl_Stat_AR_PNHV_DepTmUpdtCnt_13To16_LastState, _mPNHV_WeekDepTmTbl_Stat_AR.PNHV_DepTmUpdtCnt_13To16, 0);
    _PNHV_WeekDepTmTbl_Stat_AR_PNHV_DepTmUpdtCnt_17To20_LastState = PNHV_WeekDepTmTbl_Stat_AR_Change( _PNHV_WeekDepTmTbl_Stat_AR_PNHV_DepTmUpdtCnt_17To20_LastState, _mPNHV_WeekDepTmTbl_Stat_AR.PNHV_DepTmUpdtCnt_17To20, 0);
    _PNHV_WeekDepTmTbl_Stat_AR_PNHV_DepTmUpdtCnt_21_LastState = PNHV_WeekDepTmTbl_Stat_AR_Change( _PNHV_WeekDepTmTbl_Stat_AR_PNHV_DepTmUpdtCnt_21_LastState, _mPNHV_WeekDepTmTbl_Stat_AR.PNHV_DepTmUpdtCnt_21, 0);
    _PNHV_WeekDepTmTbl_Stat_AR_PNHV_WeekDepTmTbl_New_LastState = PNHV_WeekDepTmTbl_Stat_AR_Change( _PNHV_WeekDepTmTbl_Stat_AR_PNHV_WeekDepTmTbl_New_LastState, _mPNHV_WeekDepTmTbl_Stat_AR.PNHV_WeekDepTmTbl_New, 0);
    _PNHV_WeekDepTmTbl_Stat_AR_PNHV_WeekDepTmTbl_PartId_LastState = PNHV_WeekDepTmTbl_Stat_AR_Change( _PNHV_WeekDepTmTbl_Stat_AR_PNHV_WeekDepTmTbl_PartId_LastState, _mPNHV_WeekDepTmTbl_Stat_AR.PNHV_WeekDepTmTbl_PartId, 0);
    _PNHV_WeekDepTmTbl_Stat_AR_PNHV_WeekDepTmTbl_TxActv_LastState = PNHV_WeekDepTmTbl_Stat_AR_Change( _PNHV_WeekDepTmTbl_Stat_AR_PNHV_WeekDepTmTbl_TxActv_LastState, _mPNHV_WeekDepTmTbl_Stat_AR.PNHV_WeekDepTmTbl_TxActv, 0);
}
/*@@end*/

/*@@caplFunc:PNHV_WeekDepTmTbl_Stat_AR_output():*/
PNHV_WeekDepTmTbl_Stat_AR_output()
{
    output( _mPNHV_WeekDepTmTbl_Stat_AR );
}
/*@@end*/

/*@@caplFunc:PNHV_WeekDepTmTbl_Stat_AR_saveEnvVars(dword):*/
PNHV_WeekDepTmTbl_Stat_AR_saveEnvVars( dword hFile )
{
    filePutString("\n// Knoten EIS: PNHV_WeekDepTmTbl_Stat_AR\n", 31, hFile );
    snprintf( buffer, elcount( buffer ), "0.0000 HMI__STMSG_PNHV_WeekDepTmTbl_Stat_AR := %X\n", getValue( HMI__STMSG_PNHV_WeekDepTmTbl_Stat_AR ) );    filePutString( buffer, elcount( buffer ), hFile );
    snprintf( buffer, elcount( buffer ), "0.0000 HMI__STMSGT_PNHV_WeekDepTmTbl_Stat_AR := %X\n", getValue( HMI__STMSGT_PNHV_WeekDepTmTbl_Stat_AR ) );    filePutString( buffer, elcount( buffer ), hFile );
    snprintf( buffer, elcount( buffer ), "0.0000 HMI_PNHV_DepTm01 := %X\n", getValue( HMI_PNHV_DepTm01 ) );    filePutString( buffer, elcount( buffer ), hFile );
    snprintf( buffer, elcount( buffer ), "0.0000 HMI_PNHV_DepTm02 := %X\n", getValue( HMI_PNHV_DepTm02 ) );    filePutString( buffer, elcount( buffer ), hFile );
    snprintf( buffer, elcount( buffer ), "0.0000 HMI_PNHV_DepTm03 := %X\n", getValue( HMI_PNHV_DepTm03 ) );    filePutString( buffer, elcount( buffer ), hFile );
    snprintf( buffer, elcount( buffer ), "0.0000 HMI_PNHV_DepTm04 := %X\n", getValue( HMI_PNHV_DepTm04 ) );    filePutString( buffer, elcount( buffer ), hFile );
    snprintf( buffer, elcount( buffer ), "0.0000 HMI_PNHV_DepTm05 := %X\n", getValue( HMI_PNHV_DepTm05 ) );    filePutString( buffer, elcount( buffer ), hFile );
    snprintf( buffer, elcount( buffer ), "0.0000 HMI_PNHV_DepTm06 := %X\n", getValue( HMI_PNHV_DepTm06 ) );    filePutString( buffer, elcount( buffer ), hFile );
    snprintf( buffer, elcount( buffer ), "0.0000 HMI_PNHV_DepTm07 := %X\n", getValue( HMI_PNHV_DepTm07 ) );    filePutString( buffer, elcount( buffer ), hFile );
    snprintf( buffer, elcount( buffer ), "0.0000 HMI_PNHV_DepTm08 := %X\n", getValue( HMI_PNHV_DepTm08 ) );    filePutString( buffer, elcount( buffer ), hFile );
    snprintf( buffer, elcount( buffer ), "0.0000 HMI_PNHV_DepTm09 := %X\n", getValue( HMI_PNHV_DepTm09 ) );    filePutString( buffer, elcount( buffer ), hFile );
    snprintf( buffer, elcount( buffer ), "0.0000 HMI_PNHV_DepTm10 := %X\n", getValue( HMI_PNHV_DepTm10 ) );    filePutString( buffer, elcount( buffer ), hFile );
    snprintf( buffer, elcount( buffer ), "0.0000 HMI_PNHV_DepTm11 := %X\n", getValue( HMI_PNHV_DepTm11 ) );    filePutString( buffer, elcount( buffer ), hFile );
    snprintf( buffer, elcount( buffer ), "0.0000 HMI_PNHV_DepTm12 := %X\n", getValue( HMI_PNHV_DepTm12 ) );    filePutString( buffer, elcount( buffer ), hFile );
    snprintf( buffer, elcount( buffer ), "0.0000 HMI_PNHV_DepTm13 := %X\n", getValue( HMI_PNHV_DepTm13 ) );    filePutString( buffer, elcount( buffer ), hFile );
    snprintf( buffer, elcount( buffer ), "0.0000 HMI_PNHV_DepTm14 := %X\n", getValue( HMI_PNHV_DepTm14 ) );    filePutString( buffer, elcount( buffer ), hFile );
    snprintf( buffer, elcount( buffer ), "0.0000 HMI_PNHV_DepTm15 := %X\n", getValue( HMI_PNHV_DepTm15 ) );    filePutString( buffer, elcount( buffer ), hFile );
    snprintf( buffer, elcount( buffer ), "0.0000 HMI_PNHV_DepTm16 := %X\n", getValue( HMI_PNHV_DepTm16 ) );    filePutString( buffer, elcount( buffer ), hFile );
    snprintf( buffer, elcount( buffer ), "0.0000 HMI_PNHV_DepTm17 := %X\n", getValue( HMI_PNHV_DepTm17 ) );    filePutString( buffer, elcount( buffer ), hFile );
    snprintf( buffer, elcount( buffer ), "0.0000 HMI_PNHV_DepTm18 := %X\n", getValue( HMI_PNHV_DepTm18 ) );    filePutString( buffer, elcount( buffer ), hFile );
    snprintf( buffer, elcount( buffer ), "0.0000 HMI_PNHV_DepTm19 := %X\n", getValue( HMI_PNHV_DepTm19 ) );    filePutString( buffer, elcount( buffer ), hFile );
    snprintf( buffer, elcount( buffer ), "0.0000 HMI_PNHV_DepTm20 := %X\n", getValue( HMI_PNHV_DepTm20 ) );    filePutString( buffer, elcount( buffer ), hFile );
    snprintf( buffer, elcount( buffer ), "0.0000 HMI_PNHV_DepTm21 := %X\n", getValue( HMI_PNHV_DepTm21 ) );    filePutString( buffer, elcount( buffer ), hFile );
    snprintf( buffer, elcount( buffer ), "0.0000 HMI_PNHV_DepTmUpdtCnt_1To4 := %X\n", getValue( HMI_PNHV_DepTmUpdtCnt_1To4 ) );    filePutString( buffer, elcount( buffer ), hFile );
    snprintf( buffer, elcount( buffer ), "0.0000 HMI_PNHV_DepTmUpdtCnt_5To8 := %X\n", getValue( HMI_PNHV_DepTmUpdtCnt_5To8 ) );    filePutString( buffer, elcount( buffer ), hFile );
    snprintf( buffer, elcount( buffer ), "0.0000 HMI_PNHV_DepTmUpdtCnt_9To12 := %X\n", getValue( HMI_PNHV_DepTmUpdtCnt_9To12 ) );    filePutString( buffer, elcount( buffer ), hFile );
    snprintf( buffer, elcount( buffer ), "0.0000 HMI_PNHV_DepTmUpdtCnt_13To16 := %X\n", getValue( HMI_PNHV_DepTmUpdtCnt_13To16 ) );    filePutString( buffer, elcount( buffer ), hFile );
    snprintf( buffer, elcount( buffer ), "0.0000 HMI_PNHV_DepTmUpdtCnt_17To20 := %X\n", getValue( HMI_PNHV_DepTmUpdtCnt_17To20 ) );    filePutString( buffer, elcount( buffer ), hFile );
    snprintf( buffer, elcount( buffer ), "0.0000 HMI_PNHV_DepTmUpdtCnt_21 := %X\n", getValue( HMI_PNHV_DepTmUpdtCnt_21 ) );    filePutString( buffer, elcount( buffer ), hFile );
    snprintf( buffer, elcount( buffer ), "0.0000 HMI_PNHV_WeekDepTmTbl_New := %X\n", getValue( HMI_PNHV_WeekDepTmTbl_New ) );    filePutString( buffer, elcount( buffer ), hFile );
    snprintf( buffer, elcount( buffer ), "0.0000 HMI_PNHV_WeekDepTmTbl_PartId := %X\n", getValue( HMI_PNHV_WeekDepTmTbl_PartId ) );    filePutString( buffer, elcount( buffer ), hFile );
    snprintf( buffer, elcount( buffer ), "0.0000 HMI_PNHV_WeekDepTmTbl_TxActv := %X\n", getValue( HMI_PNHV_WeekDepTmTbl_TxActv ) );    filePutString( buffer, elcount( buffer ), hFile );
}
/*@@end*/

/*@@timer:_tPNHV_WeekDepTmTbl_Stat_AR:*/
on timer _tPNHV_WeekDepTmTbl_Stat_AR
{
    putValue( HMI__STMSG_PNHV_WeekDepTmTbl_Stat_AR, 0 );
}
/*@@end*/

/*@@envVar:HMI__STMSG_PNHV_WeekDepTmTbl_Stat_AR:*/
on EnvVar HMI__STMSG_PNHV_WeekDepTmTbl_Stat_AR
{
    long tDelay;
    if( getValue( this ) == 2 )
    {
        tDelay = getValue( HMI__STMSGT_PNHV_WeekDepTmTbl_Stat_AR );
        if( tDelay > 0)    
            setTimer( _tPNHV_WeekDepTmTbl_Stat_AR, tDelay );
        else
            putValue( HMI__STMSG_PNHV_WeekDepTmTbl_Stat_AR, 0 );
    }
}
/*@@end*/

/*@@envVar:HMI_PNHV_DepTm01:*/
on EnvVar HMI_PNHV_DepTm01
{
    _mPNHV_WeekDepTmTbl_Stat_AR.PNHV_DepTm01.phys = getValue(this);
    _PNHV_WeekDepTmTbl_Stat_AR_PNHV_DepTm01_LastState = PNHV_WeekDepTmTbl_Stat_AR_Change( _PNHV_WeekDepTmTbl_Stat_AR_PNHV_DepTm01_LastState, _mPNHV_WeekDepTmTbl_Stat_AR.PNHV_DepTm01, 0 );
}
/*@@end*/

/*@@envVar:HMI_PNHV_DepTm02:*/
on EnvVar HMI_PNHV_DepTm02
{
    _mPNHV_WeekDepTmTbl_Stat_AR.PNHV_DepTm02.phys = getValue(this);
    _PNHV_WeekDepTmTbl_Stat_AR_PNHV_DepTm02_LastState = PNHV_WeekDepTmTbl_Stat_AR_Change( _PNHV_WeekDepTmTbl_Stat_AR_PNHV_DepTm02_LastState, _mPNHV_WeekDepTmTbl_Stat_AR.PNHV_DepTm02, 0 );
}
/*@@end*/

/*@@envVar:HMI_PNHV_DepTm03:*/
on EnvVar HMI_PNHV_DepTm03
{
    _mPNHV_WeekDepTmTbl_Stat_AR.PNHV_DepTm03.phys = getValue(this);
    _PNHV_WeekDepTmTbl_Stat_AR_PNHV_DepTm03_LastState = PNHV_WeekDepTmTbl_Stat_AR_Change( _PNHV_WeekDepTmTbl_Stat_AR_PNHV_DepTm03_LastState, _mPNHV_WeekDepTmTbl_Stat_AR.PNHV_DepTm03, 0 );
}
/*@@end*/

/*@@envVar:HMI_PNHV_DepTm04:*/
on EnvVar HMI_PNHV_DepTm04
{
    _mPNHV_WeekDepTmTbl_Stat_AR.PNHV_DepTm04.phys = getValue(this);
    _PNHV_WeekDepTmTbl_Stat_AR_PNHV_DepTm04_LastState = PNHV_WeekDepTmTbl_Stat_AR_Change( _PNHV_WeekDepTmTbl_Stat_AR_PNHV_DepTm04_LastState, _mPNHV_WeekDepTmTbl_Stat_AR.PNHV_DepTm04, 0 );
}
/*@@end*/

/*@@envVar:HMI_PNHV_DepTm05:*/
on EnvVar HMI_PNHV_DepTm05
{
    _mPNHV_WeekDepTmTbl_Stat_AR.PNHV_DepTm05.phys = getValue(this);
    _PNHV_WeekDepTmTbl_Stat_AR_PNHV_DepTm05_LastState = PNHV_WeekDepTmTbl_Stat_AR_Change( _PNHV_WeekDepTmTbl_Stat_AR_PNHV_DepTm05_LastState, _mPNHV_WeekDepTmTbl_Stat_AR.PNHV_DepTm05, 0 );
}
/*@@end*/

/*@@envVar:HMI_PNHV_DepTm06:*/
on EnvVar HMI_PNHV_DepTm06
{
    _mPNHV_WeekDepTmTbl_Stat_AR.PNHV_DepTm06.phys = getValue(this);
    _PNHV_WeekDepTmTbl_Stat_AR_PNHV_DepTm06_LastState = PNHV_WeekDepTmTbl_Stat_AR_Change( _PNHV_WeekDepTmTbl_Stat_AR_PNHV_DepTm06_LastState, _mPNHV_WeekDepTmTbl_Stat_AR.PNHV_DepTm06, 0 );
}
/*@@end*/

/*@@envVar:HMI_PNHV_DepTm07:*/
on EnvVar HMI_PNHV_DepTm07
{
    _mPNHV_WeekDepTmTbl_Stat_AR.PNHV_DepTm07.phys = getValue(this);
    _PNHV_WeekDepTmTbl_Stat_AR_PNHV_DepTm07_LastState = PNHV_WeekDepTmTbl_Stat_AR_Change( _PNHV_WeekDepTmTbl_Stat_AR_PNHV_DepTm07_LastState, _mPNHV_WeekDepTmTbl_Stat_AR.PNHV_DepTm07, 0 );
}
/*@@end*/

/*@@envVar:HMI_PNHV_DepTm08:*/
on EnvVar HMI_PNHV_DepTm08
{
    _mPNHV_WeekDepTmTbl_Stat_AR.PNHV_DepTm08.phys = getValue(this);
    _PNHV_WeekDepTmTbl_Stat_AR_PNHV_DepTm08_LastState = PNHV_WeekDepTmTbl_Stat_AR_Change( _PNHV_WeekDepTmTbl_Stat_AR_PNHV_DepTm08_LastState, _mPNHV_WeekDepTmTbl_Stat_AR.PNHV_DepTm08, 0 );
}
/*@@end*/

/*@@envVar:HMI_PNHV_DepTm09:*/
on EnvVar HMI_PNHV_DepTm09
{
    _mPNHV_WeekDepTmTbl_Stat_AR.PNHV_DepTm09.phys = getValue(this);
    _PNHV_WeekDepTmTbl_Stat_AR_PNHV_DepTm09_LastState = PNHV_WeekDepTmTbl_Stat_AR_Change( _PNHV_WeekDepTmTbl_Stat_AR_PNHV_DepTm09_LastState, _mPNHV_WeekDepTmTbl_Stat_AR.PNHV_DepTm09, 0 );
}
/*@@end*/

/*@@envVar:HMI_PNHV_DepTm10:*/
on EnvVar HMI_PNHV_DepTm10
{
    _mPNHV_WeekDepTmTbl_Stat_AR.PNHV_DepTm10.phys = getValue(this);
    _PNHV_WeekDepTmTbl_Stat_AR_PNHV_DepTm10_LastState = PNHV_WeekDepTmTbl_Stat_AR_Change( _PNHV_WeekDepTmTbl_Stat_AR_PNHV_DepTm10_LastState, _mPNHV_WeekDepTmTbl_Stat_AR.PNHV_DepTm10, 0 );
}
/*@@end*/

/*@@envVar:HMI_PNHV_DepTm11:*/
on EnvVar HMI_PNHV_DepTm11
{
    _mPNHV_WeekDepTmTbl_Stat_AR.PNHV_DepTm11.phys = getValue(this);
    _PNHV_WeekDepTmTbl_Stat_AR_PNHV_DepTm11_LastState = PNHV_WeekDepTmTbl_Stat_AR_Change( _PNHV_WeekDepTmTbl_Stat_AR_PNHV_DepTm11_LastState, _mPNHV_WeekDepTmTbl_Stat_AR.PNHV_DepTm11, 0 );
}
/*@@end*/

/*@@envVar:HMI_PNHV_DepTm12:*/
on EnvVar HMI_PNHV_DepTm12
{
    _mPNHV_WeekDepTmTbl_Stat_AR.PNHV_DepTm12.phys = getValue(this);
    _PNHV_WeekDepTmTbl_Stat_AR_PNHV_DepTm12_LastState = PNHV_WeekDepTmTbl_Stat_AR_Change( _PNHV_WeekDepTmTbl_Stat_AR_PNHV_DepTm12_LastState, _mPNHV_WeekDepTmTbl_Stat_AR.PNHV_DepTm12, 0 );
}
/*@@end*/

/*@@envVar:HMI_PNHV_DepTm13:*/
on EnvVar HMI_PNHV_DepTm13
{
    _mPNHV_WeekDepTmTbl_Stat_AR.PNHV_DepTm13.phys = getValue(this);
    _PNHV_WeekDepTmTbl_Stat_AR_PNHV_DepTm13_LastState = PNHV_WeekDepTmTbl_Stat_AR_Change( _PNHV_WeekDepTmTbl_Stat_AR_PNHV_DepTm13_LastState, _mPNHV_WeekDepTmTbl_Stat_AR.PNHV_DepTm13, 0 );
}
/*@@end*/

/*@@envVar:HMI_PNHV_DepTm14:*/
on EnvVar HMI_PNHV_DepTm14
{
    _mPNHV_WeekDepTmTbl_Stat_AR.PNHV_DepTm14.phys = getValue(this);
    _PNHV_WeekDepTmTbl_Stat_AR_PNHV_DepTm14_LastState = PNHV_WeekDepTmTbl_Stat_AR_Change( _PNHV_WeekDepTmTbl_Stat_AR_PNHV_DepTm14_LastState, _mPNHV_WeekDepTmTbl_Stat_AR.PNHV_DepTm14, 0 );
}
/*@@end*/

/*@@envVar:HMI_PNHV_DepTm15:*/
on EnvVar HMI_PNHV_DepTm15
{
    _mPNHV_WeekDepTmTbl_Stat_AR.PNHV_DepTm15.phys = getValue(this);
    _PNHV_WeekDepTmTbl_Stat_AR_PNHV_DepTm15_LastState = PNHV_WeekDepTmTbl_Stat_AR_Change( _PNHV_WeekDepTmTbl_Stat_AR_PNHV_DepTm15_LastState, _mPNHV_WeekDepTmTbl_Stat_AR.PNHV_DepTm15, 0 );
}
/*@@end*/

/*@@envVar:HMI_PNHV_DepTm16:*/
on EnvVar HMI_PNHV_DepTm16
{
    _mPNHV_WeekDepTmTbl_Stat_AR.PNHV_DepTm16.phys = getValue(this);
    _PNHV_WeekDepTmTbl_Stat_AR_PNHV_DepTm16_LastState = PNHV_WeekDepTmTbl_Stat_AR_Change( _PNHV_WeekDepTmTbl_Stat_AR_PNHV_DepTm16_LastState, _mPNHV_WeekDepTmTbl_Stat_AR.PNHV_DepTm16, 0 );
}
/*@@end*/

/*@@envVar:HMI_PNHV_DepTm17:*/
on EnvVar HMI_PNHV_DepTm17
{
    _mPNHV_WeekDepTmTbl_Stat_AR.PNHV_DepTm17.phys = getValue(this);
    _PNHV_WeekDepTmTbl_Stat_AR_PNHV_DepTm17_LastState = PNHV_WeekDepTmTbl_Stat_AR_Change( _PNHV_WeekDepTmTbl_Stat_AR_PNHV_DepTm17_LastState, _mPNHV_WeekDepTmTbl_Stat_AR.PNHV_DepTm17, 0 );
}
/*@@end*/

/*@@envVar:HMI_PNHV_DepTm18:*/
on EnvVar HMI_PNHV_DepTm18
{
    _mPNHV_WeekDepTmTbl_Stat_AR.PNHV_DepTm18.phys = getValue(this);
    _PNHV_WeekDepTmTbl_Stat_AR_PNHV_DepTm18_LastState = PNHV_WeekDepTmTbl_Stat_AR_Change( _PNHV_WeekDepTmTbl_Stat_AR_PNHV_DepTm18_LastState, _mPNHV_WeekDepTmTbl_Stat_AR.PNHV_DepTm18, 0 );
}
/*@@end*/

/*@@envVar:HMI_PNHV_DepTm19:*/
on EnvVar HMI_PNHV_DepTm19
{
    _mPNHV_WeekDepTmTbl_Stat_AR.PNHV_DepTm19.phys = getValue(this);
    _PNHV_WeekDepTmTbl_Stat_AR_PNHV_DepTm19_LastState = PNHV_WeekDepTmTbl_Stat_AR_Change( _PNHV_WeekDepTmTbl_Stat_AR_PNHV_DepTm19_LastState, _mPNHV_WeekDepTmTbl_Stat_AR.PNHV_DepTm19, 0 );
}
/*@@end*/

/*@@envVar:HMI_PNHV_DepTm20:*/
on EnvVar HMI_PNHV_DepTm20
{
    _mPNHV_WeekDepTmTbl_Stat_AR.PNHV_DepTm20.phys = getValue(this);
    _PNHV_WeekDepTmTbl_Stat_AR_PNHV_DepTm20_LastState = PNHV_WeekDepTmTbl_Stat_AR_Change( _PNHV_WeekDepTmTbl_Stat_AR_PNHV_DepTm20_LastState, _mPNHV_WeekDepTmTbl_Stat_AR.PNHV_DepTm20, 0 );
}
/*@@end*/

/*@@envVar:HMI_PNHV_DepTm21:*/
on EnvVar HMI_PNHV_DepTm21
{
    _mPNHV_WeekDepTmTbl_Stat_AR.PNHV_DepTm21.phys = getValue(this);
    _PNHV_WeekDepTmTbl_Stat_AR_PNHV_DepTm21_LastState = PNHV_WeekDepTmTbl_Stat_AR_Change( _PNHV_WeekDepTmTbl_Stat_AR_PNHV_DepTm21_LastState, _mPNHV_WeekDepTmTbl_Stat_AR.PNHV_DepTm21, 0 );
}
/*@@end*/

/*@@envVar:HMI_PNHV_DepTmUpdtCnt_1To4:*/
on EnvVar HMI_PNHV_DepTmUpdtCnt_1To4
{
    _mPNHV_WeekDepTmTbl_Stat_AR.PNHV_DepTmUpdtCnt_1To4.phys = getValue(this);
    _PNHV_WeekDepTmTbl_Stat_AR_PNHV_DepTmUpdtCnt_1To4_LastState = PNHV_WeekDepTmTbl_Stat_AR_Change( _PNHV_WeekDepTmTbl_Stat_AR_PNHV_DepTmUpdtCnt_1To4_LastState, _mPNHV_WeekDepTmTbl_Stat_AR.PNHV_DepTmUpdtCnt_1To4, 0 );
}
/*@@end*/

/*@@envVar:HMI_PNHV_DepTmUpdtCnt_5To8:*/
on EnvVar HMI_PNHV_DepTmUpdtCnt_5To8
{
    _mPNHV_WeekDepTmTbl_Stat_AR.PNHV_DepTmUpdtCnt_5To8.phys = getValue(this);
    _PNHV_WeekDepTmTbl_Stat_AR_PNHV_DepTmUpdtCnt_5To8_LastState = PNHV_WeekDepTmTbl_Stat_AR_Change( _PNHV_WeekDepTmTbl_Stat_AR_PNHV_DepTmUpdtCnt_5To8_LastState, _mPNHV_WeekDepTmTbl_Stat_AR.PNHV_DepTmUpdtCnt_5To8, 0 );
}
/*@@end*/

/*@@envVar:HMI_PNHV_DepTmUpdtCnt_9To12:*/
on EnvVar HMI_PNHV_DepTmUpdtCnt_9To12
{
    _mPNHV_WeekDepTmTbl_Stat_AR.PNHV_DepTmUpdtCnt_9To12.phys = getValue(this);
    _PNHV_WeekDepTmTbl_Stat_AR_PNHV_DepTmUpdtCnt_9To12_LastState = PNHV_WeekDepTmTbl_Stat_AR_Change( _PNHV_WeekDepTmTbl_Stat_AR_PNHV_DepTmUpdtCnt_9To12_LastState, _mPNHV_WeekDepTmTbl_Stat_AR.PNHV_DepTmUpdtCnt_9To12, 0 );
}
/*@@end*/

/*@@envVar:HMI_PNHV_DepTmUpdtCnt_13To16:*/
on EnvVar HMI_PNHV_DepTmUpdtCnt_13To16
{
    _mPNHV_WeekDepTmTbl_Stat_AR.PNHV_DepTmUpdtCnt_13To16.phys = getValue(this);
    _PNHV_WeekDepTmTbl_Stat_AR_PNHV_DepTmUpdtCnt_13To16_LastState = PNHV_WeekDepTmTbl_Stat_AR_Change( _PNHV_WeekDepTmTbl_Stat_AR_PNHV_DepTmUpdtCnt_13To16_LastState, _mPNHV_WeekDepTmTbl_Stat_AR.PNHV_DepTmUpdtCnt_13To16, 0 );
}
/*@@end*/

/*@@envVar:HMI_PNHV_DepTmUpdtCnt_17To20:*/
on EnvVar HMI_PNHV_DepTmUpdtCnt_17To20
{
    _mPNHV_WeekDepTmTbl_Stat_AR.PNHV_DepTmUpdtCnt_17To20.phys = getValue(this);
    _PNHV_WeekDepTmTbl_Stat_AR_PNHV_DepTmUpdtCnt_17To20_LastState = PNHV_WeekDepTmTbl_Stat_AR_Change( _PNHV_WeekDepTmTbl_Stat_AR_PNHV_DepTmUpdtCnt_17To20_LastState, _mPNHV_WeekDepTmTbl_Stat_AR.PNHV_DepTmUpdtCnt_17To20, 0 );
}
/*@@end*/

/*@@envVar:HMI_PNHV_DepTmUpdtCnt_21:*/
on EnvVar HMI_PNHV_DepTmUpdtCnt_21
{
    _mPNHV_WeekDepTmTbl_Stat_AR.PNHV_DepTmUpdtCnt_21.phys = getValue(this);
    _PNHV_WeekDepTmTbl_Stat_AR_PNHV_DepTmUpdtCnt_21_LastState = PNHV_WeekDepTmTbl_Stat_AR_Change( _PNHV_WeekDepTmTbl_Stat_AR_PNHV_DepTmUpdtCnt_21_LastState, _mPNHV_WeekDepTmTbl_Stat_AR.PNHV_DepTmUpdtCnt_21, 0 );
}
/*@@end*/

/*@@envVar:HMI_PNHV_WeekDepTmTbl_New:*/
on EnvVar HMI_PNHV_WeekDepTmTbl_New
{
    _mPNHV_WeekDepTmTbl_Stat_AR.PNHV_WeekDepTmTbl_New.phys = getValue(this);
    _PNHV_WeekDepTmTbl_Stat_AR_PNHV_WeekDepTmTbl_New_LastState = PNHV_WeekDepTmTbl_Stat_AR_Change( _PNHV_WeekDepTmTbl_Stat_AR_PNHV_WeekDepTmTbl_New_LastState, _mPNHV_WeekDepTmTbl_Stat_AR.PNHV_WeekDepTmTbl_New, 0 );
}
/*@@end*/

/*@@envVar:HMI_PNHV_WeekDepTmTbl_PartId:*/
on EnvVar HMI_PNHV_WeekDepTmTbl_PartId
{
    _mPNHV_WeekDepTmTbl_Stat_AR.PNHV_WeekDepTmTbl_PartId.phys = getValue(this);
    _PNHV_WeekDepTmTbl_Stat_AR_PNHV_WeekDepTmTbl_PartId_LastState = PNHV_WeekDepTmTbl_Stat_AR_Change( _PNHV_WeekDepTmTbl_Stat_AR_PNHV_WeekDepTmTbl_PartId_LastState, _mPNHV_WeekDepTmTbl_Stat_AR.PNHV_WeekDepTmTbl_PartId, 0 );
}
/*@@end*/

/*@@envVar:HMI_PNHV_WeekDepTmTbl_TxActv:*/
on EnvVar HMI_PNHV_WeekDepTmTbl_TxActv
{
    _mPNHV_WeekDepTmTbl_Stat_AR.PNHV_WeekDepTmTbl_TxActv.phys = getValue(this);
    _PNHV_WeekDepTmTbl_Stat_AR_PNHV_WeekDepTmTbl_TxActv_LastState = PNHV_WeekDepTmTbl_Stat_AR_Change( _PNHV_WeekDepTmTbl_Stat_AR_PNHV_WeekDepTmTbl_TxActv_LastState, _mPNHV_WeekDepTmTbl_Stat_AR.PNHV_WeekDepTmTbl_TxActv, 0 );
}
/*@@end*/

/*@@caplFunc:PreCond_CfgStat_AR_check_output():*/
PreCond_CfgStat_AR_check_output()
{
    if( !getValue( HMI__STMSG_PreCond_CfgStat_AR ) )
    {
        // Botschaft PreCond_CfgStat_AR ID: 1179 --- Sendeart 5 cyclicAndSpontanWithDelay --- 
        _PreCond_CfgStat_AR_Cnt--;
        if( _PreCond_CfgStat_AR_Cnt < 1 )
        {
            PreCond_CfgStat_AR_output(); // Nachricht wg. abgelaufenem Zyklus ausgeben
            _PreCond_CfgStat_AR_Cnt = _PreCond_CfgStat_AR_CycleCount; // Zyklus-Zähler zurücksetzen
            _PreCond_CfgStat_AR_SpontanFlag = 0; // Spontan-Flag zurücksetzen
        }
        else if( _PreCond_CfgStat_AR_SpontanFlag)
        {
            PreCond_CfgStat_AR_output(); // Nachricht wg. spontaner Änderung ausgeben
            _PreCond_CfgStat_AR_SpontanFlag = 0; // Spontan-Flag zurücksetzen
        }
    }
}
/*@@end*/

/*@@caplFunc:PreCond_CfgStat_AR_init():*/
PreCond_CfgStat_AR_init()
{   /* Botschaft PreCond_CfgStat_AR ID: 1179 --- Sendeart 5 cyclicAndSpontanWithDelay --- 
BA_ "ApplMessage" BO_ 1179 0;
BA_ "NmAsrMessage" BO_ 1179 0;
BA_ "GenMsgMinAcceptLength" BO_ 1179 8;
BA_ "GenMsgILSupport" BO_ 1179 1;
BA_ "DiagState" BO_ 1179 0;
BA_ "DiagRequest" BO_ 1179 0;
BA_ "DiagResponse" BO_ 1179 0;
BA_ "GenMsgStartValue" BO_ 1179 "0";
BA_ "GenMsgDelayTime" BO_ 1179 5;
BA_ "GenMsgNrOfRepetitions" BO_ 1179 0;
BA_ "GenMsgCycleTime" BO_ 1179 1000;
BA_ "GenMsgSendType" BO_ 1179 5;
    */
    _PreCond_CfgStat_AR_Timebase =           c_tDBKomTimer_20ms;
    _PreCond_CfgStat_AR_CycleCount =       1000 / _PreCond_CfgStat_AR_Timebase;
    _PreCond_CfgStat_AR_StartDelay =          0 / _PreCond_CfgStat_AR_Timebase;
    _PreCond_CfgStat_AR_Cnt = _PreCond_CfgStat_AR_StartDelay;
    _PreCond_CfgStat_AR_SpontanFlag = 0;

    putValue( HMI__STMSGSD_PreCond_CfgStat_AR, _PreCond_CfgStat_AR_StartDelay * _PreCond_CfgStat_AR_Timebase );

    putValue( HMI_HVAC_PreCond_Disp_Rq, 0 );
    _mPreCond_CfgStat_AR.HVAC_PreCond_Disp_Rq.phys = getValue( HMI_HVAC_PreCond_Disp_Rq );
    _mPreCond_CfgStat_AR.HVAC_PreCond2_Disp_Rq.phys = getValue( HMI_HVAC_PreCond2_Disp_Rq );
    _mPreCond_CfgStat_AR.HVAC_PreCond4_Disp_Rq.phys = getValue( HMI_HVAC_PreCond4_Disp_Rq );
    _mPreCond_CfgStat_AR.PreCond_AirFrshnr_CfgStat.phys = getValue( HMI_PreCond_AirFrshnr_CfgStat );
    _mPreCond_CfgStat_AR.PreCond_Ionzr_CfgStat.phys = getValue( HMI_PreCond_Ionzr_CfgStat );
    _mPreCond_CfgStat_AR.PreCond_Mode_CfgStat.phys = getValue( HMI_PreCond_Mode_CfgStat );
    _mPreCond_CfgStat_AR.PreCond_Seat_FL_CfgStat.phys = getValue( HMI_PreCond_Seat_FL_CfgStat );
    _mPreCond_CfgStat_AR.PreCond_Seat_FR_CfgStat.phys = getValue( HMI_PreCond_Seat_FR_CfgStat );
    _mPreCond_CfgStat_AR.PreCond_Seat_RL_CfgStat.phys = getValue( HMI_PreCond_Seat_RL_CfgStat );
    _mPreCond_CfgStat_AR.PreCond_Seat_RR_CfgStat.phys = getValue( HMI_PreCond_Seat_RR_CfgStat );
}
/*@@end*/

/*@@caplFunc:PreCond_CfgStat_AR_output():*/
PreCond_CfgStat_AR_output(void)
{
    output( _mPreCond_CfgStat_AR );
}
/*@@end*/

/*@@caplFunc:PreCond_CfgStat_AR_saveEnvVars(dword):*/
PreCond_CfgStat_AR_saveEnvVars( dword hFile )
{
    filePutString("\n// Knoten EIS: PreCond_CfgStat_AR\n", 29, hFile );
    snprintf( buffer, elcount( buffer ), "0.0000 HMI__STMSG_PreCond_CfgStat := %X\n", getValue( HMI__STMSG_PreCond_CfgStat_AR ) );        filePutString( buffer, elcount( buffer ), hFile );
    snprintf( buffer, elcount( buffer ), "0.0000 HMI__STMSGT_PreCond_CfgStat := %X\n", getValue( HMI__STMSGT_PreCond_CfgStat_AR ) );        filePutString( buffer, elcount( buffer ), hFile );
    snprintf( buffer, elcount( buffer ), "0.0000 HMI_HVAC_PreCond2_Disp_Rq := %X\n", getValue( HMI_HVAC_PreCond2_Disp_Rq ) );        filePutString( buffer, elcount( buffer ), hFile );
    snprintf( buffer, elcount( buffer ), "0.0000 HMI_HVAC_PreCond4_Disp_Rq := %X\n", getValue( HMI_HVAC_PreCond4_Disp_Rq ) );        filePutString( buffer, elcount( buffer ), hFile );
    snprintf( buffer, elcount( buffer ), "0.0000 HMI_HVAC_PreCond_Disp_Rq := %X\n", getValue( HMI_HVAC_PreCond_Disp_Rq ) );        filePutString( buffer, elcount( buffer ), hFile );
    snprintf( buffer, elcount( buffer ), "0.0000 HMI_PreCond_AirFrshnr_CfgStat := %X\n", getValue( HMI_PreCond_AirFrshnr_CfgStat ) );        filePutString( buffer, elcount( buffer ), hFile );
    snprintf( buffer, elcount( buffer ), "0.0000 HMI_PreCond_Ionzr_CfgStat := %X\n", getValue( HMI_PreCond_Ionzr_CfgStat ) );        filePutString( buffer, elcount( buffer ), hFile );
    snprintf( buffer, elcount( buffer ), "0.0000 HMI_PreCond_Mode_CfgStat := %X\n", getValue( HMI_PreCond_Mode_CfgStat ) );        filePutString( buffer, elcount( buffer ), hFile );
    snprintf( buffer, elcount( buffer ), "0.0000 HMI_PreCond_Seat_FL_CfgStat := %X\n", getValue( HMI_PreCond_Seat_FL_CfgStat ) );        filePutString( buffer, elcount( buffer ), hFile );
    snprintf( buffer, elcount( buffer ), "0.0000 HMI_PreCond_Seat_FR_CfgStat := %X\n", getValue( HMI_PreCond_Seat_FR_CfgStat ) );        filePutString( buffer, elcount( buffer ), hFile );
    snprintf( buffer, elcount( buffer ), "0.0000 HMI_PreCond_Seat_RL_CfgStat := %X\n", getValue( HMI_PreCond_Seat_RL_CfgStat ) );        filePutString( buffer, elcount( buffer ), hFile );
    snprintf( buffer, elcount( buffer ), "0.0000 HMI_PreCond_Seat_RR_CfgStat := %X\n", getValue( HMI_PreCond_Seat_RR_CfgStat ) );        filePutString( buffer, elcount( buffer ), hFile );
}
/*@@end*/

/*@@timer:_tPreCond_CfgStat_AR:*/
on timer _tPreCond_CfgStat_AR
{
    putValue( HMI__STMSG_PreCond_CfgStat_AR, 0 );
}
/*@@end*/

/*@@envVar:HMI__STMSG_PreCond_CfgStat_AR:*/
on EnvVar HMI__STMSG_PreCond_CfgStat_AR
{
    long tDelay;
    if( getValue( this ) == 2 )
    {
        tDelay = getValue( HMI__STMSGT_PreCond_CfgStat_AR );
        if( tDelay > 0)    
            setTimer( _tPreCond_CfgStat_AR, tDelay );
        else
            putValue( HMI__STMSG_PreCond_CfgStat_AR, 0 );
    }
}
/*@@end*/

/*@@envVar:HMI_HVAC_PreCond2_Disp_Rq:*/
on EnvVar HMI_HVAC_PreCond2_Disp_Rq
{
    _mPreCond_CfgStat_AR.HVAC_PreCond2_Disp_Rq.phys = getValue(this);
    _PreCond_CfgStat_AR_SpontanFlag = 1;
}
/*@@end*/

/*@@envVar:HMI_HVAC_PreCond4_Disp_Rq:*/
on EnvVar HMI_HVAC_PreCond4_Disp_Rq
{
    _mPreCond_CfgStat_AR.HVAC_PreCond4_Disp_Rq.phys = getValue(this);
    _PreCond_CfgStat_AR_SpontanFlag = 1;
}
/*@@end*/

/*@@envVar:HMI_HVAC_PreCond_Disp_Rq:*/
on EnvVar HMI_HVAC_PreCond_Disp_Rq
{
    _mPreCond_CfgStat_AR.HVAC_PreCond_Disp_Rq.phys = getValue(this);
    _PreCond_CfgStat_AR_SpontanFlag = 1;
}
/*@@end*/

/*@@envVar:HMI_PreCond_AirFrshnr_CfgStat:*/
on EnvVar HMI_PreCond_AirFrshnr_CfgStat
{
    _mPreCond_CfgStat_AR.PreCond_AirFrshnr_CfgStat.phys = getValue(this);
    _PreCond_CfgStat_AR_SpontanFlag = 1;
}
/*@@end*/

/*@@envVar:HMI_PreCond_Ionzr_CfgStat:*/
on EnvVar HMI_PreCond_Ionzr_CfgStat
{
    _mPreCond_CfgStat_AR.PreCond_Ionzr_CfgStat.phys = getValue(this);
    _PreCond_CfgStat_AR_SpontanFlag = 1;
}
/*@@end*/

/*@@envVar:HMI_PreCond_Mode_CfgStat:*/
on EnvVar HMI_PreCond_Mode_CfgStat
{
    _mPreCond_CfgStat_AR.PreCond_Mode_CfgStat.phys = getValue(this);
    _PreCond_CfgStat_AR_SpontanFlag = 1;
}
/*@@end*/

/*@@envVar:HMI_PreCond_Seat_FL_CfgStat:*/
on EnvVar HMI_PreCond_Seat_FL_CfgStat
{
    _mPreCond_CfgStat_AR.PreCond_Seat_FL_CfgStat.phys = getValue(this);
    _PreCond_CfgStat_AR_SpontanFlag = 1;
}
/*@@end*/

/*@@envVar:HMI_PreCond_Seat_FR_CfgStat:*/
on EnvVar HMI_PreCond_Seat_FR_CfgStat
{
    _mPreCond_CfgStat_AR.PreCond_Seat_FR_CfgStat.phys = getValue(this);
    _PreCond_CfgStat_AR_SpontanFlag = 1;
}
/*@@end*/

/*@@envVar:HMI_PreCond_Seat_RL_CfgStat:*/
on EnvVar HMI_PreCond_Seat_RL_CfgStat
{
    _mPreCond_CfgStat_AR.PreCond_Seat_RL_CfgStat.phys = getValue(this);
    _PreCond_CfgStat_AR_SpontanFlag = 1;
}
/*@@end*/

/*@@envVar:HMI_PreCond_Seat_RR_CfgStat:*/
on EnvVar HMI_PreCond_Seat_RR_CfgStat
{
    _mPreCond_CfgStat_AR.PreCond_Seat_RR_CfgStat.phys = getValue(this);
    _PreCond_CfgStat_AR_SpontanFlag = 1;
}
/*@@end*/

/*@@caplFunc:PresfCtrl_Rq_ESP_Activity(int):*/
void PresfCtrl_Rq_ESP_Activity(int active )
{
      if( active )
      {
          if( _PresfCtrl_Rq_ESP_AR_SigActivity == 0)
            _PresfCtrl_Rq_ESP_AR_Cnt = 1;
        _PresfCtrl_Rq_ESP_AR_SigActivity++;
      }
    else
    {
        _PresfCtrl_Rq_ESP_AR_SigActivity--;
      }
}
/*@@end*/

/*@@caplFunc:PresfCtrl_Rq_ESP_AR_Change(int,int,int):*/
int PresfCtrl_Rq_ESP_AR_Change(int lastValue, int sigValue, int inActValue )
{
    bActiveHelper = (sigValue != inActValue );
      if( !lastValue && bActiveHelper )
        PresfCtrl_Rq_ESP_Activity( 1 );
      else if( lastValue && !bActiveHelper )
        PresfCtrl_Rq_ESP_Activity(0 );
    return bActiveHelper;
}
/*@@end*/

/*@@caplFunc:PresfCtrl_Rq_ESP_AR_check_output():*/
PresfCtrl_Rq_ESP_AR_check_output()
{
    if( !getValue( HMI__STMSG_PresfCtrl_Rq_ESP_AR ) )
    {
        // Botschaft PresfCtrl_Rq_ESP_AR ID: 33 --- Sendeart 8 cyclicIfActiveFast --- 
        _PresfCtrl_Rq_ESP_AR_Cnt--;
        if( _PresfCtrl_Rq_ESP_AR_Cnt < 1 )
        {
            PresfCtrl_Rq_ESP_AR_output(); // Zyklus abgelaufen, Nachricht senden
            _PresfCtrl_Rq_ESP_AR_Cnt = _PresfCtrl_Rq_ESP_AR_SigActivity ? _PresfCtrl_Rq_ESP_AR_CycleCountFast : _PresfCtrl_Rq_ESP_AR_CycleCountSlow;
        }
    }
}
/*@@end*/

/*@@caplFunc:PresfCtrl_Rq_ESP_AR_init():*/
PresfCtrl_Rq_ESP_AR_init()
{   /* Botschaft PresfCtrl_Rq_ESP_AR ID: 33 --- Sendeart 8 cyclicIfActiveFast --- 
BA_ "ApplMessage" BO_ 33 0;
BA_ "NmAsrMessage" BO_ 33 0;
BA_ "GenMsgMinAcceptLength" BO_ 33 8;
BA_ "GenMsgILSupport" BO_ 33 1;
BA_ "DiagState" BO_ 33 0;
BA_ "DiagRequest" BO_ 33 0;
BA_ "DiagResponse" BO_ 33 0;
BA_ "GenMsgStartValue" BO_ 33 "0";
BA_ "GenMsgDelayTime" BO_ 33 5;
BA_ "GenMsgCycleTime" BO_ 33 200;
BA_ "GenMsgCycleTimeActive" BO_ 33 20;
BA_ "GenMsgSendType" BO_ 33 8;
    */
    _PresfCtrl_Rq_ESP_AR_Timebase =           c_tDBKomTimer_20ms;
    _PresfCtrl_Rq_ESP_AR_CycleCountSlow =     200 / _PresfCtrl_Rq_ESP_AR_Timebase;
    _PresfCtrl_Rq_ESP_AR_CycleCountFast =      20 / _PresfCtrl_Rq_ESP_AR_Timebase;
    _PresfCtrl_Rq_ESP_AR_StartDelay =           0 / _PresfCtrl_Rq_ESP_AR_Timebase;
    _PresfCtrl_Rq_ESP_AR_Cnt = _PresfCtrl_Rq_ESP_AR_StartDelay;
    _PresfCtrl_Rq_ESP_AR_SigActivity = 0;

    putValue( HMI__STMSGSD_PresfCtrl_Rq_ESP_AR, _PresfCtrl_Rq_ESP_AR_StartDelay * _PresfCtrl_Rq_ESP_AR_Timebase );
    
    _mPresfCtrl_Rq_ESP_AR.Presf_Enbl.phys = getValue( HMI_Presf_Enbl );
    _mPresfCtrl_Rq_ESP_AR.Presf_FricFctr_Lo.phys = getValue( HMI_Presf_FricFctr_Lo );
    _mPresfCtrl_Rq_ESP_AR.Presf_Lvl_V2.phys = getValue( HMI_Presf_Lvl_V2 );
    _mPresfCtrl_Rq_ESP_AR.Presf_Snd_Rq.phys = getValue( HMI_Presf_Snd_Rq );
    _mPresfCtrl_Rq_ESP_AR.PresfAccelReset_NotExcd.phys = getValue( HMI_PresfAccelReset_NotExcd );
    _mPresfCtrl_Rq_ESP_AR.PresfAct1_Adj_Rq.phys = getValue( HMI_PresfAct1_Adj_Rq );
    _mPresfCtrl_Rq_ESP_AR.PresfAct2_Adj_Rq.phys = getValue( HMI_PresfAct2_Adj_Rq );
    _mPresfCtrl_Rq_ESP_AR.PresfAct3_Adj_Rq.phys = getValue( HMI_PresfAct3_Adj_Rq );
    _mPresfCtrl_Rq_ESP_AR.PresfAct4_Adj_Rq.phys = getValue( HMI_PresfAct4_Adj_Rq );
    _mPresfCtrl_Rq_ESP_AR.PresfAct5_Adj_Rq.phys = getValue( HMI_PresfAct5_Adj_Rq );
    _mPresfCtrl_Rq_ESP_AR.PresfAct6_Adj_Rq.phys = getValue( HMI_PresfAct6_Adj_Rq );
    _mPresfCtrl_Rq_ESP_AR.PresfAct7_Adj_Rq.phys = getValue( HMI_PresfAct7_Adj_Rq );
    _mPresfCtrl_Rq_ESP_AR.PresfAct8_Adj_Rq.phys = getValue( HMI_PresfAct8_Adj_Rq );
    _mPresfCtrl_Rq_ESP_AR.PresfAct9_Adj_Rq.phys = getValue( HMI_PresfAct9_Adj_Rq );
    _mPresfCtrl_Rq_ESP_AR.PresfAct10_Adj_Rq.phys = getValue( HMI_PresfAct10_Adj_Rq );
    _mPresfCtrl_Rq_ESP_AR.PresfAct11_Adj_Rq.phys = getValue( HMI_PresfAct11_Adj_Rq );
    _mPresfCtrl_Rq_ESP_AR.PresfAct12_Adj_Rq.phys = getValue( HMI_PresfAct12_Adj_Rq );
    _mPresfCtrl_Rq_ESP_AR.PresfAct_Adj_Tgl.phys = getValue( HMI_PresfAct_Adj_Tgl );
//    _mPresfCtrl_Rq_ESP_AR.Rsrv1_PresfCtrl_Rq_ESP.phys = getValue( HMI_Rsrv1_PresfCtrl_Rq_ESP );
    _mPresfCtrl_Rq_ESP_AR.Rsrv2_PresfCtrl_Rq_ESP.phys = getValue( HMI_Rsrv2_PresfCtrl_Rq_ESP );
    _mPresfCtrl_Rq_ESP_AR.Rsrv3_PresfCtrl_Rq_ESP.phys = getValue( HMI_Rsrv3_PresfCtrl_Rq_ESP );
    _mPresfCtrl_Rq_ESP_AR.Rsrv4_PresfCtrl_Rq_ESP.phys = getValue( HMI_Rsrv4_PresfCtrl_Rq_ESP );
    _mPresfCtrl_Rq_ESP_AR.Rsrv5_PresfCtrl_Rq_ESP.phys = getValue( HMI_Rsrv5_PresfCtrl_Rq_ESP );
    _mPresfCtrl_Rq_ESP_AR.Rsrv6_PresfCtrl_Rq_ESP.phys = getValue( HMI_Rsrv6_PresfCtrl_Rq_ESP );
}
/*@@end*/

/*@@caplFunc:PresfCtrl_Rq_ESP_AR_output():*/
void PresfCtrl_Rq_ESP_AR_output(void)
{
    byte crc;
    byte SQC_help;

    if( !getValue( HMI_SQC_PresfCtrl_Rq_ESP_Auto ) )
    {
        // berechne message counter
        SQC_help = getValue( HMI_SQC_PresfCtrl_Rq_ESP );
        if( SQC_help >= 15 ) SQC_help = 0;
        else SQC_help++;
        putValue( HMI_SQC_PresfCtrl_Rq_ESP, SQC_help );
        _mPresfCtrl_Rq_ESP_AR.SQC_PresfCtrl_Rq_ESP = SQC_help;
    }
    else
          _mPresfCtrl_Rq_ESP_AR.SQC_PresfCtrl_Rq_ESP = getValue( HMI_SQC_PresfCtrl_Rq_ESP );

    if( !getValue( HMI_PresfAct_Adj_Tgl_Auto ) )
    {
       // berechne message counter
        if( _mPresfCtrl_Rq_ESP_AR.PresfAct_Adj_Tgl >= 1 ) _mPresfCtrl_Rq_ESP_AR.PresfAct_Adj_Tgl = 0;
        else _mPresfCtrl_Rq_ESP_AR.PresfAct_Adj_Tgl++;
        putValue( HMI_PresfAct_Adj_Tgl, _mPresfCtrl_Rq_ESP_AR.PresfAct_Adj_Tgl);
    }
    else
          _mPresfCtrl_Rq_ESP_AR.PresfAct_Adj_Tgl = getValue( HMI_PresfAct_Adj_Tgl);

    if( getValue( HMI_CRC_PresfCtrl_Rq_ESP_Profile_02 ) )
    {
        if( !getValue( HMI_CRC_PresfCtrl_Rq_ESP_Auto ) )
        {   // CRC according Profile_02 ( W213 )
            // berechne crc
            crc = 0xFF;
//            crc = crctable_profile02[ crc ^ _mPresfCtrl_Rq_ESP_AR.byte( 0 ) ];  CRC
            crc = crctable_profile02[ crc ^ _mPresfCtrl_Rq_ESP_AR.byte( 1 ) ];
            crc = crctable_profile02[ crc ^ _mPresfCtrl_Rq_ESP_AR.byte( 2 ) ];
            crc = crctable_profile02[ crc ^ _mPresfCtrl_Rq_ESP_AR.byte( 3 ) ];
            crc = crctable_profile02[ crc ^ _mPresfCtrl_Rq_ESP_AR.byte( 4 ) ];
            crc = crctable_profile02[ crc ^ _mPresfCtrl_Rq_ESP_AR.byte( 5 ) ];
            crc = crctable_profile02[ crc ^ _mPresfCtrl_Rq_ESP_AR.byte( 6 ) ];
            crc = crctable_profile02[ crc ^ _mPresfCtrl_Rq_ESP_AR.byte( 7 ) ];
            crc = crctable_profile02[ crc ^ _PresfCtrl_Rq_ESP_AR_CRC_Offset[ _mPresfCtrl_Rq_ESP_AR.SQC_PresfCtrl_Rq_ESP ] ]; // load offset
            crc = (crc ^ 0xFF);
            if( getValue(  HMI_CRC_PresfCtrl_Rq_ESP_Invalid ) )
                crc++;
            _mPresfCtrl_Rq_ESP_AR.CRC_PresfCtrl_Rq_ESP = crc;
            putValue( HMI_CRC_PresfCtrl_Rq_ESP, crc );
        }
        else
            _mPresfCtrl_Rq_ESP_AR.CRC_PresfCtrl_Rq_ESP = getValue( HMI_CRC_PresfCtrl_Rq_ESP);
    }
    else
    {
        if( !getValue( HMI_CRC_PresfCtrl_Rq_ESP_Auto ) )
        {   // CRC according to SAE1850 ( W222 )
            // berechne crc
            crc = 0xFF;
//            crc = crctable[crc ^ _mPresfCtrl_Rq_ESP_AR.byte( 0 )];  CRC
            crc = crctable[crc ^ _mPresfCtrl_Rq_ESP_AR.byte( 1 )];
            crc = crctable[crc ^ _mPresfCtrl_Rq_ESP_AR.byte( 2 )];
            crc = crctable[crc ^ _mPresfCtrl_Rq_ESP_AR.byte( 3 )];
            crc = crctable[crc ^ _mPresfCtrl_Rq_ESP_AR.byte( 4 )];
            crc = crctable[crc ^ _mPresfCtrl_Rq_ESP_AR.byte( 5 )];
            crc = crctable[crc ^ _mPresfCtrl_Rq_ESP_AR.byte( 6 )];
            crc = crctable[crc ^ _mPresfCtrl_Rq_ESP_AR.byte( 7 )];
            crc = (crc ^ 0xFF);
            if( getValue(  HMI_CRC_PresfCtrl_Rq_ESP_Invalid ) )
                crc++;
            _mPresfCtrl_Rq_ESP_AR.CRC_PresfCtrl_Rq_ESP = crc;
            putValue( HMI_CRC_PresfCtrl_Rq_ESP, crc );
        }
        else
            _mPresfCtrl_Rq_ESP_AR.CRC_PresfCtrl_Rq_ESP = getValue( HMI_CRC_PresfCtrl_Rq_ESP);
    }
    output( _mPresfCtrl_Rq_ESP_AR );
}
/*@@end*/

/*@@caplFunc:PresfCtrl_Rq_ESP_AR_saveEnvVars(dword):*/
PresfCtrl_Rq_ESP_AR_saveEnvVars( dword hFile )
{
    filePutString("\n// Knoten EIS: PresfCtrl_Rq_ESP_AR\n", 33, hFile );
    snprintf( buffer, elcount( buffer ), "0.0000 HMI__STMSG_PresfCtrl_Rq_ESP := %X\n", getValue( HMI__STMSG_PresfCtrl_Rq_ESP_AR ) );    filePutString( buffer, elcount( buffer ), hFile );
    snprintf( buffer, elcount( buffer ), "0.0000 HMI__STMSGT_PresfCtrl_Rq_ESP := %X\n", getValue( HMI__STMSGT_PresfCtrl_Rq_ESP_AR ) );    filePutString( buffer, elcount( buffer ), hFile );
    snprintf( buffer, elcount( buffer ), "0.0000 HMI_CRC_PresfCtrl_Rq_ESP := %X\n", getValue( HMI_CRC_PresfCtrl_Rq_ESP ) );    filePutString( buffer, elcount( buffer ), hFile );
    snprintf( buffer, elcount( buffer ), "0.0000 HMI_CRC_PresfCtrl_Rq_ESP_Auto := %X\n", getValue( HMI_CRC_PresfCtrl_Rq_ESP_Auto ) );    filePutString( buffer, elcount( buffer ), hFile );
    snprintf( buffer, elcount( buffer ), "0.0000 HMI_Presf_Enbl := %X\n", getValue( HMI_Presf_Enbl ) );    filePutString( buffer, elcount( buffer ), hFile );
    snprintf( buffer, elcount( buffer ), "0.0000 HMI_Presf_FricFctr_Lo := %X\n", getValue( HMI_Presf_FricFctr_Lo ) );    filePutString( buffer, elcount( buffer ), hFile );
    snprintf( buffer, elcount( buffer ), "0.0000 HMI_Presf_Lvl_V2 := %X\n", getValue( HMI_Presf_Lvl_V2 ) );    filePutString( buffer, elcount( buffer ), hFile );
    snprintf( buffer, elcount( buffer ), "0.0000 HMI_Presf_Snd_Rq := %X\n", getValue( HMI_Presf_Snd_Rq ) );    filePutString( buffer, elcount( buffer ), hFile );
    snprintf( buffer, elcount( buffer ), "0.0000 HMI_PresfAccelReset_NotExcd := %X\n", getValue( HMI_PresfAccelReset_NotExcd ) );    filePutString( buffer, elcount( buffer ), hFile );
    snprintf( buffer, elcount( buffer ), "0.0000 HMI_PresfAct1_Adj_Rq := %X\n", getValue( HMI_PresfAct1_Adj_Rq ) );    filePutString( buffer, elcount( buffer ), hFile );
    snprintf( buffer, elcount( buffer ), "0.0000 HMI_PresfAct2_Adj_Rq := %X\n", getValue( HMI_PresfAct2_Adj_Rq ) );    filePutString( buffer, elcount( buffer ), hFile );
    snprintf( buffer, elcount( buffer ), "0.0000 HMI_PresfAct3_Adj_Rq := %X\n", getValue( HMI_PresfAct3_Adj_Rq ) );    filePutString( buffer, elcount( buffer ), hFile );
    snprintf( buffer, elcount( buffer ), "0.0000 HMI_PresfAct4_Adj_Rq := %X\n", getValue( HMI_PresfAct4_Adj_Rq ) );    filePutString( buffer, elcount( buffer ), hFile );
    snprintf( buffer, elcount( buffer ), "0.0000 HMI_PresfAct5_Adj_Rq := %X\n", getValue( HMI_PresfAct5_Adj_Rq ) );    filePutString( buffer, elcount( buffer ), hFile );
    snprintf( buffer, elcount( buffer ), "0.0000 HMI_PresfAct6_Adj_Rq := %X\n", getValue( HMI_PresfAct6_Adj_Rq ) );    filePutString( buffer, elcount( buffer ), hFile );
    snprintf( buffer, elcount( buffer ), "0.0000 HMI_PresfAct7_Adj_Rq := %X\n", getValue( HMI_PresfAct7_Adj_Rq ) );    filePutString( buffer, elcount( buffer ), hFile );
    snprintf( buffer, elcount( buffer ), "0.0000 HMI_PresfAct8_Adj_Rq := %X\n", getValue( HMI_PresfAct8_Adj_Rq ) );    filePutString( buffer, elcount( buffer ), hFile );
    snprintf( buffer, elcount( buffer ), "0.0000 HMI_PresfAct9_Adj_Rq := %X\n", getValue( HMI_PresfAct9_Adj_Rq ) );    filePutString( buffer, elcount( buffer ), hFile );
    snprintf( buffer, elcount( buffer ), "0.0000 HMI_PresfAct10_Adj_Rq := %X\n", getValue( HMI_PresfAct10_Adj_Rq ) );    filePutString( buffer, elcount( buffer ), hFile );
    snprintf( buffer, elcount( buffer ), "0.0000 HMI_PresfAct11_Adj_Rq := %X\n", getValue( HMI_PresfAct11_Adj_Rq ) );    filePutString( buffer, elcount( buffer ), hFile );
    snprintf( buffer, elcount( buffer ), "0.0000 HMI_PresfAct12_Adj_Rq := %X\n", getValue( HMI_PresfAct12_Adj_Rq ) );    filePutString( buffer, elcount( buffer ), hFile );
    snprintf( buffer, elcount( buffer ), "0.0000 HMI_PresfAct_Adj_Tgl := %X\n", getValue( HMI_PresfAct_Adj_Tgl ) );    filePutString( buffer, elcount( buffer ), hFile );
//    snprintf( buffer, elcount( buffer ), "0.0000 HMI_Rsrv1_PresfCtrl_Rq_ESP := %X\n", getValue( HMI_Rsrv1_PresfCtrl_Rq_ESP ) );    filePutString( buffer, elcount( buffer ), hFile );
    snprintf( buffer, elcount( buffer ), "0.0000 HMI_Rsrv2_PresfCtrl_Rq_ESP := %X\n", getValue( HMI_Rsrv2_PresfCtrl_Rq_ESP ) );    filePutString( buffer, elcount( buffer ), hFile );
    snprintf( buffer, elcount( buffer ), "0.0000 HMI_Rsrv3_PresfCtrl_Rq_ESP := %X\n", getValue( HMI_Rsrv3_PresfCtrl_Rq_ESP ) );    filePutString( buffer, elcount( buffer ), hFile );
    snprintf( buffer, elcount( buffer ), "0.0000 HMI_Rsrv4_PresfCtrl_Rq_ESP := %X\n", getValue( HMI_Rsrv4_PresfCtrl_Rq_ESP ) );    filePutString( buffer, elcount( buffer ), hFile );
    snprintf( buffer, elcount( buffer ), "0.0000 HMI_Rsrv5_PresfCtrl_Rq_ESP := %X\n", getValue( HMI_Rsrv5_PresfCtrl_Rq_ESP ) );    filePutString( buffer, elcount( buffer ), hFile );
    snprintf( buffer, elcount( buffer ), "0.0000 HMI_Rsrv6_PresfCtrl_Rq_ESP := %X\n", getValue( HMI_Rsrv6_PresfCtrl_Rq_ESP ) );    filePutString( buffer, elcount( buffer ), hFile );
    snprintf( buffer, elcount( buffer ), "0.0000 HMI_SQC_PresfCtrl_Rq_ESP := %X\n", getValue( HMI_SQC_PresfCtrl_Rq_ESP ) );    filePutString( buffer, elcount( buffer ), hFile );
    snprintf( buffer, elcount( buffer ), "0.0000 HMI_SQC_PresfCtrl_Rq_ESP_Auto := %X\n", getValue( HMI_SQC_PresfCtrl_Rq_ESP_Auto ) );    filePutString( buffer, elcount( buffer ), hFile );
}
/*@@end*/

/*@@timer:_tPresfCtrl_Rq_ESP_AR:*/
on timer _tPresfCtrl_Rq_ESP_AR
{
    putValue( HMI__STMSG_PresfCtrl_Rq_ESP_AR, 0 );
}
/*@@end*/

/*@@envVar:HMI__STMSG_PresfCtrl_Rq_ESP_AR:*/
on EnvVar HMI__STMSG_PresfCtrl_Rq_ESP_AR
{
    long tDelay;
    if( getValue( this ) == 2 )
    {
        tDelay = getValue( HMI__STMSGT_PresfCtrl_Rq_ESP_AR );
        if( tDelay > 0)    
            setTimer( _tPresfCtrl_Rq_ESP_AR, tDelay );
        else
            putValue( HMI__STMSG_PresfCtrl_Rq_ESP_AR, 0 );
    }
}
/*@@end*/

/*@@envVar:HMI__ALLDEF_PresfCtrl_Rq_ESP_AR:*/
on EnvVar HMI__ALLDEF_PresfCtrl_Rq_ESP_AR
{
    if( getValue(this) )
    {
        // alle signale auf default einstellen
        putValue( HMI_Rsrv6_PresfCtrl_Rq_ESP, 0 );
        putValue( HMI_Rsrv5_PresfCtrl_Rq_ESP, 0 );
        putValue( HMI_Rsrv4_PresfCtrl_Rq_ESP, 0 );
        putValue( HMI_Rsrv3_PresfCtrl_Rq_ESP, 0 );
        putValue( HMI_Rsrv2_PresfCtrl_Rq_ESP, 0 );
//        putValue( HMI_Rsrv1_PresfCtrl_Rq_ESP, 0 );
        putValue( HMI_Presf_Lvl_V2, 0 );
    }
}
/*@@end*/

/*@@envVar:HMI_Presf_Enbl:*/
on EnvVar HMI_Presf_Enbl
{
    _mPresfCtrl_Rq_ESP_AR.Presf_Enbl.phys = getValue(this);
}
/*@@end*/

/*@@envVar:HMI_Presf_FricFctr_Lo:*/
on EnvVar HMI_Presf_FricFctr_Lo
{
    _mPresfCtrl_Rq_ESP_AR.Presf_FricFctr_Lo.phys = getValue(this);
}
/*@@end*/

/*@@envVar:HMI_Presf_Lvl_V2:*/
on EnvVar HMI_Presf_Lvl_V2
{
    _mPresfCtrl_Rq_ESP_AR.Presf_Lvl_V2.phys = getValue(this);
    _PresfCtrl_Rq_ESP_AR_Presf_Lvl_V2_LastState = PresfCtrl_Rq_ESP_AR_Change( _PresfCtrl_Rq_ESP_AR_Presf_Lvl_V2_LastState, _mPresfCtrl_Rq_ESP_AR.Presf_Lvl_V2, 0 );
}
/*@@end*/

/*@@envVar:HMI_Presf_Snd_Rq:*/
on EnvVar HMI_Presf_Snd_Rq
{
    _mPresfCtrl_Rq_ESP_AR.Presf_Snd_Rq.phys = getValue(this);
}
/*@@end*/

/*@@envVar:HMI_PresfAccelReset_NotExcd:*/
on EnvVar HMI_PresfAccelReset_NotExcd
{
    _mPresfCtrl_Rq_ESP_AR.PresfAccelReset_NotExcd.phys = getValue(this);
}
/*@@end*/

/*@@envVar:HMI_PresfAct1_Adj_Rq:*/
on EnvVar HMI_PresfAct1_Adj_Rq
{
    _mPresfCtrl_Rq_ESP_AR.PresfAct1_Adj_Rq.phys = getValue(this);
}
/*@@end*/

/*@@envVar:HMI_PresfAct2_Adj_Rq:*/
on EnvVar HMI_PresfAct2_Adj_Rq
{
    _mPresfCtrl_Rq_ESP_AR.PresfAct2_Adj_Rq.phys = getValue(this);
}
/*@@end*/

/*@@envVar:HMI_PresfAct3_Adj_Rq:*/
on EnvVar HMI_PresfAct3_Adj_Rq
{
    _mPresfCtrl_Rq_ESP_AR.PresfAct3_Adj_Rq.phys = getValue(this);
}
/*@@end*/

/*@@envVar:HMI_PresfAct4_Adj_Rq:*/
on EnvVar HMI_PresfAct4_Adj_Rq
{
    _mPresfCtrl_Rq_ESP_AR.PresfAct4_Adj_Rq.phys = getValue(this);
}
/*@@end*/

/*@@envVar:HMI_PresfAct5_Adj_Rq:*/
on EnvVar HMI_PresfAct5_Adj_Rq
{
    _mPresfCtrl_Rq_ESP_AR.PresfAct5_Adj_Rq.phys = getValue(this);
}
/*@@end*/

/*@@envVar:HMI_PresfAct6_Adj_Rq:*/
on EnvVar HMI_PresfAct6_Adj_Rq
{
    _mPresfCtrl_Rq_ESP_AR.PresfAct6_Adj_Rq.phys = getValue(this);
}
/*@@end*/

/*@@envVar:HMI_PresfAct7_Adj_Rq:*/
on EnvVar HMI_PresfAct7_Adj_Rq
{
    _mPresfCtrl_Rq_ESP_AR.PresfAct7_Adj_Rq.phys = getValue(this);
}
/*@@end*/

/*@@envVar:HMI_PresfAct8_Adj_Rq:*/
on EnvVar HMI_PresfAct8_Adj_Rq
{
    _mPresfCtrl_Rq_ESP_AR.PresfAct8_Adj_Rq.phys = getValue(this);
}
/*@@end*/

/*@@envVar:HMI_PresfAct9_Adj_Rq:*/
on EnvVar HMI_PresfAct9_Adj_Rq
{
    _mPresfCtrl_Rq_ESP_AR.PresfAct9_Adj_Rq.phys = getValue(this);
}
/*@@end*/

/*@@envVar:HMI_PresfAct10_Adj_Rq:*/
on EnvVar HMI_PresfAct10_Adj_Rq
{
    _mPresfCtrl_Rq_ESP_AR.PresfAct10_Adj_Rq.phys = getValue(this);
}
/*@@end*/

/*@@envVar:HMI_PresfAct11_Adj_Rq:*/
on EnvVar HMI_PresfAct11_Adj_Rq
{
    _mPresfCtrl_Rq_ESP_AR.PresfAct11_Adj_Rq.phys = getValue(this);
}
/*@@end*/

/*@@envVar:HMI_PresfAct12_Adj_Rq:*/
on EnvVar HMI_PresfAct12_Adj_Rq
{
    _mPresfCtrl_Rq_ESP_AR.PresfAct12_Adj_Rq.phys = getValue(this);
}
/*@@end*/

/*@@envVar:HMI_Rsrv2_PresfCtrl_Rq_ESP:*/
on EnvVar HMI_Rsrv2_PresfCtrl_Rq_ESP
{
    _mPresfCtrl_Rq_ESP_AR.Rsrv2_PresfCtrl_Rq_ESP.phys = getValue(this);
    _PresfCtrl_Rq_ESP_AR_Rsrv2_PresfCtrl_Rq_ESP_LastState = PresfCtrl_Rq_ESP_AR_Change( _PresfCtrl_Rq_ESP_AR_Rsrv2_PresfCtrl_Rq_ESP_LastState, _mPresfCtrl_Rq_ESP_AR.Rsrv2_PresfCtrl_Rq_ESP, 0 );
}
/*@@end*/

/*@@envVar:HMI_Rsrv3_PresfCtrl_Rq_ESP:*/
on EnvVar HMI_Rsrv3_PresfCtrl_Rq_ESP
{
    _mPresfCtrl_Rq_ESP_AR.Rsrv3_PresfCtrl_Rq_ESP.phys = getValue(this);
    _PresfCtrl_Rq_ESP_AR_Rsrv3_PresfCtrl_Rq_ESP_LastState = PresfCtrl_Rq_ESP_AR_Change( _PresfCtrl_Rq_ESP_AR_Rsrv3_PresfCtrl_Rq_ESP_LastState, _mPresfCtrl_Rq_ESP_AR.Rsrv3_PresfCtrl_Rq_ESP, 0 );
}
/*@@end*/

/*@@envVar:HMI_Rsrv4_PresfCtrl_Rq_ESP:*/
on EnvVar HMI_Rsrv4_PresfCtrl_Rq_ESP
{
    _mPresfCtrl_Rq_ESP_AR.Rsrv4_PresfCtrl_Rq_ESP.phys = getValue(this);
    _PresfCtrl_Rq_ESP_AR_Rsrv4_PresfCtrl_Rq_ESP_LastState = PresfCtrl_Rq_ESP_AR_Change( _PresfCtrl_Rq_ESP_AR_Rsrv4_PresfCtrl_Rq_ESP_LastState, _mPresfCtrl_Rq_ESP_AR.Rsrv4_PresfCtrl_Rq_ESP, 0 );
}
/*@@end*/

/*@@envVar:HMI_Rsrv5_PresfCtrl_Rq_ESP:*/
on EnvVar HMI_Rsrv5_PresfCtrl_Rq_ESP
{
    _mPresfCtrl_Rq_ESP_AR.Rsrv5_PresfCtrl_Rq_ESP.phys = getValue(this);
    _PresfCtrl_Rq_ESP_AR_Rsrv5_PresfCtrl_Rq_ESP_LastState = PresfCtrl_Rq_ESP_AR_Change( _PresfCtrl_Rq_ESP_AR_Rsrv5_PresfCtrl_Rq_ESP_LastState, _mPresfCtrl_Rq_ESP_AR.Rsrv5_PresfCtrl_Rq_ESP, 0 );
}
/*@@end*/

/*@@envVar:HMI_Rsrv6_PresfCtrl_Rq_ESP:*/
on EnvVar HMI_Rsrv6_PresfCtrl_Rq_ESP
{
    _mPresfCtrl_Rq_ESP_AR.Rsrv6_PresfCtrl_Rq_ESP.phys = getValue(this);
    _PresfCtrl_Rq_ESP_AR_Rsrv6_PresfCtrl_Rq_ESP_LastState = PresfCtrl_Rq_ESP_AR_Change( _PresfCtrl_Rq_ESP_AR_Rsrv6_PresfCtrl_Rq_ESP_LastState, _mPresfCtrl_Rq_ESP_AR.Rsrv6_PresfCtrl_Rq_ESP, 0 );
}
/*@@end*/

/*@@caplFunc:PT_DataContain_Rq_AR_check_output():*/
PT_DataContain_Rq_AR_check_output()
{
    if( !getValue( HMI__STMSG_PT_DataContain_Rq_AR ) )
    {
        // Botschaft PT_DataContain_Rq_AR ID: 1178 --- Sendeart 5 cyclicAndSpontanWithDelay --- 
        if( _PT_DataContain_Rq_AR_DelayCnt > 0) _PT_DataContain_Rq_AR_DelayCnt--; // Mindestsendeabstand
        _PT_DataContain_Rq_AR_Cnt--;
        if( _PT_DataContain_Rq_AR_Cnt < 1 )
        {
            if( _PT_DataContain_Rq_AR_DelayCnt < 1 )
            {
                PT_DataContain_Rq_AR_output(); // Nachricht wg. abgelaufenem Zyklus ausgeben (Mindestsendeabstand eingehalten)
                _PT_DataContain_Rq_AR_SpontanFlag = 0; // Spontan-Flag zurücksetzen
                _PT_DataContain_Rq_AR_DelayCnt = _PT_DataContain_Rq_AR_MinDelay;
            }
            else
            {
                // Spontanflag setzen damit nach Ablauf Mindestsendeabstand gesendet wird
                 _PT_DataContain_Rq_AR_SpontanFlag = 1;
            }
            _PT_DataContain_Rq_AR_Cnt = _PT_DataContain_Rq_AR_CycleCount; // Zyklus-Zähler zurücksetzen
        }
        else if( _PT_DataContain_Rq_AR_SpontanFlag)
        {
            if( _PT_DataContain_Rq_AR_DelayCnt < 1 )
            {
                PT_DataContain_Rq_AR_output(); // Nachricht wg. spontaner Änderung ausgeben (Mindestsendeabstand eingehalten)
                _PT_DataContain_Rq_AR_SpontanFlag = 0; // Spontan-Flag zurücksetzen
                _PT_DataContain_Rq_AR_DelayCnt = _PT_DataContain_Rq_AR_MinDelay;
            }
        }
    }
}
/*@@end*/

/*@@caplFunc:PT_DataContain_Rq_AR_init():*/
PT_DataContain_Rq_AR_init()
{   /* Botschaft PT_DataContain_Rq_AR ID: 1178 --- Sendeart 5 cyclicAndSpontanWithDelay --- 
BA_ "ApplMessage" BO_ 1178 0;
BA_ "NmAsrMessage" BO_ 1178 0;
BA_ "GenMsgMinAcceptLength" BO_ 1178 8;
BA_ "GenMsgILSupport" BO_ 1178 1;
BA_ "DiagState" BO_ 1178 0;
BA_ "DiagRequest" BO_ 1178 0;
BA_ "DiagResponse" BO_ 1178 0;
BA_ "GenMsgStartValue" BO_ 1178 "0";
BA_ "GenMsgDelayTime" BO_ 1178 200;
BA_ "GenMsgNrOfRepetition" BO_ 1178 0;
BA_ "GenMsgCycleTime" BO_ 1178 1000;
BA_ "GenMsgSendType" BO_ 1178 5;
    */
    _PT_DataContain_Rq_AR_Timebase =           c_tDBKomTimer_20ms;
    _PT_DataContain_Rq_AR_CycleCount =       1000 / _PT_DataContain_Rq_AR_Timebase;
    _PT_DataContain_Rq_AR_StartDelay =          0 / _PT_DataContain_Rq_AR_Timebase;
    _PT_DataContain_Rq_AR_MinDelay =          200 / _PT_DataContain_Rq_AR_Timebase;
    _PT_DataContain_Rq_AR_Cnt = _PT_DataContain_Rq_AR_StartDelay;
    _PT_DataContain_Rq_AR_SpontanFlag = 0;
    _PT_DataContain_Rq_AR_DelayCnt = 0;

    putValue( HMI__STMSGSD_PT_DataContain_Rq_AR, _PT_DataContain_Rq_AR_StartDelay * _PT_DataContain_Rq_AR_Timebase );

    _mPT_DataContain_Rq_AR.HDC_AttribData.phys = getValue( HMI_HDC_AttribData );
    _mPT_DataContain_Rq_AR.HDC_AttribNum.phys = getValue( HMI_HDC_AttribNum );
    _mPT_DataContain_Rq_AR.HDC_PosnMark.phys = getValue( HMI_HDC_PosnMark );
    _mPT_DataContain_Rq_AR.HDC_RouteNum.phys = getValue( HMI_HDC_RouteNum );
    _mPT_DataContain_Rq_AR.HDC_SvContain_Rq.phys = getValue( HMI_HDC_SvContain_Rq );
}
/*@@end*/

/*@@caplFunc:PT_DataContain_Rq_AR_output():*/
PT_DataContain_Rq_AR_output()
{
    output( _mPT_DataContain_Rq_AR );
}
/*@@end*/

/*@@caplFunc:PT_DataContain_Rq_AR_saveEnvVars(dword):*/
PT_DataContain_Rq_AR_saveEnvVars( dword hFile )
{
    filePutString("\n// Knoten EIS: PT_DataContain_Rq_AR\n", 33, hFile );
    snprintf( buffer, elcount( buffer ), "0.0000 HMI__STMSG_PT_DataContain_Rq_AR := %X\n", getValue( HMI__STMSG_PT_DataContain_Rq_AR ) );    filePutString( buffer, elcount( buffer ), hFile );
    snprintf( buffer, elcount( buffer ), "0.0000 HMI__STMSGT_PT_DataContain_Rq_AR := %X\n", getValue( HMI__STMSGT_PT_DataContain_Rq_AR ) );    filePutString( buffer, elcount( buffer ), hFile );
    snprintf( buffer, elcount( buffer ), "0.0000 HMI_HDC_AttribData := %X\n", getValue( HMI_HDC_AttribData ) );    filePutString( buffer, elcount( buffer ), hFile );
    snprintf( buffer, elcount( buffer ), "0.0000 HMI_HDC_AttribNum := %X\n", getValue( HMI_HDC_AttribNum ) );    filePutString( buffer, elcount( buffer ), hFile );
    snprintf( buffer, elcount( buffer ), "0.0000 HMI_HDC_PosnMark := %X\n", getValue( HMI_HDC_PosnMark ) );    filePutString( buffer, elcount( buffer ), hFile );
    snprintf( buffer, elcount( buffer ), "0.0000 HMI_HDC_RouteNum := %X\n", getValue( HMI_HDC_RouteNum ) );    filePutString( buffer, elcount( buffer ), hFile );
    snprintf( buffer, elcount( buffer ), "0.0000 HMI_HDC_SvContain_Rq := %X\n", getValue( HMI_HDC_SvContain_Rq ) );    filePutString( buffer, elcount( buffer ), hFile );
}
/*@@end*/

/*@@timer:_tPT_DataContain_Rq_AR:*/
on timer _tPT_DataContain_Rq_AR
{
    putValue( HMI__STMSG_PT_DataContain_Rq_AR, 0 );
}
/*@@end*/

/*@@envVar:HMI__STMSG_PT_DataContain_Rq_AR:*/
on EnvVar HMI__STMSG_PT_DataContain_Rq_AR
{
    long tDelay;
    if( getValue( this ) == 2 )
    {
        tDelay = getValue( HMI__STMSGT_PT_DataContain_Rq_AR );
        if( tDelay > 0)    
            setTimer( _tPT_DataContain_Rq_AR, tDelay );
        else
            putValue( HMI__STMSG_PT_DataContain_Rq_AR, 0 );
    }
}
/*@@end*/

/*@@envVar:HMI_HDC_AttribData:*/
on EnvVar HMI_HDC_AttribData
{
    _mPT_DataContain_Rq_AR.HDC_AttribData.phys = getValue(this);
    _PT_DataContain_Rq_AR_SpontanFlag = 1;
}
/*@@end*/

/*@@envVar:HMI_HDC_AttribNum:*/
on EnvVar HMI_HDC_AttribNum
{
    _mPT_DataContain_Rq_AR.HDC_AttribNum.phys = getValue(this);
    _PT_DataContain_Rq_AR_SpontanFlag = 1;
}
/*@@end*/

/*@@envVar:HMI_HDC_PosnMark:*/
on EnvVar HMI_HDC_PosnMark
{
    _mPT_DataContain_Rq_AR.HDC_PosnMark.phys = getValue(this);
    _PT_DataContain_Rq_AR_SpontanFlag = 1;
}
/*@@end*/

/*@@envVar:HMI_HDC_RouteNum:*/
on EnvVar HMI_HDC_RouteNum
{
    _mPT_DataContain_Rq_AR.HDC_RouteNum.phys = getValue(this);
    _PT_DataContain_Rq_AR_SpontanFlag = 1;
}
/*@@end*/

/*@@envVar:HMI_HDC_SvContain_Rq:*/
on EnvVar HMI_HDC_SvContain_Rq
{
    _mPT_DataContain_Rq_AR.HDC_SvContain_Rq.phys = getValue(this);
    _PT_DataContain_Rq_AR_SpontanFlag = 1;
}
/*@@end*/

/*@@caplFunc:PT_Disp_Rq2_AR_check_output():*/
PT_Disp_Rq2_AR_check_output()
{
    if( !getValue( HMI__STMSG_PT_Disp_Rq2_AR ) )
    {
        // Botschaft PT_Disp_Rq2_AR ID: 656 --- Sendeart 0 cyclicX --- 
        _PT_Disp_Rq2_AR_Cnt--;
        if( _PT_Disp_Rq2_AR_Cnt < 1 )
        {
            PT_Disp_Rq2_AR_output(); // Nachricht wg. abgelaufenem Zyklus ausgeben
            _PT_Disp_Rq2_AR_Cnt = _PT_Disp_Rq2_AR_CycleCount; // Zyklus-Zähler zurücksetzen
        }
    }
}
/*@@end*/

/*@@caplFunc:PT_Disp_Rq2_AR_init():*/
PT_Disp_Rq2_AR_init()
{   /* Botschaft PT_Disp_Rq2_AR ID: 656 --- Sendeart 0 cyclicX --- 
BA_ "ApplMessage" BO_ 656 0;
BA_ "NmAsrMessage" BO_ 656 0;
BA_ "GenMsgMinAcceptLength" BO_ 656 8;
BA_ "GenMsgILSupport" BO_ 656 1;
BA_ "DiagState" BO_ 656 0;
BA_ "DiagRequest" BO_ 656 0;
BA_ "DiagResponse" BO_ 656 0;
BA_ "GenMsgStartValue" BO_ 656 "0";
BA_ "GenMsgCycleTime" BO_ 656 100;
BA_ "GenMsgSendType" BO_ 656 0;
    */
    _PT_Disp_Rq2_AR_Timebase =           c_tDBKomTimer_20ms;
    _PT_Disp_Rq2_AR_CycleCount =        100 / _PT_Disp_Rq2_AR_Timebase;
    _PT_Disp_Rq2_AR_StartDelay =          0 / _PT_Disp_Rq2_AR_Timebase;
    _PT_Disp_Rq2_AR_Cnt = _PT_Disp_Rq2_AR_StartDelay;

    putValue( HMI__STMSGSD_PT_Disp_Rq2_AR, _PT_Disp_Rq2_AR_StartDelay * _PT_Disp_Rq2_AR_Timebase );

    _mPT_Disp_Rq2_AR.EngPwrDisp.phys = getValue( HMI_EngPwrDisp );
    _mPT_Disp_Rq2_AR.EngPwrDisp_Max.phys = getValue( HMI_EngPwrDisp_Max );
    _mPT_Disp_Rq2_AR.EngTrqDisp.phys = getValue( HMI_EngTrqDisp );
    _mPT_Disp_Rq2_AR.EngTrqDisp_Max.phys = getValue( HMI_EngTrqDisp_Max );
    _mPT_Disp_Rq2_AR.PT_DispLrnMax.phys = getValue( HMI_PT_DispLrnMax );
}
/*@@end*/

/*@@caplFunc:PT_Disp_Rq2_AR_output():*/
PT_Disp_Rq2_AR_output(void)
{
    output( _mPT_Disp_Rq2_AR );
}
/*@@end*/

/*@@caplFunc:PT_Disp_Rq2_AR_saveEnvVars(dword):*/
PT_Disp_Rq2_AR_saveEnvVars(dword hFile )
{
    filePutString("\n// Knoten EIS: PT_Disp_Rq2_AR\n", 33, hFile );
    snprintf( buffer, elcount( buffer ), "0.0000 HMI__STMSG_PT_Disp_Rq2_AR := %X\n", getValue( HMI__STMSG_PT_Disp_Rq2_AR ) );        filePutString( buffer, elcount( buffer ), hFile );
    snprintf( buffer, elcount( buffer ), "0.0000 HMI__STMSGT_PT_Disp_Rq2_AR := %X\n", getValue( HMI__STMSGT_PT_Disp_Rq2_AR ) );        filePutString( buffer, elcount( buffer ), hFile );
    snprintf( buffer, elcount( buffer ), "0.0000 HMI_EngPwrDisp := %X\n", getValue( HMI_EngPwrDisp ) );        filePutString( buffer, elcount( buffer ), hFile );
    snprintf( buffer, elcount( buffer ), "0.0000 HMI_EngPwrDisp_Max := %X\n", getValue( HMI_EngPwrDisp_Max ) );        filePutString( buffer, elcount( buffer ), hFile );
    snprintf( buffer, elcount( buffer ), "0.0000 HMI_EngTrqDisp := %X\n", getValue( HMI_EngTrqDisp ) );        filePutString( buffer, elcount( buffer ), hFile );
    snprintf( buffer, elcount( buffer ), "0.0000 HMI_EngTrqDisp_Max := %X\n", getValue( HMI_EngTrqDisp_Max ) );        filePutString( buffer, elcount( buffer ), hFile );
    snprintf( buffer, elcount( buffer ), "0.0000 HMI_PT_DispLrnMax := %X\n", getValue( HMI_PT_DispLrnMax ) );        filePutString( buffer, elcount( buffer ), hFile );
}
/*@@end*/

/*@@timer:_tPT_Disp_Rq2_AR:*/
on timer _tPT_Disp_Rq2_AR
{
    putValue( HMI__STMSG_PT_Disp_Rq2_AR, 0 );
}
/*@@end*/

/*@@envVar:HMI__STMSG_PT_Disp_Rq2_AR:*/
on EnvVar HMI__STMSG_PT_Disp_Rq2_AR
{
    long tDelay;
    if( getValue( this ) == 2 )
    {
        tDelay = getValue( HMI__STMSGT_PT_Disp_Rq2_AR );
        if( tDelay > 0)    
            setTimer( _tPT_Disp_Rq2_AR, tDelay );
        else
            putValue( HMI__STMSG_PT_Disp_Rq2_AR, 0 );
    }
}
/*@@end*/

/*@@envVar:HMI_EngPwrDisp:*/
on EnvVar HMI_EngPwrDisp
{
    _mPT_Disp_Rq2_AR.EngPwrDisp.phys = getValue(this);
}
/*@@end*/

/*@@envVar:HMI_EngPwrDisp_Max:*/
on EnvVar HMI_EngPwrDisp_Max
{
    _mPT_Disp_Rq2_AR.EngPwrDisp_Max.phys = getValue(this);
}
/*@@end*/

/*@@envVar:HMI_EngTrqDisp:*/
on EnvVar HMI_EngTrqDisp
{
    _mPT_Disp_Rq2_AR.EngTrqDisp.phys = getValue(this);
}
/*@@end*/

/*@@envVar:HMI_EngTrqDisp_Max:*/
on EnvVar HMI_EngTrqDisp_Max
{
    _mPT_Disp_Rq2_AR.EngTrqDisp_Max.phys = getValue(this);
}
/*@@end*/

/*@@envVar:HMI_PT_DispLrnMax:*/
on EnvVar HMI_PT_DispLrnMax
{
    _mPT_Disp_Rq2_AR.PT_DispLrnMax.phys = getValue(this);
}
/*@@end*/

/*@@timer:_tPtHyb_Mngmnt_Rq_AR:*/
on timer _tPtHyb_Mngmnt_Rq_AR
{
    putValue( HMI__STMSG_PtHyb_Mngmnt_Rq_AR, 0 );
}
/*@@end*/

/*@@caplFunc:PtHyb_Mngmnt_Rq_AR_check_output():*/
PtHyb_Mngmnt_Rq_AR_check_output()
{
    if( !getValue( HMI__STMSG_PtHyb_Mngmnt_Rq_AR ) )
    {
        // Botschaft PtHyb_Mngmnt_Rq_AR ID: 1279 --- Sendeart 5 cyclicAndSpontanWithDelay --- 
        if( _PtHyb_Mngmnt_Rq_AR_DelayCnt > 0) _PtHyb_Mngmnt_Rq_AR_DelayCnt--; // Mindestsendeabstand
        _PtHyb_Mngmnt_Rq_AR_Cnt--;
        if( _PtHyb_Mngmnt_Rq_AR_Cnt < 1 )
        {
            if( _PtHyb_Mngmnt_Rq_AR_DelayCnt < 1 )
            {
                // Nachricht wg. abgelaufenem Zyklus ausgeben (Mindestsendeabstand eingehalten)
                PtHyb_Mngmnt_Rq_AR_output();
                _PtHyb_Mngmnt_Rq_AR_SpontanFlag = 0; // Spontan-Flag zurücksetzen
                _PtHyb_Mngmnt_Rq_AR_DelayCnt = _PtHyb_Mngmnt_Rq_AR_MinDelay;
            }
            else
            {
                // Spontanflag setzen damit nach Ablauf Mindestsendeabstand gesendet wird
                 _PtHyb_Mngmnt_Rq_AR_SpontanFlag = 1;
            }
            _PtHyb_Mngmnt_Rq_AR_Cnt = _PtHyb_Mngmnt_Rq_AR_CycleCount; // Zyklus-Zähler zurücksetzen
        }
        else if( _PtHyb_Mngmnt_Rq_AR_SpontanFlag)
        {
            if( _PtHyb_Mngmnt_Rq_AR_DelayCnt < 1 )
            {
                // Nachricht wg. spontaner Änderung ausgeben (Mindestsendeabstand eingehalten)
                PtHyb_Mngmnt_Rq_AR_output();
                _PtHyb_Mngmnt_Rq_AR_SpontanFlag = 0; // Spontan-Flag zurücksetzen
                _PtHyb_Mngmnt_Rq_AR_DelayCnt = _PtHyb_Mngmnt_Rq_AR_MinDelay;
            }
        }
    }
}
/*@@end*/

/*@@caplFunc:PtHyb_Mngmnt_Rq_AR_init():*/
PtHyb_Mngmnt_Rq_AR_init()
{   /* Botschaft PtHyb_Mngmnt_Rq_AR ID: 1279 --- Sendeart cyclic --- 
BA_ "ApplMessage" BO_ 1279 0;
BA_ "NmAsrMessage" BO_ 1279 0;
BA_ "GenMsgMinAcceptLength" BO_ 1279 2;
BA_ "GenMsgILSupport" BO_ 1279 1;
BA_ "DiagState" BO_ 1279 0;
BA_ "DiagRequest" BO_ 1279 0;
BA_ "DiagResponse" BO_ 1279 0;
BA_ "GenMsgStartValue" BO_ 1279 "0";
BA_ "GenMsgDelayTime" BO_ 1279 100;
BA_ "GenMsgNrOfRepetition" BO_ 1279 0;
BA_ "GenMsgCycleTime" BO_ 1279 5000;
BA_ "GenMsgSendType" BO_ 1279 5;
    */
    _PtHyb_Mngmnt_Rq_AR_Timebase =                  c_tDBKomTimer_20ms;
    _PtHyb_Mngmnt_Rq_AR_CycleCount =             5000 / _PtHyb_Mngmnt_Rq_AR_Timebase;
    _PtHyb_Mngmnt_Rq_AR_StartDelay =                0 / _PtHyb_Mngmnt_Rq_AR_Timebase;
    _PtHyb_Mngmnt_Rq_AR_MinDelay =                100 / _PtHyb_Mngmnt_Rq_AR_Timebase;
    _PtHyb_Mngmnt_Rq_AR_Cnt = _PtHyb_Mngmnt_Rq_AR_StartDelay;
    _PtHyb_Mngmnt_Rq_AR_SpontanFlag = 0;
    _PtHyb_Mngmnt_Rq_AR_DelayCnt = 0;

    putValue( HMI__STMSGSD_PtHyb_Mngmnt_Rq_AR, _PtHyb_Mngmnt_Rq_AR_StartDelay * _PtHyb_Mngmnt_Rq_AR_Timebase );

    _mPtHyb_Mngmnt_Rq_AR.RemTank_SwLED_Rq.phys = getValue( HMI_RemTank_SwLED_Rq );
    _mPtHyb_Mngmnt_Rq_AR.RemTank_Unlk_Rq.phys = getValue( HMI_RemTank_Unlk_Rq );
}
/*@@end*/

/*@@caplFunc:PtHyb_Mngmnt_Rq_AR_output():*/
PtHyb_Mngmnt_Rq_AR_output(void)
{
    output( _mPtHyb_Mngmnt_Rq_AR );
}
/*@@end*/

/*@@caplFunc:PtHyb_Mngmnt_Rq_AR_saveEnvVars(dword):*/
PtHyb_Mngmnt_Rq_AR_saveEnvVars( dword hFile )
{
    filePutString("\n// Knoten EIS: PtHyb_Mngmnt_Rq_AR\n", 28, hFile );
    snprintf( buffer, elcount( buffer ), "0.0000 HMI__STMSG_PtHyb_Mngmnt_Rq_AR := %X\n", getValue( HMI__STMSG_PtHyb_Mngmnt_Rq_AR ) );        filePutString( buffer, elcount( buffer ), hFile );
    snprintf( buffer, elcount( buffer ), "0.0000 HMI__STMSGT_PtHyb_Mngmnt_Rq_AR := %X\n", getValue( HMI__STMSGT_PtHyb_Mngmnt_Rq_AR ) );        filePutString( buffer, elcount( buffer ), hFile );
    snprintf( buffer, elcount( buffer ), "0.0000 HMI_RemTank_SwLED_Rq := %X\n", getValue( HMI_RemTank_SwLED_Rq ) );        filePutString( buffer, elcount( buffer ), hFile );
    snprintf( buffer, elcount( buffer ), "0.0000 HMI_RemTank_Unlk_Rq := %X\n", getValue( HMI_RemTank_Unlk_Rq ) );        filePutString( buffer, elcount( buffer ), hFile );
}
/*@@end*/

/*@@envVar:HMI__STMSG_PtHyb_Mngmnt_Rq_AR:*/
on EnvVar HMI__STMSG_PtHyb_Mngmnt_Rq_AR
{
    long tDelay;
    if( getValue( this ) == 2 )
    {
        tDelay = getValue( HMI__STMSGT_PtHyb_Mngmnt_Rq_AR );
        if( tDelay > 0)    
            setTimer( _tPtHyb_Mngmnt_Rq_AR, tDelay );
        else
            putValue( HMI__STMSG_PtHyb_Mngmnt_Rq_AR, 0 );
    }
}
/*@@end*/

/*@@envVar:HMI_RemTank_SwLED_Rq:*/
on EnvVar HMI_RemTank_SwLED_Rq
{
    _mPtHyb_Mngmnt_Rq_AR.RemTank_SwLED_Rq.phys = getValue(this);
}
/*@@end*/

/*@@envVar:HMI_RemTank_Unlk_Rq:*/
on EnvVar HMI_RemTank_Unlk_Rq
{
    _mPtHyb_Mngmnt_Rq_AR.RemTank_Unlk_Rq.phys = getValue(this);
}
/*@@end*/

/*@@caplFunc:PtMngmnt_Disp_Rq_AR_check_output():*/
PtMngmnt_Disp_Rq_AR_check_output()
{
    if( !getValue( HMI__STMSG_PtMngmnt_Disp_Rq_AR ) )
    {
        // Botschaft PtMngmnt_Disp_Rq_AR ID: 321 --- Sendeart 0 cyclicX --- 
        _PtMngmnt_Disp_Rq_AR_Cnt--;
        if( _PtMngmnt_Disp_Rq_AR_Cnt < 1 )
        {
            PtMngmnt_Disp_Rq_AR_output(); // Nachricht wg. abgelaufenem Zyklus ausgeben
            _PtMngmnt_Disp_Rq_AR_Cnt = _PtMngmnt_Disp_Rq_AR_CycleCount; // Zyklus-Zähler zurücksetzen
        }
    }
}
/*@@end*/

/*@@caplFunc:PtMngmnt_Disp_Rq_AR_init():*/
PtMngmnt_Disp_Rq_AR_init()
{   /* Botschaft PtMngmnt_Disp_Rq_AR ID: 321 --- Sendeart 0 cyclicX --- 
BA_ "ApplMessage" BO_ 321 0;
BA_ "NmAsrMessage" BO_ 321 0;
BA_ "GenMsgMinAcceptLength" BO_ 321 8;
BA_ "GenMsgILSupport" BO_ 321 1;
BA_ "DiagState" BO_ 321 0;
BA_ "DiagRequest" BO_ 321 0;
BA_ "DiagResponse" BO_ 321 0;
BA_ "GenMsgStartValue" BO_ 321 "0";
BA_ "GenMsgCycleTime" BO_ 321 100;
BA_ "GenMsgSendType" BO_ 321 0;
    */
    _PtMngmnt_Disp_Rq_AR_Timebase =         c_tDBKomTimer_20ms;
    _PtMngmnt_Disp_Rq_AR_CycleCount =      100 / _PtMngmnt_Disp_Rq_AR_Timebase;
    _PtMngmnt_Disp_Rq_AR_StartDelay =        0 / _PtMngmnt_Disp_Rq_AR_Timebase;
    _PtMngmnt_Disp_Rq_AR_Cnt = _PtMngmnt_Disp_Rq_AR_StartDelay;

    putValue( HMI__STMSGSD_PtMngmnt_Disp_Rq_AR, _PtMngmnt_Disp_Rq_AR_StartDelay * _PtMngmnt_Disp_Rq_AR_Timebase );

    _mPtMngmnt_Disp_Rq_AR.ClutchOverTemp_Disp_Rq.phys = getValue( HMI_ClutchOverTemp_Disp_Rq );
    _mPtMngmnt_Disp_Rq_AR.EngOilPress_Warn_Rq.phys = getValue( HMI_EngOilPress_Warn_Rq );
    _mPtMngmnt_Disp_Rq_AR.Hyb_Energy_WarnDisp_Rq.phys = getValue( HMI_Hyb_Energy_WarnDisp_Rq );
    _mPtMngmnt_Disp_Rq_AR.Hyb_EnergyFlow_Disp_Rq_V2.phys = getValue( HMI_Hyb_EnergyFlow_Disp_Rq_V2 );
    _mPtMngmnt_Disp_Rq_AR.Hyb_WarnDisp_Rq.phys = getValue( HMI_Hyb_WarnDisp_Rq );
    _mPtMngmnt_Disp_Rq_AR.HybPwr_Disp_Rq.phys = getValue( HMI_HybPwr_Disp_Rq );
    _mPtMngmnt_Disp_Rq_AR.IndLmpChk_Off_Rq.phys = getValue( HMI_IndLmpChk_Off_Rq );
    _mPtMngmnt_Disp_Rq_AR.PlugInHyb_OprtnMd_V2.phys = getValue( HMI_PlugInHyb_OprtnMd_V2 );
    _mPtMngmnt_Disp_Rq_AR.PlugInHyb_OprtnMdMsg_V2.phys = getValue( HMI_PlugInHyb_OprtnMdMsg_V2 );
    _mPtMngmnt_Disp_Rq_AR.PNHV_Bat_SOC_Disp_Rq.phys = getValue( HMI_PNHV_Bat_SOC_Disp_Rq );
    _mPtMngmnt_Disp_Rq_AR.PressClutchPdl_MsgDisp_Rq.phys = getValue( HMI_PressClutchPdl_MsgDisp_Rq );
    _mPtMngmnt_Disp_Rq_AR.PT_Rdy_IndLmp_Rq.phys = getValue( HMI_PT_Rdy_IndLmp_Rq );
    _mPtMngmnt_Disp_Rq_AR.SSA_ECO_Md_Actv_Disp_Rq.phys = getValue( HMI_SSA_ECO_Md_Actv_Disp_Rq );
    _mPtMngmnt_Disp_Rq_AR.SSA_ECO_Md_DispCol_Rq.phys = getValue( HMI_SSA_ECO_Md_DispCol_Rq );
    _mPtMngmnt_Disp_Rq_AR.SSA_ECO_Sw_LED_On_Rq.phys = getValue( HMI_SSA_ECO_Sw_LED_On_Rq );
    _mPtMngmnt_Disp_Rq_AR.SSA_Msg_Disp_Rq.phys = getValue( HMI_SSA_Msg_Disp_Rq );
}
/*@@end*/

/*@@caplFunc:PtMngmnt_Disp_Rq_AR_output():*/
PtMngmnt_Disp_Rq_AR_output(void)
{
    output( _mPtMngmnt_Disp_Rq_AR );
}
/*@@end*/

/*@@caplFunc:PtMngmnt_Disp_Rq_AR_saveEnvVars(dword):*/
PtMngmnt_Disp_Rq_AR_saveEnvVars(dword hFile )
{
    filePutString("\n// Knoten EIS: PtMngmnt_Disp_Rq_AR\n", 33, hFile );
    snprintf( buffer, elcount( buffer ), "0.0000 HMI__STMSG_PtMngmnt_Disp_Rq_AR := %X\n", getValue( HMI__STMSG_PtMngmnt_Disp_Rq_AR ) );        filePutString( buffer, elcount( buffer ), hFile );
    snprintf( buffer, elcount( buffer ), "0.0000 HMI__STMSGT_PtMngmnt_Disp_Rq_AR := %X\n", getValue( HMI__STMSGT_PtMngmnt_Disp_Rq_AR ) );        filePutString( buffer, elcount( buffer ), hFile );
    snprintf( buffer, elcount( buffer ), "0.0000 HMI_ClutchOverTemp_Disp_Rq := %X\n", getValue( HMI_ClutchOverTemp_Disp_Rq ) );        filePutString( buffer, elcount( buffer ), hFile );
    snprintf( buffer, elcount( buffer ), "0.0000 HMI_EngOilPress_Warn_Rq := %X\n", getValue( HMI_EngOilPress_Warn_Rq ) );        filePutString( buffer, elcount( buffer ), hFile );
    snprintf( buffer, elcount( buffer ), "0.0000 HMI_Hyb_Energy_WarnDisp_Rq := %X\n", getValue( HMI_Hyb_Energy_WarnDisp_Rq ) );        filePutString( buffer, elcount( buffer ), hFile );
    snprintf( buffer, elcount( buffer ), "0.0000 HMI_Hyb_EnergyFlow_Disp_Rq_V2 := %X\n", getValue( HMI_Hyb_EnergyFlow_Disp_Rq_V2 ) );        filePutString( buffer, elcount( buffer ), hFile );
    snprintf( buffer, elcount( buffer ), "0.0000 HMI_Hyb_WarnDisp_Rq := %X\n", getValue( HMI_Hyb_WarnDisp_Rq ) );        filePutString( buffer, elcount( buffer ), hFile );
    snprintf( buffer, elcount( buffer ), "0.0000 HMI_HybPwr_Disp_Rq := %X\n", getValue( HMI_HybPwr_Disp_Rq ) );        filePutString( buffer, elcount( buffer ), hFile );
    snprintf( buffer, elcount( buffer ), "0.0000 HMI_IndLmpChk_Off_Rq := %X\n", getValue( HMI_IndLmpChk_Off_Rq ) );        filePutString( buffer, elcount( buffer ), hFile );
    snprintf( buffer, elcount( buffer ), "0.0000 HMI_PlugInHyb_OprtnMd_V2 := %X\n", getValue( HMI_PlugInHyb_OprtnMd_V2 ) );        filePutString( buffer, elcount( buffer ), hFile );
    snprintf( buffer, elcount( buffer ), "0.0000 HMI_PlugInHyb_OprtnMdMsg_V2 := %X\n", getValue( HMI_PlugInHyb_OprtnMdMsg_V2 ) );        filePutString( buffer, elcount( buffer ), hFile );
    snprintf( buffer, elcount( buffer ), "0.0000 HMI_PNHV_Bat_SOC_Disp_Rq := %X\n", getValue( HMI_PNHV_Bat_SOC_Disp_Rq ) );        filePutString( buffer, elcount( buffer ), hFile );
    snprintf( buffer, elcount( buffer ), "0.0000 HMI_PressClutchPdl_MsgDisp_Rq := %X\n", getValue( HMI_PressClutchPdl_MsgDisp_Rq ) );        filePutString( buffer, elcount( buffer ), hFile );
    snprintf( buffer, elcount( buffer ), "0.0000 HMI_PT_Rdy_IndLmp_Rq := %X\n", getValue( HMI_PT_Rdy_IndLmp_Rq ) );        filePutString( buffer, elcount( buffer ), hFile );
    snprintf( buffer, elcount( buffer ), "0.0000 HMI_SSA_ECO_Md_Actv_Disp_Rq := %X\n", getValue( HMI_SSA_ECO_Md_Actv_Disp_Rq ) );        filePutString( buffer, elcount( buffer ), hFile );
    snprintf( buffer, elcount( buffer ), "0.0000 HMI_SSA_ECO_Md_DispCol_Rq := %X\n", getValue( HMI_SSA_ECO_Md_DispCol_Rq ) );        filePutString( buffer, elcount( buffer ), hFile );
    snprintf( buffer, elcount( buffer ), "0.0000 HMI_SSA_ECO_Sw_LED_On_Rq := %X\n", getValue( HMI_SSA_ECO_Sw_LED_On_Rq ) );        filePutString( buffer, elcount( buffer ), hFile );
    snprintf( buffer, elcount( buffer ), "0.0000 HMI_SSA_Msg_Disp_Rq := %X\n", getValue( HMI_SSA_Msg_Disp_Rq ) );        filePutString( buffer, elcount( buffer ), hFile );
}
/*@@end*/

/*@@timer:_tPtMngmnt_Disp_Rq_AR:*/
on timer _tPtMngmnt_Disp_Rq_AR
{
    putValue( HMI__STMSG_PtMngmnt_Disp_Rq_AR, 0 );
}
/*@@end*/

/*@@envVar:HMI__STMSG_PtMngmnt_Disp_Rq_AR:*/
on EnvVar HMI__STMSG_PtMngmnt_Disp_Rq_AR
{
    long tDelay;
    if( getValue( this ) == 2 )
    {
        tDelay = getValue( HMI__STMSGT_PtMngmnt_Disp_Rq_AR );
        if( tDelay > 0)    
            setTimer( _tPtMngmnt_Disp_Rq_AR, tDelay );
        else
            putValue( HMI__STMSG_PtMngmnt_Disp_Rq_AR, 0 );
    }
}
/*@@end*/

/*@@envVar:HMI_ClutchOverTemp_Disp_Rq:*/
on EnvVar HMI_ClutchOverTemp_Disp_Rq
{
    _mPtMngmnt_Disp_Rq_AR.ClutchOverTemp_Disp_Rq.phys = getValue(this);
}
/*@@end*/

/*@@envVar:HMI_EngOilPress_Warn_Rq:*/
on EnvVar HMI_EngOilPress_Warn_Rq
{
    _mPtMngmnt_Disp_Rq_AR.EngOilPress_Warn_Rq.phys = getValue(this);
}
/*@@end*/

/*@@envVar:HMI_Hyb_Energy_WarnDisp_Rq:*/
on EnvVar HMI_Hyb_Energy_WarnDisp_Rq
{
    _mPtMngmnt_Disp_Rq_AR.Hyb_Energy_WarnDisp_Rq.phys = getValue(this);
}
/*@@end*/

/*@@envVar:HMI_Hyb_EnergyFlow_Disp_Rq_V2:*/
on EnvVar HMI_Hyb_EnergyFlow_Disp_Rq_V2
{
    _mPtMngmnt_Disp_Rq_AR.Hyb_EnergyFlow_Disp_Rq_V2.phys = getValue(this);
}
/*@@end*/

/*@@envVar:HMI_Hyb_WarnDisp_Rq:*/
on EnvVar HMI_Hyb_WarnDisp_Rq
{
    _mPtMngmnt_Disp_Rq_AR.Hyb_WarnDisp_Rq.phys = getValue(this);
}
/*@@end*/

/*@@envVar:HMI_HybPwr_Disp_Rq:*/
on EnvVar HMI_HybPwr_Disp_Rq
{
    _mPtMngmnt_Disp_Rq_AR.HybPwr_Disp_Rq.phys = getValue(this);
}
/*@@end*/

/*@@envVar:HMI_IndLmpChk_Off_Rq:*/
on EnvVar HMI_IndLmpChk_Off_Rq
{
    _mPtMngmnt_Disp_Rq_AR.IndLmpChk_Off_Rq.phys = getValue(this);
}
/*@@end*/

/*@@envVar:HMI_PlugInHyb_OprtnMd_V2:*/
on EnvVar HMI_PlugInHyb_OprtnMd_V2
{
    _mPtMngmnt_Disp_Rq_AR.PlugInHyb_OprtnMd_V2.phys = getValue(this);
}
/*@@end*/

/*@@envVar:HMI_PlugInHyb_OprtnMdMsg_V2:*/
on EnvVar HMI_PlugInHyb_OprtnMdMsg_V2
{
    _mPtMngmnt_Disp_Rq_AR.PlugInHyb_OprtnMdMsg_V2.phys = getValue(this);
}
/*@@end*/

/*@@envVar:HMI_PNHV_Bat_SOC_Disp_Rq:*/
on EnvVar HMI_PNHV_Bat_SOC_Disp_Rq
{
    _mPtMngmnt_Disp_Rq_AR.PNHV_Bat_SOC_Disp_Rq.phys = getValue(this);
}
/*@@end*/

/*@@envVar:HMI_PressClutchPdl_MsgDisp_Rq:*/
on EnvVar HMI_PressClutchPdl_MsgDisp_Rq
{
    _mPtMngmnt_Disp_Rq_AR.PressClutchPdl_MsgDisp_Rq.phys = getValue(this);
}
/*@@end*/

/*@@envVar:HMI_PT_Rdy_IndLmp_Rq:*/
on EnvVar HMI_PT_Rdy_IndLmp_Rq
{
    _mPtMngmnt_Disp_Rq_AR.PT_Rdy_IndLmp_Rq.phys = getValue(this);
}
/*@@end*/

/*@@envVar:HMI_SSA_ECO_Md_Actv_Disp_Rq:*/
on EnvVar HMI_SSA_ECO_Md_Actv_Disp_Rq
{
    _mPtMngmnt_Disp_Rq_AR.SSA_ECO_Md_Actv_Disp_Rq.phys = getValue(this);
}
/*@@end*/

/*@@envVar:HMI_SSA_ECO_Md_DispCol_Rq:*/
on EnvVar HMI_SSA_ECO_Md_DispCol_Rq
{
    _mPtMngmnt_Disp_Rq_AR.SSA_ECO_Md_DispCol_Rq.phys = getValue(this);
}
/*@@end*/

/*@@envVar:HMI_SSA_ECO_Sw_LED_On_Rq:*/
on EnvVar HMI_SSA_ECO_Sw_LED_On_Rq
{
    _mPtMngmnt_Disp_Rq_AR.SSA_ECO_Sw_LED_On_Rq.phys = getValue(this);
}
/*@@end*/

/*@@envVar:HMI_SSA_Msg_Disp_Rq:*/
on EnvVar HMI_SSA_Msg_Disp_Rq
{
    _mPtMngmnt_Disp_Rq_AR.SSA_Msg_Disp_Rq.phys = getValue(this);
}
/*@@end*/

/*@@caplFunc:RDU_Disp_Rq_AR_check_output():*/
RDU_Disp_Rq_AR_check_output()
{
    if( !getValue( HMI__STMSG_RDU_Disp_Rq_AR ) )
    {
        // Botschaft RDU_Disp_Rq_AR --- Sendeart 5 cyclicAndSpontanWithDelay --- 
        if( _RDU_Disp_Rq_AR_DelayCnt > 0) _RDU_Disp_Rq_AR_DelayCnt--; // Mindestsendeabstand
        _RDU_Disp_Rq_AR_Cnt--;
        if( _RDU_Disp_Rq_AR_Cnt < 1 )
        {
            if( _RDU_Disp_Rq_AR_DelayCnt < 1 )
            {
                // Nachricht wg. abgelaufenem Zyklus ausgeben (Mindestsendeabstand eingehalten)
                RDU_Disp_Rq_AR_output();
                _RDU_Disp_Rq_AR_SpontanFlag = 0; // Spontan-Flag zurücksetzen
                _RDU_Disp_Rq_AR_DelayCnt = _RDU_Disp_Rq_AR_MinDelay;
            }
            else
            {
                // Spontanflag setzen damit nach Ablauf Mindestsendeabstand gesendet wird
                 _RDU_Disp_Rq_AR_SpontanFlag = 1;
            }
            _RDU_Disp_Rq_AR_Cnt = _RDU_Disp_Rq_AR_CycleCount; // Zyklus-Zähler zurücksetzen
        }
        else if( _RDU_Disp_Rq_AR_SpontanFlag)
        {
            if( _RDU_Disp_Rq_AR_DelayCnt < 1 )
            {
                // Nachricht wg. spontaner Änderung ausgeben (Mindestsendeabstand eingehalten)
                RDU_Disp_Rq_AR_output();
                _RDU_Disp_Rq_AR_SpontanFlag = 0; // Spontan-Flag zurücksetzen
                _RDU_Disp_Rq_AR_DelayCnt = _RDU_Disp_Rq_AR_MinDelay;
            }
        }
    }
}
/*@@end*/

/*@@caplFunc:RDU_Disp_Rq_AR_init():*/
RDU_Disp_Rq_AR_init()
{   /* Botschaft RDU_Disp_Rq_AR ID: 1185 --- Sendeart cyclic --- 
BA_ "ApplMessage" BO_ 812 0;
BA_ "NmAsrMessage" BO_ 812 0;
BA_ "GenMsgMinAcceptLength" BO_ 812 8;
BA_ "GenMsgILSupport" BO_ 812 1;
BA_ "DiagState" BO_ 812 0;
BA_ "DiagRequest" BO_ 812 0;
BA_ "DiagResponse" BO_ 812 0;
BA_ "GenMsgStartValue" BO_ 812 "0";
BA_ "GenMsgStartDelayTime" BO_ 812 235;
BA_ "GenMsgDelayTime" BO_ 812 50;
BA_ "GenMsgNrOfRepetitions" BO_ 812 0;
BA_ "GenMsgCycleTime" BO_ 812 500;
BA_ "GenMsgSendType" BO_ 812 5;
    */
    _RDU_Disp_Rq_AR_Timebase =                  c_tDBKomTimer_5ms;
    _RDU_Disp_Rq_AR_CycleCount =              500 / _RDU_Disp_Rq_AR_Timebase;
    _RDU_Disp_Rq_AR_StartDelay =              235 / _RDU_Disp_Rq_AR_Timebase;
    _RDU_Disp_Rq_AR_MinDelay =                 50 / _RDU_Disp_Rq_AR_Timebase;
    _RDU_Disp_Rq_AR_Cnt = _RDU_Disp_Rq_AR_StartDelay;
    _RDU_Disp_Rq_AR_SpontanFlag = 0;
    _RDU_Disp_Rq_AR_DelayCnt = 0;

    putValue( HMI__STMSGSD_RDU_Disp_Rq_AR, _RDU_Disp_Rq_AR_StartDelay * _RDU_Disp_Rq_AR_Timebase );

    _mRDU_Disp_Rq_AR.LDC_CMS_Md_Stat.phys = getValue( HMI_LDC_CMS_Md_Stat );
    _mRDU_Disp_Rq_AR.LDC_Dist_Dsr_MsgDisp_Rq_RDU.phys = getValue( HMI_LDC_Dist_Dsr_MsgDisp_Rq_RDU );
    _mRDU_Disp_Rq_AR.LDC_SLA_SpdLmtTkOvr_Avl_Stat.phys = getValue( HMI_LDC_SLA_SpdLmtTkOvr_Avl_Stat );
    _mRDU_Disp_Rq_AR.LDC_SLA_SpdLmtTkOvr_Stat.phys = getValue( HMI_LDC_SLA_SpdLmtTkOvr_Stat );
    _mRDU_Disp_Rq_AR.PN14_ElecPwr_Rq_AS.phys = getValue( HMI_PN14_ElecPwr_Rq_AS_RDU );
}
/*@@end*/

/*@@caplFunc:RDU_Disp_Rq_AR_output():*/
RDU_Disp_Rq_AR_output(void)
{
    output( _mRDU_Disp_Rq_AR );
}
/*@@end*/

/*@@caplFunc:RDU_Disp_Rq_AR_saveEnvVars(dword):*/
RDU_Disp_Rq_AR_saveEnvVars( dword hFile )
{
    filePutString("\n// Knoten EIS: RDU_Disp_Rq_AR\n", 28, hFile );
    snprintf( buffer, elcount( buffer ), "0.0000 HMI__STMSG_RDU_Disp_Rq_AR := %X\n", getValue( HMI__STMSG_RDU_Disp_Rq_AR ) );        filePutString( buffer, elcount( buffer ), hFile );
    snprintf( buffer, elcount( buffer ), "0.0000 HMI__STMSGT_RDU_Disp_Rq_AR := %X\n", getValue( HMI__STMSGT_RDU_Disp_Rq_AR ) );        filePutString( buffer, elcount( buffer ), hFile );
    snprintf( buffer, elcount( buffer ), "0.0000 HMI_LDC_CMS_Md_Stat := %X\n", getValue( HMI_LDC_CMS_Md_Stat ) );        filePutString( buffer, elcount( buffer ), hFile );
    snprintf( buffer, elcount( buffer ), "0.0000 HMI_LDC_Dist_Dsr_MsgDisp_Rq_RDU := %X\n", getValue( HMI_LDC_Dist_Dsr_MsgDisp_Rq_RDU ) );        filePutString( buffer, elcount( buffer ), hFile );
    snprintf( buffer, elcount( buffer ), "0.0000 HMI_LDC_SLA_SpdLmtTkOvr_Avl_Stat := %X\n", getValue( HMI_LDC_SLA_SpdLmtTkOvr_Avl_Stat ) );        filePutString( buffer, elcount( buffer ), hFile );
    snprintf( buffer, elcount( buffer ), "0.0000 HMI_LDC_SLA_SpdLmtTkOvr_Stat := %X\n", getValue( HMI_LDC_SLA_SpdLmtTkOvr_Stat ) );        filePutString( buffer, elcount( buffer ), hFile );
    snprintf( buffer, elcount( buffer ), "0.0000 HMI_PN14_ElecPwr_Rq_AS := %X\n", getValue( HMI_PN14_ElecPwr_Rq_AS_RDU ) );    filePutString( buffer, elcount( buffer ), hFile );
}
/*@@end*/

/*@@timer:_tRDU_Disp_Rq_AR:*/
on timer _tRDU_Disp_Rq_AR
{
    putValue( HMI__STMSG_RDU_Disp_Rq_AR, 0 );
}
/*@@end*/

/*@@envVar:HMI__STMSG_RDU_Disp_Rq_AR:*/
on EnvVar HMI__STMSG_RDU_Disp_Rq_AR
{
    long tDelay;
    if( getValue( this ) == 2 )
    {
        tDelay = getValue( HMI__STMSGT_RDU_Disp_Rq_AR );
        if( tDelay > 0)    
            setTimer( _tRDU_Disp_Rq_AR, tDelay );
        else
            putValue( HMI__STMSG_RDU_Disp_Rq_AR, 0 );
    }
}
/*@@end*/

/*@@envVar:HMI_LDC_CMS_Md_Stat:*/
on EnvVar HMI_LDC_CMS_Md_Stat
{
    _mRDU_Disp_Rq_AR.LDC_CMS_Md_Stat.phys = getValue(this);
    _RDU_Disp_Rq_AR_SpontanFlag = 1;
}
/*@@end*/

/*@@envVar:HMI_LDC_Dist_Dsr_MsgDisp_Rq_RDU:*/
on EnvVar HMI_LDC_Dist_Dsr_MsgDisp_Rq_RDU
{
    _mRDU_Disp_Rq_AR.LDC_Dist_Dsr_MsgDisp_Rq_RDU.phys = getValue(this);
    _RDU_Disp_Rq_AR_SpontanFlag = 1;
}
/*@@end*/

/*@@envVar:HMI_LDC_SLA_SpdLmtTkOvr_Avl_Stat:*/
on EnvVar HMI_LDC_SLA_SpdLmtTkOvr_Avl_Stat
{
    _mRDU_Disp_Rq_AR.LDC_SLA_SpdLmtTkOvr_Avl_Stat.phys = getValue(this);
    _RDU_Disp_Rq_AR_SpontanFlag = 1;
}
/*@@end*/

/*@@envVar:HMI_LDC_SLA_SpdLmtTkOvr_Stat:*/
on EnvVar HMI_LDC_SLA_SpdLmtTkOvr_Stat
{
    _mRDU_Disp_Rq_AR.LDC_SLA_SpdLmtTkOvr_Stat.phys = getValue(this);
    _RDU_Disp_Rq_AR_SpontanFlag = 1;
}
/*@@end*/

/*@@envVar:HMI_PN14_ElecPwr_Rq_AS_RDU:*/
on EnvVar HMI_PN14_ElecPwr_Rq_AS_RDU
{
    _mRDU_Disp_Rq_AR.PN14_ElecPwr_Rq_AS.phys = getValue(this);
    _RDU_Disp_Rq_AR_SpontanFlag = 1;
}
/*@@end*/

/*@@caplFunc:RVC_SVS_Park_Stat_AR_check_output():*/
RVC_SVS_Park_Stat_AR_check_output()
{
    if( !getValue( HMI__STMSG_RVC_SVS_Park_Stat_AR ) )
    {
        // Botschaft RVC_SVS_Park_Stat_AR ID: 1125  --- Sendeart 5 cyclicAndSpontanWithDelay --- 
        if( _RVC_SVS_Park_Stat_AR_DelayCnt > 0) _RVC_SVS_Park_Stat_AR_DelayCnt--; // Mindestsendeabstand
        _RVC_SVS_Park_Stat_AR_Cnt--;
        if( _RVC_SVS_Park_Stat_AR_Cnt < 1 )
        {
            if( _RVC_SVS_Park_Stat_AR_DelayCnt < 1 )
            {
                // Nachricht wg. abgelaufenem Zyklus ausgeben (Mindestsendeabstand eingehalten)
                RVC_SVS_Park_Stat_AR_output();
                _RVC_SVS_Park_Stat_AR_SpontanFlag = 0; // Spontan-Flag zurücksetzen
                _RVC_SVS_Park_Stat_AR_DelayCnt = _RVC_SVS_Park_Stat_AR_MinDelay;
            }
            else
            {
                // Spontanflag setzen damit nach Ablauf Mindestsendeabstand gesendet wird
                 _RVC_SVS_Park_Stat_AR_SpontanFlag = 1;
            }
            _RVC_SVS_Park_Stat_AR_Cnt = _RVC_SVS_Park_Stat_AR_CycleCount; // Zyklus-Zähler zurücksetzen
        }
        else if( _RVC_SVS_Park_Stat_AR_SpontanFlag)
        {
            if( _RVC_SVS_Park_Stat_AR_DelayCnt < 1 )
            {
                // Nachricht wg. spontaner Änderung ausgeben (Mindestsendeabstand eingehalten)
                RVC_SVS_Park_Stat_AR_output();
                _RVC_SVS_Park_Stat_AR_SpontanFlag = 0; // Spontan-Flag zurücksetzen
                _RVC_SVS_Park_Stat_AR_DelayCnt = _RVC_SVS_Park_Stat_AR_MinDelay;
            }
        }
    }
}
/*@@end*/

/*@@caplFunc:RVC_SVS_Park_Stat_AR_init():*/
RVC_SVS_Park_Stat_AR_init()
{   /* Botschaft RVC_SVS_Park_Stat_AR ID: 1125 --- Sendeart 5 cyclicAndSpontanWithDelay --- 
BA_ "ApplMessage" BO_ 1125 0;
BA_ "NmAsrMessage" BO_ 1125 0;
BA_ "GenMsgMinAcceptLength" BO_ 1125 8;
BA_ "GenMsgILSupport" BO_ 1125 1;
BA_ "DiagState" BO_ 1125 0;
BA_ "DiagRequest" BO_ 1125 0;
BA_ "DiagResponse" BO_ 1125 0;
BA_ "GenMsgStartValue" BO_ 1125 "0";
BA_ "GenMsgStartDelayTime" BO_ 1125 165;
BA_ "GenMsgDelayTime" BO_ 1125 80;
BA_ "GenMsgNrOfRepetition" BO_ 1125 0;
BA_ "GenMsgCycleTime" BO_ 1125 1000;
BA_ "GenMsgSendType" BO_ 1125 5;
    */
    _RVC_SVS_Park_Stat_AR_Timebase =      c_tDBKomTimer_20ms;
    _RVC_SVS_Park_Stat_AR_CycleCount =   1000 / _RVC_SVS_Park_Stat_AR_Timebase;
    _RVC_SVS_Park_Stat_AR_StartDelay =    165 / _RVC_SVS_Park_Stat_AR_Timebase;
    _RVC_SVS_Park_Stat_AR_MinDelay =       80 / _RVC_SVS_Park_Stat_AR_Timebase;
    _RVC_SVS_Park_Stat_AR_Cnt = _RVC_SVS_Park_Stat_AR_StartDelay;
    _RVC_SVS_Park_Stat_AR_SpontanFlag = 0;
    _RVC_SVS_Park_Stat_AR_DelayCnt = 0;

    putValue( HMI__STMSGSD_RVC_SVS_Park_Stat_AR, _RVC_SVS_Park_Stat_AR_StartDelay * _RVC_SVS_Park_Stat_AR_Timebase );

    _mRVC_SVS_Park_Stat_AR.DRVM_PkMd_Stat_V3.phys = getValue( HMI_DRVM_PkMd_Stat_V3 );
    _mRVC_SVS_Park_Stat_AR.DRVM_SysMd_Stat_V2.phys = getValue( HMI_DRVM_SysMd_Stat_V2 );
    _mRVC_SVS_Park_Stat_AR.DRVM_Warn_Rq.phys = getValue( HMI_DRVM_Warn_Rq );
    _mRVC_SVS_Park_Stat_AR.PARK_Detents_Rq.phys = getValue( HMI_PARK_Detents_Rq );
    _mRVC_SVS_Park_Stat_AR.PARK_Detents2_Rq.phys = getValue( HMI_PARK_Detents2_Rq );
    _mRVC_SVS_Park_Stat_AR.PARK_Detents3_Rq.phys = getValue( HMI_PARK_Detents3_Rq );
    _mRVC_SVS_Park_Stat_AR.Park_ExplorMd_Avl.phys = getValue( HMI_Park_ExplorMd_Avl );
    _mRVC_SVS_Park_Stat_AR.Park_Row1_MsgDisp_Rq.phys = getValue( HMI_Park_Row1_MsgDisp_Rq );
    _mRVC_SVS_Park_Stat_AR.Park_Row2_MsgDisp_Rq.phys = getValue( HMI_Park_Row2_MsgDisp_Rq );
    _mRVC_SVS_Park_Stat_AR.PARK_SelMenu_Rq.phys = getValue( HMI_PARK_SelMenu_Rq );
    _mRVC_SVS_Park_Stat_AR.PARK_SlotStartPosn_Rq.phys = getValue( HMI_PARK_SlotStartPosn_Rq );
    _mRVC_SVS_Park_Stat_AR.PARK_SlotStartPosn2_Rq.phys = getValue( HMI_PARK_SlotStartPosn2_Rq );
    _mRVC_SVS_Park_Stat_AR.PARK_SlotStartPosn3_Rq.phys = getValue( HMI_PARK_SlotStartPosn3_Rq );
    _mRVC_SVS_Park_Stat_AR.PARK_StartList_Rq.phys = getValue( HMI_PARK_StartList_Rq );
    _mRVC_SVS_Park_Stat_AR.PARK_SysMd_Rq_Cam.phys = getValue( HMI_PARK_SysMd_Rq_Cam );
    _mRVC_SVS_Park_Stat_AR.RVC_CPF_R_Rq.phys = getValue( HMI_RVC_CPF_R_Rq );
    _mRVC_SVS_Park_Stat_AR.SVS_CPF_Ft_Rq.phys = getValue( HMI_SVS_CPF_Ft_Rq );
    _mRVC_SVS_Park_Stat_AR.SVS_CPF_R_Rq.phys = getValue( HMI_SVS_CPF_R_Rq );
    _mRVC_SVS_Park_Stat_AR.SVS_ExtLmp_Rq.phys = getValue( HMI_SVS_ExtLmp_Rq );
}
/*@@end*/

/*@@caplFunc:RVC_SVS_Park_Stat_AR_output():*/
RVC_SVS_Park_Stat_AR_output(void)
{
    output( _mRVC_SVS_Park_Stat_AR );
}
/*@@end*/

/*@@caplFunc:RVC_SVS_Park_Stat_AR_saveEnvVars(dword):*/
RVC_SVS_Park_Stat_AR_saveEnvVars( dword hFile )
{
    filePutString("\n// Knoten EIS: RVC_SVS_Park_Stat_AR\n", 40, hFile );
    snprintf( buffer, elcount( buffer ), "0.0000 HMI__STMST_RVC_SVS_Park_Stat_AR := %X\n", getValue( HMI__STMSG_RVC_SVS_Park_Stat_AR ) );        filePutString( buffer, elcount( buffer ), hFile );
    snprintf( buffer, elcount( buffer ), "0.0000 HMI__STMSGT_RVC_SVS_Park_Stat_AR := %X\n", getValue( HMI__STMSGT_RVC_SVS_Park_Stat_AR ) );        filePutString( buffer, elcount( buffer ), hFile );
    snprintf( buffer, elcount( buffer ), "0.0000 HMI_DRVM_PkMd_Stat_V3 := %X\n", getValue( HMI_DRVM_PkMd_Stat_V3 ) );        filePutString( buffer, elcount( buffer ), hFile );
    snprintf( buffer, elcount( buffer ), "0.0000 HMI_DRVM_SysMd_Stat_V2 := %X\n", getValue( HMI_DRVM_SysMd_Stat_V2 ) );        filePutString( buffer, elcount( buffer ), hFile );
    snprintf( buffer, elcount( buffer ), "0.0000 HMI_DRVM_Warn_Rq := %X\n", getValue( HMI_DRVM_Warn_Rq ) );    filePutString( buffer, elcount( buffer ), hFile );
    snprintf( buffer, elcount( buffer ), "0.0000 HMI_PARK_Detents_Rq := %X\n", getValue( HMI_PARK_Detents_Rq ) );        filePutString( buffer, elcount( buffer ), hFile );
    snprintf( buffer, elcount( buffer ), "0.0000 HMI_PARK_Detents2_Rq := %X\n", getValue( HMI_PARK_Detents2_Rq ) );        filePutString( buffer, elcount( buffer ), hFile );
    snprintf( buffer, elcount( buffer ), "0.0000 HMI_PARK_Detents3_Rq := %X\n", getValue( HMI_PARK_Detents3_Rq ) );        filePutString( buffer, elcount( buffer ), hFile );
    snprintf( buffer, elcount( buffer ), "0.0000 HMI_Park_ExplorMd_Avl := %X\n", getValue( HMI_Park_ExplorMd_Avl ) );        filePutString( buffer, elcount( buffer ), hFile );
    snprintf( buffer, elcount( buffer ), "0.0000 HMI_Park_Row1_MsgDisp_Rq := %X\n", getValue( HMI_Park_Row1_MsgDisp_Rq ) );        filePutString( buffer, elcount( buffer ), hFile );
    snprintf( buffer, elcount( buffer ), "0.0000 HMI_Park_Row2_MsgDisp_Rq := %X\n", getValue( HMI_Park_Row2_MsgDisp_Rq ) );        filePutString( buffer, elcount( buffer ), hFile );
    snprintf( buffer, elcount( buffer ), "0.0000 HMI_PARK_SelMenu_Rq := %X\n", getValue( HMI_PARK_SelMenu_Rq ) );        filePutString( buffer, elcount( buffer ), hFile );
    snprintf( buffer, elcount( buffer ), "0.0000 HMI_PARK_SlotStartPosn_Rq := %X\n", getValue( HMI_PARK_SlotStartPosn_Rq ) );        filePutString( buffer, elcount( buffer ), hFile );
    snprintf( buffer, elcount( buffer ), "0.0000 HMI_PARK_SlotStartPosn2_Rq := %X\n", getValue( HMI_PARK_SlotStartPosn2_Rq ) );        filePutString( buffer, elcount( buffer ), hFile );
    snprintf( buffer, elcount( buffer ), "0.0000 HMI_PARK_SlotStartPosn3_Rq := %X\n", getValue( HMI_PARK_SlotStartPosn3_Rq ) );        filePutString( buffer, elcount( buffer ), hFile );
    snprintf( buffer, elcount( buffer ), "0.0000 HMI_PARK_StartList_Rq := %X\n", getValue( HMI_PARK_StartList_Rq ) );        filePutString( buffer, elcount( buffer ), hFile );
    snprintf( buffer, elcount( buffer ), "0.0000 HMI_PARK_SysMd_Rq_Cam := %X\n", getValue( HMI_PARK_SysMd_Rq_Cam ) );        filePutString( buffer, elcount( buffer ), hFile );
    snprintf( buffer, elcount( buffer ), "0.0000 HMI_RVC_CPF_R_Rq := %X\n", getValue( HMI_RVC_CPF_R_Rq ) );        filePutString( buffer, elcount( buffer ), hFile );
    snprintf( buffer, elcount( buffer ), "0.0000 HMI_SVS_CPF_Ft_Rq := %X\n", getValue( HMI_SVS_CPF_Ft_Rq ) );        filePutString( buffer, elcount( buffer ), hFile );
    snprintf( buffer, elcount( buffer ), "0.0000 HMI_SVS_CPF_R_Rq := %X\n", getValue( HMI_SVS_CPF_R_Rq ) );        filePutString( buffer, elcount( buffer ), hFile );
    snprintf( buffer, elcount( buffer ), "0.0000 HMI_SVS_ExtLmp_Rq := %X\n", getValue( HMI_SVS_ExtLmp_Rq ) );        filePutString( buffer, elcount( buffer ), hFile );
}
/*@@end*/

/*@@timer:_tRVC_SVS_Park_Stat_AR:*/
on timer _tRVC_SVS_Park_Stat_AR
{
    putValue( HMI__STMSG_RVC_SVS_Park_Stat_AR, 0 );
}
/*@@end*/

/*@@envVar:HMI__STMSG_RVC_SVS_Park_Stat_AR:*/
on EnvVar HMI__STMSG_RVC_SVS_Park_Stat_AR
{
    long tDelay;
    if( getValue( this ) == 2 )
    {
        tDelay = getValue( HMI__STMSGT_RVC_SVS_Park_Stat_AR );
        if( tDelay > 0 )
            setTimer( _tRVC_SVS_Park_Stat_AR, tDelay );
        else
            putValue( HMI__STMSG_RVC_SVS_Park_Stat_AR, 0 );
    }
}
/*@@end*/

/*@@envVar:HMI_DRVM_PkMd_Stat_V3:*/
on EnvVar HMI_DRVM_PkMd_Stat_V3
{
    _mRVC_SVS_Park_Stat_AR.DRVM_PkMd_Stat_V3.phys = getValue(this);
    _RVC_SVS_Park_Stat_AR_SpontanFlag = 1;
}
/*@@end*/

/*@@envVar:HMI_DRVM_SysMd_Stat_V2:*/
on EnvVar HMI_DRVM_SysMd_Stat_V2
{
    _mRVC_SVS_Park_Stat_AR.DRVM_SysMd_Stat_V2.phys = getValue(this);
    _RVC_SVS_Park_Stat_AR_SpontanFlag = 1;
}
/*@@end*/

/*@@envVar:HMI_DRVM_Warn_Rq:*/
on EnvVar HMI_DRVM_Warn_Rq
{
    _mRVC_SVS_Park_Stat_AR.DRVM_Warn_Rq.phys = getValue(this);
    _RVC_SVS_Park_Stat_AR_SpontanFlag = 1;
}
/*@@end*/

/*@@envVar:HMI_PARK_Detents_Rq:*/
on EnvVar HMI_PARK_Detents_Rq
{
    _mRVC_SVS_Park_Stat_AR.PARK_Detents_Rq.phys = getValue(this);
    _RVC_SVS_Park_Stat_AR_SpontanFlag = 1;
}
/*@@end*/

/*@@envVar:HMI_PARK_Detents2_Rq:*/
on EnvVar HMI_PARK_Detents2_Rq
{
    _mRVC_SVS_Park_Stat_AR.PARK_Detents2_Rq.phys = getValue(this);
    _RVC_SVS_Park_Stat_AR_SpontanFlag = 1;
}
/*@@end*/

/*@@envVar:HMI_PARK_Detents3_Rq:*/
on EnvVar HMI_PARK_Detents3_Rq
{
    _mRVC_SVS_Park_Stat_AR.PARK_Detents3_Rq.phys = getValue(this);
    _RVC_SVS_Park_Stat_AR_SpontanFlag = 1;
}
/*@@end*/

/*@@envVar:HMI_Park_ExplorMd_Avl:*/
on EnvVar HMI_Park_ExplorMd_Avl
{
    _mRVC_SVS_Park_Stat_AR.Park_ExplorMd_Avl.phys = getValue(this);
    _RVC_SVS_Park_Stat_AR_SpontanFlag = 1;
}
/*@@end*/

/*@@envVar:HMI_Park_Row1_MsgDisp_Rq:*/
on EnvVar HMI_Park_Row1_MsgDisp_Rq
{
    _mRVC_SVS_Park_Stat_AR.Park_Row1_MsgDisp_Rq.phys = getValue(this);
    _RVC_SVS_Park_Stat_AR_SpontanFlag = 1;
}
/*@@end*/

/*@@envVar:HMI_Park_Row2_MsgDisp_Rq:*/
on EnvVar HMI_Park_Row2_MsgDisp_Rq
{
    _mRVC_SVS_Park_Stat_AR.Park_Row2_MsgDisp_Rq.phys = getValue(this);
    _RVC_SVS_Park_Stat_AR_SpontanFlag = 1;
}
/*@@end*/

/*@@envVar:HMI_PARK_SelMenu_Rq:*/
on EnvVar HMI_PARK_SelMenu_Rq
{
    _mRVC_SVS_Park_Stat_AR.PARK_SelMenu_Rq.phys = getValue(this);
    _RVC_SVS_Park_Stat_AR_SpontanFlag = 1;
}
/*@@end*/

/*@@envVar:HMI_PARK_SlotStartPosn_Rq:*/
on EnvVar HMI_PARK_SlotStartPosn_Rq
{
    _mRVC_SVS_Park_Stat_AR.PARK_SlotStartPosn_Rq.phys = getValue(this);
    _RVC_SVS_Park_Stat_AR_SpontanFlag = 1;
}
/*@@end*/

/*@@envVar:HMI_PARK_SlotStartPosn2_Rq:*/
on EnvVar HMI_PARK_SlotStartPosn2_Rq
{
    _mRVC_SVS_Park_Stat_AR.PARK_SlotStartPosn2_Rq.phys = getValue(this);
    _RVC_SVS_Park_Stat_AR_SpontanFlag = 1;
}
/*@@end*/

/*@@envVar:HMI_PARK_SlotStartPosn3_Rq:*/
on EnvVar HMI_PARK_SlotStartPosn3_Rq
{
    _mRVC_SVS_Park_Stat_AR.PARK_SlotStartPosn3_Rq.phys = getValue(this);
    _RVC_SVS_Park_Stat_AR_SpontanFlag = 1;
}
/*@@end*/

/*@@envVar:HMI_PARK_StartList_Rq:*/
on EnvVar HMI_PARK_StartList_Rq
{
    _mRVC_SVS_Park_Stat_AR.PARK_StartList_Rq.phys = getValue(this);
    _RVC_SVS_Park_Stat_AR_SpontanFlag = 1;
}
/*@@end*/

/*@@envVar:HMI_PARK_SysMd_Rq_Cam:*/
on EnvVar HMI_PARK_SysMd_Rq_Cam
{
    _mRVC_SVS_Park_Stat_AR.PARK_SysMd_Rq_Cam.phys = getValue(this);
    _RVC_SVS_Park_Stat_AR_SpontanFlag = 1;
}
/*@@end*/

/*@@envVar:HMI_RVC_CPF_R_Rq:*/
on EnvVar HMI_RVC_CPF_R_Rq
{
    _mRVC_SVS_Park_Stat_AR.RVC_CPF_R_Rq.phys = getValue(this);
    _RVC_SVS_Park_Stat_AR_SpontanFlag = 1;
}
/*@@end*/

/*@@envVar:HMI_SVS_CPF_Ft_Rq:*/
on EnvVar HMI_SVS_CPF_Ft_Rq
{
    _mRVC_SVS_Park_Stat_AR.SVS_CPF_Ft_Rq.phys = getValue(this);
    _RVC_SVS_Park_Stat_AR_SpontanFlag = 1;
}
/*@@end*/

/*@@envVar:HMI_SVS_CPF_R_Rq:*/
on EnvVar HMI_SVS_CPF_R_Rq
{
    _mRVC_SVS_Park_Stat_AR.SVS_CPF_R_Rq.phys = getValue(this);
    _RVC_SVS_Park_Stat_AR_SpontanFlag = 1;
}
/*@@end*/

/*@@envVar:HMI_SVS_ExtLmp_Rq:*/
on EnvVar HMI_SVS_ExtLmp_Rq
{
    _mRVC_SVS_Park_Stat_AR.SVS_ExtLmp_Rq.phys = getValue(this);
    _RVC_SVS_Park_Stat_AR_SpontanFlag = 1;
}
/*@@end*/

/*@@caplFunc:SBW_DrvPosn_Disp_Rq_ISM_AR_check_output():*/
SBW_DrvPosn_Disp_Rq_ISM_AR_check_output()
{
    if( !getValue( HMI__STMSG_SBW_DrvPosn_Disp_Rq_ISM_AR ) )
    {
        // Botschaft SBW_DrvPosn_Disp_Rq_ISM_AR ID: 323 --- Sendeart 5 cyclicAndSpontanWithDelay --- 
        _SBW_DrvPosn_Disp_Rq_ISM_AR_Cnt--;
        if( _SBW_DrvPosn_Disp_Rq_ISM_AR_Cnt < 1 )
        {
            // Nachricht wg. abgelaufenem Zyklus ausgeben
            SBW_DrvPosn_Disp_Rq_ISM_AR_output();
            _SBW_DrvPosn_Disp_Rq_ISM_AR_Cnt = _SBW_DrvPosn_Disp_Rq_ISM_AR_CycleCount; // Zyklus-Zähler zurücksetzen
            _SBW_DrvPosn_Disp_Rq_ISM_AR_SpontanFlag = 0; // Spontan-Flag zurücksetzen
        }
        else if( _SBW_DrvPosn_Disp_Rq_ISM_AR_SpontanFlag)
        {
            // Nachricht wg. spontaner Änderung ausgeben
            SBW_DrvPosn_Disp_Rq_ISM_AR_output();
            _SBW_DrvPosn_Disp_Rq_ISM_AR_SpontanFlag = 0; // Spontan-Flag zurücksetzen
        }
    }
}
/*@@end*/

/*@@caplFunc:SBW_DrvPosn_Disp_Rq_ISM_AR_init():*/
SBW_DrvPosn_Disp_Rq_ISM_AR_init()
{   /* Botschaft SBW_DrvPosn_Disp_Rq_ISM_AR ID: 323 --- Sendeart 5 cyclicAndSpontanWithDelay --- 
BA_ "ApplMessage" BO_ 323 0;
BA_ "NmAsrMessage" BO_ 323 0;
BA_ "GenMsgMinAcceptLength" BO_ 323 8;
BA_ "GenMsgILSupport" BO_ 323 1;
BA_ "DiagState" BO_ 323 0;
BA_ "DiagRequest" BO_ 323 0;
BA_ "DiagResponse" BO_ 323 0;
BA_ "GenMsgStartValue" BO_ 323 "0";
BA_ "GenMsgDelayTime" BO_ 323 20;
BA_ "GenMsgNrOfRepetitions" BO_ 323 0;
BA_ "GenMsgCycleTime" BO_ 323 200;
BA_ "GenMsgSendType" BO_ 323 5;
    */
    _SBW_DrvPosn_Disp_Rq_ISM_AR_Timebase =         c_tDBKomTimer_20ms;
    _SBW_DrvPosn_Disp_Rq_ISM_AR_CycleCount =     200 / _SBW_DrvPosn_Disp_Rq_ISM_AR_Timebase;
    _SBW_DrvPosn_Disp_Rq_ISM_AR_StartDelay =       0 / _SBW_DrvPosn_Disp_Rq_ISM_AR_Timebase;
    _SBW_DrvPosn_Disp_Rq_ISM_AR_Cnt = _SBW_DrvPosn_Disp_Rq_ISM_AR_StartDelay;
    _SBW_DrvPosn_Disp_Rq_ISM_AR_SpontanFlag = 0;

    putValue( HMI__STMSGSD_SBW_DrvPosn_Disp_Rq_ISM_AR, _SBW_DrvPosn_Disp_Rq_ISM_AR_StartDelay * _SBW_DrvPosn_Disp_Rq_ISM_AR_Timebase );

//    _mSBW_DrvPosn_Disp_Rq_ISM_AR.Rsrv1_ISM_TxDrvPosn_Disp_Rq.phys = getValue( HMI_Rsrv1_ISM_TxDrvPosn_Disp_Rq );
//    _mSBW_DrvPosn_Disp_Rq_ISM_AR.Rsrv2_ISM_TxDrvPosn_Disp_Rq.phys = getValue( HMI_Rsrv2_ISM_TxDrvPosn_Disp_Rq );
    _mSBW_DrvPosn_Disp_Rq_ISM_AR.Rsrv3_ISM_TxDrvPosn_Disp_Rq.phys = getValue( HMI_Rsrv3_ISM_TxDrvPosn_Disp_Rq );
    _mSBW_DrvPosn_Disp_Rq_ISM_AR.SBW_Msg_Disp_Rq_ISM.phys = getValue( HMI_SBW_Msg_Disp_Rq_ISM);
    _mSBW_DrvPosn_Disp_Rq_ISM_AR.SBW_ShiftLk_Msg_RevGr_ISM.phys = getValue( HMI_SBW_ShiftLk_Msg_RevGr_ISM );
    _mSBW_DrvPosn_Disp_Rq_ISM_AR.TSL_MtnLk1_Disp_Rq_ISM_V2.phys = getValue( HMI_TSL_MtnLk1_Disp_Rq_ISM_V2 );
    _mSBW_DrvPosn_Disp_Rq_ISM_AR.TSL_MtnLk2_Disp_Rq_ISM_V2.phys = getValue( HMI_TSL_MtnLk2_Disp_Rq_ISM_V2 );
    _mSBW_DrvPosn_Disp_Rq_ISM_AR.TSL_MtnLk3_Disp_Rq_ISM_V2.phys = getValue( HMI_TSL_MtnLk3_Disp_Rq_ISM_V2 );
    _mSBW_DrvPosn_Disp_Rq_ISM_AR.TxDrvPosn_Disp_Rq_ISM.phys = getValue( HMI_TxDrvPosn_Disp_Rq_ISM);
}
/*@@end*/

/*@@caplFunc:SBW_DrvPosn_Disp_Rq_ISM_AR_output():*/
void SBW_DrvPosn_Disp_Rq_ISM_AR_output(void)
{
    byte crc;
    byte SQC_help;

    if( !getValue( HMI_SQC_ISM_TxDrvPosn_Disp_Rq_Auto ) )
    {
        // berechne message counter
        SQC_help = getValue( HMI_SQC_ISM_TxDrvPosn_Disp_Rq );
        if( SQC_help >= 15 ) SQC_help = 0;
        else SQC_help++;
        putValue( HMI_SQC_ISM_TxDrvPosn_Disp_Rq, SQC_help );
        _mSBW_DrvPosn_Disp_Rq_ISM_AR.SQC_ISM_TxDrvPosn_Disp_Rq = SQC_help;
    }
    else
          _mSBW_DrvPosn_Disp_Rq_ISM_AR.SQC_ISM_TxDrvPosn_Disp_Rq = getValue( HMI_SQC_ISM_TxDrvPosn_Disp_Rq );

    if( getValue( HMI_CRC_ISM_TxDrvPosn_Disp_Rq_Profile_02 ) )
    {
        if( !getValue( HMI_CRC_ISM_TxDrvPosn_Disp_Rq_Auto ) )
        {   // CRC according Profile_02 ( W213 )
            // berechne crc
            crc = 0xFF;
//            crc = crctable_profile02[ crc ^ _mSBW_DrvPosn_Disp_Rq_ISM_AR.byte( 0 )];  CRC
            crc = crctable_profile02[ crc ^ _mSBW_DrvPosn_Disp_Rq_ISM_AR.byte( 1 )];
            crc = crctable_profile02[ crc ^ _mSBW_DrvPosn_Disp_Rq_ISM_AR.byte( 2 )];
//            crc = crctable_profile02[ crc ^ _mSBW_DrvPosn_Disp_Rq_ISM_AR.byte( 3 )];
//            crc = crctable_profile02[ crc ^ _mSBW_DrvPosn_Disp_Rq_ISM_AR.byte( 4 )];
//            crc = crctable_profile02[ crc ^ _mSBW_DrvPosn_Disp_Rq_ISM_AR.byte( 5 )];
//            crc = crctable_profile02[ crc ^ _mSBW_DrvPosn_Disp_Rq_ISM_AR.byte( 6 )];
//            crc = crctable_profile02[ crc ^ _mSBW_DrvPosn_Disp_Rq_ISM_AR.byte( 7 )];
            crc = crctable_profile02[ crc ^ _SBW_DrvPosn_Disp_Rq_ISM_AR_CRC_Offset[ _mSBW_DrvPosn_Disp_Rq_ISM_AR.SQC_ISM_TxDrvPosn_Disp_Rq ] ]; // load offset
            crc = (crc ^ 0xFF);
            if( getValue(  HMI_CRC_ISM_TxDrvPosn_Disp_Rq_Invalid ) )
                crc++;
            _mSBW_DrvPosn_Disp_Rq_ISM_AR.CRC_ISM_TxDrvPosn_Disp_Rq = crc;
            putValue( HMI_CRC_ISM_TxDrvPosn_Disp_Rq, crc );
        }
        else
            _mSBW_DrvPosn_Disp_Rq_ISM_AR.CRC_ISM_TxDrvPosn_Disp_Rq = getValue( HMI_CRC_ISM_TxDrvPosn_Disp_Rq );
    }
    else
    {
        if( !getValue( HMI_CRC_ISM_TxDrvPosn_Disp_Rq_Auto ) )
        {   // CRC according to SAE1850 ( W222 )
            // berechne crc
            crc = 0xFF;
//            crc = crctable[crc ^ _mSBW_DrvPosn_Disp_Rq_ISM_AR.byte( 0 )];  CRC
            crc = crctable[crc ^ _mSBW_DrvPosn_Disp_Rq_ISM_AR.byte( 1 )];
            crc = crctable[crc ^ _mSBW_DrvPosn_Disp_Rq_ISM_AR.byte( 2 )];
//            crc = crctable[crc ^ _mSBW_DrvPosn_Disp_Rq_ISM_AR.byte( 3 )];
//            crc = crctable[crc ^ _mSBW_DrvPosn_Disp_Rq_ISM_AR.byte( 4 )];
//            crc = crctable[crc ^ _mSBW_DrvPosn_Disp_Rq_ISM_AR.byte( 5 )];
//            crc = crctable[crc ^ _mSBW_DrvPosn_Disp_Rq_ISM_AR.byte( 6 )];
//            crc = crctable[crc ^ _mSBW_DrvPosn_Disp_Rq_ISM_AR.byte( 7 )];
            crc = (crc ^ 0xFF);
            if( getValue(  HMI_CRC_ISM_TxDrvPosn_Disp_Rq_Invalid ) )
                crc++;
            _mSBW_DrvPosn_Disp_Rq_ISM_AR.CRC_ISM_TxDrvPosn_Disp_Rq = crc;
            putValue( HMI_CRC_ISM_TxDrvPosn_Disp_Rq, crc );
        }
        else
            _mSBW_DrvPosn_Disp_Rq_ISM_AR.CRC_ISM_TxDrvPosn_Disp_Rq  = getValue( HMI_CRC_ISM_TxDrvPosn_Disp_Rq );
    }

    output( _mSBW_DrvPosn_Disp_Rq_ISM_AR );
}
/*@@end*/

/*@@caplFunc:SBW_DrvPosn_Disp_Rq_ISM_AR_saveEnvVars(dword):*/
SBW_DrvPosn_Disp_Rq_ISM_AR_saveEnvVars( dword hFile )
{
    filePutString("\n// Knoten EIS: SBW_DrvPosn_Disp_Rq_ISM_AR\n", 40, hFile );
    snprintf( buffer, elcount( buffer ), "0.0000 HMI__STMSSBW_DrvPosn_Disp_Rq_ISM := %X\n", getValue( HMI__STMSG_SBW_DrvPosn_Disp_Rq_ISM_AR ) );        filePutString( buffer, elcount( buffer ), hFile );
    snprintf( buffer, elcount( buffer ), "0.0000 HMI__STMSSBW_DrvPosn_Disp_Rq__02 := %X\n", getValue( HMI__STMSGT_SBW_DrvPosn_Disp_Rq_ISM_AR ) );        filePutString( buffer, elcount( buffer ), hFile );
    snprintf( buffer, elcount( buffer ), "0.0000 HMI_CRC_ISM_TxDrvPosn_Disp_Rq := %X\n", getValue( HMI_CRC_ISM_TxDrvPosn_Disp_Rq ) );        filePutString( buffer, elcount( buffer ), hFile );
    snprintf( buffer, elcount( buffer ), "0.0000 HMI_CRC_ISM_TxDrvPosn_Disp_Rq_Auto := %X\n", getValue( HMI_CRC_ISM_TxDrvPosn_Disp_Rq_Auto ) );        filePutString( buffer, elcount( buffer ), hFile );
    snprintf( buffer, elcount( buffer ), "0.0000 HMI_Rsrv3_ISM_TxDrvPosn_Disp_Rq := %X\n", getValue( HMI_Rsrv3_ISM_TxDrvPosn_Disp_Rq ) );        filePutString( buffer, elcount( buffer ), hFile );
    snprintf( buffer, elcount( buffer ), "0.0000 HMI_SBW_Msg_Disp_Rq_ISM := %X\n", getValue( HMI_SBW_Msg_Disp_Rq_ISM ) );        filePutString( buffer, elcount( buffer ), hFile );
    snprintf( buffer, elcount( buffer ), "0.0000 HMI_SBW_ShiftLk_Msg_RevGr_ISM := %X\n", getValue( HMI_SBW_ShiftLk_Msg_RevGr_ISM ) );        filePutString( buffer, elcount( buffer ), hFile );
    snprintf( buffer, elcount( buffer ), "0.0000 HMI_SQC_ISM_TxDrvPosn_Disp_Rq := %X\n", getValue( HMI_SQC_ISM_TxDrvPosn_Disp_Rq ) );        filePutString( buffer, elcount( buffer ), hFile );
    snprintf( buffer, elcount( buffer ), "0.0000 HMI_SQC_ISM_TxDrvPosn_Disp_Rq_Auto := %X\n", getValue( HMI_SQC_ISM_TxDrvPosn_Disp_Rq_Auto ) );        filePutString( buffer, elcount( buffer ), hFile );
    snprintf( buffer, elcount( buffer ), "0.0000 HMI_TSL_MtnLk1_Disp_Rq_ISM_V2 := %X\n", getValue( HMI_TSL_MtnLk1_Disp_Rq_ISM_V2 ) );        filePutString( buffer, elcount( buffer ), hFile );
    snprintf( buffer, elcount( buffer ), "0.0000 HMI_TSL_MtnLk2_Disp_Rq_ISM_V2 := %X\n", getValue( HMI_TSL_MtnLk2_Disp_Rq_ISM_V2 ) );        filePutString( buffer, elcount( buffer ), hFile );
    snprintf( buffer, elcount( buffer ), "0.0000 HMI_TSL_MtnLk3_Disp_Rq_ISM_V2 := %X\n", getValue( HMI_TSL_MtnLk3_Disp_Rq_ISM_V2 ) );        filePutString( buffer, elcount( buffer ), hFile );
    snprintf( buffer, elcount( buffer ), "0.0000 HMI_TxDrvPosn_Disp_Rq_ISM := %X\n", getValue( HMI_TxDrvPosn_Disp_Rq_ISM ) );        filePutString( buffer, elcount( buffer ), hFile );
}
/*@@end*/

/*@@timer:_tSBW_DrvPosn_Disp_Rq_ISM_AR:*/
on timer _tSBW_DrvPosn_Disp_Rq_ISM_AR
{
    putValue( HMI__STMSG_SBW_DrvPosn_Disp_Rq_ISM_AR, 0 );
}
/*@@end*/

/*@@envVar:HMI__STMSG_SBW_DrvPosn_Disp_Rq_ISM_AR:*/
on EnvVar HMI__STMSG_SBW_DrvPosn_Disp_Rq_ISM_AR
{
    long tDelay;
    if( getValue( this ) == 2 )
    {
        tDelay = getValue( HMI__STMSGT_SBW_DrvPosn_Disp_Rq_ISM_AR );
        if( tDelay > 0)    
            setTimer( _tSBW_DrvPosn_Disp_Rq_ISM_AR, tDelay );
        else
            putValue( HMI__STMSG_SBW_DrvPosn_Disp_Rq_ISM_AR, 0 );
    }
}
/*@@end*/

/*@@envVar:HMI_Rsrv3_ISM_TxDrvPosn_Disp_Rq:*/
on EnvVar HMI_Rsrv3_ISM_TxDrvPosn_Disp_Rq
{
    _mSBW_DrvPosn_Disp_Rq_ISM_AR.Rsrv3_ISM_TxDrvPosn_Disp_Rq.phys = getValue(this);
    _SBW_DrvPosn_Disp_Rq_ISM_AR_SpontanFlag = 1;
}
/*@@end*/

/*@@envVar:HMI_SBW_Msg_Disp_Rq_ISM:*/
on EnvVar HMI_SBW_Msg_Disp_Rq_ISM
{
    _mSBW_DrvPosn_Disp_Rq_ISM_AR.SBW_Msg_Disp_Rq_ISM.phys = getValue(this);
    _SBW_DrvPosn_Disp_Rq_ISM_AR_SpontanFlag = 1;
}
/*@@end*/

/*@@envVar:HMI_SBW_ShiftLk_Msg_RevGr_ISM:*/
on EnvVar HMI_SBW_ShiftLk_Msg_RevGr_ISM
{
    _mSBW_DrvPosn_Disp_Rq_ISM_AR.SBW_ShiftLk_Msg_RevGr_ISM.phys = getValue(this);
    _SBW_DrvPosn_Disp_Rq_ISM_AR_SpontanFlag = 1;
}
/*@@end*/

/*@@envVar:HMI_TSL_MtnLk1_Disp_Rq_ISM_V2:*/
on EnvVar HMI_TSL_MtnLk1_Disp_Rq_ISM_V2
{
    _mSBW_DrvPosn_Disp_Rq_ISM_AR.TSL_MtnLk1_Disp_Rq_ISM_V2.phys = getValue(this);
    _SBW_DrvPosn_Disp_Rq_ISM_AR_SpontanFlag = 1;
}
/*@@end*/

/*@@envVar:HMI_TSL_MtnLk2_Disp_Rq_ISM_V2:*/
on EnvVar HMI_TSL_MtnLk2_Disp_Rq_ISM_V2
{
    _mSBW_DrvPosn_Disp_Rq_ISM_AR.TSL_MtnLk2_Disp_Rq_ISM_V2.phys = getValue(this);
    _SBW_DrvPosn_Disp_Rq_ISM_AR_SpontanFlag = 1;
}
/*@@end*/

/*@@envVar:HMI_TSL_MtnLk3_Disp_Rq_ISM_V2:*/
on EnvVar HMI_TSL_MtnLk3_Disp_Rq_ISM_V2
{
    _mSBW_DrvPosn_Disp_Rq_ISM_AR.TSL_MtnLk3_Disp_Rq_ISM_V2.phys = getValue(this);
    _SBW_DrvPosn_Disp_Rq_ISM_AR_SpontanFlag = 1;
}
/*@@end*/

/*@@envVar:HMI_TxDrvPosn_Disp_Rq_ISM:*/
on EnvVar HMI_TxDrvPosn_Disp_Rq_ISM
{
    if( ( getValue( Env_Stress__StresstestMainActiv ) == 0 )   &&
        ( getValue( HMI__NM_EIS_AutomaticNM_Switching ) == 0 )    )
    {
        _SetCommRequest( cGearIndNMRequest );
        setTimer( t_GearIndNMCancelTimer, c_NMCancelTimer_05sec ); // 5 seconds for auto-shut-off
    }
    _mSBW_DrvPosn_Disp_Rq_ISM_AR.TxDrvPosn_Disp_Rq_ISM.phys = getValue(this);
    _SBW_DrvPosn_Disp_Rq_ISM_AR_SpontanFlag = 1;
}
/*@@end*/

/*@@caplFunc:SBW_DrvPosn_Disp_Rq_TCM_AR_check_output():*/
SBW_DrvPosn_Disp_Rq_TCM_AR_check_output()
{
    if( !getValue( HMI__STMSG_SBW_DrvPosn_Disp_Rq_TCM_AR ) )
    {
        // Botschaft SBW_DrvPosn_Disp_Rq_TCM_AR ID: 711 --- Sendeart 5 cyclicAndSpontanWithDelay --- 
        _SBW_DrvPosn_Disp_Rq_TCM_AR_Cnt--;
        if( _SBW_DrvPosn_Disp_Rq_TCM_AR_Cnt < 1 )
        {
            // Nachricht wg. abgelaufenem Zyklus ausgeben
            SBW_DrvPosn_Disp_Rq_TCM_AR_output();
            _SBW_DrvPosn_Disp_Rq_TCM_AR_Cnt = _SBW_DrvPosn_Disp_Rq_TCM_AR_CycleCount; // Zyklus-Zähler zurücksetzen
            _SBW_DrvPosn_Disp_Rq_TCM_AR_SpontanFlag = 0; // Spontan-Flag zurücksetzen
        }
        else if( _SBW_DrvPosn_Disp_Rq_TCM_AR_SpontanFlag)
        {
            // Nachricht wg. spontaner Änderung ausgeben
            SBW_DrvPosn_Disp_Rq_TCM_AR_output();
            _SBW_DrvPosn_Disp_Rq_TCM_AR_SpontanFlag = 0; // Spontan-Flag zurücksetzen
        }
    }
}
/*@@end*/

/*@@caplFunc:SBW_DrvPosn_Disp_Rq_TCM_AR_init():*/
SBW_DrvPosn_Disp_Rq_TCM_AR_init()
{   /* Botschaft SBW_DrvPosn_Disp_Rq_TCM_AR ID: 711 --- Sendeart 5 cyclicAndSpontanWithDelay --- 
BA_ "ApplMessage" BO_ 711 0;
BA_ "NmAsrMessage" BO_ 711 0;
BA_ "GenMsgMinAcceptLength" BO_ 711 8;
BA_ "GenMsgILSupport" BO_ 711 1;
BA_ "DiagState" BO_ 711 0;
BA_ "DiagRequest" BO_ 711 0;
BA_ "DiagResponse" BO_ 711 0;
BA_ "GenMsgStartValue" BO_ 711 "0";
BA_ "GenMsgDelayTime" BO_ 711 20;
BA_ "GenMsgNrOfRepetitions" BO_ 711 0;
BA_ "GenMsgCycleTime" BO_ 711 200;
BA_ "GenMsgSendType" BO_ 711 5;
    */
    _SBW_DrvPosn_Disp_Rq_TCM_AR_Timebase =         c_tDBKomTimer_20ms;
    _SBW_DrvPosn_Disp_Rq_TCM_AR_CycleCount =     200 / _SBW_DrvPosn_Disp_Rq_TCM_AR_Timebase;
    _SBW_DrvPosn_Disp_Rq_TCM_AR_StartDelay =       0 / _SBW_DrvPosn_Disp_Rq_TCM_AR_Timebase;
    _SBW_DrvPosn_Disp_Rq_TCM_AR_Cnt = _SBW_DrvPosn_Disp_Rq_TCM_AR_StartDelay;
    _SBW_DrvPosn_Disp_Rq_TCM_AR_SpontanFlag = 0;

    putValue( HMI__STMSGSD_SBW_DrvPosn_Disp_Rq_TCM_AR, _SBW_DrvPosn_Disp_Rq_TCM_AR_StartDelay * _SBW_DrvPosn_Disp_Rq_TCM_AR_Timebase );

    _mSBW_DrvPosn_Disp_Rq_TCM_AR.Gr_Target_Disp_Rq_V2.phys = getValue( HMI_Gr_Target_Disp_Rq_V2 );
    _mSBW_DrvPosn_Disp_Rq_TCM_AR.RaceStartMd_Disp_Rq_AMG.phys = getValue( HMI_RaceStartMd_Disp_Rq_AMG);
//    _mSBW_DrvPosn_Disp_Rq_TCM_AR.Rsrv1_SBW_Drv_Pk_Posn_TCM.phys = getValue( HMI_Rsrv1_SBW_Drv_Pk_Posn_TCM );
//    _mSBW_DrvPosn_Disp_Rq_TCM_AR.Rsrv2_SBW_Drv_Pk_Posn_TCM.phys = getValue( HMI_Rsrv2_SBW_Drv_Pk_Posn_TCM );
    _mSBW_DrvPosn_Disp_Rq_TCM_AR.SBW_Msg_Disp_Rq_TCM.phys = getValue( HMI_SBW_Msg_Disp_Rq_TCM);
    _mSBW_DrvPosn_Disp_Rq_TCM_AR.SBW_ShiftLk_Msg_RevGr_TCM.phys = getValue( HMI_SBW_ShiftLk_Msg_RevGr_TCM );
    _mSBW_DrvPosn_Disp_Rq_TCM_AR.TCM_LHOM_Stat.phys = getValue( HMI_TCM_LHOM_Stat );
    _mSBW_DrvPosn_Disp_Rq_TCM_AR.TCM_PkPosn_Flt_Stat.phys = getValue( HMI_TCM_PkPosn_Flt_Stat );
    _mSBW_DrvPosn_Disp_Rq_TCM_AR.TCM_Temp_Flt_Stat.phys = getValue( HMI_TCM_Temp_Flt_Stat );
    _mSBW_DrvPosn_Disp_Rq_TCM_AR.TSL_MtnLk1_Disp_Rq_TCM_V2.phys = getValue( HMI_TSL_MtnLk1_Disp_Rq_TCM_V2 );
    _mSBW_DrvPosn_Disp_Rq_TCM_AR.TSL_MtnLk2_Disp_Rq_TCM_V2.phys = getValue( HMI_TSL_MtnLk2_Disp_Rq_TCM_V2 );
    _mSBW_DrvPosn_Disp_Rq_TCM_AR.TSL_MtnLk3_Disp_Rq_TCM_V2.phys = getValue( HMI_TSL_MtnLk3_Disp_Rq_TCM_V2 );
    _mSBW_DrvPosn_Disp_Rq_TCM_AR.TxDrvPosn_Disp_Rq_TCM.phys = getValue( HMI_TxDrvPosn_Disp_Rq_TCM);
    /* sofort */   _mSBW_DrvPosn_Disp_Rq_TCM_AR.TxDrvProg_Disp_Rq_TCM.phys = getValue( HMI_TxDrvProg_Disp_Rq_TCM);
    _mSBW_DrvPosn_Disp_Rq_TCM_AR.TxShiftRcmmnd_Disp_Rq_TCM.phys = getValue( HMI_TxShiftRcmmnd_Disp_Rq_TCM);
}
/*@@end*/

/*@@caplFunc:SBW_DrvPosn_Disp_Rq_TCM_AR_output():*/
void SBW_DrvPosn_Disp_Rq_TCM_AR_output(void)
{
    byte crc;
    byte SQC_help;

    if( !getValue( HMI_SQC_SBW_Drv_Pk_Posn_TCM_Auto ) )
    {
        // berechne message counter
        SQC_help = getValue( HMI_SQC_SBW_Drv_Pk_Posn_TCM );
        if( SQC_help >= 15 ) SQC_help = 0;
        else SQC_help++;
        putValue( HMI_SQC_SBW_Drv_Pk_Posn_TCM, SQC_help );
        _mSBW_DrvPosn_Disp_Rq_TCM_AR.SQC_SBW_Drv_Pk_Posn_TCM = SQC_help;
    }
    else
          _mSBW_DrvPosn_Disp_Rq_TCM_AR.SQC_SBW_Drv_Pk_Posn_TCM = getValue( HMI_SQC_SBW_Drv_Pk_Posn_TCM );

    if( getValue( HMI_CRC_SBW_Drv_Pk_Posn_TCM_Profile_02 ) )
    {
        if( !getValue( HMI_CRC_SBW_Drv_Pk_Posn_TCM_Auto ) )
        {   // CRC according Profile_02 ( W213 )
            // berechne crc
            crc = 0xFF;
//            crc = crctable_profile02[ crc ^ _mSBW_DrvPosn_Disp_Rq_TCM_AR.byte( 0 )];  CRC
            crc = crctable_profile02[ crc ^ _mSBW_DrvPosn_Disp_Rq_TCM_AR.byte( 1 )];
            crc = crctable_profile02[ crc ^ _mSBW_DrvPosn_Disp_Rq_TCM_AR.byte( 2 )];
//            crc = crctable_profile02[ crc ^ _mSBW_DrvPosn_Disp_Rq_TCM_AR.byte( 3 )];
//            crc = crctable_profile02[ crc ^ _mSBW_DrvPosn_Disp_Rq_TCM_AR.byte( 4 )];
//            crc = crctable_profile02[ crc ^ _mSBW_DrvPosn_Disp_Rq_TCM_AR.byte( 5 )];
//            crc = crctable_profile02[ crc ^ _mSBW_DrvPosn_Disp_Rq_TCM_AR.byte( 6 )];
//            crc = crctable_profile02[ crc ^ _mSBW_DrvPosn_Disp_Rq_TCM_AR.byte( 7 )];
            crc = crctable_profile02[ crc ^ _SBW_DrvPosn_Disp_Rq_TCM_AR_CRC_Offset[ _mSBW_DrvPosn_Disp_Rq_TCM_AR.SQC_SBW_Drv_Pk_Posn_TCM ] ]; // load offset
            crc = (crc ^ 0xFF);
            if( getValue(  HMI_CRC_SBW_Drv_Pk_Posn_TCM_Invalid ) )
                crc++;
            _mSBW_DrvPosn_Disp_Rq_TCM_AR.CRC_SBW_Drv_Pk_Posn_TCM = crc;
            putValue( HMI_CRC_SBW_Drv_Pk_Posn_TCM, crc );
        }
        else
            _mSBW_DrvPosn_Disp_Rq_TCM_AR.CRC_SBW_Drv_Pk_Posn_TCM = getValue( HMI_CRC_SBW_Drv_Pk_Posn_TCM );
    }
    else
    {
        if( !getValue( HMI_CRC_SBW_Drv_Pk_Posn_TCM_Auto ) )
        {   // CRC according to SAE1850 ( W222 )
            // berechne crc
            crc = 0xFF;
//            crc = crctable[crc ^ _mSBW_DrvPosn_Disp_Rq_TCM_AR.byte( 0 )];  CRC
            crc = crctable[crc ^ _mSBW_DrvPosn_Disp_Rq_TCM_AR.byte( 1 )];
            crc = crctable[crc ^ _mSBW_DrvPosn_Disp_Rq_TCM_AR.byte( 2 )];
//            crc = crctable[crc ^ _mSBW_DrvPosn_Disp_Rq_TCM_AR.byte( 3 )];
//            crc = crctable[crc ^ _mSBW_DrvPosn_Disp_Rq_TCM_AR.byte( 4 )];
//            crc = crctable[crc ^ _mSBW_DrvPosn_Disp_Rq_TCM_AR.byte( 5 )];
//            crc = crctable[crc ^ _mSBW_DrvPosn_Disp_Rq_TCM_AR.byte( 6 )];
//            crc = crctable[crc ^ _mSBW_DrvPosn_Disp_Rq_TCM_AR.byte( 7 )];
            crc = (crc ^ 0xFF);
            if( getValue(  HMI_CRC_SBW_Drv_Pk_Posn_TCM_Invalid ) )
                crc++;
            _mSBW_DrvPosn_Disp_Rq_TCM_AR.CRC_SBW_Drv_Pk_Posn_TCM = crc;
            putValue( HMI_CRC_SBW_Drv_Pk_Posn_TCM, crc );
        }
        else
            _mSBW_DrvPosn_Disp_Rq_TCM_AR.CRC_SBW_Drv_Pk_Posn_TCM = getValue( HMI_CRC_SBW_Drv_Pk_Posn_TCM );
    }

    output( _mSBW_DrvPosn_Disp_Rq_TCM_AR );
}
/*@@end*/

/*@@caplFunc:SBW_DrvPosn_Disp_Rq_TCM_AR_saveEnvVars(dword):*/
SBW_DrvPosn_Disp_Rq_TCM_AR_saveEnvVars( dword hFile )
{
    filePutString("\n// Knoten EIS: SBW_DrvPosn_Disp_Rq_TCM_AR\n", 40, hFile );
    snprintf( buffer, elcount( buffer ), "0.0000 HMI__STMSSBW_DrvPosn_Disp_Rq_TCM := %X\n", getValue( HMI__STMSG_SBW_DrvPosn_Disp_Rq_TCM_AR ) );    filePutString( buffer, elcount( buffer ), hFile );
    snprintf( buffer, elcount( buffer ), "0.0000 HMI__STMSSBW_DrvPosn_Disp_Rq__01 := %X\n", getValue( HMI__STMSGT_SBW_DrvPosn_Disp_Rq_TCM_AR ) );    filePutString( buffer, elcount( buffer ), hFile );
    snprintf( buffer, elcount( buffer ), "0.0000 HMI_Gr_Target_Disp_Rq_V2 := %X\n", getValue( HMI_Gr_Target_Disp_Rq_V2 ) );    filePutString( buffer, elcount( buffer ), hFile );
    snprintf( buffer, elcount( buffer ), "0.0000 HMI_RaceStartMd_Disp_Rq_AMG := %X\n", getValue( HMI_RaceStartMd_Disp_Rq_AMG ) );    filePutString( buffer, elcount( buffer ), hFile );
    snprintf( buffer, elcount( buffer ), "0.0000 HMI_SBW_Msg_Disp_Rq_TCM := %X\n", getValue( HMI_SBW_Msg_Disp_Rq_TCM ) );    filePutString( buffer, elcount( buffer ), hFile );
    snprintf( buffer, elcount( buffer ), "0.0000 HMI_SBW_ShiftLk_Msg_RevGr_TCM := %X\n", getValue( HMI_SBW_ShiftLk_Msg_RevGr_TCM ) );    filePutString( buffer, elcount( buffer ), hFile );
    snprintf( buffer, elcount( buffer ), "0.0000 HMI_TCM_LHOM_Stat := %X\n", getValue( HMI_TCM_LHOM_Stat ) );    filePutString( buffer, elcount( buffer ), hFile );
    snprintf( buffer, elcount( buffer ), "0.0000 HMI_TCM_PkPosn_Flt_Stat := %X\n", getValue( HMI_TCM_PkPosn_Flt_Stat ) );    filePutString( buffer, elcount( buffer ), hFile );
    snprintf( buffer, elcount( buffer ), "0.0000 HMI_TCM_Temp_Flt_Stat := %X\n", getValue( HMI_TCM_Temp_Flt_Stat ) );    filePutString( buffer, elcount( buffer ), hFile );
    snprintf( buffer, elcount( buffer ), "0.0000 HMI_TSL_MtnLk1_Disp_Rq_TCM_V2 := %X\n", getValue( HMI_TSL_MtnLk1_Disp_Rq_TCM_V2 ) );    filePutString( buffer, elcount( buffer ), hFile );
    snprintf( buffer, elcount( buffer ), "0.0000 HMI_TSL_MtnLk2_Disp_Rq_TCM_V2 := %X\n", getValue( HMI_TSL_MtnLk2_Disp_Rq_TCM_V2 ) );    filePutString( buffer, elcount( buffer ), hFile );
    snprintf( buffer, elcount( buffer ), "0.0000 HMI_TSL_MtnLk3_Disp_Rq_TCM_V2 := %X\n", getValue( HMI_TSL_MtnLk3_Disp_Rq_TCM_V2 ) );    filePutString( buffer, elcount( buffer ), hFile );
    snprintf( buffer, elcount( buffer ), "0.0000 HMI_TxDrvPosn_Disp_Rq_TCM := %X\n", getValue( HMI_TxDrvPosn_Disp_Rq_TCM ) );    filePutString( buffer, elcount( buffer ), hFile );
    snprintf( buffer, elcount( buffer ), "0.0000 HMI_TxDrvProg_Disp_Rq_TCM := %X\n", getValue( HMI_TxDrvProg_Disp_Rq_TCM ) );    filePutString( buffer, elcount( buffer ), hFile );
    snprintf( buffer, elcount( buffer ), "0.0000 HMI_TxShiftRcmmnd_Disp_Rq_TCM := %X\n", getValue( HMI_TxShiftRcmmnd_Disp_Rq_TCM ) );    filePutString( buffer, elcount( buffer ), hFile );
}
/*@@end*/

/*@@timer:_tSBW_DrvPosn_Disp_Rq_TCM_AR:*/
on timer _tSBW_DrvPosn_Disp_Rq_TCM_AR
{
    putValue( HMI__STMSG_SBW_DrvPosn_Disp_Rq_TCM_AR, 0 );
}
/*@@end*/

/*@@envVar:HMI__STMSG_SBW_DrvPosn_Disp_Rq_TCM_AR:*/
on EnvVar HMI__STMSG_SBW_DrvPosn_Disp_Rq_TCM_AR
{
    long tDelay;
    if( getValue( this ) == 2 )
    {
        tDelay = getValue( HMI__STMSGT_SBW_DrvPosn_Disp_Rq_TCM_AR );
        if( tDelay > 0)    
            setTimer( _tSBW_DrvPosn_Disp_Rq_TCM_AR, tDelay );
        else
            putValue( HMI__STMSG_SBW_DrvPosn_Disp_Rq_TCM_AR, 0 );
    }
}
/*@@end*/

/*@@envVar:HMI_Gr_Target_Disp_Rq_V2:*/
on EnvVar HMI_Gr_Target_Disp_Rq_V2
{
    _mSBW_DrvPosn_Disp_Rq_TCM_AR.Gr_Target_Disp_Rq_V2.phys = getValue(this);
    _SBW_DrvPosn_Disp_Rq_TCM_AR_SpontanFlag = 1;
}
/*@@end*/

/*@@envVar:HMI_RaceStartMd_Disp_Rq_AMG:*/
on EnvVar HMI_RaceStartMd_Disp_Rq_AMG
{
    _mSBW_DrvPosn_Disp_Rq_TCM_AR.RaceStartMd_Disp_Rq_AMG.phys = getValue(this);
    _SBW_DrvPosn_Disp_Rq_TCM_AR_SpontanFlag = 1;
}
/*@@end*/

/*@@envVar:HMI_SBW_Msg_Disp_Rq_TCM:*/
on EnvVar HMI_SBW_Msg_Disp_Rq_TCM
{
    _mSBW_DrvPosn_Disp_Rq_TCM_AR.SBW_Msg_Disp_Rq_TCM.phys = getValue(this);
    _SBW_DrvPosn_Disp_Rq_TCM_AR_SpontanFlag = 1;
}
/*@@end*/

/*@@envVar:HMI_SBW_ShiftLk_Msg_RevGr_TCM:*/
on envVar HMI_SBW_ShiftLk_Msg_RevGr_TCM
{
    _mSBW_DrvPosn_Disp_Rq_TCM_AR.SBW_ShiftLk_Msg_RevGr_TCM.phys = getValue(this);
    _SBW_DrvPosn_Disp_Rq_TCM_AR_SpontanFlag = 1;
}
/*@@end*/

/*@@envVar:HMI_TCM_LHOM_Stat:*/
on envVar HMI_TCM_LHOM_Stat
{
    _mSBW_DrvPosn_Disp_Rq_TCM_AR.TCM_LHOM_Stat.phys = getValue(this);
    _SBW_DrvPosn_Disp_Rq_TCM_AR_SpontanFlag = 1;
}
/*@@end*/

/*@@envVar:HMI_TCM_PkPosn_Flt_Stat:*/
on envVar HMI_TCM_PkPosn_Flt_Stat
{
    _mSBW_DrvPosn_Disp_Rq_TCM_AR.TCM_PkPosn_Flt_Stat.phys = getValue(this);
    _SBW_DrvPosn_Disp_Rq_TCM_AR_SpontanFlag = 1;
}
/*@@end*/

/*@@envVar:HMI_TCM_Temp_Flt_Stat:*/
on envVar HMI_TCM_Temp_Flt_Stat
{
    _mSBW_DrvPosn_Disp_Rq_TCM_AR.TCM_Temp_Flt_Stat.phys = getValue(this);
    _SBW_DrvPosn_Disp_Rq_TCM_AR_SpontanFlag = 1;
}
/*@@end*/

/*@@envVar:HMI_TSL_MtnLk1_Disp_Rq_TCM_V2:*/
on EnvVar HMI_TSL_MtnLk1_Disp_Rq_TCM_V2
{
    _mSBW_DrvPosn_Disp_Rq_TCM_AR.TSL_MtnLk1_Disp_Rq_TCM_V2.phys = getValue(this);
    _SBW_DrvPosn_Disp_Rq_TCM_AR_SpontanFlag = 1;
}
/*@@end*/

/*@@envVar:HMI_TSL_MtnLk2_Disp_Rq_TCM_V2:*/
on EnvVar HMI_TSL_MtnLk2_Disp_Rq_TCM_V2
{
    _mSBW_DrvPosn_Disp_Rq_TCM_AR.TSL_MtnLk2_Disp_Rq_TCM_V2.phys = getValue(this);
    _SBW_DrvPosn_Disp_Rq_TCM_AR_SpontanFlag = 1;
}
/*@@end*/

/*@@envVar:HMI_TSL_MtnLk3_Disp_Rq_TCM_V2:*/
on EnvVar HMI_TSL_MtnLk3_Disp_Rq_TCM_V2
{
    _mSBW_DrvPosn_Disp_Rq_TCM_AR.TSL_MtnLk3_Disp_Rq_TCM_V2.phys = getValue(this);
    _SBW_DrvPosn_Disp_Rq_TCM_AR_SpontanFlag = 1;
}
/*@@end*/

/*@@envVar:HMI_TxDrvPosn_Disp_Rq_TCM:*/
on EnvVar HMI_TxDrvPosn_Disp_Rq_TCM
{
    if( ( getValue( Env_Stress__StresstestMainActiv ) == 0 )   &&
        ( getValue( HMI__NM_EIS_AutomaticNM_Switching ) == 0 )    )
    {
        _SetCommRequest( cGearIndNMRequest );
        setTimer( t_GearIndNMCancelTimer, c_NMCancelTimer_05sec ); // 5 seconds for auto-shut-off
    }
    _mSBW_DrvPosn_Disp_Rq_TCM_AR.TxDrvPosn_Disp_Rq_TCM.phys = getValue(this);
    _SBW_DrvPosn_Disp_Rq_TCM_AR_SpontanFlag = 1;
}
/*@@end*/

/*@@envVar:HMI_TxDrvProg_Disp_Rq_TCM:*/
on EnvVar HMI_TxDrvProg_Disp_Rq_TCM
{
    _mSBW_DrvPosn_Disp_Rq_TCM_AR.TxDrvProg_Disp_Rq_TCM.phys = getValue(this);
    _SBW_DrvPosn_Disp_Rq_TCM_AR_SpontanFlag = 1;
}
/*@@end*/

/*@@envVar:HMI_TxShiftRcmmnd_Disp_Rq_TCM:*/
on EnvVar HMI_TxShiftRcmmnd_Disp_Rq_TCM
{
    _mSBW_DrvPosn_Disp_Rq_TCM_AR.TxShiftRcmmnd_Disp_Rq_TCM.phys = getValue(this);
    _SBW_DrvPosn_Disp_Rq_TCM_AR_SpontanFlag = 1;
}
/*@@end*/

/*@@caplFunc:Seat_D_Stat_AR_check_output():*/
Seat_D_Stat_AR_check_output()
{
    if( !getValue( HMI__STMSG_Seat_D_Stat_AR ) )
    {
        // Botschaft Seat_D_Stat_AR ID: 937 --- Sendeart 5 cyclicAndSpontanWithDelay --- 
        _Seat_D_Stat_AR_Cnt--;
        if( _Seat_D_Stat_AR_Cnt < 1 )
        {
            // Nachricht wg. abgelaufenem Zyklus ausgeben
            Seat_D_Stat_AR_output();
            _Seat_D_Stat_AR_Cnt = _Seat_D_Stat_AR_CycleCount; // Zyklus-Zähler zurücksetzen
            _Seat_D_Stat_AR_SpontanFlag = 0; // Spontan-Flag zurücksetzen
        }
        else if( _Seat_D_Stat_AR_SpontanFlag )
        {
            // Nachricht wg. spontaner Änderung ausgeben
            Seat_D_Stat_AR_output();
            _Seat_D_Stat_AR_SpontanFlag = 0; // Spontan-Flag zurücksetzen
        }
    }
}
/*@@end*/

/*@@caplFunc:Seat_D_Stat_AR_init():*/
Seat_D_Stat_AR_init()
{   /* Botschaft Seat_D_Stat_AR ID: 937 --- Sendeart 5 cyclicAndSpontanWithDelay --- 
BA_ "ApplMessage" BO_ 937 0;
BA_ "NmAsrMessage" BO_ 937 0;
BA_ "GenMsgMinAcceptLength" BO_ 937 4;
BA_ "GenMsgILSupport" BO_ 937 1;
BA_ "DiagState" BO_ 937 0;
BA_ "DiagRequest" BO_ 937 0;
BA_ "DiagResponse" BO_ 937 0;
BA_ "GenMsgStartValue" BO_ 937 "0";
BA_ "GenMsgDelayTime" BO_ 937 5;
BA_ "GenMsgNrOfRepetitions" BO_ 937 0;
BA_ "GenMsgCycleTime" BO_ 937 500;
BA_ "GenMsgSendType" BO_ 937 5;
    */
    _Seat_D_Stat_AR_Timebase =         c_tDBKomTimer_20ms;
    _Seat_D_Stat_AR_CycleCount =     500 / _Seat_D_Stat_AR_Timebase;
    _Seat_D_Stat_AR_StartDelay =       0 / _Seat_D_Stat_AR_Timebase;
    _Seat_D_Stat_AR_Cnt = _Seat_D_Stat_AR_StartDelay;
    _Seat_D_Stat_AR_SpontanFlag = 0;

    putValue( HMI__STMSGSD_Seat_D_Stat_AR, _Seat_D_Stat_AR_StartDelay * _Seat_D_Stat_AR_Timebase );

    _mSeat_D_Stat_AR.EEH_SeatAdj_Stat.phys = getValue( HMI_EEH_SeatAdj_Stat );
    _mSeat_D_Stat_AR.EEH_StW_Adj_Stat.phys = getValue( HMI_EEH_StW_Adj_Stat );
    _mSeat_D_Stat_AR.FWLP_Pmp_Rq_D.phys = getValue( HMI_FWLP_Pmp_Rq_D );
    _mSeat_D_Stat_AR.Mem_D_Sv_Beep_Rq.phys = getValue( HMI_Mem_D_Sv_Beep_Rq );
    _mSeat_D_Stat_AR.Mem_D_Sv_Tgl.phys = getValue( HMI_Mem_D_Sv_Tgl );
    _mSeat_D_Stat_AR.Seat_D_collision.phys = getValue( HMI_Seat_D_collision );
    _mSeat_D_Stat_AR.Seat_D_IncorrPosn.phys = getValue( HMI_Seat_D_IncorrPosn );
    _mSeat_D_Stat_AR.SeatBkRst_D_Unlk.phys = getValue( HMI_SeatBkRst_D_Unlk );
}
/*@@end*/

/*@@caplFunc:Seat_D_Stat_AR_output():*/
void Seat_D_Stat_AR_output(void)
{
    if( !getValue( HMI_Mem_D_Sv_Tgl_Auto ) )
    {
       // berechne message counter
        if( _mSeat_D_Stat_AR.Mem_D_Sv_Tgl >= 1 ) _mSeat_D_Stat_AR.Mem_D_Sv_Tgl = 0;
        else _mSeat_D_Stat_AR.Mem_D_Sv_Tgl++;
        //putValue( HMI_Mem_D_Sv_Tgl, _mSeat_D_Stat_AR.Mem_D_Sv_Tgl);
    }
    else
          _mSeat_D_Stat_AR.Mem_D_Sv_Tgl = getValue( HMI_Mem_D_Sv_Tgl );

    output( _mSeat_D_Stat_AR );
}
/*@@end*/

/*@@caplFunc:Seat_D_Stat_AR_saveEnvVars(dword):*/
void Seat_D_Stat_AR_saveEnvVars( dword hFile )
{
    filePutString("\n// Knoten EIS: Seat_D_Stat_AR\n", 28, hFile );
    snprintf( buffer, elcount( buffer ), "0.0000 HMI__STMSG_Seat_D_Stat := %X\n", getValue( HMI__STMSG_Seat_D_Stat_AR ) );        filePutString( buffer, elcount( buffer ), hFile );
    snprintf( buffer, elcount( buffer ), "0.0000 HMI__STMSGT_Seat_D_Stat := %X\n", getValue( HMI__STMSGT_Seat_D_Stat_AR ) );        filePutString( buffer, elcount( buffer ), hFile );
    snprintf( buffer, elcount( buffer ), "0.0000 HMI_EEH_SeatAdj_Stat := %X\n", getValue( HMI_EEH_SeatAdj_Stat ) );        filePutString( buffer, elcount( buffer ), hFile );
    snprintf( buffer, elcount( buffer ), "0.0000 HMI_EEH_StW_Adj_Stat := %X\n", getValue( HMI_EEH_StW_Adj_Stat ) );        filePutString( buffer, elcount( buffer ), hFile );
    snprintf( buffer, elcount( buffer ), "0.0000 HMI_FWLP_Pmp_Rq_D := %X\n", getValue( HMI_FWLP_Pmp_Rq_D ) );        filePutString( buffer, elcount( buffer ), hFile );
    snprintf( buffer, elcount( buffer ), "0.0000 HMI_Mem_D_Sv_Beep_Rq := %X\n", getValue( HMI_Mem_D_Sv_Beep_Rq ) );        filePutString( buffer, elcount( buffer ), hFile );
    snprintf( buffer, elcount( buffer ), "0.0000 HMI_Mem_D_Sv_Tgl := %X\n", getValue( HMI_Mem_D_Sv_Tgl ) );        filePutString( buffer, elcount( buffer ), hFile );
    snprintf( buffer, elcount( buffer ), "0.0000 HMI_Seat_D_collision := %X\n", getValue( HMI_Seat_D_collision ) );        filePutString( buffer, elcount( buffer ), hFile );
    snprintf( buffer, elcount( buffer ), "0.0000 HMI_Seat_D_IncorrPosn := %X\n", getValue( HMI_Seat_D_IncorrPosn ) );        filePutString( buffer, elcount( buffer ), hFile );
    snprintf( buffer, elcount( buffer ), "0.0000 HMI_SeatBkRst_D_Unlk := %X\n", getValue( HMI_SeatBkRst_D_Unlk ) );        filePutString( buffer, elcount( buffer ), hFile );
}
/*@@end*/

/*@@timer:_tSeat_D_Stat_AR:*/
on timer _tSeat_D_Stat_AR
{
    putValue( HMI__STMSG_Seat_D_Stat_AR, 0 );
}
/*@@end*/

/*@@envVar:HMI__STMSG_Seat_D_Stat_AR:*/
on EnvVar HMI__STMSG_Seat_D_Stat_AR
{
    long tDelay;
    if( getValue( this ) == 2 )
    {
        tDelay = getValue( HMI__STMSGT_Seat_D_Stat_AR );
        if( tDelay > 0)    
            setTimer( _tSeat_D_Stat_AR, tDelay );
        else
            putValue( HMI__STMSG_Seat_D_Stat_AR, 0 );
    }
}
/*@@end*/

/*@@envVar:HMI_EEH_SeatAdj_Stat:*/
on EnvVar HMI_EEH_SeatAdj_Stat
{
    _mSeat_D_Stat_AR.EEH_SeatAdj_Stat.phys = getValue(this);
    _Seat_D_Stat_AR_SpontanFlag = 1;
}
/*@@end*/

/*@@envVar:HMI_EEH_StW_Adj_Stat:*/
on EnvVar HMI_EEH_StW_Adj_Stat
{
    _mSeat_D_Stat_AR.EEH_StW_Adj_Stat.phys = getValue(this);
    _Seat_D_Stat_AR_SpontanFlag = 1;
}
/*@@end*/

/*@@envVar:HMI_FWLP_Pmp_Rq_D:*/
on EnvVar HMI_FWLP_Pmp_Rq_D
{
    _mSeat_D_Stat_AR.FWLP_Pmp_Rq_D.phys = getValue(this);
    _Seat_D_Stat_AR_SpontanFlag = 1;
}
/*@@end*/

/*@@envVar:HMI_Mem_D_Sv_Beep_Rq:*/
on EnvVar HMI_Mem_D_Sv_Beep_Rq
{
    _mSeat_D_Stat_AR.Mem_D_Sv_Beep_Rq.phys = getValue(this);
    _Seat_D_Stat_AR_SpontanFlag = 1;
}
/*@@end*/

/*@@envVar:HMI_Seat_D_collision:*/
on EnvVar HMI_Seat_D_collision
{
    _mSeat_D_Stat_AR.Seat_D_collision.phys = getValue(this);
    _Seat_D_Stat_AR_SpontanFlag = 1;
}
/*@@end*/

/*@@envVar:HMI_Seat_D_IncorrPosn:*/
on EnvVar HMI_Seat_D_IncorrPosn
{
    _mSeat_D_Stat_AR.Seat_D_IncorrPosn.phys = getValue(this);
    _Seat_D_Stat_AR_SpontanFlag = 1;
}
/*@@end*/

/*@@envVar:HMI_SeatBkRst_D_Unlk:*/
on EnvVar HMI_SeatBkRst_D_Unlk
{
    _mSeat_D_Stat_AR.SeatBkRst_D_Unlk.phys = getValue(this);
    _Seat_D_Stat_AR_SpontanFlag = 1;
}
/*@@end*/

/*@@caplFunc:Seat_P_Stat_AR_check_output():*/
Seat_P_Stat_AR_check_output()
{
    if( !getValue( HMI__STMSG_Seat_P_Stat_AR ) )
    {
        // Botschaft Seat_P_Stat_AR ID: 939 --- Sendeart 5 cyclicAndSpontanWithDelay --- 
        _Seat_P_Stat_AR_Cnt--;
        if( _Seat_P_Stat_AR_Cnt < 1 )
        {
            // Nachricht wg. abgelaufenem Zyklus ausgeben
            Seat_P_Stat_AR_output();
            _Seat_P_Stat_AR_Cnt = _Seat_P_Stat_AR_CycleCount; // Zyklus-Zähler zurücksetzen
            _Seat_P_Stat_AR_SpontanFlag = 0; // Spontan-Flag zurücksetzen
        }
        else if( _Seat_P_Stat_AR_SpontanFlag)
        {
            // Nachricht wg. spontaner Änderung ausgeben
            Seat_P_Stat_AR_output();
            _Seat_P_Stat_AR_SpontanFlag = 0; // Spontan-Flag zurücksetzen
        }
    }
}
/*@@end*/

/*@@caplFunc:Seat_P_Stat_AR_init():*/
Seat_P_Stat_AR_init()
{   /* Botschaft Seat_P_Stat_AR ID: 939 --- Sendeart 5 cyclicAndSpontanWithDelay --- 
BA_ "ApplMessage" BO_ 939 0;
BA_ "NmAsrMessage" BO_ 939 0;
BA_ "GenMsgMinAcceptLength" BO_ 939 4;
BA_ "GenMsgILSupport" BO_ 939 1;
BA_ "DiagState" BO_ 939 0;
BA_ "DiagRequest" BO_ 939 0;
BA_ "DiagResponse" BO_ 939 0;
BA_ "GenMsgStartValue" BO_ 939 "0";
BA_ "GenMsgDelayTime" BO_ 939 5;
BA_ "GenMsgNrOfRepetitions" BO_ 939 0;
BA_ "GenMsgCycleTime" BO_ 939 500;
BA_ "GenMsgSendType" BO_ 939 5;
    */
    _Seat_P_Stat_AR_Timebase =         c_tDBKomTimer_20ms;
    _Seat_P_Stat_AR_CycleCount =     500 / _Seat_P_Stat_AR_Timebase;
    _Seat_P_Stat_AR_StartDelay =       0 / _Seat_P_Stat_AR_Timebase;
    _Seat_P_Stat_AR_Cnt = _Seat_P_Stat_AR_StartDelay;
    _Seat_P_Stat_AR_SpontanFlag = 0;

    putValue( HMI__STMSGSD_Seat_P_Stat_AR, _Seat_P_Stat_AR_StartDelay * _Seat_P_Stat_AR_Timebase );

    _mSeat_P_Stat_AR.FWLP_Pmp_Rq_P.phys = getValue( HMI_FWLP_Pmp_Rq_P );
    _mSeat_P_Stat_AR.Mem_P_Sv_Beep_Rq.phys = getValue( HMI_Mem_P_Sv_Beep_Rq );
    _mSeat_P_Stat_AR.Mem_P_Sv_Tgl.phys = getValue( HMI_Mem_P_Sv_Tgl );
    _mSeat_P_Stat_AR.Seat_P_collision.phys = getValue( HMI_Seat_P_collision );
    _mSeat_P_Stat_AR.Seat_P_IncorrPosn.phys = getValue( HMI_Seat_P_IncorrPosn );
    _mSeat_P_Stat_AR.Seat_P_MirrViewObstr.phys = getValue( HMI_Seat_P_MirrViewObstr );
    _mSeat_P_Stat_AR.SeatBkRst_P_Unlk.phys = getValue( HMI_SeatBkRst_P_Unlk );
    _mSeat_P_Stat_AR.SeatMemAdj_R_Enbl.phys = getValue( HMI_SeatMemAdj_R_Enbl );
}
/*@@end*/

/*@@caplFunc:Seat_P_Stat_AR_output():*/
void Seat_P_Stat_AR_output(void)
{
    if( !getValue( HMI_Mem_P_Sv_Tgl_Auto ) )
    {
       // berechne message counter
        if( _mSeat_P_Stat_AR.Mem_P_Sv_Tgl >= 1 ) _mSeat_P_Stat_AR.Mem_P_Sv_Tgl = 0;
        else _mSeat_P_Stat_AR.Mem_P_Sv_Tgl++;
        //putValue( HMI_Mem_P_Sv_Tgl, _mSeat_P_Stat_AR.Mem_P_Sv_Tgl);
    }
    else
          _mSeat_P_Stat_AR.Mem_P_Sv_Tgl = getValue( HMI_Mem_P_Sv_Tgl );

    output( _mSeat_P_Stat_AR );
}
/*@@end*/

/*@@caplFunc:Seat_P_Stat_AR_saveEnvVars(dword):*/
Seat_P_Stat_AR_saveEnvVars( dword hFile )
{
    filePutString("\n// Knoten EIS: Seat_P_Stat_AR\n", 28, hFile );
    snprintf( buffer, elcount( buffer ), "0.0000 HMI__STMSG_Seat_P_Stat_AR := %X\n", getValue( HMI__STMSG_Seat_P_Stat_AR ) );    filePutString( buffer, elcount( buffer ), hFile );
    snprintf( buffer, elcount( buffer ), "0.0000 HMI__STMSGT_Seat_P_Stat_AR := %X\n", getValue( HMI__STMSGT_Seat_P_Stat_AR ) );    filePutString( buffer, elcount( buffer ), hFile );
    snprintf( buffer, elcount( buffer ), "0.0000 HMI_FWLP_Pmp_Rq_P := %X\n", getValue( HMI_FWLP_Pmp_Rq_P ) );    filePutString( buffer, elcount( buffer ), hFile );
    snprintf( buffer, elcount( buffer ), "0.0000 HMI_Mem_P_Sv_Beep_Rq := %X\n", getValue( HMI_Mem_P_Sv_Beep_Rq ) );    filePutString( buffer, elcount( buffer ), hFile );
    snprintf( buffer, elcount( buffer ), "0.0000 HMI_Mem_P_Sv_Tgl := %X\n", getValue( HMI_Mem_P_Sv_Tgl ) );    filePutString( buffer, elcount( buffer ), hFile );
    snprintf( buffer, elcount( buffer ), "0.0000 HMI_Seat_P_collision := %X\n", getValue( HMI_Seat_P_collision ) );    filePutString( buffer, elcount( buffer ), hFile );
    snprintf( buffer, elcount( buffer ), "0.0000 HMI_Seat_P_IncorrPosn := %X\n", getValue( HMI_Seat_P_IncorrPosn ) );    filePutString( buffer, elcount( buffer ), hFile );
    snprintf( buffer, elcount( buffer ), "0.0000 HMI_Seat_P_MirrViewObstr := %X\n", getValue( HMI_Seat_P_MirrViewObstr ) );    filePutString( buffer, elcount( buffer ), hFile );
    snprintf( buffer, elcount( buffer ), "0.0000 HMI_SeatBkRst_P_Unlk := %X\n", getValue( HMI_SeatBkRst_P_Unlk ) );    filePutString( buffer, elcount( buffer ), hFile );
    snprintf( buffer, elcount( buffer ), "0.0000 HMI_SeatMemAdj_R_Enbl := %X\n", getValue( HMI_SeatMemAdj_R_Enbl ) );    filePutString( buffer, elcount( buffer ), hFile );
}
/*@@end*/

/*@@timer:_tSeat_P_Stat_AR:*/
on timer _tSeat_P_Stat_AR
{
    putValue( HMI__STMSG_Seat_P_Stat_AR, 0 );
}
/*@@end*/

/*@@envVar:HMI__STMSG_Seat_P_Stat_AR:*/
on EnvVar HMI__STMSG_Seat_P_Stat_AR
{
    long tDelay;
    if( getValue( this ) == 2 )
    {
        tDelay = getValue( HMI__STMSGT_Seat_P_Stat_AR );
        if( tDelay > 0)    
            setTimer( _tSeat_P_Stat_AR, tDelay );
        else
            putValue( HMI__STMSG_Seat_P_Stat_AR, 0 );
    }
}
/*@@end*/

/*@@envVar:HMI_FWLP_Pmp_Rq_P:*/
on EnvVar HMI_FWLP_Pmp_Rq_P
{
    _mSeat_P_Stat_AR.FWLP_Pmp_Rq_P.phys = getValue(this);
    _Seat_P_Stat_AR_SpontanFlag = 1;
}
/*@@end*/

/*@@envVar:HMI_Mem_P_Sv_Beep_Rq:*/
on EnvVar HMI_Mem_P_Sv_Beep_Rq
{
    _mSeat_P_Stat_AR.Mem_P_Sv_Beep_Rq.phys = getValue(this);
    _Seat_P_Stat_AR_SpontanFlag = 1;
}
/*@@end*/

/*@@envVar:HMI_Seat_P_collision:*/
on EnvVar HMI_Seat_P_collision
{
    _mSeat_P_Stat_AR.Seat_P_collision.phys = getValue(this);
    _Seat_P_Stat_AR_SpontanFlag = 1;
}
/*@@end*/

/*@@envVar:HMI_Seat_P_IncorrPosn:*/
on EnvVar HMI_Seat_P_IncorrPosn
{
    _mSeat_P_Stat_AR.Seat_P_IncorrPosn.phys = getValue(this);
    _Seat_P_Stat_AR_SpontanFlag = 1;
}
/*@@end*/

/*@@envVar:HMI_Seat_P_MirrViewObstr:*/
on EnvVar HMI_Seat_P_MirrViewObstr
{
    _mSeat_P_Stat_AR.Seat_P_MirrViewObstr.phys = getValue(this);
    _Seat_P_Stat_AR_SpontanFlag = 1;
}
/*@@end*/

/*@@envVar:HMI_SeatBkRst_P_Unlk:*/
on EnvVar HMI_SeatBkRst_P_Unlk
{
    _mSeat_P_Stat_AR.SeatBkRst_P_Unlk.phys = getValue(this);
    _Seat_P_Stat_AR_SpontanFlag = 1;
}
/*@@end*/

/*@@envVar:HMI_SeatMemAdj_R_Enbl:*/
on EnvVar HMI_SeatMemAdj_R_Enbl
{
    _mSeat_P_Stat_AR.SeatMemAdj_R_Enbl.phys = getValue(this);
    _Seat_P_Stat_AR_SpontanFlag = 1;
}
/*@@end*/

/*@@caplFunc:Seat_RL_Stat_AR_check_output():*/
Seat_RL_Stat_AR_check_output()
{
    if( !getValue( HMI__STMSG_Seat_RL_Stat_AR ) )
    {
        // Botschaft Seat_RL_Stat_AR ID: 941 --- Sendeart 5 cyclicAndSpontanWithDelay --- 
        _Seat_RL_Stat_AR_Cnt--;
        if( _Seat_RL_Stat_AR_Cnt < 1 )
        {
            // Nachricht wg. abgelaufenem Zyklus ausgeben
            Seat_RL_Stat_AR_output();
            _Seat_RL_Stat_AR_Cnt = _Seat_RL_Stat_AR_CycleCount; // Zyklus-Zähler zurücksetzen
            _Seat_RL_Stat_AR_SpontanFlag = 0; // Spontan-Flag zurücksetzen
        }
        else if( _Seat_RL_Stat_AR_SpontanFlag )
        {
            // Nachricht wg. spontaner Änderung ausgeben
            Seat_RL_Stat_AR_output();
            _Seat_RL_Stat_AR_SpontanFlag = 0; // Spontan-Flag zurücksetzen
        }
    }
}
/*@@end*/

/*@@caplFunc:Seat_RL_Stat_AR_init():*/
Seat_RL_Stat_AR_init()
{   /* Botschaft Seat_RL_Stat_AR ID: 941 --- Sendeart 5 cyclicAndSpontanWithDelay --- 
BA_ "ApplMessage" BO_ 941 0;
BA_ "NmAsrMessage" BO_ 941 0;
BA_ "GenMsgMinAcceptLength" BO_ 941 4;
BA_ "GenMsgILSupport" BO_ 941 1;
BA_ "DiagState" BO_ 941 0;
BA_ "DiagRequest" BO_ 941 0;
BA_ "DiagResponse" BO_ 941 0;
BA_ "GenMsgStartValue" BO_ 941 "0";
BA_ "GenMsgDelayTime" BO_ 941 5;
BA_ "GenMsgNrOfRepetitions" BO_ 941 0;
BA_ "GenMsgCycleTime" BO_ 941 500;
BA_ "GenMsgSendType" BO_ 941 5;
    */
    _Seat_RL_Stat_AR_Timebase =         c_tDBKomTimer_20ms;
    _Seat_RL_Stat_AR_CycleCount =   500 / _Seat_RL_Stat_AR_Timebase;
    _Seat_RL_Stat_AR_StartDelay =     0 / _Seat_RL_Stat_AR_Timebase;
    _Seat_RL_Stat_AR_Cnt = _Seat_RL_Stat_AR_StartDelay;
    _Seat_RL_Stat_AR_SpontanFlag = 0;

    putValue( HMI__STMSGSD_Seat_RL_Stat_AR, _Seat_RL_Stat_AR_StartDelay * _Seat_RL_Stat_AR_Timebase );

    _mSeat_RL_Stat_AR.Mem_RL_Sv_Beep_Rq.phys = getValue( HMI_Mem_RL_Sv_Beep_Rq );
    _mSeat_RL_Stat_AR.Mem_RL_Sv_Tgl.phys = getValue( HMI_Mem_RL_Sv_Tgl );
    _mSeat_RL_Stat_AR.SeatBkRst_RL_Stat_SEAT.phys = getValue( HMI_SeatBkRst_RL_Stat_SEAT );
    _mSeat_RL_Stat_AR.SeatBkRst_RM_Stat_SEAT.phys = getValue( HMI_SeatBkRst_RM_Stat_SEAT );
    _mSeat_RL_Stat_AR.SeatCsn_RL_Stat_SEAT.phys = getValue( HMI_SeatCsn_RL_Stat_SEAT );
    _mSeat_RL_Stat_AR.SeatHdRst_RL_Dn_Actv.phys = getValue( HMI_SeatHdRst_RL_Dn_Actv );
    _mSeat_RL_Stat_AR.SeatRestPosn_RL.phys = getValue( HMI_SeatRestPosn_RL );
}
/*@@end*/

/*@@caplFunc:Seat_RL_Stat_AR_output():*/
void Seat_RL_Stat_AR_output(void)
{
    if( !getValue( HMI_Mem_RL_Sv_Tgl_Auto ) )
    {
       // berechne message counter
        if( _mSeat_RL_Stat_AR.Mem_RL_Sv_Tgl >= 1 ) _mSeat_RL_Stat_AR.Mem_RL_Sv_Tgl = 0;
        else _mSeat_RL_Stat_AR.Mem_RL_Sv_Tgl++;
        //putValue( HMI_Mem_RL_Sv_Tgl, _mSeat_RL_Stat_AR.Mem_RL_Sv_Tgl);
    }
    else
          _mSeat_RL_Stat_AR.Mem_RL_Sv_Tgl = getValue( HMI_Mem_RL_Sv_Tgl);

    output( _mSeat_RL_Stat_AR );
}
/*@@end*/

/*@@caplFunc:Seat_RL_Stat_AR_saveEnvVars(dword):*/
Seat_RL_Stat_AR_saveEnvVars( dword hFile )
{
    filePutString("\n// Knoten EIS: Seat_RL_Stat_AR\n", 29, hFile );
    snprintf( buffer, elcount( buffer ), "0.0000 HMI__STMSG_Seat_RL_Stat := %X\n", getValue( HMI__STMSG_Seat_RL_Stat_AR ) );        filePutString( buffer, elcount( buffer ), hFile );
    snprintf( buffer, elcount( buffer ), "0.0000 HMI__STMSGT_Seat_RL_Stat := %X\n", getValue( HMI__STMSGT_Seat_RL_Stat_AR ) );        filePutString( buffer, elcount( buffer ), hFile );
    snprintf( buffer, elcount( buffer ), "0.0000 HMI_Mem_RL_Sv_Beep_Rq := %X\n", getValue( HMI_Mem_RL_Sv_Beep_Rq ) );        filePutString( buffer, elcount( buffer ), hFile );
    snprintf( buffer, elcount( buffer ), "0.0000 HMI_Mem_RL_Sv_Tgl := %X\n", getValue( HMI_Mem_RL_Sv_Tgl ) );        filePutString( buffer, elcount( buffer ), hFile );
    snprintf( buffer, elcount( buffer ), "0.0000 HMI_SeatBkRst_RL_Stat_SEAT := %X\n", getValue( HMI_SeatBkRst_RL_Stat_SEAT ) );        filePutString( buffer, elcount( buffer ), hFile );
    snprintf( buffer, elcount( buffer ), "0.0000 HMI_SeatBkRst_RM_Stat_SEAT := %X\n", getValue( HMI_SeatBkRst_RM_Stat_SEAT ) );        filePutString( buffer, elcount( buffer ), hFile );
    snprintf( buffer, elcount( buffer ), "0.0000 HMI_SeatCsn_RL_Stat_SEAT := %X\n", getValue( HMI_SeatCsn_RL_Stat_SEAT ) );        filePutString( buffer, elcount( buffer ), hFile );
    snprintf( buffer, elcount( buffer ), "0.0000 HMI_SeatHdRst_RL_Dn_Actv := %X\n", getValue( HMI_SeatHdRst_RL_Dn_Actv ) );        filePutString( buffer, elcount( buffer ), hFile );
    snprintf( buffer, elcount( buffer ), "0.0000 HMI_SeatRestPosn_RL := %X\n", getValue( HMI_SeatRestPosn_RL ) );        filePutString( buffer, elcount( buffer ), hFile );
}
/*@@end*/

/*@@timer:_tSeat_RL_Stat_AR:*/
on timer _tSeat_RL_Stat_AR
{
    putValue( HMI__STMSG_Seat_RL_Stat_AR, 0 );
}
/*@@end*/

/*@@envVar:HMI__STMSG_Seat_RL_Stat_AR:*/
on EnvVar HMI__STMSG_Seat_RL_Stat_AR
{
    long tDelay;
    if( getValue( this ) == 2 )
    {
        tDelay = getValue( HMI__STMSGT_Seat_RL_Stat_AR );
        if( tDelay > 0)    
            setTimer( _tSeat_RL_Stat_AR, tDelay );
        else
            putValue( HMI__STMSG_Seat_RL_Stat_AR, 0 );
    }
}
/*@@end*/

/*@@envVar:HMI_Mem_RL_Sv_Beep_Rq:*/
on EnvVar HMI_Mem_RL_Sv_Beep_Rq
{
    _mSeat_RL_Stat_AR.Mem_RL_Sv_Beep_Rq.phys = getValue(this);
    _Seat_RL_Stat_AR_SpontanFlag = 1;
}
/*@@end*/

/*@@envVar:HMI_SeatBkRst_RL_Stat_SEAT:*/
on EnvVar HMI_SeatBkRst_RL_Stat_SEAT
{
    _mSeat_RL_Stat_AR.SeatBkRst_RL_Stat_SEAT.phys = getValue(this);
    _Seat_RL_Stat_AR_SpontanFlag = 1;
}
/*@@end*/

/*@@envVar:HMI_SeatBkRst_RM_Stat_SEAT:*/
on EnvVar HMI_SeatBkRst_RM_Stat_SEAT
{
    _mSeat_RL_Stat_AR.SeatBkRst_RM_Stat_SEAT.phys = getValue(this);
    _Seat_RL_Stat_AR_SpontanFlag = 1;
}
/*@@end*/

/*@@envVar:HMI_SeatCsn_RL_Stat_SEAT:*/
on EnvVar HMI_SeatCsn_RL_Stat_SEAT
{
    _mSeat_RL_Stat_AR.SeatCsn_RL_Stat_SEAT.phys = getValue(this);
    _Seat_RL_Stat_AR_SpontanFlag = 1;
}
/*@@end*/

/*@@envVar:HMI_SeatHdRst_RL_Dn_Actv:*/
on EnvVar HMI_SeatHdRst_RL_Dn_Actv
{
    _mSeat_RL_Stat_AR.SeatHdRst_RL_Dn_Actv.phys = getValue(this);
    _Seat_RL_Stat_AR_SpontanFlag = 1;
}
/*@@end*/

/*@@envVar:HMI_SeatRestPosn_RL:*/
on EnvVar HMI_SeatRestPosn_RL
{
    _mSeat_RL_Stat_AR.SeatRestPosn_RL.phys = getValue(this);
    _Seat_RL_Stat_AR_SpontanFlag = 1;
}
/*@@end*/

/*@@caplFunc:Seat_RR_Stat_AR_check_output():*/
Seat_RR_Stat_AR_check_output()
{
    if( !getValue( HMI__STMSG_Seat_RR_Stat_AR ) )
    {
        // Botschaft Seat_RR_Stat_AR ID: 943 --- Sendeart 5 cyclicAndSpontanWithDelay --- 
        _Seat_RR_Stat_AR_Cnt--;
        if( _Seat_RR_Stat_AR_Cnt < 1 )
        {
            Seat_RR_Stat_AR_output(); // Nachricht wg. abgelaufenem Zyklus ausgeben
            _Seat_RR_Stat_AR_Cnt = _Seat_RR_Stat_AR_CycleCount; // Zyklus-Zähler zurücksetzen
            _Seat_RR_Stat_AR_SpontanFlag = 0; // Spontan-Flag zurücksetzen
        }
        else if( _Seat_RR_Stat_AR_SpontanFlag )
        {
            Seat_RR_Stat_AR_output(); // Nachricht wg. spontaner Änderung ausgeben
            _Seat_RR_Stat_AR_SpontanFlag = 0; // Spontan-Flag zurücksetzen
        }
    }
}
/*@@end*/

/*@@caplFunc:Seat_RR_Stat_AR_init():*/
Seat_RR_Stat_AR_init()
{   /* Botschaft Seat_RR_Stat_AR ID: 943 --- Sendeart 5 cyclicAndSpontanWithDelay --- 
BA_ "ApplMessage" BO_ 943 0;
BA_ "NmAsrMessage" BO_ 943 0;
BA_ "GenMsgMinAcceptLength" BO_ 943 4;
BA_ "GenMsgILSupport" BO_ 943 1;
BA_ "DiagState" BO_ 943 0;
BA_ "DiagRequest" BO_ 943 0;
BA_ "DiagResponse" BO_ 943 0;
BA_ "GenMsgStartValue" BO_ 943 "0";
BA_ "GenMsgDelayTime" BO_ 943 5;
BA_ "GenMsgNrOfRepetitions" BO_ 943 0;
BA_ "GenMsgCycleTime" BO_ 943 500;
BA_ "GenMsgSendType" BO_ 943 5;
    */
    _Seat_RR_Stat_AR_Timebase =         c_tDBKomTimer_20ms;
    _Seat_RR_Stat_AR_CycleCount =     500 / _Seat_RR_Stat_AR_Timebase;
    _Seat_RR_Stat_AR_StartDelay =       0 / _Seat_RR_Stat_AR_Timebase;
    _Seat_RR_Stat_AR_Cnt = _Seat_RR_Stat_AR_StartDelay;
    _Seat_RR_Stat_AR_SpontanFlag = 0;

    putValue( HMI__STMSGSD_Seat_RR_Stat_AR, _Seat_RR_Stat_AR_StartDelay * _Seat_RR_Stat_AR_Timebase );

    _mSeat_RR_Stat_AR.Mem_RR_Sv_Beep_Rq.phys = getValue( HMI_Mem_RR_Sv_Beep_Rq );
    _mSeat_RR_Stat_AR.Mem_RR_Sv_Tgl.phys = getValue( HMI_Mem_RR_Sv_Tgl );
    _mSeat_RR_Stat_AR.Seat_R_ArmRst_Fld.phys = getValue( HMI_Seat_R_ArmRst_Fld );
    _mSeat_RR_Stat_AR.SeatBkRst_RR_Stat_SEAT.phys = getValue( HMI_SeatBkRst_RR_Stat_SEAT );
    _mSeat_RR_Stat_AR.SeatCsn_RR_Stat_SEAT.phys = getValue( HMI_SeatCsn_RR_Stat_SEAT );
    _mSeat_RR_Stat_AR.SeatHdRst_R_Rq.phys = getValue( HMI_SeatHdRst_R_Rq );
    _mSeat_RR_Stat_AR.SeatRestPosn_RR.phys = getValue( HMI_SeatRestPosn_RR );
}
/*@@end*/

/*@@caplFunc:Seat_RR_Stat_AR_output():*/
void Seat_RR_Stat_AR_output(void)
{
    if( !getValue( HMI_Mem_RR_Sv_Tgl_Auto ) )
    {
       // berechne message counter
        if( _mSeat_RR_Stat_AR.Mem_RR_Sv_Tgl >= 1 ) _mSeat_RR_Stat_AR.Mem_RR_Sv_Tgl = 0;
        else _mSeat_RR_Stat_AR.Mem_RR_Sv_Tgl++;
        //putValue( HMI_Mem_RR_Sv_Tgl, _mSeat_RR_Stat_AR.Mem_RR_Sv_Tgl);
    }
    else
          _mSeat_RR_Stat_AR.Mem_RR_Sv_Tgl = getValue( HMI_Mem_RR_Sv_Tgl);

    output( _mSeat_RR_Stat_AR );
}
/*@@end*/

/*@@caplFunc:Seat_RR_Stat_AR_saveEnvVars(dword):*/
Seat_RR_Stat_AR_saveEnvVars( dword hFile )
{
    filePutString("\n// Knoten EIS: Seat_RR_Stat_AR\n", 29, hFile );
    snprintf( buffer, elcount( buffer ), "0.0000 HMI__STMSG_Seat_RR_Stat := %X\n", getValue( HMI__STMSG_Seat_RR_Stat_AR ) );        filePutString( buffer, elcount( buffer ), hFile );
    snprintf( buffer, elcount( buffer ), "0.0000 HMI__STMSGT_Seat_RR_Stat := %X\n", getValue( HMI__STMSGT_Seat_RR_Stat_AR ) );        filePutString( buffer, elcount( buffer ), hFile );
    snprintf( buffer, elcount( buffer ), "0.0000 HMI_Mem_RR_Sv_Beep_Rq := %X\n", getValue( HMI_Mem_RR_Sv_Beep_Rq ) );        filePutString( buffer, elcount( buffer ), hFile );
    snprintf( buffer, elcount( buffer ), "0.0000 HMI_Mem_RR_Sv_Tgl := %X\n", getValue( HMI_Mem_RR_Sv_Tgl ) );        filePutString( buffer, elcount( buffer ), hFile );
    snprintf( buffer, elcount( buffer ), "0.0000 HMI_Seat_R_ArmRst_Fld := %X\n", getValue( HMI_Seat_R_ArmRst_Fld ) );        filePutString( buffer, elcount( buffer ), hFile );
    snprintf( buffer, elcount( buffer ), "0.0000 HMI_SeatHdRst_R_Rq := %X\n", getValue( HMI_SeatHdRst_R_Rq ) );        filePutString( buffer, elcount( buffer ), hFile );
    snprintf( buffer, elcount( buffer ), "0.0000 HMI_SeatBkRst_RR_Stat_SEAT := %X\n", getValue( HMI_SeatBkRst_RR_Stat_SEAT ) );        filePutString( buffer, elcount( buffer ), hFile );
    snprintf( buffer, elcount( buffer ), "0.0000 HMI_SeatCsn_RR_Stat_SEAT := %X\n", getValue( HMI_SeatCsn_RR_Stat_SEAT ) );        filePutString( buffer, elcount( buffer ), hFile );
    snprintf( buffer, elcount( buffer ), "0.0000 HMI_SeatRestPosn_RR := %X\n", getValue( HMI_SeatRestPosn_RR ) );        filePutString( buffer, elcount( buffer ), hFile );
}
/*@@end*/

/*@@timer:_tSeat_RR_Stat_AR:*/
on timer _tSeat_RR_Stat_AR
{
    putValue( HMI__STMSG_Seat_RR_Stat_AR, 0 );
}
/*@@end*/

/*@@envVar:HMI__STMSG_Seat_RR_Stat_AR:*/
on EnvVar HMI__STMSG_Seat_RR_Stat_AR
{
    long tDelay;
    if( getValue( this ) == 2 )
    {
        tDelay = getValue( HMI__STMSGT_Seat_RR_Stat_AR );
        if( tDelay > 0)    
            setTimer( _tSeat_RR_Stat_AR, tDelay );
        else
            putValue( HMI__STMSG_Seat_RR_Stat_AR, 0 );
    }
}
/*@@end*/

/*@@envVar:HMI_Mem_RR_Sv_Beep_Rq:*/
on EnvVar HMI_Mem_RR_Sv_Beep_Rq
{
    _mSeat_RR_Stat_AR.Mem_RR_Sv_Beep_Rq.phys = getValue(this);
    _Seat_RR_Stat_AR_SpontanFlag = 1;
}
/*@@end*/

/*@@envVar:HMI_Seat_R_ArmRst_Fld:*/
on EnvVar HMI_Seat_R_ArmRst_Fld
{
    _mSeat_RR_Stat_AR.Seat_R_ArmRst_Fld.phys = getValue(this);
    _Seat_RR_Stat_AR_SpontanFlag = 1;
}
/*@@end*/

/*@@envVar:HMI_SeatBkRst_RR_Stat_SEAT:*/
on EnvVar HMI_SeatBkRst_RR_Stat_SEAT
{
    _mSeat_RR_Stat_AR.SeatBkRst_RR_Stat_SEAT.phys = getValue(this);
    _Seat_RR_Stat_AR_SpontanFlag = 1;
}
/*@@end*/

/*@@envVar:HMI_SeatCsn_RR_Stat_SEAT:*/
on EnvVar HMI_SeatCsn_RR_Stat_SEAT
{
    _mSeat_RR_Stat_AR.SeatCsn_RR_Stat_SEAT.phys = getValue(this);
    _Seat_RR_Stat_AR_SpontanFlag = 1;
}
/*@@end*/

/*@@envVar:HMI_SeatHdRst_R_Rq:*/
on EnvVar HMI_SeatHdRst_R_Rq
{
    _mSeat_RR_Stat_AR.SeatHdRst_R_Rq.phys = getValue(this);
    _Seat_RR_Stat_AR_SpontanFlag = 1;
}
/*@@end*/

/*@@envVar:HMI_SeatRestPosn_RR:*/
on EnvVar HMI_SeatRestPosn_RR
{
    _mSeat_RR_Stat_AR.SeatRestPosn_RR.phys = getValue(this);
    _Seat_RR_Stat_AR_SpontanFlag = 1;
}
/*@@end*/

/*@@caplFunc:SeatHtVn_Stat_AR_check_output():*/
SeatHtVn_Stat_AR_check_output()
{
    if( !getValue( HMI__STMSG_SeatHtVn_Stat_AR ) )
    {
        // Botschaft SeatHtVn_Stat_AR ID: 915 --- Sendeart 5 cyclicAndSpontanWithDelay --- 
        _SeatHtVn_Stat_AR_Cnt--;
        if( _SeatHtVn_Stat_AR_Cnt < 1 )
        {
            // Nachricht wg. abgelaufenem Zyklus ausgeben
            SeatHtVn_Stat_AR_output();
            _SeatHtVn_Stat_AR_Cnt = _SeatHtVn_Stat_AR_CycleCount; // Zyklus-Zähler zurücksetzen
            _SeatHtVn_Stat_AR_SpontanFlag = 0; // Spontan-Flag zurücksetzen
        }
        else if( _SeatHtVn_Stat_AR_SpontanFlag)
        {
            // Nachricht wg. spontaner Änderung ausgeben
            SeatHtVn_Stat_AR_output();
            _SeatHtVn_Stat_AR_SpontanFlag = 0; // Spontan-Flag zurücksetzen
        }
    }
}
/*@@end*/

/*@@caplFunc:SeatHtVn_Stat_AR_init():*/
SeatHtVn_Stat_AR_init()
{   /* Botschaft SeatHtVn_Stat_AR ID: 915 --- Sendeart 5 cyclicAndSpontanWithDelay --- 
BA_ "ApplMessage" BO_ 915 0;
BA_ "NmAsrMessage" BO_ 915 0;
BA_ "GenMsgMinAcceptLength" BO_ 915 8;
BA_ "GenMsgILSupport" BO_ 915 1;
BA_ "DiagState" BO_ 915 0;
BA_ "DiagRequest" BO_ 915 0;
BA_ "DiagResponse" BO_ 915 0;
BA_ "GenMsgStartValue" BO_ 915 "0";
BA_ "GenMsgDelayTime" BO_ 915 5;
BA_ "GenMsgNrOfRepetitions" BO_ 915 0;
BA_ "GenMsgCycleTime" BO_ 915 1000;
BA_ "GenMsgSendType" BO_ 915 5;
    */
    _SeatHtVn_Stat_AR_Timebase =               c_tDBKomTimer_20ms;
    _SeatHtVn_Stat_AR_CycleCount =           1000 / _SeatHtVn_Stat_AR_Timebase;
    _SeatHtVn_Stat_AR_StartDelay =              0 / _SeatHtVn_Stat_AR_Timebase;
    _SeatHtVn_Stat_AR_Cnt = _SeatHtVn_Stat_AR_StartDelay;
    _SeatHtVn_Stat_AR_SpontanFlag = 0;

    putValue( HMI__STMSGSD_SeatHtVn_Stat_AR, _SeatHtVn_Stat_AR_StartDelay * _SeatHtVn_Stat_AR_Timebase );

    _mSeatHtVn_Stat_AR.HotStn_FL_Stat.phys = getValue( HMI_HotStn_FL_Stat );
    _mSeatHtVn_Stat_AR.HotStn_FR_Stat.phys = getValue( HMI_HotStn_FR_Stat );
    _mSeatHtVn_Stat_AR.HotStn_RL_Stat.phys = getValue( HMI_HotStn_RL_Stat );
    _mSeatHtVn_Stat_AR.HotStn_RR_Stat.phys = getValue( HMI_HotStn_RR_Stat );
    _mSeatHtVn_Stat_AR.SEAT_D_Ht_Blnc_Stat.phys = getValue( HMI_SEAT_D_Ht_Blnc_Stat );
    _mSeatHtVn_Stat_AR.Seat_HtVn_PreCond2_Actv.phys = getValue( HMI_Seat_HtVn_PreCond2_Actv );
    _mSeatHtVn_Stat_AR.SEAT_P_Ht_Blnc_Stat.phys = getValue( HMI_SEAT_P_Ht_Blnc_Stat );
    _mSeatHtVn_Stat_AR.SEAT_RL_Ht_Blnc_Stat.phys = getValue( HMI_SEAT_RL_Ht_Blnc_Stat );
    _mSeatHtVn_Stat_AR.SEAT_RR_Ht_Blnc_Stat.phys = getValue( HMI_SEAT_RR_Ht_Blnc_Stat );
    _mSeatHtVn_Stat_AR.SeatHt_FL_Stat.phys = getValue( HMI_SeatHt_FL_Stat );
    _mSeatHtVn_Stat_AR.SeatHt_FR_Stat.phys = getValue( HMI_SeatHt_FR_Stat );
    _mSeatHtVn_Stat_AR.SeatHt_RL_Stat.phys = getValue( HMI_SeatHt_RL_Stat );
    _mSeatHtVn_Stat_AR.SeatHt_RR_Stat.phys = getValue( HMI_SeatHt_RR_Stat );
    _mSeatHtVn_Stat_AR.SeatVn_FL_Stat.phys = getValue( HMI_SeatVn_FL_Stat );
    _mSeatHtVn_Stat_AR.SeatVn_FR_Stat.phys = getValue( HMI_SeatVn_FR_Stat );
    _mSeatHtVn_Stat_AR.SeatVn_RL_Stat.phys = getValue( HMI_SeatVn_RL_Stat );
    _mSeatHtVn_Stat_AR.SeatVn_RR_Stat.phys = getValue( HMI_SeatVn_RR_Stat );
}
/*@@end*/

/*@@caplFunc:SeatHtVn_Stat_AR_output():*/
SeatHtVn_Stat_AR_output(void)
{
    output( _mSeatHtVn_Stat_AR );
}
/*@@end*/

/*@@caplFunc:SeatHtVn_Stat_AR_saveEnvVars(dword):*/
SeatHtVn_Stat_AR_saveEnvVars( dword hFile )
{
    filePutString("\n// Knoten EIS: SeatHtVn_Stat_AR\n", 30, hFile );
    snprintf( buffer, elcount( buffer ), "0.0000 HMI__STMSG_SeatHtVn_Stat := %X\n", getValue( HMI__STMSG_SeatHtVn_Stat_AR ) );    filePutString( buffer, elcount( buffer ), hFile );
    snprintf( buffer, elcount( buffer ), "0.0000 HMI__STMSGT_SeatHtVn_Stat := %X\n", getValue( HMI__STMSGT_SeatHtVn_Stat_AR ) );    filePutString( buffer, elcount( buffer ), hFile );
    snprintf( buffer, elcount( buffer ), "0.0000 HMI_HotStn_FL_Stat := %X\n", getValue( HMI_HotStn_FL_Stat ) );    filePutString( buffer, elcount( buffer ), hFile );
    snprintf( buffer, elcount( buffer ), "0.0000 HMI_HotStn_FR_Stat := %X\n", getValue( HMI_HotStn_FR_Stat ) );    filePutString( buffer, elcount( buffer ), hFile );
    snprintf( buffer, elcount( buffer ), "0.0000 HMI_HotStn_RL_Stat := %X\n", getValue( HMI_HotStn_RL_Stat ) );    filePutString( buffer, elcount( buffer ), hFile );
    snprintf( buffer, elcount( buffer ), "0.0000 HMI_HotStn_RR_Stat := %X\n", getValue( HMI_HotStn_RR_Stat ) );    filePutString( buffer, elcount( buffer ), hFile );
    snprintf( buffer, elcount( buffer ), "0.0000 HMI_SEAT_D_Ht_Blnc_Stat := %X\n", getValue( HMI_SEAT_D_Ht_Blnc_Stat ) );    filePutString( buffer, elcount( buffer ), hFile );
    snprintf( buffer, elcount( buffer ), "0.0000 HMI_Seat_HtVn_PreCond2_Actv := %X\n", getValue( HMI_Seat_HtVn_PreCond2_Actv ) );    filePutString( buffer, elcount( buffer ), hFile );
    snprintf( buffer, elcount( buffer ), "0.0000 HMI_SEAT_P_Ht_Blnc_Stat := %X\n", getValue( HMI_SEAT_P_Ht_Blnc_Stat ) );    filePutString( buffer, elcount( buffer ), hFile );
    snprintf( buffer, elcount( buffer ), "0.0000 HMI_SEAT_RL_Ht_Blnc_Stat := %X\n", getValue( HMI_SEAT_RL_Ht_Blnc_Stat ) );    filePutString( buffer, elcount( buffer ), hFile );
    snprintf( buffer, elcount( buffer ), "0.0000 HMI_SEAT_RR_Ht_Blnc_Stat := %X\n", getValue( HMI_SEAT_RR_Ht_Blnc_Stat ) );    filePutString( buffer, elcount( buffer ), hFile );
    snprintf( buffer, elcount( buffer ), "0.0000 HMI_SeatHt_FL_Stat := %X\n", getValue( HMI_SeatHt_FL_Stat ) );    filePutString( buffer, elcount( buffer ), hFile );
    snprintf( buffer, elcount( buffer ), "0.0000 HMI_SeatHt_FR_Stat := %X\n", getValue( HMI_SeatHt_FR_Stat ) );    filePutString( buffer, elcount( buffer ), hFile );
    snprintf( buffer, elcount( buffer ), "0.0000 HMI_SeatHt_RL_Stat := %X\n", getValue( HMI_SeatHt_RL_Stat ) );    filePutString( buffer, elcount( buffer ), hFile );
    snprintf( buffer, elcount( buffer ), "0.0000 HMI_SeatHt_RR_Stat := %X\n", getValue( HMI_SeatHt_RR_Stat ) );    filePutString( buffer, elcount( buffer ), hFile );
    snprintf( buffer, elcount( buffer ), "0.0000 HMI_SeatVn_FL_Stat := %X\n", getValue( HMI_SeatVn_FL_Stat ) );    filePutString( buffer, elcount( buffer ), hFile );
    snprintf( buffer, elcount( buffer ), "0.0000 HMI_SeatVn_FR_Stat := %X\n", getValue( HMI_SeatVn_FR_Stat ) );    filePutString( buffer, elcount( buffer ), hFile );
    snprintf( buffer, elcount( buffer ), "0.0000 HMI_SeatVn_RL_Stat := %X\n", getValue( HMI_SeatVn_RL_Stat ) );    filePutString( buffer, elcount( buffer ), hFile );
    snprintf( buffer, elcount( buffer ), "0.0000 HMI_SeatVn_RR_Stat := %X\n", getValue( HMI_SeatVn_RR_Stat ) );    filePutString( buffer, elcount( buffer ), hFile );
}
/*@@end*/

/*@@timer:_tSeatHtVn_Stat_AR:*/
on timer _tSeatHtVn_Stat_AR
{
    putValue( HMI__STMSG_SeatHtVn_Stat_AR, 0 );
}
/*@@end*/

/*@@envVar:HMI__STMSG_SeatHtVn_Stat_AR:*/
on EnvVar HMI__STMSG_SeatHtVn_Stat_AR
{
    long tDelay;
    if( getValue( this ) == 2 )
    {
        tDelay = getValue( HMI__STMSGT_SeatHtVn_Stat_AR );
        if( tDelay > 0)    
            setTimer( _tSeatHtVn_Stat_AR, tDelay );
        else
            putValue( HMI__STMSG_SeatHtVn_Stat_AR, 0 );
    }
}
/*@@end*/

/*@@envVar:HMI_HotStn_FL_Stat:*/
on EnvVar HMI_HotStn_FL_Stat
{
    _mSeatHtVn_Stat_AR.HotStn_FL_Stat.phys = getValue(this);
    _SeatHtVn_Stat_AR_SpontanFlag = 1;
}
/*@@end*/

/*@@envVar:HMI_HotStn_FR_Stat:*/
on EnvVar HMI_HotStn_FR_Stat
{
    _mSeatHtVn_Stat_AR.HotStn_FR_Stat.phys = getValue(this);
    _SeatHtVn_Stat_AR_SpontanFlag = 1;
}
/*@@end*/

/*@@envVar:HMI_HotStn_RL_Stat:*/
on EnvVar HMI_HotStn_RL_Stat
{
    _mSeatHtVn_Stat_AR.HotStn_RL_Stat.phys = getValue(this);
    _SeatHtVn_Stat_AR_SpontanFlag = 1;
}
/*@@end*/

/*@@envVar:HMI_HotStn_RR_Stat:*/
on EnvVar HMI_HotStn_RR_Stat
{
    _mSeatHtVn_Stat_AR.HotStn_RR_Stat.phys = getValue(this);
    _SeatHtVn_Stat_AR_SpontanFlag = 1;
}
/*@@end*/

/*@@envVar:HMI_SEAT_D_Ht_Blnc_Stat:*/
on EnvVar HMI_SEAT_D_Ht_Blnc_Stat
{
    _mSeatHtVn_Stat_AR.SEAT_D_Ht_Blnc_Stat.phys = getValue(this);
    _SeatHtVn_Stat_AR_SpontanFlag = 1;
}
/*@@end*/

/*@@envVar:HMI_Seat_HtVn_PreCond2_Actv:*/
on EnvVar HMI_Seat_HtVn_PreCond2_Actv
{
    _mSeatHtVn_Stat_AR.Seat_HtVn_PreCond2_Actv.phys = getValue(this);
    _SeatHtVn_Stat_AR_SpontanFlag = 1;
}
/*@@end*/

/*@@envVar:HMI_SEAT_P_Ht_Blnc_Stat:*/
on EnvVar HMI_SEAT_P_Ht_Blnc_Stat
{
    _mSeatHtVn_Stat_AR.SEAT_P_Ht_Blnc_Stat.phys = getValue(this);
    _SeatHtVn_Stat_AR_SpontanFlag = 1;
}
/*@@end*/

/*@@envVar:HMI_SEAT_RL_Ht_Blnc_Stat:*/
on EnvVar HMI_SEAT_RL_Ht_Blnc_Stat
{
    _mSeatHtVn_Stat_AR.SEAT_RL_Ht_Blnc_Stat.phys = getValue(this);
    _SeatHtVn_Stat_AR_SpontanFlag = 1;
}
/*@@end*/

/*@@envVar:HMI_SEAT_RR_Ht_Blnc_Stat:*/
on EnvVar HMI_SEAT_RR_Ht_Blnc_Stat
{
    _mSeatHtVn_Stat_AR.SEAT_RR_Ht_Blnc_Stat.phys = getValue(this);
    _SeatHtVn_Stat_AR_SpontanFlag = 1;
}
/*@@end*/

/*@@envVar:HMI_SeatHt_FL_Stat:*/
on EnvVar HMI_SeatHt_FL_Stat
{
    _mSeatHtVn_Stat_AR.SeatHt_FL_Stat.phys = getValue(this);
    _SeatHtVn_Stat_AR_SpontanFlag = 1;
}
/*@@end*/

/*@@envVar:HMI_SeatHt_FR_Stat:*/
on EnvVar HMI_SeatHt_FR_Stat
{
    _mSeatHtVn_Stat_AR.SeatHt_FR_Stat.phys = getValue(this);
    _SeatHtVn_Stat_AR_SpontanFlag = 1;
}
/*@@end*/

/*@@envVar:HMI_SeatHt_RL_Stat:*/
on EnvVar HMI_SeatHt_RL_Stat
{
    _mSeatHtVn_Stat_AR.SeatHt_RL_Stat.phys = getValue(this);
    _SeatHtVn_Stat_AR_SpontanFlag = 1;
}
/*@@end*/

/*@@envVar:HMI_SeatHt_RR_Stat:*/
on EnvVar HMI_SeatHt_RR_Stat
{
    _mSeatHtVn_Stat_AR.SeatHt_RR_Stat.phys = getValue(this);
    _SeatHtVn_Stat_AR_SpontanFlag = 1;
}
/*@@end*/

/*@@envVar:HMI_SeatVn_FL_Stat:*/
on EnvVar HMI_SeatVn_FL_Stat
{
    _mSeatHtVn_Stat_AR.SeatVn_FL_Stat.phys = getValue(this);
    _SeatHtVn_Stat_AR_SpontanFlag = 1;
}
/*@@end*/

/*@@envVar:HMI_SeatVn_FR_Stat:*/
on EnvVar HMI_SeatVn_FR_Stat
{
    _mSeatHtVn_Stat_AR.SeatVn_FR_Stat.phys = getValue(this);
    _SeatHtVn_Stat_AR_SpontanFlag = 1;
}
/*@@end*/

/*@@envVar:HMI_SeatVn_RL_Stat:*/
on EnvVar HMI_SeatVn_RL_Stat
{
    _mSeatHtVn_Stat_AR.SeatVn_RL_Stat.phys = getValue(this);
    _SeatHtVn_Stat_AR_SpontanFlag = 1;
}
/*@@end*/

/*@@envVar:HMI_SeatVn_RR_Stat:*/
on EnvVar HMI_SeatVn_RR_Stat
{
    _mSeatHtVn_Stat_AR.SeatVn_RR_Stat.phys = getValue(this);
    _SeatHtVn_Stat_AR_SpontanFlag = 1;
}
/*@@end*/

/*@@caplFunc:SeatHtVn_Stat2_AR_check_output():*/
SeatHtVn_Stat2_AR_check_output()
{
    if( !getValue( HMI__STMSG_SeatHtVn_Stat2_AR ) )
    {
        // Botschaft SeatHtVn_Stat2_AR ID: 916 --- Sendeart 5 cyclicAndSpontanWithDelay --- 
        if( _SeatHtVn_Stat2_AR_DelayCnt > 0) _SeatHtVn_Stat2_AR_DelayCnt--; // Mindestsendeabstand
        _SeatHtVn_Stat2_AR_Cnt--;
        if( _SeatHtVn_Stat2_AR_Cnt < 1 )
        {
            if( _SeatHtVn_Stat2_AR_DelayCnt < 1 )
            {
                // Nachricht wg. abgelaufenem Zyklus ausgeben (Mindestsendeabstand eingehalten)
                SeatHtVn_Stat2_AR_output();
                _SeatHtVn_Stat2_AR_SpontanFlag = 0; // Spontan-Flag zurücksetzen
                _SeatHtVn_Stat2_AR_DelayCnt = _SeatHtVn_Stat2_AR_MinDelay;
            }
            else
            {
                // Spontanflag setzen damit nach Ablauf Mindestsendeabstand gesendet wird
                 _SeatHtVn_Stat2_AR_SpontanFlag = 1;
            }
            _SeatHtVn_Stat2_AR_Cnt = _SeatHtVn_Stat2_AR_CycleCount; // Zyklus-Zähler zurücksetzen
        }
        else if( _SeatHtVn_Stat2_AR_SpontanFlag)
        {
            if( _SeatHtVn_Stat2_AR_DelayCnt < 1 )
            {
                // Nachricht wg. spontaner Änderung ausgeben (Mindestsendeabstand eingehalten)
                SeatHtVn_Stat2_AR_output();
                _SeatHtVn_Stat2_AR_SpontanFlag = 0; // Spontan-Flag zurücksetzen
                _SeatHtVn_Stat2_AR_DelayCnt = _SeatHtVn_Stat2_AR_MinDelay;
            }
        }
    }
}
/*@@end*/

/*@@caplFunc:SeatHtVn_Stat2_AR_init():*/
SeatHtVn_Stat2_AR_init()
{   /* Botschaft SeatHtVn_Stat2_AR ID: 916 --- Sendeart 0 cyclicX --- 
BA_ "ApplMessage" BO_ 916 0;
BA_ "NmAsrMessage" BO_ 916 0;
BA_ "GenMsgMinAcceptLength" BO_ 916 4;
BA_ "GenMsgILSupport" BO_ 916 1;
BA_ "DiagState" BO_ 916 0;
BA_ "DiagRequest" BO_ 916 0;
BA_ "DiagResponse" BO_ 916 0;
BA_ "GenMsgStartValue" BO_ 916 "0";
BA_ "GenMsgDelayTime" BO_ 916 200;
BA_ "GenMsgNrOfRepetitions" BO_ 916 0;
BA_ "GenMsgCycleTime" BO_ 916 1000;
BA_ "GenMsgSendType" BO_ 916 5;
    */
    _SeatHtVn_Stat2_AR_Timebase =      c_tDBKomTimer_20ms;
    _SeatHtVn_Stat2_AR_CycleCount =   1000 / _SeatHtVn_Stat2_AR_Timebase;
    _SeatHtVn_Stat2_AR_StartDelay =      0 / _SeatHtVn_Stat2_AR_Timebase;
    _SeatHtVn_Stat2_AR_MinDelay =      200 / _SeatHtVn_Stat2_AR_Timebase;
    _SeatHtVn_Stat2_AR_Cnt = _SeatHtVn_Stat2_AR_StartDelay;
    _SeatHtVn_Stat2_AR_SpontanFlag = 0;
    _SeatHtVn_Stat2_AR_DelayCnt = 0;

    putValue( HMI__STMSGSD_SeatHtVn_Stat2_AR, _SeatHtVn_Stat2_AR_StartDelay * _SeatHtVn_Stat2_AR_Timebase );

    _mSeatHtVn_Stat2_AR.SeatCond_ActvComf_Seat_FL_Stat.phys = getValue( HMI_SeatCond_ActvComf_Seat_FL_Stat );
    _mSeatHtVn_Stat2_AR.SeatCond_ActvComf_Seat_FR_Stat.phys = getValue( HMI_SeatCond_ActvComf_Seat_FR_Stat );
    _mSeatHtVn_Stat2_AR.SeatCond_ActvComf_Seat_RL_Stat.phys = getValue( HMI_SeatCond_ActvComf_Seat_RL_Stat );
    _mSeatHtVn_Stat2_AR.SeatCond_ActvComf_Seat_RR_Stat.phys = getValue( HMI_SeatCond_ActvComf_Seat_RR_Stat );
}
/*@@end*/

/*@@caplFunc:SeatHtVn_Stat2_AR_output():*/
SeatHtVn_Stat2_AR_output(void)
{
    output( _mSeatHtVn_Stat2_AR );
}
/*@@end*/

/*@@caplFunc:SeatHtVn_Stat2_AR_saveEnvVars(dword):*/
SeatHtVn_Stat2_AR_saveEnvVars( dword hFile )
{
    filePutString("\n// Knoten EIS: SeatHtVn_Stat2_AR\n", 28, hFile );
    snprintf( buffer, elcount( buffer ), "0.0000 HMI__STMSG_SeatHtVn_Stat2_AR := %X\n", getValue( HMI__STMSG_SeatHtVn_Stat2_AR ) );    filePutString( buffer, elcount( buffer ), hFile );
    snprintf( buffer, elcount( buffer ), "0.0000 HMI__STMSGT_SeatHtVn_Stat2_AR := %X\n", getValue( HMI__STMSGT_SeatHtVn_Stat2_AR ) );    filePutString( buffer, elcount( buffer ), hFile );
    snprintf( buffer, elcount( buffer ), "0.0000 HMI_SeatCond_ActvComf_Seat_FL_Stat := %X\n", getValue( HMI_SeatCond_ActvComf_Seat_FL_Stat ) );    filePutString( buffer, elcount( buffer ), hFile );
    snprintf( buffer, elcount( buffer ), "0.0000 HMI_SeatCond_ActvComf_Seat_FR_Stat := %X\n", getValue( HMI_SeatCond_ActvComf_Seat_FR_Stat ) );    filePutString( buffer, elcount( buffer ), hFile );
    snprintf( buffer, elcount( buffer ), "0.0000 HMI_SeatCond_ActvComf_Seat_RL_Stat := %X\n", getValue( HMI_SeatCond_ActvComf_Seat_RL_Stat ) );    filePutString( buffer, elcount( buffer ), hFile );
    snprintf( buffer, elcount( buffer ), "0.0000 HMI_SeatCond_ActvComf_Seat_RR_Stat := %X\n", getValue( HMI_SeatCond_ActvComf_Seat_RR_Stat ) );    filePutString( buffer, elcount( buffer ), hFile );
}
/*@@end*/

/*@@timer:_tSeatHtVn_Stat2_AR:*/
on timer _tSeatHtVn_Stat2_AR
{
    putValue( HMI__STMSG_SeatHtVn_Stat2_AR, 0 );
}
/*@@end*/

/*@@envVar:HMI__STMSG_SeatHtVn_Stat2_AR:*/
on EnvVar HMI__STMSG_SeatHtVn_Stat2_AR
{
    long tDelay;
    if( getValue( this ) == 2 )
    {
        tDelay = getValue( HMI__STMSGT_SeatHtVn_Stat2_AR );
        if( tDelay > 0)    
            setTimer( _tSeatHtVn_Stat2_AR, tDelay );
        else
            putValue( HMI__STMSG_SeatHtVn_Stat2_AR, 0 );
    }
}
/*@@end*/

/*@@envVar:HMI_SeatCond_ActvComf_Seat_FL_Stat:*/
on EnvVar HMI_SeatCond_ActvComf_Seat_FL_Stat
{
    _mSeatHtVn_Stat2_AR.SeatCond_ActvComf_Seat_FL_Stat.phys = getValue(this);
    _SeatHtVn_Stat2_AR_SpontanFlag = 1;
}
/*@@end*/

/*@@envVar:HMI_SeatCond_ActvComf_Seat_FR_Stat:*/
on EnvVar HMI_SeatCond_ActvComf_Seat_FR_Stat
{
    _mSeatHtVn_Stat2_AR.SeatCond_ActvComf_Seat_FR_Stat.phys = getValue(this);
    _SeatHtVn_Stat2_AR_SpontanFlag = 1;
}
/*@@end*/

/*@@envVar:HMI_SeatCond_ActvComf_Seat_RL_Stat:*/
on EnvVar HMI_SeatCond_ActvComf_Seat_RL_Stat
{
    _mSeatHtVn_Stat2_AR.SeatCond_ActvComf_Seat_RL_Stat.phys = getValue(this);
    _SeatHtVn_Stat2_AR_SpontanFlag = 1;
}
/*@@end*/

/*@@envVar:HMI_SeatCond_ActvComf_Seat_RR_Stat:*/
on EnvVar HMI_SeatCond_ActvComf_Seat_RR_Stat
{
    _mSeatHtVn_Stat2_AR.SeatCond_ActvComf_Seat_RR_Stat.phys = getValue(this);
    _SeatHtVn_Stat2_AR_SpontanFlag = 1;
}
/*@@end*/

/*@@caplFunc:SeatMem_D_Rq_AR_Activity(int):*/
void SeatMem_D_Rq_AR_Activity(int active)
{
      if( active)
      {
          if( _SeatMem_D_Rq_AR_SigActivity == 0)
            _SeatMem_D_Rq_AR_Cnt = 1;
        _SeatMem_D_Rq_AR_SigActivity++;
      }
      else
    {
        _SeatMem_D_Rq_AR_SigActivity--;
      }
}
/*@@end*/

/*@@caplFunc:SeatMem_D_Rq_AR_Change(int,int,int):*/
int SeatMem_D_Rq_AR_Change(int lastValue, int sigValue, int inActValue)
{
    bActiveHelper = (sigValue != inActValue);
      if( !lastValue && bActiveHelper)
        SeatMem_D_Rq_AR_Activity( 1 );
      else if( lastValue && !bActiveHelper)
        SeatMem_D_Rq_AR_Activity(0 );
    return bActiveHelper;
}
/*@@end*/

/*@@caplFunc:SeatMem_D_Rq_AR_check_output():*/
SeatMem_D_Rq_AR_check_output()
{
    if( !getValue( HMI__STMSG_SeatMem_D_Rq_AR ) )
    {
        // Botschaft SeatMem_D_Rq_AR ID: 297 --- Sendeart 2 cyclicIfActive --- 
        if( _SeatMem_D_Rq_AR_SigActivity )
            _SeatMem_D_Rq_AR_Cnt--;
        if( _SeatMem_D_Rq_AR_Cnt < 1 )
        {
            SeatMem_D_Rq_AR_output(); // Zyklus abgelaufen, Nachricht senden
            _SeatMem_D_Rq_AR_Cnt = _SeatMem_D_Rq_AR_CycleCount;
        }
    }
}
/*@@end*/

/*@@caplFunc:SeatMem_D_Rq_AR_init():*/
SeatMem_D_Rq_AR_init()
{   /* Botschaft SeatMem_D_Rq_AR ID: 297 --- Sendeart 2 cyclicIfActive --- 
BA_ "ApplMessage" BO_ 297 0;
BA_ "NmAsrMessage" BO_ 297 0;
BA_ "GenMsgMinAcceptLength" BO_ 297 3;
BA_ "GenMsgILSupport" BO_ 297 1;
BA_ "DiagState" BO_ 297 0;
BA_ "DiagRequest" BO_ 297 0;
BA_ "DiagResponse" BO_ 297 0;
BA_ "GenMsgStartValue" BO_ 297 "0";
BA_ "GenMsgStartDelayTime" BO_ 297 0;
BA_ "GenMsgDelayTime" BO_ 297 5;
BA_ "GenMsgCycleTime" BO_ 297 0;
BA_ "GenMsgCycleTimeActive" BO_ 297 40;
BA_ "GenMsgSendType" BO_ 297 2;
    */
    _SeatMem_D_Rq_AR_Timebase =           c_tDBKomTimer_5ms;
    _SeatMem_D_Rq_AR_CycleCount =       40 / _SeatMem_D_Rq_AR_Timebase;
    _SeatMem_D_Rq_AR_StartDelay =        0 / _SeatMem_D_Rq_AR_Timebase;
    _SeatMem_D_Rq_AR_Cnt = _SeatMem_D_Rq_AR_StartDelay;
    _SeatMem_D_Rq_AR_Active = 0;
    _SeatMem_D_Rq_AR_SigActivity = 0;

    putValue( HMI__STMSGSD_SeatMem_D_Rq_AR, _SeatMem_D_Rq_AR_StartDelay * _SeatMem_D_Rq_AR_Timebase );

    _mSeatMem_D_Rq_AR.MCMS_DrvPosn_D_Rq.phys     = getValue( HMI_MCMS_DrvPosn_D_Rq );
    _mSeatMem_D_Rq_AR.MCMS_DrvPosn_D_Sv_Rq.phys  = getValue( HMI_MCMS_DrvPosn_D_Sv_Rq );
    _mSeatMem_D_Rq_AR.MCMS_EEH_Posn_Rq.phys       = getValue( HMI_MCMS_EEH_Posn_Rq );
    _mSeatMem_D_Rq_AR.MCMS_HomePosn_D_Rq.phys       = getValue( HMI_MCMS_HomePosn_D_Rq );
    _mSeatMem_D_Rq_AR.MCMS_HomePosn_D_Sv_Rq.phys       = getValue( HMI_MCMS_HomePosn_D_Sv_Rq );
    _mSeatMem_D_Rq_AR.Mem_D_Posn_Rq.phys       = getValue( HMI_Mem_D_Posn_Rq );
    _mSeatMem_D_Rq_AR.Mem_D_Prof_Posn_Rq.phys       = getValue( HMI_Mem_D_Prof_Posn_Rq );
    _mSeatMem_D_Rq_AR.Mem_D_Rc_Rq.phys         = getValue( HMI_Mem_D_Rc_Rq );
    _mSeatMem_D_Rq_AR.Mem_D_Sv_Rq.phys         = getValue( HMI_Mem_D_Sv_Rq );
    _mSeatMem_D_Rq_AR.MirrDrvPosn_Rq.phys      = getValue( HMI_MirrDrvPosn_Rq );
    _mSeatMem_D_Rq_AR.MirrDrvPosn_Sv_Rq.phys   = getValue( HMI_MirrDrvPosn_Sv_Rq );
    _SeatMem_D_Rq_AR_MCMS_DrvPosn_D_Rq_LastState = SeatMem_D_Rq_AR_Change( _SeatMem_D_Rq_AR_MCMS_DrvPosn_D_Rq_LastState, _mSeatMem_D_Rq_AR.MCMS_DrvPosn_D_Rq, 0);
    _SeatMem_D_Rq_AR_MCMS_DrvPosn_D_Sv_Rq_LastState = SeatMem_D_Rq_AR_Change( _SeatMem_D_Rq_AR_MCMS_DrvPosn_D_Sv_Rq_LastState, _mSeatMem_D_Rq_AR.MCMS_DrvPosn_D_Sv_Rq, 0);
    _SeatMem_D_Rq_AR_MCMS_EEH_Posn_Rq_LastState = SeatMem_D_Rq_AR_Change( _SeatMem_D_Rq_AR_MCMS_EEH_Posn_Rq_LastState, _mSeatMem_D_Rq_AR.MCMS_EEH_Posn_Rq, 0);
    _SeatMem_D_Rq_AR_MCMS_HomePosn_D_Rq_LastState = SeatMem_D_Rq_AR_Change( _SeatMem_D_Rq_AR_MCMS_HomePosn_D_Rq_LastState, _mSeatMem_D_Rq_AR.MCMS_HomePosn_D_Rq, 0);
    _SeatMem_D_Rq_AR_MCMS_HomePosn_D_Sv_Rq_LastState = SeatMem_D_Rq_AR_Change( _SeatMem_D_Rq_AR_MCMS_HomePosn_D_Sv_Rq_LastState, _mSeatMem_D_Rq_AR.MCMS_HomePosn_D_Sv_Rq, 0);
    _SeatMem_D_Rq_AR_Mem_D_Posn_Rq_LastState = SeatMem_D_Rq_AR_Change( _SeatMem_D_Rq_AR_Mem_D_Posn_Rq_LastState, _mSeatMem_D_Rq_AR.Mem_D_Posn_Rq, 0);
    _SeatMem_D_Rq_AR_Mem_D_Prof_Posn_Rq_LastState = SeatMem_D_Rq_AR_Change( _SeatMem_D_Rq_AR_Mem_D_Prof_Posn_Rq_LastState, _mSeatMem_D_Rq_AR.Mem_D_Prof_Posn_Rq, 0);
    _SeatMem_D_Rq_AR_Mem_D_Rc_Rq_LastState = SeatMem_D_Rq_AR_Change( _SeatMem_D_Rq_AR_Mem_D_Rc_Rq_LastState, _mSeatMem_D_Rq_AR.Mem_D_Rc_Rq, 0);
    _SeatMem_D_Rq_AR_Mem_D_Sv_Rq_LastState = SeatMem_D_Rq_AR_Change( _SeatMem_D_Rq_AR_Mem_D_Sv_Rq_LastState, _mSeatMem_D_Rq_AR.Mem_D_Sv_Rq, 0);
    _SeatMem_D_Rq_AR_MirrDrvPosn_Rq_LastState = SeatMem_D_Rq_AR_Change( _SeatMem_D_Rq_AR_MirrDrvPosn_Rq_LastState, _mSeatMem_D_Rq_AR.MirrDrvPosn_Rq, 0);
    _SeatMem_D_Rq_AR_MirrDrvPosn_Sv_Rq_LastState = SeatMem_D_Rq_AR_Change( _SeatMem_D_Rq_AR_MirrDrvPosn_Sv_Rq_LastState, _mSeatMem_D_Rq_AR.MirrDrvPosn_Sv_Rq, 0);
}
/*@@end*/

/*@@caplFunc:SeatMem_D_Rq_AR_output():*/
SeatMem_D_Rq_AR_output()
{
    output( _mSeatMem_D_Rq_AR );
}
/*@@end*/

/*@@caplFunc:SeatMem_D_Rq_AR_saveEnvVars(dword):*/
SeatMem_D_Rq_AR_saveEnvVars( dword hFile )
{
    filePutString("\n// Knoten EIS: SeatMem_D_Rq_AR\n", 31, hFile );
    snprintf( buffer, elcount( buffer ), "0.0000 HMI__STMSG_SeatMem_D_Rq_AR := %X\n", getValue( HMI__STMSG_SeatMem_D_Rq_AR ) );    filePutString( buffer, elcount( buffer ), hFile );
    snprintf( buffer, elcount( buffer ), "0.0000 HMI__STMSGT_SeatMem_D_Rq_AR := %X\n", getValue( HMI__STMSGT_SeatMem_D_Rq_AR ) );    filePutString( buffer, elcount( buffer ), hFile );
    snprintf( buffer, elcount( buffer ), "0.0000 HMI_MCMS_DrvPosn_D_Rq := %X\n", getValue( HMI_MCMS_DrvPosn_D_Rq ) );    filePutString( buffer, elcount( buffer ), hFile );
    snprintf( buffer, elcount( buffer ), "0.0000 HMI_MCMS_DrvPosn_D_Sv_Rq := %X\n", getValue( HMI_MCMS_DrvPosn_D_Sv_Rq ) );    filePutString( buffer, elcount( buffer ), hFile );
    snprintf( buffer, elcount( buffer ), "0.0000 HMI_MCMS_EEH_Posn_Rq := %X\n", getValue( HMI_MCMS_EEH_Posn_Rq ) );    filePutString( buffer, elcount( buffer ), hFile );
    snprintf( buffer, elcount( buffer ), "0.0000 HMI_MCMS_HomePosn_D_Rq := %X\n", getValue( HMI_MCMS_HomePosn_D_Rq ) );    filePutString( buffer, elcount( buffer ), hFile );
    snprintf( buffer, elcount( buffer ), "0.0000 HMI_MCMS_HomePosn_D_Sv_Rq := %X\n", getValue( HMI_MCMS_HomePosn_D_Sv_Rq ) );    filePutString( buffer, elcount( buffer ), hFile );
    snprintf( buffer, elcount( buffer ), "0.0000 HMI_Mem_D_Posn_Rq := %X\n", getValue( HMI_Mem_D_Posn_Rq ) );    filePutString( buffer, elcount( buffer ), hFile );
    snprintf( buffer, elcount( buffer ), "0.0000 HMI_Mem_D_Prof_Posn_Rq := %X\n", getValue( HMI_Mem_D_Prof_Posn_Rq ) );    filePutString( buffer, elcount( buffer ), hFile );
    snprintf( buffer, elcount( buffer ), "0.0000 HMI_Mem_D_Rc_Rq := %X\n", getValue( HMI_Mem_D_Rc_Rq ) );    filePutString( buffer, elcount( buffer ), hFile );
    snprintf( buffer, elcount( buffer ), "0.0000 HMI_Mem_D_Sv_Rq := %X\n", getValue( HMI_Mem_D_Sv_Rq ) );    filePutString( buffer, elcount( buffer ), hFile );
    snprintf( buffer, elcount( buffer ), "0.0000 HMI_MirrDrvPosn_Rq := %X\n", getValue( HMI_MirrDrvPosn_Rq ) );    filePutString( buffer, elcount( buffer ), hFile );
    snprintf( buffer, elcount( buffer ), "0.0000 HMI_MirrDrvPosn_Sv_Rq := %X\n", getValue( HMI_MirrDrvPosn_Sv_Rq ) );    filePutString( buffer, elcount( buffer ), hFile );
}
/*@@end*/

/*@@timer:_tSeatMem_D_Rq_AR:*/
on timer _tSeatMem_D_Rq_AR
{
    putValue( HMI__STMSG_SeatMem_D_Rq_AR, 0 );
}
/*@@end*/

/*@@envVar:HMI__STMSG_SeatMem_D_Rq_AR:*/
on EnvVar HMI__STMSG_SeatMem_D_Rq_AR
{
    long tDelay;
    if( getValue( this ) == 2 )
    {
        tDelay = getValue( HMI__STMSGT_SeatMem_D_Rq_AR );
        if( tDelay > 0)    
            setTimer( _tSeatMem_D_Rq_AR, tDelay );
        else
            putValue( HMI__STMSG_SeatMem_D_Rq_AR, 0 );
    }
}
/*@@end*/

/*@@envVar:HMI_MCMS_DrvPosn_D_Rq:*/
on EnvVar HMI_MCMS_DrvPosn_D_Rq
{
    _mSeatMem_D_Rq_AR.MCMS_DrvPosn_D_Rq.phys = getValue(this);
    _SeatMem_D_Rq_AR_MCMS_DrvPosn_D_Rq_LastState = SeatMem_D_Rq_AR_Change(_SeatMem_D_Rq_AR_MCMS_DrvPosn_D_Rq_LastState, _mSeatMem_D_Rq_AR.MCMS_DrvPosn_D_Rq, 0 );
}
/*@@end*/

/*@@envVar:HMI_MCMS_DrvPosn_D_Sv_Rq:*/
on EnvVar HMI_MCMS_DrvPosn_D_Sv_Rq
{
    _mSeatMem_D_Rq_AR.MCMS_DrvPosn_D_Sv_Rq.phys = getValue(this);
    _SeatMem_D_Rq_AR_MCMS_DrvPosn_D_Sv_Rq_LastState = SeatMem_D_Rq_AR_Change(_SeatMem_D_Rq_AR_MCMS_DrvPosn_D_Sv_Rq_LastState, _mSeatMem_D_Rq_AR.MCMS_DrvPosn_D_Sv_Rq, 0 );
}
/*@@end*/

/*@@envVar:HMI_MCMS_EEH_Posn_Rq:*/
on EnvVar HMI_MCMS_EEH_Posn_Rq
{
    _mSeatMem_D_Rq_AR.MCMS_EEH_Posn_Rq.phys = getValue(this);
    _SeatMem_D_Rq_AR_MCMS_EEH_Posn_Rq_LastState = SeatMem_D_Rq_AR_Change(_SeatMem_D_Rq_AR_MCMS_EEH_Posn_Rq_LastState, _mSeatMem_D_Rq_AR.MCMS_EEH_Posn_Rq, 0 );
}
/*@@end*/

/*@@envVar:HMI_MCMS_HomePosn_D_Rq:*/
on EnvVar HMI_MCMS_HomePosn_D_Rq
{
    _mSeatMem_D_Rq_AR.MCMS_HomePosn_D_Rq.phys = getValue(this);
    _SeatMem_D_Rq_AR_MCMS_HomePosn_D_Rq_LastState = SeatMem_D_Rq_AR_Change(_SeatMem_D_Rq_AR_MCMS_HomePosn_D_Rq_LastState, _mSeatMem_D_Rq_AR.MCMS_HomePosn_D_Rq, 0 );
}
/*@@end*/

/*@@envVar:HMI_MCMS_HomePosn_D_Sv_Rq:*/
on EnvVar HMI_MCMS_HomePosn_D_Sv_Rq
{
    _mSeatMem_D_Rq_AR.MCMS_HomePosn_D_Sv_Rq.phys = getValue(this);
    _SeatMem_D_Rq_AR_MCMS_HomePosn_D_Sv_Rq_LastState = SeatMem_D_Rq_AR_Change(_SeatMem_D_Rq_AR_MCMS_HomePosn_D_Sv_Rq_LastState, _mSeatMem_D_Rq_AR.MCMS_HomePosn_D_Sv_Rq, 0 );
}
/*@@end*/

/*@@envVar:HMI_Mem_D_Posn_Rq:*/
on EnvVar HMI_Mem_D_Posn_Rq
{
    _mSeatMem_D_Rq_AR.Mem_D_Posn_Rq.phys = getValue(this);
    _SeatMem_D_Rq_AR_Mem_D_Posn_Rq_LastState = SeatMem_D_Rq_AR_Change(_SeatMem_D_Rq_AR_Mem_D_Posn_Rq_LastState, _mSeatMem_D_Rq_AR.Mem_D_Posn_Rq, 0 );
}
/*@@end*/

/*@@envVar:HMI_Mem_D_Prof_Posn_Rq:*/
on EnvVar HMI_Mem_D_Prof_Posn_Rq
{
    _mSeatMem_D_Rq_AR.Mem_D_Prof_Posn_Rq.phys = getValue(this);
    _SeatMem_D_Rq_AR_Mem_D_Prof_Posn_Rq_LastState = SeatMem_D_Rq_AR_Change(_SeatMem_D_Rq_AR_Mem_D_Prof_Posn_Rq_LastState, _mSeatMem_D_Rq_AR.Mem_D_Prof_Posn_Rq, 0 );
}
/*@@end*/

/*@@envVar:HMI_Mem_D_Rc_Rq:*/
on EnvVar HMI_Mem_D_Rc_Rq
{
    _mSeatMem_D_Rq_AR.Mem_D_Rc_Rq.phys = getValue(this);
    _SeatMem_D_Rq_AR_Mem_D_Rc_Rq_LastState = SeatMem_D_Rq_AR_Change(_SeatMem_D_Rq_AR_Mem_D_Rc_Rq_LastState, _mSeatMem_D_Rq_AR.Mem_D_Rc_Rq, 0 );
}
/*@@end*/

/*@@envVar:HMI_Mem_D_Sv_Rq:*/
on EnvVar HMI_Mem_D_Sv_Rq
{
    _mSeatMem_D_Rq_AR.Mem_D_Sv_Rq.phys = getValue(this);
    _SeatMem_D_Rq_AR_Mem_D_Sv_Rq_LastState = SeatMem_D_Rq_AR_Change(_SeatMem_D_Rq_AR_Mem_D_Sv_Rq_LastState, _mSeatMem_D_Rq_AR.Mem_D_Sv_Rq, 0 );
}
/*@@end*/

/*@@envVar:HMI_MirrDrvPosn_Rq:*/
on EnvVar HMI_MirrDrvPosn_Rq
{
    _mSeatMem_D_Rq_AR.MirrDrvPosn_Rq.phys = getValue(this);
    _SeatMem_D_Rq_AR_MirrDrvPosn_Rq_LastState = SeatMem_D_Rq_AR_Change(_SeatMem_D_Rq_AR_MirrDrvPosn_Rq_LastState, _mSeatMem_D_Rq_AR.MirrDrvPosn_Rq, 0 );
}
/*@@end*/

/*@@envVar:HMI_MirrDrvPosn_Sv_Rq:*/
on EnvVar HMI_MirrDrvPosn_Sv_Rq
{
    _mSeatMem_D_Rq_AR.MirrDrvPosn_Sv_Rq.phys = getValue(this);
    _SeatMem_D_Rq_AR_MirrDrvPosn_Sv_Rq_LastState = SeatMem_D_Rq_AR_Change(_SeatMem_D_Rq_AR_MirrDrvPosn_Sv_Rq_LastState, _mSeatMem_D_Rq_AR.MirrDrvPosn_Sv_Rq, 0 );
}
/*@@end*/

/*@@caplFunc:SeatPosn_Abs_D_AR_check_output():*/
SeatPosn_Abs_D_AR_check_output()
{
    if( !getValue( HMI__STMSG_SeatPosn_Abs_D_AR ) )
    {
        // Botschaft SeatPosn_Abs_D_AR ID: 961 --- Sendeart 5 cyclicAndSpontanWithDelay --- 
        if( _SeatPosn_Abs_D_AR_DelayCnt > 0) _SeatPosn_Abs_D_AR_DelayCnt--; // Mindestsendeabstand
        _SeatPosn_Abs_D_AR_Cnt--;
        if( _SeatPosn_Abs_D_AR_Cnt < 1 )
        {
            if( _SeatPosn_Abs_D_AR_DelayCnt < 1 )
            {
                // Nachricht wg. abgelaufenem Zyklus ausgeben (Mindestsendeabstand eingehalten)
                SeatPosn_Abs_D_AR_output();
                _SeatPosn_Abs_D_AR_SpontanFlag = 0; // Spontan-Flag zurücksetzen
                _SeatPosn_Abs_D_AR_DelayCnt = _SeatPosn_Abs_D_AR_MinDelay;
            }
            else
            {
                // Spontanflag setzen damit nach Ablauf Mindestsendeabstand gesendet wird
                 _SeatPosn_Abs_D_AR_SpontanFlag = 1;
            }
            _SeatPosn_Abs_D_AR_Cnt = _SeatPosn_Abs_D_AR_CycleCount; // Zyklus-Zähler zurücksetzen
        }
        else if( _SeatPosn_Abs_D_AR_SpontanFlag)
        {
            if( _SeatPosn_Abs_D_AR_DelayCnt < 1 )
            {
                // Nachricht wg. spontaner Änderung ausgeben (Mindestsendeabstand eingehalten)
                SeatPosn_Abs_D_AR_output();
                _SeatPosn_Abs_D_AR_SpontanFlag = 0; // Spontan-Flag zurücksetzen
                _SeatPosn_Abs_D_AR_DelayCnt = _SeatPosn_Abs_D_AR_MinDelay;
            }
        }
    }
}
/*@@end*/

/*@@caplFunc:SeatPosn_Abs_D_AR_init():*/
SeatPosn_Abs_D_AR_init()
{   /* Botschaft SeatPosn_Abs_D_AR ID: 961 --- Sendeart 5 cyclicAndSpontanWithDelay --- 
BA_ "ApplMessage" BO_ 961 0;
BA_ "NmAsrMessage" BO_ 961 0;
BA_ "GenMsgMinAcceptLength" BO_ 961 8;
BA_ "GenMsgILSupport" BO_ 961 1;
BA_ "DiagState" BO_ 961 0;
BA_ "DiagRequest" BO_ 961 0;
BA_ "DiagResponse" BO_ 961 0;
BA_ "GenMsgStartValue" BO_ 961 "0";
BA_ "GenMsgDelayTime" BO_ 961 100;
BA_ "GenMsgNrOfRepetitions" BO_ 961 0;
BA_ "GenMsgCycleTime" BO_ 961 1000;
BA_ "GenMsgSendType" BO_ 961 5;
    */
    _SeatPosn_Abs_D_AR_Timebase =        c_tDBKomTimer_20ms;
    _SeatPosn_Abs_D_AR_CycleCount =    1000 / _SeatPosn_Abs_D_AR_Timebase;
    _SeatPosn_Abs_D_AR_StartDelay =       0 / _SeatPosn_Abs_D_AR_Timebase;
    _SeatPosn_Abs_D_AR_MinDelay =       100 / _SeatPosn_Abs_D_AR_Timebase;
    _SeatPosn_Abs_D_AR_Cnt = _SeatPosn_Abs_D_AR_StartDelay;
    _SeatPosn_Abs_D_AR_SpontanFlag = 0;
    _SeatPosn_Abs_D_AR_DelayCnt = 0;

    putValue( HMI__STMSGSD_SeatPosn_Abs_D_AR, _SeatPosn_Abs_D_AR_StartDelay * _SeatPosn_Abs_D_AR_Timebase );

    _mSeatPosn_Abs_D_AR.SeatLgthHghtPosn_D_Vld.phys = getValue( HMI_SeatLgthHghtPosn_D_Vld );
    _mSeatPosn_Abs_D_AR.SeatLgthHghtPosnAbs_D.phys = getValue( HMI_SeatLgthHghtPosnAbs_D );
    _mSeatPosn_Abs_D_AR.SeatLgthHghtPosnRel_D.phys = getValue( HMI_SeatLgthHghtPosnRel_D );
    _mSeatPosn_Abs_D_AR.SeatLgthPosn_D_Vld.phys = getValue( HMI_SeatLgthPosn_D_Vld );
    _mSeatPosn_Abs_D_AR.SeatLgthPosnAbs_D.phys = getValue( HMI_SeatLgthPosnAbs_D );
    _mSeatPosn_Abs_D_AR.SeatLgthPosnRel_D.phys = getValue( HMI_SeatLgthPosnRel_D );
}
/*@@end*/

/*@@caplFunc:SeatPosn_Abs_D_AR_output():*/
SeatPosn_Abs_D_AR_output()
{
    byte crc;
    byte SQC_help;

    if( !getValue( HMI_SQC_SeatPosn_Abs_D_Auto ) )
    {
        // berechne message counter
        SQC_help = getValue( HMI_SQC_SeatPosn_Abs_D );
        if( SQC_help >= 15 ) SQC_help = 0;
        else SQC_help++;
        putValue( HMI_SQC_SeatPosn_Abs_D, SQC_help );
        _mSeatPosn_Abs_D_AR.SQC_SeatPosn_Abs_D = SQC_help;
    }
    else
          _mSeatPosn_Abs_D_AR.SQC_SeatPosn_Abs_D = getValue( HMI_SQC_SeatPosn_Abs_D );

    if( getValue( HMI_CRC_SeatPosn_Abs_D_Profile_02 ) )
    {
        if( !getValue( HMI_CRC_SeatPosn_Abs_D_Auto ) )
        {   // CRC according Profile_02 ( W213 )
            // berechne crc
            crc = 0xFF;
//            crc = crctable_profile02[ crc ^ _mSeatPosn_Abs_D_AR.byte( 0 )];  CRC
            crc = crctable_profile02[ crc ^ _mSeatPosn_Abs_D_AR.byte( 1 )];
            crc = crctable_profile02[ crc ^ _mSeatPosn_Abs_D_AR.byte( 2 )];
            crc = crctable_profile02[ crc ^ _mSeatPosn_Abs_D_AR.byte( 3 )];
            crc = crctable_profile02[ crc ^ _mSeatPosn_Abs_D_AR.byte( 4 )];
            crc = crctable_profile02[ crc ^ _mSeatPosn_Abs_D_AR.byte( 5 )];
            crc = crctable_profile02[ crc ^ _mSeatPosn_Abs_D_AR.byte( 6 )];
            crc = crctable_profile02[ crc ^ _mSeatPosn_Abs_D_AR.byte( 7 )];
            crc = crctable_profile02[ crc ^ _SeatPosn_Abs_D_AR_CRC_Offset[ _mSeatPosn_Abs_D_AR.SQC_SeatPosn_Abs_D ] ]; // load offset
            crc = (crc ^ 0xFF);
            if( getValue(  HMI_CRC_SeatPosn_Abs_D_Invalid ) )
                crc++;
            _mSeatPosn_Abs_D_AR.CRC_SeatPosn_Abs_D = crc;
            putValue( HMI_CRC_SeatPosn_Abs_D, crc );
        }
        else
            _mSeatPosn_Abs_D_AR.CRC_SeatPosn_Abs_D = getValue( HMI_CRC_SeatPosn_Abs_D );
    }
    output( _mSeatPosn_Abs_D_AR );
}
/*@@end*/

/*@@caplFunc:SeatPosn_Abs_D_AR_saveEnvVars(dword):*/
SeatPosn_Abs_D_AR_saveEnvVars( dword hFile )
{
    filePutString("\n// Knoten EIS: SeatPosn_Abs_D_AR\n", 31, hFile );
    snprintf( buffer, elcount( buffer ), "0.0000 HMI__STMSG_SeatPosn_Abs_D := %X\n", getValue( HMI__STMSG_SeatPosn_Abs_D_AR ) );    filePutString( buffer, elcount( buffer ), hFile );
    snprintf( buffer, elcount( buffer ), "0.0000 HMI__STMSGT_SeatPosn_Abs_D := %X\n", getValue( HMI__STMSGT_SeatPosn_Abs_D_AR ) );    filePutString( buffer, elcount( buffer ), hFile );
    snprintf( buffer, elcount( buffer ), "0.0000 HMI_SeatLgthHghtPosn_D_Vld := %X\n", getValue( HMI_SeatLgthHghtPosn_D_Vld ) );    filePutString( buffer, elcount( buffer ), hFile );
    snprintf( buffer, elcount( buffer ), "0.0000 HMI_SeatLgthHghtPosnAbs_D := %X\n", getValue( HMI_SeatLgthHghtPosnAbs_D ) );    filePutString( buffer, elcount( buffer ), hFile );
    snprintf( buffer, elcount( buffer ), "0.0000 HMI_SeatLgthHghtPosnRel_D := %X\n", getValue( HMI_SeatLgthHghtPosnRel_D ) );    filePutString( buffer, elcount( buffer ), hFile );
    snprintf( buffer, elcount( buffer ), "0.0000 HMI_SeatLgthPosn_D_Vld := %X\n", getValue( HMI_SeatLgthPosn_D_Vld ) );    filePutString( buffer, elcount( buffer ), hFile );
    snprintf( buffer, elcount( buffer ), "0.0000 HMI_SeatLgthPosnAbs_D := %X\n", getValue( HMI_SeatLgthPosnAbs_D ) );    filePutString( buffer, elcount( buffer ), hFile );
    snprintf( buffer, elcount( buffer ), "0.0000 HMI_SeatLgthPosnRel_D := %X\n", getValue( HMI_SeatLgthPosnRel_D ) );    filePutString( buffer, elcount( buffer ), hFile );
}
/*@@end*/

/*@@timer:_tSeatPosn_Abs_D_AR:*/
on timer _tSeatPosn_Abs_D_AR
{
    putValue( HMI__STMSG_SeatPosn_Abs_D_AR, 0 );
}
/*@@end*/

/*@@envVar:HMI__STMSG_SeatPosn_Abs_D_AR:*/
on EnvVar HMI__STMSG_SeatPosn_Abs_D_AR
{
    long tDelay;
    if( getValue( this ) == 2 )
    {
        tDelay = getValue( HMI__STMSGT_SeatPosn_Abs_D_AR );
        if( tDelay > 0)    
            setTimer( _tSeatPosn_Abs_D_AR, tDelay );
        else
            putValue( HMI__STMSG_SeatPosn_Abs_D_AR, 0 );
    }
}
/*@@end*/

/*@@envVar:HMI_SeatLgthPosn_D_Vld:*/
on EnvVar HMI_SeatLgthPosn_D_Vld
{
    _mSeatPosn_Abs_D_AR.SeatLgthPosn_D_Vld.phys = getValue(this);
    _SeatPosn_Abs_D_AR_SpontanFlag = 1;
}
/*@@end*/

/*@@envVar:HMI_SeatLgthPosnAbs_D:*/
on EnvVar HMI_SeatLgthPosnAbs_D
{
    _mSeatPosn_Abs_D_AR.SeatLgthPosnAbs_D.phys = getValue(this);
    _SeatPosn_Abs_D_AR_SpontanFlag = 1;
}
/*@@end*/

/*@@envVar:HMI_SeatLgthPosnRel_D:*/
on EnvVar HMI_SeatLgthPosnRel_D
{
    _mSeatPosn_Abs_D_AR.SeatLgthPosnRel_D.phys = getValue(this);
    _SeatPosn_Abs_D_AR_SpontanFlag = 1;
}
/*@@end*/

/*@@envVar:HMI_SeatLgthHghtPosn_D_Vld:*/
on EnvVar HMI_SeatLgthHghtPosn_D_Vld
{
    _mSeatPosn_Abs_D_AR.SeatLgthHghtPosn_D_Vld.phys = getValue(this);
    _SeatPosn_Abs_D_AR_SpontanFlag = 1;
}
/*@@end*/

/*@@envVar:HMI_SeatLgthHghtPosnAbs_D:*/
on EnvVar HMI_SeatLgthHghtPosnAbs_D
{
    _mSeatPosn_Abs_D_AR.SeatLgthHghtPosnAbs_D.phys = getValue(this);
    _SeatPosn_Abs_D_AR_SpontanFlag = 1;
}
/*@@end*/

/*@@envVar:HMI_SeatLgthHghtPosnRel_D:*/
on EnvVar HMI_SeatLgthHghtPosnRel_D
{
    _mSeatPosn_Abs_D_AR.SeatLgthHghtPosnRel_D.phys = getValue(this);
    _SeatPosn_Abs_D_AR_SpontanFlag = 1;
}
/*@@end*/

/*@@caplFunc:SeatPosn_Abs_P_AR_check_output():*/
SeatPosn_Abs_P_AR_check_output()
{
    if( !getValue( HMI__STMSG_SeatPosn_Abs_P_AR ) )
    {
        // Botschaft SeatPosn_Abs_P_AR ID: 963 --- Sendeart 5 cyclicAndSpontanWithDelay --- 
        if( _SeatPosn_Abs_P_AR_DelayCnt > 0) _SeatPosn_Abs_P_AR_DelayCnt--; // Mindestsendeabstand
        _SeatPosn_Abs_P_AR_Cnt--;
        if( _SeatPosn_Abs_P_AR_Cnt < 1 )
        {
            if( _SeatPosn_Abs_P_AR_DelayCnt < 1 )
            {
                // Nachricht wg. abgelaufenem Zyklus ausgeben (Mindestsendeabstand eingehalten)
                SeatPosn_Abs_P_AR_output();
                _SeatPosn_Abs_P_AR_SpontanFlag = 0; // Spontan-Flag zurücksetzen
                _SeatPosn_Abs_P_AR_DelayCnt = _SeatPosn_Abs_P_AR_MinDelay;
            }
            else
            {
                // Spontanflag setzen damit nach Ablauf Mindestsendeabstand gesendet wird
                 _SeatPosn_Abs_P_AR_SpontanFlag = 1;
            }
            _SeatPosn_Abs_P_AR_Cnt = _SeatPosn_Abs_P_AR_CycleCount; // Zyklus-Zähler zurücksetzen
        }
        else if( _SeatPosn_Abs_P_AR_SpontanFlag)
        {
            if( _SeatPosn_Abs_P_AR_DelayCnt < 1 )
            {
                // Nachricht wg. spontaner Änderung ausgeben (Mindestsendeabstand eingehalten)
                SeatPosn_Abs_P_AR_output();
                _SeatPosn_Abs_P_AR_SpontanFlag = 0; // Spontan-Flag zurücksetzen
                _SeatPosn_Abs_P_AR_DelayCnt = _SeatPosn_Abs_P_AR_MinDelay;
            }
        }
    }
}
/*@@end*/

/*@@caplFunc:SeatPosn_Abs_P_AR_init():*/
SeatPosn_Abs_P_AR_init()
{   /* Botschaft SeatPosn_Abs_P_AR ID: 963 --- Sendeart 5 cyclicAndSpontanWithDelay --- 
BA_ "ApplMessage" BO_ 963 0;
BA_ "NmAsrMessage" BO_ 963 0;
BA_ "GenMsgMinAcceptLength" BO_ 963 8;
BA_ "GenMsgILSupport" BO_ 963 1;
BA_ "DiagState" BO_ 963 0;
BA_ "DiagRequest" BO_ 963 0;
BA_ "DiagResponse" BO_ 963 0;
BA_ "GenMsgStartValue" BO_ 963 "0";
BA_ "GenMsgDelayTime" BO_ 963 100;
BA_ "GenMsgNrOfRepetitions" BO_ 963 0;
BA_ "GenMsgCycleTime" BO_ 963 1000;
BA_ "GenMsgSendType" BO_ 963 5;
    */
    _SeatPosn_Abs_P_AR_Timebase =        c_tDBKomTimer_20ms;
    _SeatPosn_Abs_P_AR_CycleCount =    1000 / _SeatPosn_Abs_P_AR_Timebase;
    _SeatPosn_Abs_P_AR_StartDelay =       0 / _SeatPosn_Abs_P_AR_Timebase;
    _SeatPosn_Abs_P_AR_MinDelay =       100 / _SeatPosn_Abs_P_AR_Timebase;
    _SeatPosn_Abs_P_AR_Cnt = _SeatPosn_Abs_P_AR_StartDelay;
    _SeatPosn_Abs_P_AR_SpontanFlag = 0;
    _SeatPosn_Abs_P_AR_DelayCnt = 0;

    putValue( HMI__STMSGSD_SeatPosn_Abs_P_AR, _SeatPosn_Abs_P_AR_StartDelay * _SeatPosn_Abs_P_AR_Timebase );

    _mSeatPosn_Abs_P_AR.SeatLgthHghtPosn_P_Vld.phys = getValue( HMI_SeatLgthHghtPosn_P_Vld );
    _mSeatPosn_Abs_P_AR.SeatLgthHghtPosnAbs_P.phys = getValue( HMI_SeatLgthHghtPosnAbs_P );
    _mSeatPosn_Abs_P_AR.SeatLgthHghtPosnRel_P.phys = getValue( HMI_SeatLgthHghtPosnRel_P );
    _mSeatPosn_Abs_P_AR.SeatLgthPosn_P_Vld.phys = getValue( HMI_SeatLgthPosn_P_Vld );
    _mSeatPosn_Abs_P_AR.SeatLgthPosnAbs_P.phys = getValue( HMI_SeatLgthPosnAbs_P );
    _mSeatPosn_Abs_P_AR.SeatLgthPosnRel_P.phys = getValue( HMI_SeatLgthPosnRel_P );
}
/*@@end*/

/*@@caplFunc:SeatPosn_Abs_P_AR_output():*/
SeatPosn_Abs_P_AR_output()
{
    byte crc;
    byte SQC_help;

    if( !getValue( HMI_SQC_SeatPosn_Abs_P_Auto ) )
    {
        // berechne message counter
        SQC_help = getValue( HMI_SQC_SeatPosn_Abs_P );
        if( SQC_help >= 15 ) SQC_help = 0;
        else SQC_help++;
        putValue( HMI_SQC_SeatPosn_Abs_P, SQC_help );
        _mSeatPosn_Abs_P_AR.SQC_SeatPosn_Abs_P = SQC_help;
    }
    else
          _mSeatPosn_Abs_P_AR.SQC_SeatPosn_Abs_P = getValue( HMI_SQC_SeatPosn_Abs_P );

    if( getValue( HMI_CRC_SeatPosn_Abs_P_Profile_02 ) )
    {
        if( !getValue( HMI_CRC_SeatPosn_Abs_P_Auto ) )
        {   // CRC according Profile_02 ( W213 )
            // berechne crc
            crc = 0xFF;
//            crc = crctable_profile02[ crc ^ _mSeatPosn_Abs_P_AR.byte( 0 )];  CRC
            crc = crctable_profile02[ crc ^ _mSeatPosn_Abs_P_AR.byte( 1 )];
            crc = crctable_profile02[ crc ^ _mSeatPosn_Abs_P_AR.byte( 2 )];
            crc = crctable_profile02[ crc ^ _mSeatPosn_Abs_P_AR.byte( 3 )];
            crc = crctable_profile02[ crc ^ _mSeatPosn_Abs_P_AR.byte( 4 )];
            crc = crctable_profile02[ crc ^ _mSeatPosn_Abs_P_AR.byte( 5 )];
            crc = crctable_profile02[ crc ^ _mSeatPosn_Abs_P_AR.byte( 6 )];
            crc = crctable_profile02[ crc ^ _mSeatPosn_Abs_P_AR.byte( 7 )];
            crc = crctable_profile02[ crc ^ _SeatPosn_Abs_P_AR_CRC_Offset[ _mSeatPosn_Abs_P_AR.SQC_SeatPosn_Abs_P ] ]; // load offset
            crc = (crc ^ 0xFF);
            if( getValue(  HMI_CRC_SeatPosn_Abs_P_Invalid ) )
                crc++;
            _mSeatPosn_Abs_P_AR.CRC_SeatPosn_Abs_P = crc;
            putValue( HMI_CRC_SeatPosn_Abs_P, crc );
        }
        else
            _mSeatPosn_Abs_P_AR.CRC_SeatPosn_Abs_P = getValue( HMI_CRC_SeatPosn_Abs_P );
    }
    output( _mSeatPosn_Abs_P_AR );
}
/*@@end*/

/*@@caplFunc:SeatPosn_Abs_P_AR_saveEnvVars(dword):*/
SeatPosn_Abs_P_AR_saveEnvVars( dword hFile )
{
    filePutString("\n// Knoten EIS: SeatPosn_Abs_P_AR\n", 31, hFile );
    snprintf( buffer, elcount( buffer ), "0.0000 HMI__STMSG_SeatPosn_Abs_P := %X\n", getValue( HMI__STMSG_SeatPosn_Abs_P_AR ) );    filePutString( buffer, elcount( buffer ), hFile );
    snprintf( buffer, elcount( buffer ), "0.0000 HMI__STMSGT_SeatPosn_Abs_P := %X\n", getValue( HMI__STMSGT_SeatPosn_Abs_P_AR ) );    filePutString( buffer, elcount( buffer ), hFile );
    snprintf( buffer, elcount( buffer ), "0.0000 HMI_SeatLgthHghtPosn_P_Vld := %X\n", getValue( HMI_SeatLgthHghtPosn_P_Vld ) );    filePutString( buffer, elcount( buffer ), hFile );
    snprintf( buffer, elcount( buffer ), "0.0000 HMI_SeatLgthHghtPosnAbs_P := %X\n", getValue( HMI_SeatLgthHghtPosnAbs_P ) );    filePutString( buffer, elcount( buffer ), hFile );
    snprintf( buffer, elcount( buffer ), "0.0000 HMI_SeatLgthHghtPosnRel_P := %X\n", getValue( HMI_SeatLgthHghtPosnRel_P ) );    filePutString( buffer, elcount( buffer ), hFile );
    snprintf( buffer, elcount( buffer ), "0.0000 HMI_SeatLgthPosn_P_Vld := %X\n", getValue( HMI_SeatLgthPosn_P_Vld ) );    filePutString( buffer, elcount( buffer ), hFile );
    snprintf( buffer, elcount( buffer ), "0.0000 HMI_SeatLgthPosnAbs_P := %X\n", getValue( HMI_SeatLgthPosnAbs_P ) );    filePutString( buffer, elcount( buffer ), hFile );
    snprintf( buffer, elcount( buffer ), "0.0000 HMI_SeatLgthPosnRel_P := %X\n", getValue( HMI_SeatLgthPosnRel_P ) );    filePutString( buffer, elcount( buffer ), hFile );
}
/*@@end*/

/*@@timer:_tSeatPosn_Abs_P_AR:*/
on timer _tSeatPosn_Abs_P_AR
{
    putValue( HMI__STMSG_SeatPosn_Abs_P_AR, 0 );
}
/*@@end*/

/*@@envVar:HMI__STMSG_SeatPosn_Abs_P_AR:*/
on EnvVar HMI__STMSG_SeatPosn_Abs_P_AR
{
    long tDelay;
    if( getValue( this ) == 2 )
    {
        tDelay = getValue( HMI__STMSGT_SeatPosn_Abs_P_AR );
        if( tDelay > 0)    
            setTimer( _tSeatPosn_Abs_P_AR, tDelay );
        else
            putValue( HMI__STMSG_SeatPosn_Abs_P_AR, 0 );
    }
}
/*@@end*/

/*@@envVar:HMI_SeatLgthHghtPosn_P_Vld:*/
on EnvVar HMI_SeatLgthHghtPosn_P_Vld
{
    _mSeatPosn_Abs_P_AR.SeatLgthHghtPosn_P_Vld.phys = getValue(this);
    _SeatPosn_Abs_P_AR_SpontanFlag = 1;
}
/*@@end*/

/*@@envVar:HMI_SeatLgthHghtPosnAbs_P:*/
on EnvVar HMI_SeatLgthHghtPosnAbs_P
{
    _mSeatPosn_Abs_P_AR.SeatLgthHghtPosnAbs_P.phys = getValue(this);
    _SeatPosn_Abs_P_AR_SpontanFlag = 1;
}
/*@@end*/

/*@@envVar:HMI_SeatLgthHghtPosnRel_P:*/
on EnvVar HMI_SeatLgthHghtPosnRel_P
{
    _mSeatPosn_Abs_P_AR.SeatLgthHghtPosnRel_P.phys = getValue(this);
    _SeatPosn_Abs_P_AR_SpontanFlag = 1;
}
/*@@end*/

/*@@envVar:HMI_SeatLgthPosn_P_Vld:*/
on EnvVar HMI_SeatLgthPosn_P_Vld
{
    _mSeatPosn_Abs_P_AR.SeatLgthPosn_P_Vld.phys = getValue(this);
    _SeatPosn_Abs_P_AR_SpontanFlag = 1;
}
/*@@end*/

/*@@envVar:HMI_SeatLgthPosnAbs_P:*/
on EnvVar HMI_SeatLgthPosnAbs_P
{
    _mSeatPosn_Abs_P_AR.SeatLgthPosnAbs_P.phys = getValue(this);
    _SeatPosn_Abs_P_AR_SpontanFlag = 1;
}
/*@@end*/

/*@@envVar:HMI_SeatLgthPosnRel_P:*/
on EnvVar HMI_SeatLgthPosnRel_P
{
    _mSeatPosn_Abs_P_AR.SeatLgthPosnRel_P.phys = getValue(this);
    _SeatPosn_Abs_P_AR_SpontanFlag = 1;
}
/*@@end*/

/*@@caplFunc:SND_GEN_Stat_AR_check_output():*/
SND_GEN_Stat_AR_check_output()
{
    if( !getValue( HMI__STMSG_SND_GEN_Stat_AR ) )
    {
        // Botschaft SND_GEN_Stat_AR ID: 1210 --- Sendeart 5 cyclicAndSpontanWithDelay --- 
        if( _SND_GEN_Stat_AR_DelayCnt > 0) _SND_GEN_Stat_AR_DelayCnt--; // Mindestsendeabstand
        _SND_GEN_Stat_AR_Cnt--;
        if( _SND_GEN_Stat_AR_Cnt < 1 )
        {
            if( _SND_GEN_Stat_AR_DelayCnt < 1 )
            {
                // Nachricht wg. abgelaufenem Zyklus ausgeben (Mindestsendeabstand eingehalten)
                SND_GEN_Stat_AR_output();
                _SND_GEN_Stat_AR_SpontanFlag = 0; // Spontan-Flag zurücksetzen
                _SND_GEN_Stat_AR_DelayCnt = _SND_GEN_Stat_AR_MinDelay;
            }
            else
            {
                // Spontanflag setzen damit nach Ablauf Mindestsendeabstand gesendet wird
                 _SND_GEN_Stat_AR_SpontanFlag = 1;
            }
            _SND_GEN_Stat_AR_Cnt = _SND_GEN_Stat_AR_CycleCount; // Zyklus-Zähler zurücksetzen
        }
        else if( _SND_GEN_Stat_AR_SpontanFlag)
        {
            if( _SND_GEN_Stat_AR_DelayCnt < 1 )
            {
                // Nachricht wg. spontaner Änderung ausgeben (Mindestsendeabstand eingehalten)
                SND_GEN_Stat_AR_output();
                _SND_GEN_Stat_AR_SpontanFlag = 0; // Spontan-Flag zurücksetzen
                _SND_GEN_Stat_AR_DelayCnt = _SND_GEN_Stat_AR_MinDelay;
            }
        }
    }
}
/*@@end*/

/*@@caplFunc:SND_GEN_Stat_AR_init():*/
SND_GEN_Stat_AR_init()
{   /* Botschaft SND_GEN_Stat_AR ID: 1210 --- Sendeart 5 cyclicAndSpontanWithDelay --- 
BA_ "ApplMessage" BO_ 1210 0;
BA_ "NmAsrMessage" BO_ 1210 0;
BA_ "GenMsgMinAcceptLength" BO_ 1210 1;
BA_ "GenMsgILSupport" BO_ 1210 1;
BA_ "DiagState" BO_ 1210 0;
BA_ "DiagRequest" BO_ 1210 0;
BA_ "DiagResponse" BO_ 1210 0;
BA_ "GenMsgStartValue" BO_ 1210 "0";
BA_ "GenMsgDelayTime" BO_ 1210 100;
BA_ "GenMsgNrOfRepetitions" BO_ 1210 0;
BA_ "GenMsgCycleTime" BO_ 1210 600;
BA_ "GenMsgSendType" BO_ 1210 5;
    */
    _SND_GEN_Stat_AR_Timebase =            c_tDBKomTimer_20ms;
    _SND_GEN_Stat_AR_CycleCount =         600 / _SND_GEN_Stat_AR_Timebase;
    _SND_GEN_Stat_AR_StartDelay =           0 / _SND_GEN_Stat_AR_Timebase;
    _SND_GEN_Stat_AR_MinDelay =           100 / _SND_GEN_Stat_AR_Timebase;
    _SND_GEN_Stat_AR_Cnt = _SND_GEN_Stat_AR_StartDelay;
    _SND_GEN_Stat_AR_SpontanFlag = 0;
    _SND_GEN_Stat_AR_DelayCnt = 0;
    
    putValue( HMI__STMSGSD_SND_GEN_Stat_AR, _SND_GEN_Stat_AR_StartDelay * _SND_GEN_Stat_AR_Timebase );

    _mSND_GEN_Stat_AR.SND_GEN_Err.phys = getValue( HMI_SND_GEN_Err );
    _mSND_GEN_Stat_AR.SND_GEN_Md_Stat.phys = getValue( HMI_SND_GEN_Md_Stat );
}
/*@@end*/

/*@@caplFunc:SND_GEN_Stat_AR_output():*/
SND_GEN_Stat_AR_output()
{
    output( _mSND_GEN_Stat_AR );
}
/*@@end*/

/*@@caplFunc:SND_GEN_Stat_AR_saveEnvVars(dword):*/
SND_GEN_Stat_AR_saveEnvVars( dword hFile )
{
    filePutString("\n// Knoten EIS: SND_GEN_Stat_AR\n", 37, hFile );
    snprintf( buffer, elcount( buffer ), "0.0000 HMI__STMSG_SND_GEN_Stat_AR := %X\n", getValue( HMI__STMSG_SND_GEN_Stat_AR ) );        filePutString( buffer, elcount( buffer ), hFile );
    snprintf( buffer, elcount( buffer ), "0.0000 HMI__STMSGT_SND_GEN_Stat_AR := %X\n", getValue( HMI__STMSGT_SND_GEN_Stat_AR ) );        filePutString( buffer, elcount( buffer ), hFile );
    snprintf( buffer, elcount( buffer ), "0.0000 HMI_SND_GEN_Err := %X\n", getValue( HMI_SND_GEN_Err ) );        filePutString( buffer, elcount( buffer ), hFile );
    snprintf( buffer, elcount( buffer ), "0.0000 HMI_SND_GEN_Md_Stat := %X\n", getValue( HMI_SND_GEN_Md_Stat ) );        filePutString( buffer, elcount( buffer ), hFile );
}
/*@@end*/

/*@@timer:_tSND_GEN_Stat_AR:*/
on timer _tSND_GEN_Stat_AR
{
    putValue( HMI__STMSG_SND_GEN_Stat_AR, 0 );
}
/*@@end*/

/*@@envVar:HMI__STMSG_SND_GEN_Stat_AR:*/
on EnvVar HMI__STMSG_SND_GEN_Stat_AR
{
    long tDelay;
    if( getValue( this ) == 2 )
    {
        tDelay = getValue( HMI__STMSGT_SND_GEN_Stat_AR );
        if( tDelay > 0)    
            setTimer( _tSND_GEN_Stat_AR, tDelay );
        else
            putValue( HMI__STMSG_SND_GEN_Stat_AR, 0 );
    }
}
/*@@end*/

/*@@envVar:HMI_SND_GEN_Err:*/
on EnvVar HMI_SND_GEN_Err
{
    _mSND_GEN_Stat_AR.SND_GEN_Err.phys = getValue(this);
    _SND_GEN_Stat_AR_SpontanFlag = 1;
}
/*@@end*/

/*@@envVar:HMI_SND_GEN_Md_Stat:*/
on EnvVar HMI_SND_GEN_Md_Stat
{
    _mSND_GEN_Stat_AR.SND_GEN_Md_Stat.phys = getValue(this);
    _SND_GEN_Stat_AR_SpontanFlag = 1;
}
/*@@end*/

/*@@caplFunc:SPC_Disp_Rq_AR_check_output():*/
SPC_Disp_Rq_AR_check_output()
{
    if( !getValue( HMI__STMSG_SPC_Disp_Rq_AR ) )
    {
        // Botschaft SPC_Disp_Rq_AR ID: 635--- Sendeart 0 cyclicX --- 
        _SPC_Disp_Rq_AR_Cnt--;
        if( _SPC_Disp_Rq_AR_Cnt < 1 )
        {
            SPC_Disp_Rq_AR_output(); // Nachricht wg. abgelaufenem Zyklus ausgeben
            _SPC_Disp_Rq_AR_Cnt = _SPC_Disp_Rq_AR_CycleCount; // Zyklus-Zähler zurücksetzen
        }
    }
}
/*@@end*/

/*@@caplFunc:SPC_Disp_Rq_AR_init():*/
SPC_Disp_Rq_AR_init()
{   /* Botschaft SPC_Disp_Rq_AR  ID: 635 --- Sendeart 0 cyclicX --- 
BA_ "ApplMessage" BO_ 635 0;
BA_ "NmAsrMessage" BO_ 635 0;
BA_ "GenMsgMinAcceptLength" BO_ 635 8;
BA_ "GenMsgILSupport" BO_ 635 1;
BA_ "DiagState" BO_ 635 0;
BA_ "DiagRequest" BO_ 635 0;
BA_ "DiagResponse" BO_ 635 0;
BA_ "GenMsgStartValue" BO_ 635 "0";
BA_ "GenMsgCycleTime" BO_ 635 200;
BA_ "GenMsgSendType" BO_ 635 0;
    */
    _SPC_Disp_Rq_AR_Timebase =            c_tDBKomTimer_5ms;
    _SPC_Disp_Rq_AR_CycleCount =        200 / _SPC_Disp_Rq_AR_Timebase;
    _SPC_Disp_Rq_AR_StartDelay =          0 / _SPC_Disp_Rq_AR_Timebase;
    _SPC_Disp_Rq_AR_Cnt = _SPC_Disp_Rq_AR_StartDelay;

    putValue( HMI__STMSGSD_SPC_Disp_Rq_AR, _SPC_Disp_Rq_AR_StartDelay * _SPC_Disp_Rq_AR_Timebase );
   
    _mSPC_Disp_Rq_AR.DampRatio_FL_Disp_Rq.phys = getValue( HMI_DampRatio_FL_Disp_Rq );
    _mSPC_Disp_Rq_AR.DampRatio_FR_Disp_Rq.phys = getValue( HMI_DampRatio_FR_Disp_Rq );
    _mSPC_Disp_Rq_AR.DampRatio_RL_Disp_Rq.phys = getValue( HMI_DampRatio_RL_Disp_Rq );
    _mSPC_Disp_Rq_AR.DampRatio_RR_Disp_Rq.phys = getValue( HMI_DampRatio_RR_Disp_Rq );
}
/*@@end*/

/*@@caplFunc:SPC_Disp_Rq_AR_output():*/
SPC_Disp_Rq_AR_output(void)
{
    output( _mSPC_Disp_Rq_AR );
}
/*@@end*/

/*@@caplFunc:SPC_Disp_Rq_AR_saveEnvVars(dword):*/
SPC_Disp_Rq_AR_saveEnvVars(dword hFile )
{
    filePutString("\n// Knoten EIS: SPC_Disp_Rq_AR\n", 33, hFile );
    snprintf( buffer, elcount( buffer ), "0.0000 HMI__STMSG_SPC_Disp_Rq_AR := %X\n", getValue( HMI__STMSG_SPC_Disp_Rq_AR ) );        filePutString( buffer, elcount( buffer ), hFile );
    snprintf( buffer, elcount( buffer ), "0.0000 HMI__STMSGT_SPC_Disp_Rq_AR := %X\n", getValue( HMI__STMSGT_SPC_Disp_Rq_AR ) );        filePutString( buffer, elcount( buffer ), hFile );
    snprintf( buffer, elcount( buffer ), "0.0000 HMI_DampRatio_FL_Disp_Rq := %X\n", getValue( HMI_DampRatio_FL_Disp_Rq ) );        filePutString( buffer, elcount( buffer ), hFile );
    snprintf( buffer, elcount( buffer ), "0.0000 HMI_DampRatio_FR_Disp_Rq := %X\n", getValue( HMI_DampRatio_FR_Disp_Rq ) );        filePutString( buffer, elcount( buffer ), hFile );
    snprintf( buffer, elcount( buffer ), "0.0000 HMI_DampRatio_RL_Disp_Rq := %X\n", getValue( HMI_DampRatio_RL_Disp_Rq ) );        filePutString( buffer, elcount( buffer ), hFile );
    snprintf( buffer, elcount( buffer ), "0.0000 HMI_DampRatio_RR_Disp_Rq := %X\n", getValue( HMI_DampRatio_RR_Disp_Rq ) );        filePutString( buffer, elcount( buffer ), hFile );
}
/*@@end*/

/*@@timer:_tSPC_Disp_Rq_AR:*/
on timer _tSPC_Disp_Rq_AR
{
    putValue( HMI__STMSG_SPC_Disp_Rq_AR, 0 );
}
/*@@end*/

/*@@envVar:HMI__STMSG_SPC_Disp_Rq_AR:*/
on EnvVar HMI__STMSG_SPC_Disp_Rq_AR
{
    long tDelay;
    if( getValue( this ) == 2 )
    {
        tDelay = getValue( HMI__STMSGT_SPC_Disp_Rq_AR );
        if( tDelay > 0)    
            setTimer( _tSPC_Disp_Rq_AR, tDelay );
        else
            putValue( HMI__STMSG_SPC_Disp_Rq_AR, 0 );
    }
}
/*@@end*/

/*@@envVar:HMI_DampRatio_FL_Disp_Rq:*/
on EnvVar HMI_DampRatio_FL_Disp_Rq
{
    _mSPC_Disp_Rq_AR.DampRatio_FL_Disp_Rq.phys = getValue(this);
}
/*@@end*/

/*@@envVar:HMI_DampRatio_FR_Disp_Rq:*/
on EnvVar HMI_DampRatio_FR_Disp_Rq
{
    _mSPC_Disp_Rq_AR.DampRatio_FR_Disp_Rq.phys = getValue(this);
}
/*@@end*/

/*@@envVar:HMI_DampRatio_RL_Disp_Rq:*/
on EnvVar HMI_DampRatio_RL_Disp_Rq
{
    _mSPC_Disp_Rq_AR.DampRatio_RL_Disp_Rq.phys = getValue(this);
}
/*@@end*/

/*@@envVar:HMI_DampRatio_RR_Disp_Rq:*/
on EnvVar HMI_DampRatio_RR_Disp_Rq
{
    _mSPC_Disp_Rq_AR.DampRatio_RR_Disp_Rq.phys = getValue(this);
}
/*@@end*/

/*@@caplFunc:SPC_SwLED_Msg_Rq_AR_check_output():*/
SPC_SwLED_Msg_Rq_AR_check_output()
{
    if( !getValue( HMI__STMSG_SPC_SwLED_Msg_Rq_AR ) )
    {
        // Botschaft SPC_SwLED_Msg_Rq_AR --- Sendeart 5 cyclicAndSpontanWithDelay --- 
        _SPC_SwLED_Msg_Rq_AR_Cnt--;
        if( _SPC_SwLED_Msg_Rq_AR_Cnt < 1 )
        {
            // Nachricht wg. abgelaufenem Zyklus ausgeben
            SPC_SwLED_Msg_Rq_AR_output();
            _SPC_SwLED_Msg_Rq_AR_Cnt = _SPC_SwLED_Msg_Rq_AR_CycleCount; // Zyklus-Zähler zurücksetzen
            _SPC_SwLED_Msg_Rq_AR_SpontanFlag = 0; // Spontan-Flag zurücksetzen
        }
        else if( _SPC_SwLED_Msg_Rq_AR_SpontanFlag)
        {
            SPC_SwLED_Msg_Rq_AR_output(); // Nachricht wg. spontaner Änderung ausgeben
            _SPC_SwLED_Msg_Rq_AR_SpontanFlag = 0; // Spontan-Flag zurücksetzen
        }
    }
}
/*@@end*/

/*@@caplFunc:SPC_SwLED_Msg_Rq_AR_init():*/
SPC_SwLED_Msg_Rq_AR_init()
{   /* Botschaft SPC_SwLED_Msg_Rq_AR ID: 1083 --- Sendeart 5 cyclicAndSpontanWithDelay --- 
BA_ "ApplMessage" BO_ 1083 0;
BA_ "NmAsrMessage" BO_ 1083 0;
BA_ "GenMsgMinAcceptLength" BO_ 1083 8;
BA_ "GenMsgILSupport" BO_ 1083 1;
BA_ "DiagState" BO_ 1083 0;
BA_ "DiagRequest" BO_ 1083 0;
BA_ "DiagResponse" BO_ 1083 0;
BA_ "GenMsgStartValue" BO_ 1083 "0";
BA_ "GenMsgDelayTime" BO_ 1083 20;
BA_ "GenMsgNrOfRepetitions" BO_ 1083 0;
BA_ "GenMsgCycleTime" BO_ 1083 200;
BA_ "GenMsgSendType" BO_ 1083 5;
    */
    _SPC_SwLED_Msg_Rq_AR_Timebase =      c_tDBKomTimer_20ms;
    _SPC_SwLED_Msg_Rq_AR_CycleCount =    200 / _SPC_SwLED_Msg_Rq_AR_Timebase;
    _SPC_SwLED_Msg_Rq_AR_StartDelay =      0 / _SPC_SwLED_Msg_Rq_AR_Timebase;
    _SPC_SwLED_Msg_Rq_AR_Cnt = _SPC_SwLED_Msg_Rq_AR_StartDelay;
    _SPC_SwLED_Msg_Rq_AR_SpontanFlag = 0;

    putValue( HMI__STMSGSD_SPC_SwLED_Msg_Rq_AR, _SPC_SwLED_Msg_Rq_AR_StartDelay * _SPC_SwLED_Msg_Rq_AR_Timebase );


    _mSPC_SwLED_Msg_Rq_AR.ADC_SwLED_Rq_V2.phys = getValue( HMI_ADC_SwLED_Rq_V2 );
    _mSPC_SwLED_Msg_Rq_AR.DPC_Md_Susp_Rs_V2.phys = getValue( HMI_DPC_Md_Susp_Rs_V2 );
    _mSPC_SwLED_Msg_Rq_AR.Preview_Stat_Disp_Rq.phys = getValue( HMI_Preview_Stat_Disp_Rq );
    _mSPC_SwLED_Msg_Rq_AR.Rsrv1_SPC_Msg_Rq.phys = getValue( HMI_Rsrv1_SPC_Msg_Rq );
    _mSPC_SwLED_Msg_Rq_AR.SPC_ErrMsg1_Disp_Rq_V2.phys = getValue( HMI_SPC_ErrMsg1_Disp_Rq_V2 );
    _mSPC_SwLED_Msg_Rq_AR.SPC_ErrMsg2_Disp_Rq_V2.phys = getValue( HMI_SPC_ErrMsg2_Disp_Rq_V2 );
    _mSPC_SwLED_Msg_Rq_AR.SPC_ErrMsg3_Disp_Rq_V2.phys = getValue( HMI_SPC_ErrMsg3_Disp_Rq_V2 );
    _mSPC_SwLED_Msg_Rq_AR.SPC_ErrMsg4_Disp_Rq_V2.phys = getValue( HMI_SPC_ErrMsg4_Disp_Rq_V2 );
    _mSPC_SwLED_Msg_Rq_AR.SPC_ErrMsg5_Disp_Rq_V2.phys = getValue( HMI_SPC_ErrMsg5_Disp_Rq_V2 );
    _mSPC_SwLED_Msg_Rq_AR.SPC_Flt_Stat.phys = getValue( HMI_SPC_Flt_Stat );
    _mSPC_SwLED_Msg_Rq_AR.SPC_Id.phys = getValue( HMI_SPC_Id );
    _mSPC_SwLED_Msg_Rq_AR.SPC_LvlMsg_Disp_Rq.phys = getValue( HMI_SPC_LvlMsg_Disp_Rq );
    _mSPC_SwLED_Msg_Rq_AR.SPC_LvlMsg_Disp_Rq_TrgRq.phys = getValue( HMI_SPC_LvlMsg_Disp_Rq_TrgRq );
    _mSPC_SwLED_Msg_Rq_AR.SPC_LvlMsg_NoCnfrm.phys = getValue( HMI_SPC_LvlMsg_NoCnfrm );
    _mSPC_SwLED_Msg_Rq_AR.SPC_Msg1_Disp_Rq.phys = getValue( HMI_SPC_Msg1_Disp_Rq );
    _mSPC_SwLED_Msg_Rq_AR.SPC_Msg2_Disp_Rq.phys = getValue( HMI_SPC_Msg2_Disp_Rq );
    _mSPC_SwLED_Msg_Rq_AR.SPC_Msg3_Disp_Rq.phys = getValue( HMI_SPC_Msg3_Disp_Rq );
    _mSPC_SwLED_Msg_Rq_AR.SPC_Msg4_Disp_Rq.phys = getValue( HMI_SPC_Msg4_Disp_Rq );
    _mSPC_SwLED_Msg_Rq_AR.SPC_Msg5_Disp_Rq.phys = getValue( HMI_SPC_Msg5_Disp_Rq );
    _mSPC_SwLED_Msg_Rq_AR.SPC_Msg6_Disp_Rq.phys = getValue( HMI_SPC_Msg6_Disp_Rq );
    _mSPC_SwLED_Msg_Rq_AR.SPC_Msg7_Disp_Rq.phys = getValue( HMI_SPC_Msg7_Disp_Rq );
    _mSPC_SwLED_Msg_Rq_AR.SPC_Msg13_Disp_Rq.phys = getValue( HMI_SPC_Msg13_Disp_Rq );
    _mSPC_SwLED_Msg_Rq_AR.SPC_WarnMsg_Disp_Rq.phys = getValue( HMI_SPC_WarnMsg_Disp_Rq );
    _mSPC_SwLED_Msg_Rq_AR.SuspLvlAdjSwLED_Rq.phys = getValue( HMI_SuspLvlAdjSwLED_Rq );
}
/*@@end*/

/*@@caplFunc:SPC_SwLED_Msg_Rq_AR_output():*/
SPC_SwLED_Msg_Rq_AR_output()
{
    byte crc;
    byte SQC_help;

    if( !getValue( HMI_SQC_SPC_Msg_Rq_Auto ) )
    {
        // berechne message counter
        SQC_help = getValue( HMI_SQC_SPC_Msg_Rq );
        if( SQC_help >= 15 ) SQC_help = 0;
        else SQC_help++;
        putValue( HMI_SQC_SPC_Msg_Rq, SQC_help );
        _mSPC_SwLED_Msg_Rq_AR.SQC_SPC_Msg_Rq = SQC_help;
    }
    else
          _mSPC_SwLED_Msg_Rq_AR.SQC_SPC_Msg_Rq = getValue( HMI_SQC_SPC_Msg_Rq );

    if( getValue( HMI_CRC_SPC_Msg_Rq_Profile_02 ) )
    {
        if( !getValue( HMI_CRC_SPC_Msg_Rq_Auto ) )
        {   // CRC according Profile_02 ( W213 )
            // berechne crc
            crc = 0xFF;
//          crc = crctable_profile02[ crc ^ _mSPC_SwLED_Msg_Rq_AR.byte( 0 ) ];  CRC
            crc = crctable_profile02[ crc ^ _mSPC_SwLED_Msg_Rq_AR.byte( 1 ) ];
            crc = crctable_profile02[ crc ^ _mSPC_SwLED_Msg_Rq_AR.byte( 2 ) ];
            crc = crctable_profile02[ crc ^ _mSPC_SwLED_Msg_Rq_AR.byte( 3 ) ];
            // crc = crctable_profile02[ crc ^ _mSPC_SwLED_Msg_Rq_AR.byte( 4 ) ];
            // crc = crctable_profile02[ crc ^ _mSPC_SwLED_Msg_Rq_AR.byte( 5 ) ];
            // crc = crctable_profile02[ crc ^ _mSPC_SwLED_Msg_Rq_AR.byte( 6 ) ];
            // crc = crctable_profile02[ crc ^ _mSPC_SwLED_Msg_Rq_AR.byte( 7 ) ];
            crc = crctable_profile02[ crc ^ _SPC_SwLED_Msg_Rq_AR_CRC_Offset[ _mSPC_SwLED_Msg_Rq_AR.SQC_SPC_Msg_Rq ] ]; // load offset
            crc = (crc ^ 0xFF);
            if( getValue(  HMI_CRC_SPC_Msg_Rq_Invalid ) )
                crc++;
            _mSPC_SwLED_Msg_Rq_AR.CRC_SPC_Msg_Rq = crc;
            putValue( HMI_CRC_SPC_Msg_Rq, crc );
        }
        else
            _mSPC_SwLED_Msg_Rq_AR.CRC_SPC_Msg_Rq = getValue( HMI_CRC_SPC_Msg_Rq );
    }
    else
    {
        if( !getValue( HMI_CRC_SPC_Msg_Rq_Auto ) )
        {   // CRC according to SAE1850 ( W222 )
            // berechne crc
            crc = 0xFF;
//            crc = crctable[crc ^ _mSPC_SwLED_Msg_Rq_AR.byte( 0 )];  CRC
            crc = crctable[crc ^ _mSPC_SwLED_Msg_Rq_AR.byte( 1 )];
            crc = crctable[crc ^ _mSPC_SwLED_Msg_Rq_AR.byte( 2 )];
            crc = crctable[crc ^ _mSPC_SwLED_Msg_Rq_AR.byte( 3 )];
            // crc = crctable[crc ^ _mSPC_SwLED_Msg_Rq_AR.byte( 4 )];
            // crc = crctable[crc ^ _mSPC_SwLED_Msg_Rq_AR.byte( 5 )];
            // crc = crctable[crc ^ _mSPC_SwLED_Msg_Rq_AR.byte( 6 )];
            // crc = crctable[crc ^ _mSPC_SwLED_Msg_Rq_AR.byte( 7 )];
            crc = (crc ^ 0xFF);
            if( getValue(  HMI_CRC_SPC_Msg_Rq_Invalid ) )
                crc++;
            _mSPC_SwLED_Msg_Rq_AR.CRC_SPC_Msg_Rq = crc;
            putValue( HMI_CRC_SPC_Msg_Rq, crc );
        }
        else
            _mSPC_SwLED_Msg_Rq_AR.CRC_SPC_Msg_Rq = getValue( HMI_CRC_SPC_Msg_Rq );
    }
    output( _mSPC_SwLED_Msg_Rq_AR );
}
/*@@end*/

/*@@caplFunc:SPC_SwLED_Msg_Rq_AR_saveEnvVars(dword):*/
SPC_SwLED_Msg_Rq_AR_saveEnvVars( dword hFile )
{
    filePutString("\n// Knoten EIS: SPC_SwLED_Msg_Rq_AR\n", 37, hFile );
    snprintf( buffer, elcount( buffer ), "0.0000 HMI__STMSG_ESPC_SwLED_Msg_Rq_HMI := %X\n", getValue( HMI__STMSG_SPC_SwLED_Msg_Rq_AR ) );        filePutString( buffer, elcount( buffer ), hFile );
    snprintf( buffer, elcount( buffer ), "0.0000 HMI__STMSGT_SPC_SwLED_Msg_Rq_HMI := %X\n", getValue( HMI__STMSGT_SPC_SwLED_Msg_Rq_AR ) );        filePutString( buffer, elcount( buffer ), hFile );
    snprintf( buffer, elcount( buffer ), "0.0000 HMI_ADC_SwLED_Rq_V2 := %X\n", getValue( HMI_ADC_SwLED_Rq_V2 ) );        filePutString( buffer, elcount( buffer ), hFile );
    snprintf( buffer, elcount( buffer ), "0.0000 HMI_DPC_Md_Susp_Rs_V2 := %X\n", getValue( HMI_DPC_Md_Susp_Rs_V2 ) );        filePutString( buffer, elcount( buffer ), hFile );
    snprintf( buffer, elcount( buffer ), "0.0000 HMI_Preview_Stat_Disp_Rq := %X\n", getValue( HMI_Preview_Stat_Disp_Rq ) );        filePutString( buffer, elcount( buffer ), hFile );
    snprintf( buffer, elcount( buffer ), "0.0000 HMI_Rsrv1_SPC_Msg_Rq := %X\n", getValue( HMI_Rsrv1_SPC_Msg_Rq ) );        filePutString( buffer, elcount( buffer ), hFile );
    snprintf( buffer, elcount( buffer ), "0.0000 HMI_SPC_ErrMsg1_Disp_Rq_V2 := %X\n", getValue( HMI_SPC_ErrMsg1_Disp_Rq_V2 ) );        filePutString( buffer, elcount( buffer ), hFile );
    snprintf( buffer, elcount( buffer ), "0.0000 HMI_SPC_ErrMsg2_Disp_Rq_V2 := %X\n", getValue( HMI_SPC_ErrMsg2_Disp_Rq_V2 ) );        filePutString( buffer, elcount( buffer ), hFile );
    snprintf( buffer, elcount( buffer ), "0.0000 HMI_SPC_ErrMsg3_Disp_Rq_V2 := %X\n", getValue( HMI_SPC_ErrMsg3_Disp_Rq_V2 ) );        filePutString( buffer, elcount( buffer ), hFile );
    snprintf( buffer, elcount( buffer ), "0.0000 HMI_SPC_ErrMsg4_Disp_Rq_V2 := %X\n", getValue( HMI_SPC_ErrMsg4_Disp_Rq_V2 ) );        filePutString( buffer, elcount( buffer ), hFile );
    snprintf( buffer, elcount( buffer ), "0.0000 HMI_SPC_ErrMsg5_Disp_Rq_V2 := %X\n", getValue( HMI_SPC_ErrMsg5_Disp_Rq_V2 ) );        filePutString( buffer, elcount( buffer ), hFile );
    snprintf( buffer, elcount( buffer ), "0.0000 HMI_SPC_Flt_Stat := %X\n", getValue( HMI_SPC_Flt_Stat ) );        filePutString( buffer, elcount( buffer ), hFile );
    snprintf( buffer, elcount( buffer ), "0.0000 HMI_SPC_Id := %X\n", getValue( HMI_SPC_Id ) );        filePutString( buffer, elcount( buffer ), hFile );
    snprintf( buffer, elcount( buffer ), "0.0000 HMI_SPC_LvlMsg_Disp_Rq := %X\n", getValue( HMI_SPC_LvlMsg_Disp_Rq ) );        filePutString( buffer, elcount( buffer ), hFile );
    snprintf( buffer, elcount( buffer ), "0.0000 HMI_SPC_LvlMsg_Disp_Rq_TrgRq := %X\n", getValue( HMI_SPC_LvlMsg_Disp_Rq_TrgRq ) );        filePutString( buffer, elcount( buffer ), hFile );
    snprintf( buffer, elcount( buffer ), "0.0000 HMI_SPC_LvlMsg_NoCnfrm := %X\n", getValue( HMI_SPC_LvlMsg_NoCnfrm ) );        filePutString( buffer, elcount( buffer ), hFile );
    snprintf( buffer, elcount( buffer ), "0.0000 HMI_SPC_Msg1_Disp_Rq := %X\n", getValue( HMI_SPC_Msg1_Disp_Rq ) );        filePutString( buffer, elcount( buffer ), hFile );
    snprintf( buffer, elcount( buffer ), "0.0000 HMI_SPC_Msg2_Disp_Rq := %X\n", getValue( HMI_SPC_Msg2_Disp_Rq ) );        filePutString( buffer, elcount( buffer ), hFile );
    snprintf( buffer, elcount( buffer ), "0.0000 HMI_SPC_Msg3_Disp_Rq := %X\n", getValue( HMI_SPC_Msg3_Disp_Rq ) );        filePutString( buffer, elcount( buffer ), hFile );
    snprintf( buffer, elcount( buffer ), "0.0000 HMI_SPC_Msg4_Disp_Rq := %X\n", getValue( HMI_SPC_Msg4_Disp_Rq ) );        filePutString( buffer, elcount( buffer ), hFile );
    snprintf( buffer, elcount( buffer ), "0.0000 HMI_SPC_Msg5_Disp_Rq := %X\n", getValue( HMI_SPC_Msg5_Disp_Rq ) );        filePutString( buffer, elcount( buffer ), hFile );
    snprintf( buffer, elcount( buffer ), "0.0000 HMI_SPC_Msg6_Disp_Rq := %X\n", getValue( HMI_SPC_Msg6_Disp_Rq ) );        filePutString( buffer, elcount( buffer ), hFile );
    snprintf( buffer, elcount( buffer ), "0.0000 HMI_SPC_Msg7_Disp_Rq := %X\n", getValue( HMI_SPC_Msg7_Disp_Rq ) );        filePutString( buffer, elcount( buffer ), hFile );
    snprintf( buffer, elcount( buffer ), "0.0000 HMI_SPC_Msg13_Disp_Rq := %X\n", getValue( HMI_SPC_Msg13_Disp_Rq ) );        filePutString( buffer, elcount( buffer ), hFile );
    snprintf( buffer, elcount( buffer ), "0.0000 HMI_SPC_WarnMsg_Disp_Rq := %X\n", getValue( HMI_SPC_WarnMsg_Disp_Rq ) );        filePutString( buffer, elcount( buffer ), hFile );
    snprintf( buffer, elcount( buffer ), "0.0000 HMI_SuspLvlAdjSwLED_Rq := %X\n", getValue( HMI_SuspLvlAdjSwLED_Rq ) );        filePutString( buffer, elcount( buffer ), hFile );
}
/*@@end*/

/*@@timer:_tSPC_SwLED_Msg_Rq_AR:*/
on timer _tSPC_SwLED_Msg_Rq_AR
{
    putValue( HMI__STMSG_SPC_SwLED_Msg_Rq_AR, 0 );
}
/*@@end*/

/*@@envVar:HMI__STMSG_SPC_SwLED_Msg_Rq_AR:*/
on EnvVar HMI__STMSG_SPC_SwLED_Msg_Rq_AR
{
    long tDelay;
    if( getValue( this ) == 2 )
    {
        tDelay = getValue( HMI__STMSGT_SPC_SwLED_Msg_Rq_AR );
        if( tDelay > 0)    
            setTimer( _tSPC_SwLED_Msg_Rq_AR, tDelay );
        else
            putValue( HMI__STMSG_SPC_SwLED_Msg_Rq_AR, 0 );
    }
}
/*@@end*/

/*@@envVar:HMI_ADC_SwLED_Rq_V2:*/
on EnvVar HMI_ADC_SwLED_Rq_V2
{
    _mSPC_SwLED_Msg_Rq_AR.ADC_SwLED_Rq_V2.phys = getValue(this);
    _SPC_SwLED_Msg_Rq_AR_SpontanFlag = 1;
}
/*@@end*/

/*@@envVar:HMI_DPC_Md_Susp_Rs_V2:*/
on EnvVar HMI_DPC_Md_Susp_Rs_V2
{
    _mSPC_SwLED_Msg_Rq_AR.DPC_Md_Susp_Rs_V2.phys = getValue(this);
    _SPC_SwLED_Msg_Rq_AR_SpontanFlag = 1;
}
/*@@end*/

/*@@envVar:HMI_Preview_Stat_Disp_Rq:*/
on EnvVar HMI_Preview_Stat_Disp_Rq
{
    _mSPC_SwLED_Msg_Rq_AR.Preview_Stat_Disp_Rq.phys = getValue(this);
    _SPC_SwLED_Msg_Rq_AR_SpontanFlag = 1;
}
/*@@end*/

/*@@envVar:HMI_Rsrv1_SPC_Msg_Rq:*/
on EnvVar HMI_Rsrv1_SPC_Msg_Rq
{
    _mSPC_SwLED_Msg_Rq_AR.Rsrv1_SPC_Msg_Rq.phys = getValue(this);
    _SPC_SwLED_Msg_Rq_AR_SpontanFlag = 1;
}
/*@@end*/

/*@@envVar:HMI_SPC_ECU_Stat:*/
on EnvVar HMI_SPC_ECU_Stat
{
    _mSPC_SwLED_Msg_Rq_AR.SPC_ECU_Stat.phys = getValue(this);
    _SPC_SwLED_Msg_Rq_AR_SpontanFlag = 1;
}
/*@@end*/

/*@@envVar:HMI_SPC_ErrMsg1_Disp_Rq_V2:*/
on EnvVar HMI_SPC_ErrMsg1_Disp_Rq_V2
{
    _mSPC_SwLED_Msg_Rq_AR.SPC_ErrMsg1_Disp_Rq_V2.phys = getValue(this);
    _SPC_SwLED_Msg_Rq_AR_SpontanFlag = 1;
}
/*@@end*/

/*@@envVar:HMI_SPC_ErrMsg2_Disp_Rq_V2:*/
on EnvVar HMI_SPC_ErrMsg2_Disp_Rq_V2
{
    _mSPC_SwLED_Msg_Rq_AR.SPC_ErrMsg2_Disp_Rq_V2.phys = getValue(this);
    _SPC_SwLED_Msg_Rq_AR_SpontanFlag = 1;
}
/*@@end*/

/*@@envVar:HMI_SPC_ErrMsg3_Disp_Rq_V2:*/
on EnvVar HMI_SPC_ErrMsg3_Disp_Rq_V2
{
    _mSPC_SwLED_Msg_Rq_AR.SPC_ErrMsg3_Disp_Rq_V2.phys = getValue(this);
    _SPC_SwLED_Msg_Rq_AR_SpontanFlag = 1;
}
/*@@end*/

/*@@envVar:HMI_SPC_ErrMsg4_Disp_Rq_V2:*/
on EnvVar HMI_SPC_ErrMsg4_Disp_Rq_V2
{
    _mSPC_SwLED_Msg_Rq_AR.SPC_ErrMsg4_Disp_Rq_V2.phys = getValue(this);
    _SPC_SwLED_Msg_Rq_AR_SpontanFlag = 1;
}
/*@@end*/

/*@@envVar:HMI_SPC_ErrMsg5_Disp_Rq_V2:*/
on EnvVar HMI_SPC_ErrMsg5_Disp_Rq_V2
{
    _mSPC_SwLED_Msg_Rq_AR.SPC_ErrMsg5_Disp_Rq_V2.phys = getValue(this);
    _SPC_SwLED_Msg_Rq_AR_SpontanFlag = 1;
}
/*@@end*/

/*@@envVar:HMI_SPC_Flt_Stat:*/
on EnvVar HMI_SPC_Flt_Stat
{
    _mSPC_SwLED_Msg_Rq_AR.SPC_Flt_Stat.phys = getValue(this);
    _SPC_SwLED_Msg_Rq_AR_SpontanFlag = 1;
}
/*@@end*/

/*@@envVar:HMI_SPC_Id:*/
on EnvVar HMI_SPC_Id
{
    _mSPC_SwLED_Msg_Rq_AR.SPC_Id.phys = getValue(this);
    _SPC_SwLED_Msg_Rq_AR_SpontanFlag = 1;
}
/*@@end*/

/*@@envVar:HMI_SPC_LvlMsg_Disp_Rq:*/
on EnvVar HMI_SPC_LvlMsg_Disp_Rq
{
    _mSPC_SwLED_Msg_Rq_AR.SPC_LvlMsg_Disp_Rq.phys = getValue(this);
    _SPC_SwLED_Msg_Rq_AR_SpontanFlag = 1;
}
/*@@end*/

/*@@envVar:HMI_SPC_LvlMsg_Disp_Rq_TrgRq:*/
on EnvVar HMI_SPC_LvlMsg_Disp_Rq_TrgRq
{
    _mSPC_SwLED_Msg_Rq_AR.SPC_LvlMsg_Disp_Rq_TrgRq.phys = getValue(this);
    _SPC_SwLED_Msg_Rq_AR_SpontanFlag = 1;
}
/*@@end*/

/*@@envVar:HMI_SPC_LvlMsg_NoCnfrm:*/
on EnvVar HMI_SPC_LvlMsg_NoCnfrm
{
    _mSPC_SwLED_Msg_Rq_AR.SPC_LvlMsg_NoCnfrm.phys = getValue(this);
    _SPC_SwLED_Msg_Rq_AR_SpontanFlag = 1;
}
/*@@end*/

/*@@envVar:HMI_SPC_Msg1_Disp_Rq:*/
on EnvVar HMI_SPC_Msg1_Disp_Rq
{
    _mSPC_SwLED_Msg_Rq_AR.SPC_Msg1_Disp_Rq.phys = getValue(this);
    _SPC_SwLED_Msg_Rq_AR_SpontanFlag = 1;
}
/*@@end*/

/*@@envVar:HMI_SPC_Msg2_Disp_Rq:*/
on EnvVar HMI_SPC_Msg2_Disp_Rq
{
    _mSPC_SwLED_Msg_Rq_AR.SPC_Msg2_Disp_Rq.phys = getValue(this);
    _SPC_SwLED_Msg_Rq_AR_SpontanFlag = 1;
}
/*@@end*/

/*@@envVar:HMI_SPC_Msg3_Disp_Rq:*/
on EnvVar HMI_SPC_Msg3_Disp_Rq
{
    _mSPC_SwLED_Msg_Rq_AR.SPC_Msg3_Disp_Rq.phys = getValue(this);
    _SPC_SwLED_Msg_Rq_AR_SpontanFlag = 1;
}
/*@@end*/

/*@@envVar:HMI_SPC_Msg4_Disp_Rq:*/
on EnvVar HMI_SPC_Msg4_Disp_Rq
{
    _mSPC_SwLED_Msg_Rq_AR.SPC_Msg4_Disp_Rq.phys = getValue(this);
    _SPC_SwLED_Msg_Rq_AR_SpontanFlag = 1;
}
/*@@end*/

/*@@envVar:HMI_SPC_Msg5_Disp_Rq:*/
on EnvVar HMI_SPC_Msg5_Disp_Rq
{
    _mSPC_SwLED_Msg_Rq_AR.SPC_Msg5_Disp_Rq.phys = getValue(this);
    _SPC_SwLED_Msg_Rq_AR_SpontanFlag = 1;
}
/*@@end*/

/*@@envVar:HMI_SPC_Msg6_Disp_Rq:*/
on EnvVar HMI_SPC_Msg6_Disp_Rq
{
    _mSPC_SwLED_Msg_Rq_AR.SPC_Msg6_Disp_Rq.phys = getValue(this);
    _SPC_SwLED_Msg_Rq_AR_SpontanFlag = 1;
}
/*@@end*/

/*@@envVar:HMI_SPC_Msg7_Disp_Rq:*/
on EnvVar HMI_SPC_Msg7_Disp_Rq
{
    _mSPC_SwLED_Msg_Rq_AR.SPC_Msg7_Disp_Rq.phys = getValue(this);
    _SPC_SwLED_Msg_Rq_AR_SpontanFlag = 1;
}
/*@@end*/

/*@@envVar:HMI_SPC_Msg13_Disp_Rq:*/
on EnvVar HMI_SPC_Msg13_Disp_Rq
{
    _mSPC_SwLED_Msg_Rq_AR.SPC_Msg13_Disp_Rq.phys = getValue(this);
    _SPC_SwLED_Msg_Rq_AR_SpontanFlag = 1;
}
/*@@end*/

/*@@envVar:HMI_SPC_WarnMsg_Disp_Rq:*/
on EnvVar HMI_SPC_WarnMsg_Disp_Rq
{
    _mSPC_SwLED_Msg_Rq_AR.SPC_WarnMsg_Disp_Rq.phys = getValue(this);
    _SPC_SwLED_Msg_Rq_AR_SpontanFlag = 1;
}
/*@@end*/

/*@@envVar:HMI_SuspLvlAdjSwLED_Rq:*/
on EnvVar HMI_SuspLvlAdjSwLED_Rq
{
    _mSPC_SwLED_Msg_Rq_AR.SuspLvlAdjSwLED_Rq.phys = getValue(this);
    _SPC_SwLED_Msg_Rq_AR_SpontanFlag = 1;
}
/*@@end*/

/*@@caplFunc:SPV_Rq_AR_Activity(int):*/
void SPV_Rq_AR_Activity(int active )
{
    if( active )
    {
        if( _SPV_Rq_AR_SigActivity == 0)
            _SPV_Rq_AR_Cnt = 1;
        _SPV_Rq_AR_SigActivity++;
    }
    else
    {
        _SPV_Rq_AR_SigActivity--;
    }
}
/*@@end*/

/*@@caplFunc:SPV_Rq_AR_Change(int,int,int):*/
int SPV_Rq_AR_Change(int lastValue, int sigValue, int inActValue )
{
    bActiveHelper = (sigValue != inActValue );
      if( !lastValue && bActiveHelper )
        SPV_Rq_AR_Activity( 1 );
      else if( lastValue && !bActiveHelper )
        SPV_Rq_AR_Activity(0 );
    return bActiveHelper;
}
/*@@end*/

/*@@caplFunc:SPV_Rq_AR_check_output():*/
SPV_Rq_AR_check_output()
{
    if( !getValue( HMI__STMSG_SPV_Rq_AR ) )
    {
        // Botschaft SPV_Rq_AR ID: 789 --- Sendeart 8 cyclicIfActiveFast --- 
        _SPV_Rq_AR_Cnt--;
        if( _SPV_Rq_AR_Cnt < 1 )
        {
            SPV_Rq_AR_output(); // Zyklus abgelaufen, Nachricht senden
            _SPV_Rq_AR_Cnt = _SPV_Rq_AR_SigActivity ? _SPV_Rq_AR_CycleCountFast : _SPV_Rq_AR_CycleCountSlow;
        }
    }
}
/*@@end*/

/*@@caplFunc:SPV_Rq_AR_init():*/
SPV_Rq_AR_init()
{   /* Botschaft SPV_Rq_AR ID: 789 --- Sendeart 8 cyclicIfActiveFast --- 
BA_ "ApplMessage" BO_ 789 0;
BA_ "NmAsrMessage" BO_ 789 0;
BA_ "GenMsgMinAcceptLength" BO_ 789 2;
BA_ "GenMsgILSupport" BO_ 789 1;
BA_ "DiagState" BO_ 789 0;
BA_ "DiagRequest" BO_ 789 0;
BA_ "DiagResponse" BO_ 789 0;
BA_ "GenMsgStartValue" BO_ 789 "0";
BA_ "GenMsgDelayTime" BO_ 789 5;
BA_ "GenMsgCycleTime" BO_ 789 1000;
BA_ "GenMsgCycleTimeActive" BO_ 789 100;
BA_ "GenMsgSendType" BO_ 789 8;
    */
    _SPV_Rq_AR_Timebase =                 c_tDBKomTimer_5ms;
    _SPV_Rq_AR_CycleCountSlow =         1000 / _SPV_Rq_AR_Timebase;
    _SPV_Rq_AR_CycleCountFast =          100 / _SPV_Rq_AR_Timebase;
    _SPV_Rq_AR_StartDelay =                0 / _SPV_Rq_AR_Timebase;
    _SPV_Rq_AR_Cnt = _SPV_Rq_AR_StartDelay;
    _SPV_Rq_AR_SigActivity = 0;

    putValue( HMI__STMSGSD_SPV_Rq_AR, _SPV_Rq_AR_StartDelay * _SPV_Rq_AR_Timebase );

    _mSPV_Rq_AR.AcustWarn_Rq_MPM.phys = getValue( HMI_AcustWarn_Rq_MPM );                  _SPV_Rq_AR_AcustWarn_Rq_MPM_LastState = SPV_Rq_AR_Change( _SPV_Rq_AR_AcustWarn_Rq_MPM_LastState, _mSPV_Rq_AR.AcustWarn_Rq_MPM, 0 );
    _mSPV_Rq_AR.AudioMute_1_Rq.phys = getValue( HMI_AudioMute_1_Rq );                  _SPV_Rq_AR_AudioMute_1_Rq_LastState = SPV_Rq_AR_Change( _SPV_Rq_AR_AudioMute_1_Rq_LastState, _mSPV_Rq_AR.AudioMute_1_Rq, 0 );
    _mSPV_Rq_AR.AudioMute_2_Rq.phys = getValue( HMI_AudioMute_2_Rq );                  _SPV_Rq_AR_AudioMute_2_Rq_LastState = SPV_Rq_AR_Change( _SPV_Rq_AR_AudioMute_2_Rq_LastState, _mSPV_Rq_AR.AudioMute_2_Rq, 0 );
    _mSPV_Rq_AR.AuthRadio_Actv.phys = getValue( HMI_AuthRadio_Actv );                  _SPV_Rq_AR_AuthRadio_Actv_LastState = SPV_Rq_AR_Change( _SPV_Rq_AR_AuthRadio_Actv_LastState, _mSPV_Rq_AR.AuthRadio_Actv, 0 );
    _mSPV_Rq_AR.FBAS_VideoIn_Rq.phys = getValue( HMI_FBAS_VideoIn_Rq );                  _SPV_Rq_AR_FBAS_VideoIn_Rq_LastState = SPV_Rq_AR_Change( _SPV_Rq_AR_FBAS_VideoIn_Rq_LastState, _mSPV_Rq_AR.FBAS_VideoIn_Rq, 0 );
    _mSPV_Rq_AR.Gas_Dr_Unlk_Rq_MPM.phys = getValue( HMI_Gas_Dr_Unlk_Rq_MPM );                  _SPV_Rq_AR_Gas_Dr_Unlk_Rq_MPM_LastState = SPV_Rq_AR_Change( _SPV_Rq_AR_Gas_Dr_Unlk_Rq_MPM_LastState, _mSPV_Rq_AR.Gas_Dr_Unlk_Rq_MPM, 0 );
    _mSPV_Rq_AR.Radio_NumPad_Rq.phys = getValue( HMI_Radio_NumPad_Rq );                  _SPV_Rq_AR_Radio_NumPad_Rq_LastState = SPV_Rq_AR_Change( _SPV_Rq_AR_Radio_NumPad_Rq_LastState, _mSPV_Rq_AR.Radio_NumPad_Rq, 0 );
    _mSPV_Rq_AR.RadioHdFree_Actv.phys = getValue( HMI_RadioHdFree_Actv );                  _SPV_Rq_AR_RadioHdFree_Actv_LastState = SPV_Rq_AR_Change( _SPV_Rq_AR_RadioHdFree_Actv_LastState, _mSPV_Rq_AR.RadioHdFree_Actv, 0 );
    _mSPV_Rq_AR.SPV_Rem_UI_Rq.phys = getValue( HMI_SPV_Rem_UI_Rq );                  _SPV_Rq_AR_SPV_Rem_UI_Rq_LastState = SPV_Rq_AR_Change( _SPV_Rq_AR_SPV_Rem_UI_Rq_LastState, _mSPV_Rq_AR.SPV_Rem_UI_Rq, 0 );
}
/*@@end*/

/*@@caplFunc:SPV_Rq_AR_output():*/
SPV_Rq_AR_output(void)
{
    output( _mSPV_Rq_AR );
}
/*@@end*/

/*@@caplFunc:SPV_Rq_AR_saveEnvVars(dword):*/
SPV_Rq_AR_saveEnvVars( dword hFile )
{
    filePutString("\n// Knoten EIS: SPV_Rq_AR\n", 31, hFile );
    snprintf( buffer, elcount( buffer ), "0.0000 HMI__STMSG_SPV_Rq_AR := %X\n", getValue( HMI__STMSG_SPV_Rq_AR ) );    filePutString( buffer, elcount( buffer ), hFile );
    snprintf( buffer, elcount( buffer ), "0.0000 HMI__STMSGT_SPV_Rq_AR := %X\n", getValue( HMI__STMSGT_SPV_Rq_AR ) );    filePutString( buffer, elcount( buffer ), hFile );
    snprintf( buffer, elcount( buffer ), "0.0000 HMI_AcustWarn_Rq_MPM := %X\n", getValue( HMI_AcustWarn_Rq_MPM ) );    filePutString( buffer, elcount( buffer ), hFile );
    snprintf( buffer, elcount( buffer ), "0.0000 HMI_AudioMute_1_Rq := %X\n", getValue( HMI_AudioMute_1_Rq ) );    filePutString( buffer, elcount( buffer ), hFile );
    snprintf( buffer, elcount( buffer ), "0.0000 HMI_AudioMute_2_Rq := %X\n", getValue( HMI_AudioMute_2_Rq ) );    filePutString( buffer, elcount( buffer ), hFile );
    snprintf( buffer, elcount( buffer ), "0.0000 HMI_AuthRadio_Actv := %X\n", getValue( HMI_AuthRadio_Actv ) );    filePutString( buffer, elcount( buffer ), hFile );
    snprintf( buffer, elcount( buffer ), "0.0000 HMI_FBAS_VideoIn_Rq := %X\n", getValue( HMI_FBAS_VideoIn_Rq ) );    filePutString( buffer, elcount( buffer ), hFile );
    snprintf( buffer, elcount( buffer ), "0.0000 HMI_Gas_Dr_Unlk_Rq_MPM := %X\n", getValue( HMI_Gas_Dr_Unlk_Rq_MPM ) );    filePutString( buffer, elcount( buffer ), hFile );
    snprintf( buffer, elcount( buffer ), "0.0000 HMI_Radio_NumPad_Rq := %X\n", getValue( HMI_Radio_NumPad_Rq ) );    filePutString( buffer, elcount( buffer ), hFile );
    snprintf( buffer, elcount( buffer ), "0.0000 HMI_RadioHdFree_Actv := %X\n", getValue( HMI_RadioHdFree_Actv ) );    filePutString( buffer, elcount( buffer ), hFile );
    snprintf( buffer, elcount( buffer ), "0.0000 HMI_SPV_Rem_UI_Rq := %X\n", getValue( HMI_SPV_Rem_UI_Rq ) );    filePutString( buffer, elcount( buffer ), hFile );
}
/*@@end*/

/*@@timer:_tSPV_Rq_AR:*/
on timer _tSPV_Rq_AR
{
    putValue( HMI__STMSG_SPV_Rq_AR, 0 );
}
/*@@end*/

/*@@envVar:HMI__STMSG_SPV_Rq_AR:*/
on EnvVar HMI__STMSG_SPV_Rq_AR
{
    long tDelay;
    if( getValue( this ) == 2 )
    {
        tDelay = getValue( HMI__STMSGT_SPV_Rq_AR );
        if( tDelay > 0)    
            setTimer( _tSPV_Rq_AR, tDelay );
        else
            putValue( HMI__STMSG_SPV_Rq_AR, 0 );
    }
}
/*@@end*/

/*@@envVar:HMI__ALLDEF_SPV_Rq_AR:*/
on EnvVar HMI__ALLDEF_SPV_Rq_AR
{
    if( getValue(this) )
    {
        // alle signale auf default einstellen
        putValue( HMI_AcustWarn_Rq_MPM, 0 );
        putValue( HMI_AudioMute_1_Rq, 0 );
        putValue( HMI_AuthRadio_Actv, 0 );
        putValue( HMI_FBAS_VideoIn_Rq, 0 );
        putValue( HMI_Gas_Dr_Unlk_Rq_MPM, 0 );
        putValue( HMI_Radio_NumPad_Rq, 0 );
        putValue( HMI_RadioHdFree_Actv, 0 );
        putValue( HMI_SPV_Rem_UI_Rq, 0 );
    }
}
/*@@end*/

/*@@envVar:HMI_AcustWarn_Rq_MPM:*/
on EnvVar HMI_AcustWarn_Rq_MPM
{
    _mSPV_Rq_AR.AcustWarn_Rq_MPM.phys = getValue(this);
    _SPV_Rq_AR_AcustWarn_Rq_MPM_LastState = SPV_Rq_AR_Change( _SPV_Rq_AR_AcustWarn_Rq_MPM_LastState, _mSPV_Rq_AR.AcustWarn_Rq_MPM, 0 );
}
/*@@end*/

/*@@envVar:HMI_AudioMute_1_Rq:*/
on EnvVar HMI_AudioMute_1_Rq
{
    _mSPV_Rq_AR.AudioMute_1_Rq.phys = getValue(this);
    _SPV_Rq_AR_AudioMute_1_Rq_LastState = SPV_Rq_AR_Change( _SPV_Rq_AR_AudioMute_1_Rq_LastState, _mSPV_Rq_AR.AudioMute_1_Rq, 0 );
}
/*@@end*/

/*@@envVar:HMI_AudioMute_2_Rq:*/
on EnvVar HMI_AudioMute_2_Rq
{
    _mSPV_Rq_AR.AudioMute_2_Rq.phys = getValue(this);
    _SPV_Rq_AR_AudioMute_2_Rq_LastState = SPV_Rq_AR_Change( _SPV_Rq_AR_AudioMute_2_Rq_LastState, _mSPV_Rq_AR.AudioMute_2_Rq, 0 );
}
/*@@end*/

/*@@envVar:HMI_AuthRadio_Actv:*/
on EnvVar HMI_AuthRadio_Actv
{
    _mSPV_Rq_AR.AuthRadio_Actv.phys = getValue(this);
    _SPV_Rq_AR_AuthRadio_Actv_LastState = SPV_Rq_AR_Change( _SPV_Rq_AR_AuthRadio_Actv_LastState, _mSPV_Rq_AR.AuthRadio_Actv, 0 );
}
/*@@end*/

/*@@envVar:HMI_FBAS_VideoIn_Rq:*/
on EnvVar HMI_FBAS_VideoIn_Rq
{
    _mSPV_Rq_AR.FBAS_VideoIn_Rq.phys = getValue(this);
    _SPV_Rq_AR_FBAS_VideoIn_Rq_LastState = SPV_Rq_AR_Change( _SPV_Rq_AR_FBAS_VideoIn_Rq_LastState, _mSPV_Rq_AR.FBAS_VideoIn_Rq, 0 );
}
/*@@end*/

/*@@envVar:HMI_Gas_Dr_Unlk_Rq_MPM:*/
on EnvVar HMI_Gas_Dr_Unlk_Rq_MPM
{
    _mSPV_Rq_AR.Gas_Dr_Unlk_Rq_MPM.phys = getValue(this);
    _SPV_Rq_AR_Gas_Dr_Unlk_Rq_MPM_LastState = SPV_Rq_AR_Change( _SPV_Rq_AR_Gas_Dr_Unlk_Rq_MPM_LastState, _mSPV_Rq_AR.Gas_Dr_Unlk_Rq_MPM, 0 );
}
/*@@end*/

/*@@envVar:HMI_Radio_NumPad_Rq:*/
on EnvVar HMI_Radio_NumPad_Rq
{
    _mSPV_Rq_AR.Radio_NumPad_Rq.phys = getValue(this);
    _SPV_Rq_AR_Radio_NumPad_Rq_LastState = SPV_Rq_AR_Change( _SPV_Rq_AR_Radio_NumPad_Rq_LastState, _mSPV_Rq_AR.Radio_NumPad_Rq, 0 );
}
/*@@end*/

/*@@envVar:HMI_RadioHdFree_Actv:*/
on EnvVar HMI_RadioHdFree_Actv
{
    _mSPV_Rq_AR.RadioHdFree_Actv.phys = getValue(this);
    _SPV_Rq_AR_RadioHdFree_Actv_LastState = SPV_Rq_AR_Change( _SPV_Rq_AR_RadioHdFree_Actv_LastState, _mSPV_Rq_AR.RadioHdFree_Actv, 0 );
}
/*@@end*/

/*@@envVar:HMI_SPV_Rem_UI_Rq:*/
on EnvVar HMI_SPV_Rem_UI_Rq
{
    _mSPV_Rq_AR.SPV_Rem_UI_Rq.phys = getValue(this);
    _SPV_Rq_AR_SPV_Rem_UI_Rq_LastState = SPV_Rq_AR_Change( _SPV_Rq_AR_SPV_Rem_UI_Rq_LastState, _mSPV_Rq_AR.SPV_Rem_UI_Rq, 0 );
}
/*@@end*/

/*@@caplFunc:SPV_Stat_AR_check_output():*/
SPV_Stat_AR_check_output()
{
    if( !getValue( HMI__STMSG_SPV_Stat_AR ) )
    {
        // Botschaft SPV_Stat_AR ID: 791 --- Sendeart 5 cyclicAndSpontanWithDelay --- 
        if( _SPV_Stat_AR_DelayCnt > 0) _SPV_Stat_AR_DelayCnt--; // Mindestsendeabstand
        _SPV_Stat_AR_Cnt--;
        if( _SPV_Stat_AR_Cnt < 1 )
        {
            if( _SPV_Stat_AR_DelayCnt < 1 )
            {
                // Nachricht wg. abgelaufenem Zyklus ausgeben (Mindestsendeabstand eingehalten)
                SPV_Stat_AR_output();
                 _SPV_Stat_AR_SpontanFlag = 0; // Spontan-Flag zurücksetzen
                _SPV_Stat_AR_DelayCnt = _SPV_Stat_AR_MinDelay;
            }
            else
            {
                // Spontanflag setzen damit nach Ablauf Mindestsendeabstand gesendet wird
                 _SPV_Stat_AR_SpontanFlag = 1;
            }
            _SPV_Stat_AR_Cnt = _SPV_Stat_AR_CycleCount; // Zyklus-Zähler zurücksetzen
        }
        else if( _SPV_Stat_AR_SpontanFlag)
        {
            if( _SPV_Stat_AR_DelayCnt < 1 )
            {
                // Nachricht wg. spontaner Änderung ausgeben (Mindestsendeabstand eingehalten)
                SPV_Stat_AR_output();
                _SPV_Stat_AR_SpontanFlag = 0; // Spontan-Flag zurücksetzen
                _SPV_Stat_AR_DelayCnt = _SPV_Stat_AR_MinDelay;
            }
        }
    }
}
/*@@end*/

/*@@caplFunc:SPV_Stat_AR_init():*/
SPV_Stat_AR_init()
{   /* Botschaft SPV_Stat_AR ID: 791 --- Sendeart 5 cyclicAndSpontanWithDelay --- 
BA_ "ApplMessage" BO_ 791 0;
BA_ "NmAsrMessage" BO_ 791 0;
BA_ "GenMsgMinAcceptLength" BO_ 791 4;
BA_ "GenMsgILSupport" BO_ 791 1;
BA_ "DiagState" BO_ 791 0;
BA_ "DiagRequest" BO_ 791 0;
BA_ "DiagResponse" BO_ 791 0;
BA_ "GenMsgStartValue" BO_ 791 "0";
BA_ "GenMsgStartDelayTime" BO_ 791 0;
BA_ "GenMsgDelayTime" BO_ 791 50;
BA_ "GenMsgNrOfRepetitions" BO_ 791 0;
BA_ "GenMsgCycleTime" BO_ 791 1000;
BA_ "GenMsgSendType" BO_ 791 5;
    */
    _SPV_Stat_AR_Timebase =               c_tDBKomTimer_5ms;
    _SPV_Stat_AR_CycleCount =            1000 / _SPV_Stat_AR_Timebase;
    _SPV_Stat_AR_StartDelay =               0 / _SPV_Stat_AR_Timebase;
    _SPV_Stat_AR_MinDelay =                50 / _SPV_Stat_AR_Timebase;
    _SPV_Stat_AR_Cnt = _SPV_Stat_AR_StartDelay;
    _SPV_Stat_AR_SpontanFlag = 0;
    _SPV_Stat_AR_DelayCnt = 0;

    putValue( HMI__STMSGSD_SPV_Stat_AR, _SPV_Stat_AR_StartDelay * _SPV_Stat_AR_Timebase );

    _mSPV_Stat_AR.Audio_TwoCabSnd_Stat.phys = getValue( HMI_Audio_TwoCabSnd_Stat );
    _mSPV_Stat_AR.Audio_TwoCabSrc_Rq.phys = getValue( HMI_Audio_TwoCabSrc_Rq );
    _mSPV_Stat_AR.C2X_Emg_Actv.phys = getValue( HMI_C2X_Emg_Actv );
    _mSPV_Stat_AR.CiA447_Flt.phys = getValue( HMI_CiA447_Flt );
    _mSPV_Stat_AR.ContEngRun_Sw_Psd.phys = getValue( HMI_ContEngRun_Sw_Psd );
    _mSPV_Stat_AR.EF_On_Rq_MPM.phys = getValue( HMI_EF_On_Rq_MPM );
    _mSPV_Stat_AR.EmgAlm_Flt.phys = getValue( HMI_EmgAlm_Flt );
    _mSPV_Stat_AR.ES_EmgVeh_Flt.phys = getValue( HMI_ES_EmgVeh_Flt );
    _mSPV_Stat_AR.ES_Taxi_Flt.phys = getValue( HMI_ES_Taxi_Flt );
    _mSPV_Stat_AR.ES_TaxiLim_Warn.phys = getValue( HMI_ES_TaxiLim_Warn );
    _mSPV_Stat_AR.FAS_Actv.phys = getValue( HMI_FAS_Actv );
    _mSPV_Stat_AR.FAS_Empty.phys = getValue( HMI_FAS_Empty );
    _mSPV_Stat_AR.FAS_Inact.phys = getValue( HMI_FAS_Inact );
    _mSPV_Stat_AR.FES_Actv.phys = getValue( HMI_FES_Actv );
    _mSPV_Stat_AR.FES_Empty.phys = getValue( HMI_FES_Empty );
    _mSPV_Stat_AR.FES_Flt.phys = getValue( HMI_FES_Flt );
    _mSPV_Stat_AR.FES_On.phys = getValue( HMI_FES_On );
    _mSPV_Stat_AR.Hrn_On_Rq_MPM.phys = getValue( HMI_Hrn_On_Rq_MPM );
    _mSPV_Stat_AR.IL_Dim_On_Rq.phys = getValue( HMI_IL_Dim_On_Rq );
    _mSPV_Stat_AR.PN14_SupBatCutSw_Rq.phys = getValue( HMI_PN14_SupBatCutSw_Rq );
    _mSPV_Stat_AR.RoofLmpChk_Rq.phys = getValue( HMI_RoofLmpChk_Rq );
    _mSPV_Stat_AR.RoofLmpIndLmp_On_Rq.phys = getValue( HMI_RoofLmpIndLmp_On_Rq );
    _mSPV_Stat_AR.SSA_Dsbl_Rq_MPM.phys = getValue( HMI_SSA_Dsbl_Rq_MPM );
    _mSPV_Stat_AR.TaxiRoofLmpMd_Stat.phys = getValue( HMI_TaxiRoofLmpMd_Stat );
    _mSPV_Stat_AR.Volt_Low_MPM.phys = getValue( HMI_Volt_Low_MPM );
}
/*@@end*/

/*@@caplFunc:SPV_Stat_AR_output():*/
SPV_Stat_AR_output(void)
{
    output( _mSPV_Stat_AR );
}
/*@@end*/

/*@@caplFunc:SPV_Stat_AR_saveEnvVars(dword):*/
SPV_Stat_AR_saveEnvVars( dword hFile )
{
    filePutString("\n// Knoten EIS: SPV_Stat_AR\n", 25, hFile );
    snprintf( buffer, elcount( buffer ), "0.0000 HMI__STMSG_SPV_Stat := %X\n", getValue( HMI__STMSG_SPV_Stat_AR ) );        filePutString( buffer, elcount( buffer ), hFile );
    snprintf( buffer, elcount( buffer ), "0.0000 HMI__STMSGT_SPV_Stat := %X\n", getValue( HMI__STMSGT_SPV_Stat_AR ) );        filePutString( buffer, elcount( buffer ), hFile );
    snprintf( buffer, elcount( buffer ), "0.0000 HMI_Audio_TwoCabSnd_Stat := %X\n", getValue( HMI_Audio_TwoCabSnd_Stat ) );        filePutString( buffer, elcount( buffer ), hFile );
    snprintf( buffer, elcount( buffer ), "0.0000 HMI_Audio_TwoCabSrc_Rq := %X\n", getValue( HMI_Audio_TwoCabSrc_Rq ) );        filePutString( buffer, elcount( buffer ), hFile );
    snprintf( buffer, elcount( buffer ), "0.0000 HMI_C2X_Emg_Actv := %X\n", getValue( HMI_C2X_Emg_Actv ) );        filePutString( buffer, elcount( buffer ), hFile );
    snprintf( buffer, elcount( buffer ), "0.0000 HMI_CiA447_Flt := %X\n", getValue( HMI_CiA447_Flt ) );        filePutString( buffer, elcount( buffer ), hFile );
    snprintf( buffer, elcount( buffer ), "0.0000 HMI_ContEngRun_Sw_Psd := %X\n", getValue( HMI_ContEngRun_Sw_Psd ) );        filePutString( buffer, elcount( buffer ), hFile );
    snprintf( buffer, elcount( buffer ), "0.0000 HMI_EF_On_Rq_MPM := %X\n", getValue( HMI_EF_On_Rq_MPM ) );        filePutString( buffer, elcount( buffer ), hFile );
    snprintf( buffer, elcount( buffer ), "0.0000 HMI_EmgAlm_Flt := %X\n", getValue( HMI_EmgAlm_Flt ) );        filePutString( buffer, elcount( buffer ), hFile );
    snprintf( buffer, elcount( buffer ), "0.0000 HMI_ES_EmgVeh_Flt := %X\n", getValue( HMI_ES_EmgVeh_Flt ) );        filePutString( buffer, elcount( buffer ), hFile );
    snprintf( buffer, elcount( buffer ), "0.0000 HMI_ES_Taxi_Flt := %X\n", getValue( HMI_ES_Taxi_Flt ) );        filePutString( buffer, elcount( buffer ), hFile );
    snprintf( buffer, elcount( buffer ), "0.0000 HMI_ES_TaxiLim_Warn := %X\n", getValue( HMI_ES_TaxiLim_Warn ) );        filePutString( buffer, elcount( buffer ), hFile );
    snprintf( buffer, elcount( buffer ), "0.0000 HMI_FAS_Actv := %X\n", getValue( HMI_FAS_Actv ) );        filePutString( buffer, elcount( buffer ), hFile );
    snprintf( buffer, elcount( buffer ), "0.0000 HMI_FAS_Empty := %X\n", getValue( HMI_FAS_Empty ) );        filePutString( buffer, elcount( buffer ), hFile );
    snprintf( buffer, elcount( buffer ), "0.0000 HMI_FAS_Inact := %X\n", getValue( HMI_FAS_Inact ) );        filePutString( buffer, elcount( buffer ), hFile );
    snprintf( buffer, elcount( buffer ), "0.0000 HMI_FES_Actv := %X\n", getValue( HMI_FES_Actv ) );        filePutString( buffer, elcount( buffer ), hFile );
    snprintf( buffer, elcount( buffer ), "0.0000 HMI_FES_Empty := %X\n", getValue( HMI_FES_Empty ) );        filePutString( buffer, elcount( buffer ), hFile );
    snprintf( buffer, elcount( buffer ), "0.0000 HMI_FES_Flt := %X\n", getValue( HMI_FES_Flt ) );        filePutString( buffer, elcount( buffer ), hFile );
    snprintf( buffer, elcount( buffer ), "0.0000 HMI_FES_On := %X\n", getValue( HMI_FES_On ) );        filePutString( buffer, elcount( buffer ), hFile );
    snprintf( buffer, elcount( buffer ), "0.0000 HMI_Hrn_On_Rq_MPM := %X\n", getValue( HMI_Hrn_On_Rq_MPM ) );        filePutString( buffer, elcount( buffer ), hFile );
    snprintf( buffer, elcount( buffer ), "0.0000 HMI_IL_Dim_On_Rq := %X\n", getValue( HMI_IL_Dim_On_Rq ) );        filePutString( buffer, elcount( buffer ), hFile );
    snprintf( buffer, elcount( buffer ), "0.0000 HMI_PN14_SupBatCutSw_Rq := %X\n", getValue( HMI_PN14_SupBatCutSw_Rq ) );        filePutString( buffer, elcount( buffer ), hFile );
    snprintf( buffer, elcount( buffer ), "0.0000 HMI_RoofLmpChk_Rq := %X\n", getValue( HMI_RoofLmpChk_Rq ) );        filePutString( buffer, elcount( buffer ), hFile );
    snprintf( buffer, elcount( buffer ), "0.0000 HMI_RoofLmpIndLmp_On_Rq := %X\n", getValue( HMI_RoofLmpIndLmp_On_Rq ) );        filePutString( buffer, elcount( buffer ), hFile );
    snprintf( buffer, elcount( buffer ), "0.0000 HMI_SSA_Dsbl_Rq_MPM := %X\n", getValue( HMI_SSA_Dsbl_Rq_MPM ) );        filePutString( buffer, elcount( buffer ), hFile );
    snprintf( buffer, elcount( buffer ), "0.0000 HMI_TaxiRoofLmpMd_Stat := %X\n", getValue( HMI_TaxiRoofLmpMd_Stat ) );        filePutString( buffer, elcount( buffer ), hFile );
    snprintf( buffer, elcount( buffer ), "0.0000 HMI_Volt_Low_MPM := %X\n", getValue( HMI_Volt_Low_MPM ) );        filePutString( buffer, elcount( buffer ), hFile );
}
/*@@end*/

/*@@timer:_tSPV_Stat_AR:*/
on timer _tSPV_Stat_AR
{
    putValue( HMI__STMSG_SPV_Stat_AR, 0 );
}
/*@@end*/

/*@@envVar:HMI__STMSG_SPV_Stat_AR:*/
on EnvVar HMI__STMSG_SPV_Stat_AR
{
    long tDelay;
    if( getValue( this ) == 2 )
    {
        tDelay = getValue( HMI__STMSGT_SPV_Stat_AR );
        if( tDelay > 0)    
            setTimer( _tSPV_Stat_AR, tDelay );
        else
            putValue( HMI__STMSG_SPV_Stat_AR, 0 );
    }
}
/*@@end*/

/*@@envVar:HMI_Audio_TwoCabSnd_Stat:*/
on EnvVar HMI_Audio_TwoCabSnd_Stat
{
    _mSPV_Stat_AR.Audio_TwoCabSnd_Stat.phys = getValue(this);
    _SPV_Stat_AR_SpontanFlag = 1;
}
/*@@end*/

/*@@envVar:HMI_Audio_TwoCabSrc_Rq:*/
on EnvVar HMI_Audio_TwoCabSrc_Rq
{
    _mSPV_Stat_AR.Audio_TwoCabSrc_Rq.phys = getValue(this);
    _SPV_Stat_AR_SpontanFlag = 1;
}
/*@@end*/

/*@@envVar:HMI_C2X_Emg_Actv:*/
on EnvVar HMI_C2X_Emg_Actv
{
    _mSPV_Stat_AR.C2X_Emg_Actv.phys = getValue(this);
    _SPV_Stat_AR_SpontanFlag = 1;
}
/*@@end*/

/*@@envVar:HMI_CiA447_Flt:*/
on EnvVar HMI_CiA447_Flt
{
    _mSPV_Stat_AR.CiA447_Flt.phys = getValue(this);
    _SPV_Stat_AR_SpontanFlag = 1;
}
/*@@end*/

/*@@envVar:HMI_ContEngRun_Sw_Psd:*/
on EnvVar HMI_ContEngRun_Sw_Psd
{
    _mSPV_Stat_AR.ContEngRun_Sw_Psd.phys = getValue(this);
    _SPV_Stat_AR_SpontanFlag = 1;
}
/*@@end*/

/*@@envVar:HMI_EF_On_Rq_MPM:*/
on EnvVar HMI_EF_On_Rq_MPM
{
    _mSPV_Stat_AR.EF_On_Rq_MPM.phys = getValue(this);
    _SPV_Stat_AR_SpontanFlag = 1;
}
/*@@end*/

/*@@envVar:HMI_EmgAlm_Flt:*/
on EnvVar HMI_EmgAlm_Flt
{
    _mSPV_Stat_AR.EmgAlm_Flt.phys = getValue(this);
    _SPV_Stat_AR_SpontanFlag = 1;
}
/*@@end*/

/*@@envVar:HMI_ES_EmgVeh_Flt:*/
on EnvVar HMI_ES_EmgVeh_Flt
{
    _mSPV_Stat_AR.ES_EmgVeh_Flt.phys = getValue(this);
    _SPV_Stat_AR_SpontanFlag = 1;
}
/*@@end*/

/*@@envVar:HMI_ES_Taxi_Flt:*/
on EnvVar HMI_ES_Taxi_Flt
{
    _mSPV_Stat_AR.ES_Taxi_Flt.phys = getValue(this);
    _SPV_Stat_AR_SpontanFlag = 1;
}
/*@@end*/

/*@@envVar:HMI_ES_TaxiLim_Warn:*/
on EnvVar HMI_ES_TaxiLim_Warn
{
    _mSPV_Stat_AR.ES_TaxiLim_Warn.phys = getValue(this);
    _SPV_Stat_AR_SpontanFlag = 1;
}
/*@@end*/

/*@@envVar:HMI_FAS_Actv:*/
on EnvVar HMI_FAS_Actv
{
    _mSPV_Stat_AR.FAS_Actv.phys = getValue(this);
    _SPV_Stat_AR_SpontanFlag = 1;
}
/*@@end*/

/*@@envVar:HMI_FAS_Empty:*/
on EnvVar HMI_FAS_Empty
{
    _mSPV_Stat_AR.FAS_Empty.phys = getValue(this);
    _SPV_Stat_AR_SpontanFlag = 1;
}
/*@@end*/

/*@@envVar:HMI_FAS_Inact:*/
on EnvVar HMI_FAS_Inact
{
    _mSPV_Stat_AR.FAS_Inact.phys = getValue(this);
    _SPV_Stat_AR_SpontanFlag = 1;
}
/*@@end*/

/*@@envVar:HMI_FES_Actv:*/
on EnvVar HMI_FES_Actv
{
    _mSPV_Stat_AR.FES_Actv.phys = getValue(this);
    _SPV_Stat_AR_SpontanFlag = 1;
}
/*@@end*/

/*@@envVar:HMI_FES_Empty:*/
on EnvVar HMI_FES_Empty
{
    _mSPV_Stat_AR.FES_Empty.phys = getValue(this);
    _SPV_Stat_AR_SpontanFlag = 1;
}
/*@@end*/

/*@@envVar:HMI_FES_Flt:*/
on EnvVar HMI_FES_Flt
{
    _mSPV_Stat_AR.FES_Flt.phys = getValue(this);
    _SPV_Stat_AR_SpontanFlag = 1;
}
/*@@end*/

/*@@envVar:HMI_FES_On:*/
on EnvVar HMI_FES_On
{
    _mSPV_Stat_AR.FES_On.phys = getValue(this);
    _SPV_Stat_AR_SpontanFlag = 1;
}
/*@@end*/

/*@@envVar:HMI_Hrn_On_Rq_MPM:*/
on EnvVar HMI_Hrn_On_Rq_MPM
{
    _mSPV_Stat_AR.Hrn_On_Rq_MPM.phys = getValue(this);
    _SPV_Stat_AR_SpontanFlag = 1;
}
/*@@end*/

/*@@envVar:HMI_IL_Dim_On_Rq:*/
on EnvVar HMI_IL_Dim_On_Rq
{
    _mSPV_Stat_AR.IL_Dim_On_Rq.phys = getValue(this);
    _SPV_Stat_AR_SpontanFlag = 1;
}
/*@@end*/

/*@@envVar:HMI_PN14_SupBatCutSw_Rq:*/
on EnvVar HMI_PN14_SupBatCutSw_Rq
{
    _mSPV_Stat_AR.PN14_SupBatCutSw_Rq.phys = getValue(this);
    _SPV_Stat_AR_SpontanFlag = 1;
}
/*@@end*/

/*@@envVar:HMI_RoofLmpChk_Rq:*/
on EnvVar HMI_RoofLmpChk_Rq
{
    _mSPV_Stat_AR.RoofLmpChk_Rq.phys = getValue(this);
    _SPV_Stat_AR_SpontanFlag = 1;
}
/*@@end*/

/*@@envVar:HMI_RoofLmpIndLmp_On_Rq:*/
on EnvVar HMI_RoofLmpIndLmp_On_Rq
{
    _mSPV_Stat_AR.RoofLmpIndLmp_On_Rq.phys = getValue(this);
    _SPV_Stat_AR_SpontanFlag = 1;
}
/*@@end*/

/*@@envVar:HMI_SSA_Dsbl_Rq_MPM:*/
on EnvVar HMI_SSA_Dsbl_Rq_MPM
{
    _mSPV_Stat_AR.SSA_Dsbl_Rq_MPM.phys = getValue(this);
    _SPV_Stat_AR_SpontanFlag = 1;
}
/*@@end*/

/*@@envVar:HMI_TaxiRoofLmpMd_Stat:*/
on EnvVar HMI_TaxiRoofLmpMd_Stat
{
    _mSPV_Stat_AR.TaxiRoofLmpMd_Stat.phys = getValue(this);
    _SPV_Stat_AR_SpontanFlag = 1;
}
/*@@end*/

/*@@envVar:HMI_Volt_Low_MPM:*/
on EnvVar HMI_Volt_Low_MPM
{
    _mSPV_Stat_AR.Volt_Low_MPM.phys = getValue(this);
    _SPV_Stat_AR_SpontanFlag = 1;
}
/*@@end*/

/*@@caplFunc:StWhl_Angl_Stat_AR_check_output():*/
StWhl_Angl_Stat_AR_check_output()
{
    if( !getValue( HMI__STMSG_StWhl_Angl_Stat_AR ) )
    {
        // Botschaft StWhl_Angl_Stat_AR ID: 47 --- Sendeart 0 cyclicX --- 
        _StWhl_Angl_Stat_AR_Cnt--;
        if( _StWhl_Angl_Stat_AR_Cnt < 1 )
        {
            StWhl_Angl_Stat_AR_output(); // Nachricht wg. abgelaufenem Zyklus ausgeben
            _StWhl_Angl_Stat_AR_Cnt = _StWhl_Angl_Stat_AR_CycleCount; // Zyklus-Zähler zurücksetzen
        }
    }
}
/*@@end*/

/*@@caplFunc:StWhl_Angl_Stat_AR_init():*/
StWhl_Angl_Stat_AR_init()
{   /* Botschaft StWhl_Angl_Stat_AR ID: 47 --- Sendeart 0 cyclicX --- 
BA_ "ApplMessage" BO_ 47 0;
BA_ "NmAsrMessage" BO_ 47 0;
BA_ "GenMsgMinAcceptLength" BO_ 47 8;
BA_ "GenMsgILSupport" BO_ 47 1;
BA_ "DiagState" BO_ 47 0;
BA_ "DiagRequest" BO_ 47 0;
BA_ "DiagResponse" BO_ 47 0;
BA_ "GenMsgStartValue" BO_ 47 "0";
BA_ "GenMsgStartDelayTime" BO_ 47 0;
BA_ "GenMsgCycleTime" BO_ 47 10;
BA_ "GenMsgSendType" BO_ 47 0;
    */
    _StWhl_Angl_Stat_AR_Timebase =        c_tDBKomTimer_5ms;
    _StWhl_Angl_Stat_AR_CycleCount =      10 / _StWhl_Angl_Stat_AR_Timebase;
    _StWhl_Angl_Stat_AR_StartDelay =       0 / _StWhl_Angl_Stat_AR_Timebase;
    _StWhl_Angl_Stat_AR_Cnt = _StWhl_Angl_Stat_AR_StartDelay;

    putValue( HMI__STMSGSD_StWhl_Angl_Stat_AR, _StWhl_Angl_Stat_AR_StartDelay * _StWhl_Angl_Stat_AR_Timebase );

    _mStWhl_Angl_Stat_AR.Rsrv2_StWhl_Angl_Stat.phys = getValue( HMI_Rsrv2_StWhl_Angl_Stat );
    _mStWhl_Angl_Stat_AR.Rsrv3_StWhl_Angl_Stat.phys = getValue( HMI_Rsrv3_StWhl_Angl_Stat );
    _mStWhl_Angl_Stat_AR.StWhl_Angl.phys = getValue( HMI_StWhl_Angl );
    _mStWhl_Angl_Stat_AR.StWhl_AnglSens_Id.phys = getValue( HMI_StWhl_AnglSens_Id );
    _mStWhl_Angl_Stat_AR.StWhl_AnglSens_Stat.phys = getValue( HMI_StWhl_AnglSens_Stat );
    _mStWhl_Angl_Stat_AR.StWhl_AnglSensVld_Stat.phys = getValue( HMI_StWhl_AnglSensVld_Stat );
    _mStWhl_Angl_Stat_AR.StWhl_AnglSpd.phys = getValue( HMI_StWhl_AnglSpd );
}
/*@@end*/

/*@@caplFunc:StWhl_Angl_Stat_AR_output():*/
void StWhl_Angl_Stat_AR_output(void)
{
    byte crc;
    byte SQC_help;

    if( !getValue( HMI_SQC_StWhl_Angl_Stat_Auto ) )
    {
        // berechne message counter
        SQC_help = getValue( HMI_SQC_StWhl_Angl_Stat );
        if( SQC_help >= 15 ) SQC_help = 0;
        else SQC_help++;
        putValue( HMI_SQC_StWhl_Angl_Stat, SQC_help );
        _mStWhl_Angl_Stat_AR.SQC_StWhl_Angl_Stat = SQC_help;
    }
    else
          _mStWhl_Angl_Stat_AR.SQC_StWhl_Angl_Stat = getValue( HMI_SQC_StWhl_Angl_Stat );

    if( getValue( HMI_CRC_StWhl_Angl_Stat_Profile_02 ) )
    {
        if( !getValue( HMI_CRC_StWhl_Angl_Stat_Auto ) )
        {   // CRC according Profile_02 ( W213 )
            // berechne crc
            crc = 0xFF;
//          crc = crctable_profile02[ crc ^ _mStWhl_Angl_Stat_AR.byte( 0 ) ];  CRC
            crc = crctable_profile02[ crc ^ _mStWhl_Angl_Stat_AR.byte( 1 ) ];
            crc = crctable_profile02[ crc ^ _mStWhl_Angl_Stat_AR.byte( 2 ) ];
            crc = crctable_profile02[ crc ^ _mStWhl_Angl_Stat_AR.byte( 3 ) ];
            crc = crctable_profile02[ crc ^ _mStWhl_Angl_Stat_AR.byte( 4 ) ];
            crc = crctable_profile02[ crc ^ _mStWhl_Angl_Stat_AR.byte( 5 ) ];
            crc = crctable_profile02[ crc ^ _mStWhl_Angl_Stat_AR.byte( 6 ) ];
            crc = crctable_profile02[ crc ^ _mStWhl_Angl_Stat_AR.byte( 7 ) ];
            crc = crctable_profile02[ crc ^ _StWhl_Angl_Stat_AR_CRC_Offset[ _mStWhl_Angl_Stat_AR.SQC_StWhl_Angl_Stat ] ]; // load offset
            crc = (crc ^ 0xFF);
            if( getValue(  HMI_CRC_StWhl_Angl_Stat_Invalid ) )
                crc++;
            _mStWhl_Angl_Stat_AR.CRC_StWhl_Angl_Stat = crc;
            putValue( HMI_CRC_StWhl_Angl_Stat, crc );
        }
        else
            _mStWhl_Angl_Stat_AR.CRC_StWhl_Angl_Stat = getValue( HMI_CRC_StWhl_Angl_Stat );
    }
    else
    {
        if( !getValue( HMI_CRC_StWhl_Angl_Stat_Auto ) )
        {   // CRC according to SAE1850 ( W222 )
            // berechne crc
            crc = 0xFF;
//            crc = crctable[crc ^ _mStWhl_Angl_Stat_AR.byte( 0 )];  CRC
            crc = crctable[crc ^ _mStWhl_Angl_Stat_AR.byte( 1 )];
            crc = crctable[crc ^ _mStWhl_Angl_Stat_AR.byte( 2 )];
            crc = crctable[crc ^ _mStWhl_Angl_Stat_AR.byte( 3 )];
            crc = crctable[crc ^ _mStWhl_Angl_Stat_AR.byte( 4 )];
            crc = crctable[crc ^ _mStWhl_Angl_Stat_AR.byte( 5 )];
            crc = crctable[crc ^ _mStWhl_Angl_Stat_AR.byte( 6 )];
            crc = crctable[crc ^ _mStWhl_Angl_Stat_AR.byte( 7 )];
            crc = (crc ^ 0xFF);
            if( getValue(  HMI_CRC_StWhl_Angl_Stat_Invalid ) )
                crc++;
            _mStWhl_Angl_Stat_AR.CRC_StWhl_Angl_Stat = crc;
            putValue( HMI_CRC_StWhl_Angl_Stat, crc );
        }
        else
            _mStWhl_Angl_Stat_AR.CRC_StWhl_Angl_Stat = getValue( HMI_CRC_StWhl_Angl_Stat );
    }
    output( _mStWhl_Angl_Stat_AR );
}
/*@@end*/

/*@@caplFunc:StWhl_Angl_Stat_AR_saveEnvVars(dword):*/
void StWhl_Angl_Stat_AR_saveEnvVars( dword hFile )
{
    filePutString("\n// Knoten EIS: StWhl_Angl_Stat_AR\n", 32, hFile );
    snprintf( buffer, elcount( buffer ), "0.0000 HMI__STMSG_StWhl_Angl_Stat_AR := %X\n", getValue( HMI__STMSG_StWhl_Angl_Stat_AR ) );    filePutString( buffer, elcount( buffer ), hFile );
    snprintf( buffer, elcount( buffer ), "0.0000 HMI__STMSGT_StWhl_Angl_Stat_AR := %X\n", getValue( HMI__STMSGT_StWhl_Angl_Stat_AR ) );    filePutString( buffer, elcount( buffer ), hFile );
    snprintf( buffer, elcount( buffer ), "0.0000 HMI_CRC_StWhl_Angl_Stat := %f\n", getValue( HMI_CRC_StWhl_Angl_Stat ) );    filePutString( buffer, elcount( buffer ), hFile );
    snprintf( buffer, elcount( buffer ), "0.0000 HMI_CRC_StWhl_Angl_Stat_Auto := %f\n", getValue( HMI_CRC_StWhl_Angl_Stat_Auto ) );    filePutString( buffer, elcount( buffer ), hFile );
    snprintf( buffer, elcount( buffer ), "0.0000 HMI_Rsrv2_StWhl_Angl_Stat := %f\n", getValue( HMI_Rsrv2_StWhl_Angl_Stat ) );    filePutString( buffer, elcount( buffer ), hFile );
    snprintf( buffer, elcount( buffer ), "0.0000 HMI_Rsrv3_StWhl_Angl_Stat := %f\n", getValue( HMI_Rsrv3_StWhl_Angl_Stat ) );    filePutString( buffer, elcount( buffer ), hFile );
    snprintf( buffer, elcount( buffer ), "0.0000 HMI_SQC_StWhl_Angl_Stat := %f\n", getValue( HMI_SQC_StWhl_Angl_Stat ) );    filePutString( buffer, elcount( buffer ), hFile );
    snprintf( buffer, elcount( buffer ), "0.0000 HMI_SQC_StWhl_Angl_Stat_Auto := %f\n", getValue( HMI_SQC_StWhl_Angl_Stat_Auto ) );    filePutString( buffer, elcount( buffer ), hFile );
    snprintf( buffer, elcount( buffer ), "0.0000 HMI_StWhl_Angl := %f\n", getValue( HMI_StWhl_Angl ) );    filePutString( buffer, elcount( buffer ), hFile );
    snprintf( buffer, elcount( buffer ), "0.0000 HMI_StWhl_AnglSens_Id := %f\n", getValue( HMI_StWhl_AnglSens_Id ) );    filePutString( buffer, elcount( buffer ), hFile );
    snprintf( buffer, elcount( buffer ), "0.0000 HMI_StWhl_AnglSens_Stat := %f\n", getValue( HMI_StWhl_AnglSens_Stat ) );    filePutString( buffer, elcount( buffer ), hFile );
    snprintf( buffer, elcount( buffer ), "0.0000 HMI_StWhl_AnglSensVld_Stat := %f\n", getValue( HMI_StWhl_AnglSensVld_Stat ) );    filePutString( buffer, elcount( buffer ), hFile );
    snprintf( buffer, elcount( buffer ), "0.0000 HMI_StWhl_AnglSpd := %f\n", getValue( HMI_StWhl_AnglSpd ) );    filePutString( buffer, elcount( buffer ), hFile );
}
/*@@end*/

/*@@timer:_tStWhl_Angl_Stat_AR:*/
on timer _tStWhl_Angl_Stat_AR
{
    putValue( HMI__STMSG_StWhl_Angl_Stat_AR, 0 );
}
/*@@end*/

/*@@envVar:HMI__STMSG_StWhl_Angl_Stat_AR:*/
on EnvVar HMI__STMSG_StWhl_Angl_Stat_AR
{
    long tDelay;
    if( getValue( this ) == 2 )
    {
        tDelay = getValue( HMI__STMSGT_StWhl_Angl_Stat_AR );
        if( tDelay > 0)    
            setTimer( _tStWhl_Angl_Stat_AR, tDelay );
        else
            putValue( HMI__STMSG_StWhl_Angl_Stat_AR, 0 );
    }
}
/*@@end*/

/*@@envVar:HMI_Rsrv2_StWhl_Angl_Stat:*/
on EnvVar HMI_Rsrv2_StWhl_Angl_Stat
{
    _mStWhl_Angl_Stat_AR.Rsrv2_StWhl_Angl_Stat.phys = getValue(this);
}
/*@@end*/

/*@@envVar:HMI_Rsrv3_StWhl_Angl_Stat:*/
on EnvVar HMI_Rsrv3_StWhl_Angl_Stat
{
    _mStWhl_Angl_Stat_AR.Rsrv3_StWhl_Angl_Stat.phys = getValue(this);
}
/*@@end*/

/*@@envVar:HMI_StWhl_Angl:*/
on EnvVar HMI_StWhl_Angl
{
    _mStWhl_Angl_Stat_AR.StWhl_Angl.phys = getValue(this);
}
/*@@end*/

/*@@envVar:HMI_StWhl_AnglSens_Id:*/
on EnvVar HMI_StWhl_AnglSens_Id
{
    _mStWhl_Angl_Stat_AR.StWhl_AnglSens_Id.phys = getValue(this);
}
/*@@end*/

/*@@envVar:HMI_StWhl_AnglSens_Stat:*/
on EnvVar HMI_StWhl_AnglSens_Stat
{
    _mStWhl_Angl_Stat_AR.StWhl_AnglSens_Stat.phys = getValue(this);
}
/*@@end*/

/*@@envVar:HMI_StWhl_AnglSensVld_Stat:*/
on EnvVar HMI_StWhl_AnglSensVld_Stat
{
    _mStWhl_Angl_Stat_AR.StWhl_AnglSensVld_Stat.phys = getValue(this);
}
/*@@end*/

/*@@envVar:HMI_StWhl_AnglSpd:*/
on EnvVar HMI_StWhl_AnglSpd
{
    _mStWhl_Angl_Stat_AR.StWhl_AnglSpd.phys = getValue(this);
}
/*@@end*/

/*@@caplFunc:StWhl_OFN_Stat_AR_check_output():*/
StWhl_OFN_Stat_AR_check_output()
{
    if( !getValue( HMI__STMSG_StWhl_OFN_Stat_AR ) )
    {
        // Botschaft StWhl_OFN_Stat_AR ID: xxx --- Sendeart 5 cyclicAndSpontanWithDelay --- 
        if( _StWhl_OFN_Stat_AR_DelayCnt > 0) _StWhl_OFN_Stat_AR_DelayCnt--; // Mindestsendeabstand
        _StWhl_OFN_Stat_AR_Cnt--;
        if( _StWhl_OFN_Stat_AR_Cnt < 1 )
        {
            if( _StWhl_OFN_Stat_AR_DelayCnt < 1 )
            {
                // Nachricht wg. abgelaufenem Zyklus ausgeben (Mindestsendeabstand eingehalten)
                StWhl_OFN_Stat_AR_output();
                _StWhl_OFN_Stat_AR_SpontanFlag = 0; // Spontan-Flag zurücksetzen
                _StWhl_OFN_Stat_AR_DelayCnt = _StWhl_OFN_Stat_AR_MinDelay;
            }
            else
            {
                // Spontanflag setzen damit nach Ablauf Mindestsendeabstand gesendet wird
                 _StWhl_OFN_Stat_AR_SpontanFlag = 1;
            }
            _StWhl_OFN_Stat_AR_Cnt = _StWhl_OFN_Stat_AR_CycleCount; // Zyklus-Zähler zurücksetzen
        }
        else if( _StWhl_OFN_Stat_AR_SpontanFlag)
        {
            if( _StWhl_OFN_Stat_AR_DelayCnt < 1 )
            {
                // Nachricht wg. spontaner Änderung ausgeben (Mindestsendeabstand eingehalten)
                StWhl_OFN_Stat_AR_output();
                _StWhl_OFN_Stat_AR_SpontanFlag = 0; // Spontan-Flag zurücksetzen
                _StWhl_OFN_Stat_AR_DelayCnt = _StWhl_OFN_Stat_AR_MinDelay;
            }
        }
    }
}
/*@@end*/

/*@@caplFunc:StWhl_OFN_Stat_AR_init():*/
StWhl_OFN_Stat_AR_init()
{   /* Botschaft StWhl_OFN_Stat_AR ID: 621 --- Sendeart 5 cyclicAndSpontanWithDelay --- 
BA_ "ApplMessage" BO_ 621 0;
BA_ "NmAsrMessage" BO_ 621 0;
BA_ "GenMsgMinAcceptLength" BO_ 621 8;
BA_ "GenMsgILSupport" BO_ 621 1;
BA_ "DiagState" BO_ 621 0;
BA_ "DiagRequest" BO_ 621 0;
BA_ "DiagResponse" BO_ 621 0;
BA_ "GenMsgStartValue" BO_ 621 "0";
BA_ "GenMsgDelayTime" BO_ 621 20;
BA_ "GenMsgNrOfRepetitions" BO_ 621 0;
BA_ "GenMsgCycleTime" BO_ 621 100;
BA_ "GenMsgSendType" BO_ 621 5;
    */
    _StWhl_OFN_Stat_AR_Timebase =      c_tDBKomTimer_5ms;
    _StWhl_OFN_Stat_AR_CycleCount =    100 / _StWhl_OFN_Stat_AR_Timebase;
    _StWhl_OFN_Stat_AR_StartDelay =      0 / _StWhl_OFN_Stat_AR_Timebase;
    _StWhl_OFN_Stat_AR_MinDelay = 40 / _StWhl_OFN_Stat_AR_Timebase;
    _StWhl_OFN_Stat_AR_Cnt = _StWhl_OFN_Stat_AR_StartDelay;
    _StWhl_OFN_Stat_AR_SpontanFlag = 0;
    _StWhl_OFN_Stat_AR_DelayCnt = 0;

    putValue( HMI__STMSGSD_StWhl_OFN_Stat_AR, _StWhl_OFN_Stat_AR_StartDelay * _StWhl_OFN_Stat_AR_Timebase );

    _mStWhl_OFN_Stat_AR.StWhl_OFN_SnstyMd_Stat.phys = getValue( HMI_StWhl_OFN_SnstyMd_Stat );
    _mStWhl_OFN_Stat_AR.StWhl_OFN1_Mtn_X_Comp.phys = getValue( HMI_StWhl_OFN1_Mtn_X_Comp );
    _mStWhl_OFN_Stat_AR.StWhl_OFN1_Mtn_Y_Comp.phys = getValue( HMI_StWhl_OFN1_Mtn_Y_Comp );
    _mStWhl_OFN_Stat_AR.StWhl_OFN1_Stat.phys = getValue( HMI_StWhl_OFN1_Stat );
    _mStWhl_OFN_Stat_AR.StWhl_OFN1_TmStmp.phys = getValue( HMI_StWhl_OFN1_TmStmp );
    _mStWhl_OFN_Stat_AR.StWhl_OFN2_Mtn_X_Comp.phys = getValue( HMI_StWhl_OFN2_Mtn_X_Comp );
    _mStWhl_OFN_Stat_AR.StWhl_OFN2_Mtn_Y_Comp.phys = getValue( HMI_StWhl_OFN2_Mtn_Y_Comp );
    _mStWhl_OFN_Stat_AR.StWhl_OFN2_Stat.phys = getValue( HMI_StWhl_OFN2_Stat );
    _mStWhl_OFN_Stat_AR.StWhl_OFN2_TmStmp.phys = getValue( HMI_StWhl_OFN2_TmStmp );
}
/*@@end*/

/*@@caplFunc:StWhl_OFN_Stat_AR_output():*/
StWhl_OFN_Stat_AR_output()
{
    output( _mStWhl_OFN_Stat_AR );
}
/*@@end*/

/*@@caplFunc:StWhl_OFN_Stat_AR_saveEnvVars(dword):*/
StWhl_OFN_Stat_AR_saveEnvVars( dword hFile )
{
    filePutString("\n// Knoten EIS: StWhl_OFN_Stat_AR\n", 28, hFile );
    snprintf( buffer, elcount( buffer ), "0.0000 HMI__STMSG_StWhl_OFN_Stat_AR := %X\n", getValue( HMI__STMSG_StWhl_OFN_Stat_AR ) );        filePutString( buffer, elcount( buffer ), hFile );
    snprintf( buffer, elcount( buffer ), "0.0000 HMI__STMSGT_StWhl_OFN_Stat_AR := %X\n", getValue( HMI__STMSGT_StWhl_OFN_Stat_AR ) );        filePutString( buffer, elcount( buffer ), hFile );
    snprintf( buffer, elcount( buffer ), "0.0000 HMI_StWhl_OFN_SnstyMd_Stat := %X\n", getValue( HMI_StWhl_OFN_SnstyMd_Stat ) );        filePutString( buffer, elcount( buffer ), hFile );
    snprintf( buffer, elcount( buffer ), "0.0000 HMI_StWhl_OFN1_Mtn_X_Comp := %X\n", getValue( HMI_StWhl_OFN1_Mtn_X_Comp ) );        filePutString( buffer, elcount( buffer ), hFile );
    snprintf( buffer, elcount( buffer ), "0.0000 HMI_StWhl_OFN1_Mtn_Y_Comp := %X\n", getValue( HMI_StWhl_OFN1_Mtn_Y_Comp ) );        filePutString( buffer, elcount( buffer ), hFile );
    snprintf( buffer, elcount( buffer ), "0.0000 HMI_StWhl_OFN1_Stat := %X\n", getValue( HMI_StWhl_OFN1_Stat ) );        filePutString( buffer, elcount( buffer ), hFile );
    snprintf( buffer, elcount( buffer ), "0.0000 HMI_StWhl_OFN1_TmStmp := %X\n", getValue( HMI_StWhl_OFN1_TmStmp ) );        filePutString( buffer, elcount( buffer ), hFile );
    snprintf( buffer, elcount( buffer ), "0.0000 HMI_StWhl_OFN2_Mtn_X_Comp := %X\n", getValue( HMI_StWhl_OFN2_Mtn_X_Comp ) );        filePutString( buffer, elcount( buffer ), hFile );
    snprintf( buffer, elcount( buffer ), "0.0000 HMI_StWhl_OFN2_Mtn_Y_Comp := %X\n", getValue( HMI_StWhl_OFN2_Mtn_Y_Comp ) );        filePutString( buffer, elcount( buffer ), hFile );
    snprintf( buffer, elcount( buffer ), "0.0000 HMI_StWhl_OFN2_Stat := %X\n", getValue( HMI_StWhl_OFN2_Stat ) );        filePutString( buffer, elcount( buffer ), hFile );
    snprintf( buffer, elcount( buffer ), "0.0000 HMI_StWhl_OFN2_TmStmp := %X\n", getValue( HMI_StWhl_OFN2_TmStmp ) );        filePutString( buffer, elcount( buffer ), hFile );
}
/*@@end*/

/*@@timer:_tStWhl_OFN_Stat_AR:*/
on timer _tStWhl_OFN_Stat_AR
{
    putValue( HMI__STMSG_StWhl_OFN_Stat_AR, 0 );
}
/*@@end*/

/*@@envVar:HMI__STMSG_StWhl_OFN_Stat_AR:*/
on EnvVar HMI__STMSG_StWhl_OFN_Stat_AR
{
    long tDelay;
    if( getValue( this ) == 2 )
    {
        tDelay = getValue( HMI__STMSGT_StWhl_OFN_Stat_AR );
        if( tDelay > 0)    
            setTimer( _tStWhl_OFN_Stat_AR, tDelay );
        else
            putValue( HMI__STMSG_StWhl_OFN_Stat_AR, 0 );
    }
}
/*@@end*/

/*@@envVar:HMI__TRIGMSG_StWhl_OFN_Stat_AR:*/
on EnvVar HMI__TRIGMSG_StWhl_OFN_Stat_AR
{
    if( getValue( this ) )
    {
        _StWhl_OFN_Stat_AR_SpontanFlag = 1;
        putValue( this, 0 );
    }
}
/*@@end*/

/*@@envVar:HMI_StWhl_OFN_SnstyMd_Stat:*/
on EnvVar HMI_StWhl_OFN_SnstyMd_Stat
{
    _mStWhl_OFN_Stat_AR.StWhl_OFN_SnstyMd_Stat.phys = getValue(this);
//    _StWhl_OFN_Stat_AR_SpontanFlag = 1;
}
/*@@end*/

/*@@envVar:HMI_StWhl_OFN1_Mtn_X_Comp:*/
on EnvVar HMI_StWhl_OFN1_Mtn_X_Comp
{
    _mStWhl_OFN_Stat_AR.StWhl_OFN1_Mtn_X_Comp.phys = getValue(this);
//    _StWhl_OFN_Stat_AR_SpontanFlag = 1; // used by OFN-Simu, must not be set here!
}
/*@@end*/

/*@@envVar:HMI_StWhl_OFN1_Mtn_Y_Comp:*/
on EnvVar HMI_StWhl_OFN1_Mtn_Y_Comp
{
    _mStWhl_OFN_Stat_AR.StWhl_OFN1_Mtn_Y_Comp.phys = getValue(this);
//    _StWhl_OFN_Stat_AR_SpontanFlag = 1;
}
/*@@end*/

/*@@envVar:HMI_StWhl_OFN1_Stat:*/
on EnvVar HMI_StWhl_OFN1_Stat
{
    _mStWhl_OFN_Stat_AR.StWhl_OFN1_Stat.phys = getValue(this);
//    _StWhl_OFN_Stat_AR_SpontanFlag = 1;
}
/*@@end*/

/*@@envVar:HMI_StWhl_OFN1_TmStmp:*/
on EnvVar HMI_StWhl_OFN1_TmStmp
{
    _mStWhl_OFN_Stat_AR.StWhl_OFN1_TmStmp.phys = getValue(this);
//    _StWhl_OFN_Stat_AR_SpontanFlag = 1;
}
/*@@end*/

/*@@envVar:HMI_StWhl_OFN2_Mtn_X_Comp:*/
on EnvVar HMI_StWhl_OFN2_Mtn_X_Comp
{
    _mStWhl_OFN_Stat_AR.StWhl_OFN2_Mtn_X_Comp.phys = getValue(this);
//    _StWhl_OFN_Stat_AR_SpontanFlag = 1;
}
/*@@end*/

/*@@envVar:HMI_StWhl_OFN2_Mtn_Y_Comp:*/
on EnvVar HMI_StWhl_OFN2_Mtn_Y_Comp
{
    _mStWhl_OFN_Stat_AR.StWhl_OFN2_Mtn_Y_Comp.phys = getValue(this);
//    _StWhl_OFN_Stat_AR_SpontanFlag = 1;
}
/*@@end*/

/*@@envVar:HMI_StWhl_OFN2_Stat:*/
on EnvVar HMI_StWhl_OFN2_Stat
{
    _mStWhl_OFN_Stat_AR.StWhl_OFN2_Stat.phys = getValue(this);
//    _StWhl_OFN_Stat_AR_SpontanFlag = 1;
}
/*@@end*/

/*@@envVar:HMI_StWhl_OFN2_TmStmp:*/
on EnvVar HMI_StWhl_OFN2_TmStmp
{
    _mStWhl_OFN_Stat_AR.StWhl_OFN2_TmStmp.phys = getValue(this);
//    _StWhl_OFN_Stat_AR_SpontanFlag = 1;
}
/*@@end*/

/*@@caplFunc:StWhl_Sw_Stat_AR_check_output():*/
StWhl_Sw_Stat_AR_check_output()
{
    if( !getValue( HMI__STMSG_StWhl_Sw_Stat_AR ) )
    {
        // Botschaft StWhl_Sw_Stat_AR ID: 1025 --- Sendeart 5 cyclicAndSpontanWithDelay --- 
        _StWhl_Sw_Stat_AR_Cnt--;
        if( _StWhl_Sw_Stat_AR_Cnt < 1 )
        {
            // Nachricht wg. abgelaufenem Zyklus ausgeben
            StWhl_Sw_Stat_AR_output();
            _StWhl_Sw_Stat_AR_Cnt = _StWhl_Sw_Stat_AR_CycleCount; // Zyklus-Zähler zurücksetzen
            _StWhl_Sw_Stat_AR_SpontanFlag = 0; // Spontan-Flag zurücksetzen
        }
        else if( _StWhl_Sw_Stat_AR_SpontanFlag )
        {
            // Nachricht wg. spontaner Änderung ausgeben
            StWhl_Sw_Stat_AR_output();
            _StWhl_Sw_Stat_AR_SpontanFlag = 0; // Spontan-Flag zurücksetzen
        }
    }
}
/*@@end*/

/*@@caplFunc:StWhl_Sw_Stat_AR_init():*/
StWhl_Sw_Stat_AR_init()
{   /* Botschaft StWhl_Sw_Stat_AR ID: 1025 --- Sendeart 5 cyclicAndSpontanWithDelay --- 
BA_ "ApplMessage" BO_ 1025 0;
BA_ "NmAsrMessage" BO_ 1025 0;
BA_ "GenMsgMinAcceptLength" BO_ 1025 8;
BA_ "GenMsgILSupport" BO_ 1025 1;
BA_ "DiagState" BO_ 1025 0;
BA_ "DiagRequest" BO_ 1025 0;
BA_ "DiagResponse" BO_ 1025 0;
BA_ "GenMsgStartValue" BO_ 1025 "0";
BA_ "GenMsgStartDelayTime" BO_ 1025 0;
BA_ "GenMsgDelayTime" BO_ 1025 20;
BA_ "GenMsgNrOfRepetitions" BO_ 1025 0;
BA_ "GenMsgCycleTime" BO_ 1025 100;
BA_ "GenMsgSendType" BO_ 1025 5;
    */
    _StWhl_Sw_Stat_AR_Timebase =        c_tDBKomTimer_20ms;
    _StWhl_Sw_Stat_AR_CycleCount =     100 / _StWhl_Sw_Stat_AR_Timebase;
    _StWhl_Sw_Stat_AR_StartDelay =       0 / _StWhl_Sw_Stat_AR_Timebase;
    _StWhl_Sw_Stat_AR_Cnt = _StWhl_Sw_Stat_AR_StartDelay;
    _StWhl_Sw_Stat_AR_SpontanFlag = 0;

    putValue( HMI__STMSGSD_StWhl_Sw_Stat_AR, _StWhl_Sw_Stat_AR_StartDelay * _StWhl_Sw_Stat_AR_Timebase );

    _mStWhl_Sw_Stat_AR.ALDW_VibMot_Avl.phys = getValue( HMI_ALDW_VibMot_Avl );
    _mStWhl_Sw_Stat_AR.ALDW_VibMot_Avl_UB.phys = getValue( HMI_ALDW_VibMot_Avl_UB );
    _mStWhl_Sw_Stat_AR.ALDW_VibMot_Stat.phys = getValue( HMI_ALDW_VibMot_Stat );
    _mStWhl_Sw_Stat_AR.ALDW_VibMot_Stat_UB.phys = getValue( HMI_ALDW_VibMot_Stat_UB );
    _mStWhl_Sw_Stat_AR.HrnSw_Psd_V2.phys = getValue( HMI_HrnSw_Psd_V2 );
    _mStWhl_Sw_Stat_AR.StWhl_Cond_ALDW_Sup.phys = getValue( HMI_StWhl_Cond_ALDW_Sup );
    _mStWhl_Sw_Stat_AR.StWhl_Sw_Back1_Psd.phys = getValue( HMI_StWhl_Sw_Back1_Psd );
    _mStWhl_Sw_Stat_AR.StWhl_Sw_Back2_Psd.phys = getValue( HMI_StWhl_Sw_Back2_Psd );
    _mStWhl_Sw_Stat_AR.StWhl_Sw_Minus_Psd.phys = getValue( HMI_StWhl_Sw_Minus_Psd );
    _mStWhl_Sw_Stat_AR.StWhl_Sw_Mute_Psd.phys = getValue( HMI_StWhl_Sw_Mute_Psd );
    _mStWhl_Sw_Stat_AR.StWhl_Sw_Ok1_Psd.phys = getValue( HMI_StWhl_Sw_Ok1_Psd );
    _mStWhl_Sw_Stat_AR.StWhl_Sw_Ok2_Psd.phys = getValue( HMI_StWhl_Sw_Ok2_Psd );
    _mStWhl_Sw_Stat_AR.StWhl_Sw_Plus_Psd.phys = getValue( HMI_StWhl_Sw_Plus_Psd );
    _mStWhl_Sw_Stat_AR.StWhl_Sw_PTT_Psd.phys = getValue( HMI_StWhl_Sw_PTT_Psd );
    _mStWhl_Sw_Stat_AR.StWhl_Sw_TelEnd_Psd.phys = getValue( HMI_StWhl_Sw_TelEnd_Psd );
    _mStWhl_Sw_Stat_AR.StWhl_Sw_TelSend_Psd.phys = getValue( HMI_StWhl_Sw_TelSend_Psd );
    _mStWhl_Sw_Stat_AR.Vol_Rq_SWSP.phys = getValue( HMI_Vol_Rq_SWSP );
}
/*@@end*/

/*@@caplFunc:StWhl_Sw_Stat_AR_output():*/
void StWhl_Sw_Stat_AR_output(void)
{
    byte crc;
    byte SQC_help;

    if( !getValue( HMI_SQC_StWhl_Sw_Ok1_Ok2_Psd_Auto ) )
    {
        // berechne message counter
        SQC_help = getValue( HMI_SQC_StWhl_Sw_Ok1_Ok2_Psd );
        if( SQC_help >= 15 ) SQC_help = 0;
        else SQC_help++;
        putValue( HMI_SQC_StWhl_Sw_Ok1_Ok2_Psd, SQC_help );
        _mStWhl_Sw_Stat_AR.SQC_StWhl_Sw_Ok1_Ok2_Psd = SQC_help;
    }
    else
          _mStWhl_Sw_Stat_AR.SQC_StWhl_Sw_Ok1_Ok2_Psd = getValue( HMI_SQC_StWhl_Sw_Ok1_Ok2_Psd );

    if( getValue( HMI_CRC_StWhl_Sw_Ok1_Ok2_Psd_Profile_02 ) )
    {
        if( !getValue( HMI_CRC_StWhl_Sw_Ok1_Ok2_Psd_Auto ) )
        {   // CRC according Profile_02 ( W213 )
            // berechne crc
            crc = 0xFF;
//          crc = crctable_profile02[ crc ^ _mStWhl_Sw_Stat_AR.byte( 0 ) ];
//            crc = crctable_profile02[crc ^ _mStWhl_Sw_Stat_AR.byte( 1 )];  CRC
            crc = crctable_profile02[crc ^ _mStWhl_Sw_Stat_AR.byte( 2 )];
//            crc = crctable_profile02[crc ^ _mStWhl_Sw_Stat_AR.byte( 3 )];
//            crc = crctable_profile02[crc ^ _mStWhl_Sw_Stat_AR.byte( 4 )];
//            crc = crctable_profile02[crc ^ _mStWhl_Sw_Stat_AR.byte( 5 )];
//            crc = crctable_profile02[crc ^ _mStWhl_Sw_Stat_AR.byte( 6 )];
//            crc = crctable_profile02[crc ^ _mStWhl_Sw_Stat_AR.byte( 7 )];
            crc = crctable_profile02[ crc ^ _StWhl_Sw_Stat_AR_CRC_Offset[ _mStWhl_Sw_Stat_AR.SQC_StWhl_Sw_Ok1_Ok2_Psd ] ]; // load offset
            crc = (crc ^ 0xFF);
            if( getValue(  HMI_CRC_StWhl_Sw_Ok1_Ok2_Psd_Invalid ) )
                crc++;
            _mStWhl_Sw_Stat_AR.CRC_StWhl_Sw_Ok1_Ok2_Psd = crc;
            putValue( HMI_CRC_StWhl_Sw_Ok1_Ok2_Psd, crc );
        }
        else
            _mStWhl_Sw_Stat_AR.CRC_StWhl_Sw_Ok1_Ok2_Psd = getValue( HMI_CRC_StWhl_Sw_Ok1_Ok2_Psd );
    }
    output( _mStWhl_Sw_Stat_AR );
}
/*@@end*/

/*@@caplFunc:StWhl_Sw_Stat_AR_saveEnvVars(dword):*/
StWhl_Sw_Stat_AR_saveEnvVars( dword hFile )
{
    filePutString("\n// Knoten EIS: StWhl_Sw_Stat_AR\n", 28, hFile );
    snprintf( buffer, elcount( buffer ), "0.0000 HMI__STMSG_StWhl_Sw_Stat_AR := %X\n", getValue( HMI__STMSG_StWhl_Sw_Stat_AR ) );        filePutString( buffer, elcount( buffer ), hFile );
    snprintf( buffer, elcount( buffer ), "0.0000 HMI__STMSGT_StWhl_Sw_Stat_AR := %X\n", getValue( HMI__STMSGT_StWhl_Sw_Stat_AR ) );        filePutString( buffer, elcount( buffer ), hFile );
    snprintf( buffer, elcount( buffer ), "0.0000 HMI_ALDW_VibMot_Avl := %X\n", getValue( HMI_ALDW_VibMot_Avl ) );        filePutString( buffer, elcount( buffer ), hFile );
    snprintf( buffer, elcount( buffer ), "0.0000 HMI_ALDW_VibMot_Avl_UB := %X\n", getValue( HMI_ALDW_VibMot_Avl_UB ) );        filePutString( buffer, elcount( buffer ), hFile );
    snprintf( buffer, elcount( buffer ), "0.0000 HMI_ALDW_VibMot_Stat := %X\n", getValue( HMI_ALDW_VibMot_Stat ) );        filePutString( buffer, elcount( buffer ), hFile );
    snprintf( buffer, elcount( buffer ), "0.0000 HMI_ALDW_VibMot_Stat_UB := %X\n", getValue( HMI_ALDW_VibMot_Stat_UB ) );        filePutString( buffer, elcount( buffer ), hFile );
    snprintf( buffer, elcount( buffer ), "0.0000 HMI_CRC_StWhl_Sw_Ok1_Ok2_Psd := %X\n", getValue( HMI_CRC_StWhl_Sw_Ok1_Ok2_Psd ) );        filePutString( buffer, elcount( buffer ), hFile );
    snprintf( buffer, elcount( buffer ), "0.0000 HMI_CRC_StWhl_Sw_Ok1_Ok2_Psd_Auto := %X\n", getValue( HMI_CRC_StWhl_Sw_Ok1_Ok2_Psd_Auto ) );        filePutString( buffer, elcount( buffer ), hFile );
    snprintf( buffer, elcount( buffer ), "0.0000 HMI_CRC_StWhl_Sw_Ok1_Ok2_Psd_Profile_02 := %X\n", getValue( HMI_CRC_StWhl_Sw_Ok1_Ok2_Psd_Profile_02 ) );        filePutString( buffer, elcount( buffer ), hFile );
    snprintf( buffer, elcount( buffer ), "0.0000 HMI_HrnSw_Psd_V2 := %X\n", getValue( HMI_HrnSw_Psd_V2 ) );        filePutString( buffer, elcount( buffer ), hFile );
//    snprintf( buffer, elcount( buffer ), "0.0000 HMI_Rsrv1_StWhl_Sw_Ok1_Ok2_Psd := %X\n", getValue( HMI_Rsrv1_StWhl_Sw_Ok1_Ok2_Psd ) );        filePutString( buffer, elcount( buffer ), hFile );
    snprintf( buffer, elcount( buffer ), "0.0000 HMI_SQC_StWhl_Sw_Ok1_Ok2_Psd := %X\n", getValue( HMI_SQC_StWhl_Sw_Ok1_Ok2_Psd ) );        filePutString( buffer, elcount( buffer ), hFile );
    snprintf( buffer, elcount( buffer ), "0.0000 HMI_SQC_StWhl_Sw_Ok1_Ok2_Psd_Auto := %X\n", getValue( HMI_SQC_StWhl_Sw_Ok1_Ok2_Psd_Auto ) );        filePutString( buffer, elcount( buffer ), hFile );
    snprintf( buffer, elcount( buffer ), "0.0000 HMI_StWhl_Cond_ALDW_Sup := %X\n", getValue( HMI_StWhl_Cond_ALDW_Sup ) );        filePutString( buffer, elcount( buffer ), hFile );
    snprintf( buffer, elcount( buffer ), "0.0000 HMI_StWhl_Sw_Back1_Psd := %X\n", getValue( HMI_StWhl_Sw_Back1_Psd ) );        filePutString( buffer, elcount( buffer ), hFile );
    snprintf( buffer, elcount( buffer ), "0.0000 HMI_StWhl_Sw_Back2_Psd := %X\n", getValue( HMI_StWhl_Sw_Back2_Psd ) );        filePutString( buffer, elcount( buffer ), hFile );
    snprintf( buffer, elcount( buffer ), "0.0000 HMI_StWhl_Sw_Minus_Psd := %X\n", getValue( HMI_StWhl_Sw_Minus_Psd ) );        filePutString( buffer, elcount( buffer ), hFile );
    snprintf( buffer, elcount( buffer ), "0.0000 HMI_StWhl_Sw_Mute_Psd := %X\n", getValue( HMI_StWhl_Sw_Mute_Psd ) );        filePutString( buffer, elcount( buffer ), hFile );
    snprintf( buffer, elcount( buffer ), "0.0000 HMI_StWhl_Sw_Ok1_Psd := %X\n", getValue( HMI_StWhl_Sw_Ok1_Psd ) );        filePutString( buffer, elcount( buffer ), hFile );
    snprintf( buffer, elcount( buffer ), "0.0000 HMI_StWhl_Sw_Ok2_Psd := %X\n", getValue( HMI_StWhl_Sw_Ok2_Psd ) );        filePutString( buffer, elcount( buffer ), hFile );
    snprintf( buffer, elcount( buffer ), "0.0000 HMI_StWhl_Sw_Plus_Psd := %X\n", getValue( HMI_StWhl_Sw_Plus_Psd ) );        filePutString( buffer, elcount( buffer ), hFile );
    snprintf( buffer, elcount( buffer ), "0.0000 HMI_StWhl_Sw_PTT_Psd := %X\n", getValue( HMI_StWhl_Sw_PTT_Psd ) );        filePutString( buffer, elcount( buffer ), hFile );
    snprintf( buffer, elcount( buffer ), "0.0000 HMI_StWhl_Sw_TelEnd_Psd := %X\n", getValue( HMI_StWhl_Sw_TelEnd_Psd ) );        filePutString( buffer, elcount( buffer ), hFile );
    snprintf( buffer, elcount( buffer ), "0.0000 HMI_StWhl_Sw_TelSend_Psd := %X\n", getValue( HMI_StWhl_Sw_TelSend_Psd ) );        filePutString( buffer, elcount( buffer ), hFile );
    snprintf( buffer, elcount( buffer ), "0.0000 HMI_Vol_Rq_SWSP := %X\n", getValue( HMI_Vol_Rq_SWSP ) );        filePutString( buffer, elcount( buffer ), hFile );
}
/*@@end*/

/*@@timer:_tStWhl_Sw_Stat_AR:*/
on timer _tStWhl_Sw_Stat_AR
{
    putValue( HMI__STMSG_StWhl_Sw_Stat_AR, 0 );
}
/*@@end*/

/*@@envVar:HMI__STMSG_StWhl_Sw_Stat_AR:*/
on EnvVar HMI__STMSG_StWhl_Sw_Stat_AR
{
    long tDelay;
    if( getValue( this ) == 2 )
    {
        tDelay = getValue( HMI__STMSGT_StWhl_Sw_Stat_AR );
        if( tDelay > 0)    
            setTimer( _tStWhl_Sw_Stat_AR, tDelay );
        else
            putValue( HMI__STMSG_StWhl_Sw_Stat_AR, 0 );
    }
}
/*@@end*/

/*@@envVar:HMI_ALDW_VibMot_Avl:*/
on EnvVar HMI_ALDW_VibMot_Avl
{
    _mStWhl_Sw_Stat_AR.ALDW_VibMot_Avl.phys = getValue(this);
    _StWhl_Sw_Stat_AR_SpontanFlag = 1;
}
/*@@end*/

/*@@envVar:HMI_ALDW_VibMot_Avl_UB:*/
on EnvVar HMI_ALDW_VibMot_Avl_UB
{
    _mStWhl_Sw_Stat_AR.ALDW_VibMot_Avl_UB.phys = getValue(this);
    _StWhl_Sw_Stat_AR_SpontanFlag = 1;
}
/*@@end*/

/*@@envVar:HMI_ALDW_VibMot_Stat:*/
on EnvVar HMI_ALDW_VibMot_Stat
{
    _mStWhl_Sw_Stat_AR.ALDW_VibMot_Stat.phys = getValue(this);
    _StWhl_Sw_Stat_AR_SpontanFlag = 1;
}
/*@@end*/

/*@@envVar:HMI_ALDW_VibMot_Stat_UB:*/
on EnvVar HMI_ALDW_VibMot_Stat_UB
{
    _mStWhl_Sw_Stat_AR.ALDW_VibMot_Stat_UB.phys = getValue(this);
    _StWhl_Sw_Stat_AR_SpontanFlag = 1;
}
/*@@end*/

/*@@envVar:HMI_HrnSw_Psd_V2:*/
on EnvVar HMI_HrnSw_Psd_V2
{
    _mStWhl_Sw_Stat_AR.HrnSw_Psd_V2.phys = getValue(this);
    _StWhl_Sw_Stat_AR_SpontanFlag = 1;
}
/*@@end*/

/*@@envVar:HMI_StWhl_Cond_ALDW_Sup:*/
on EnvVar HMI_StWhl_Cond_ALDW_Sup
{
    _mStWhl_Sw_Stat_AR.StWhl_Cond_ALDW_Sup.phys = getValue(this);
    _StWhl_Sw_Stat_AR_SpontanFlag = 1;
}
/*@@end*/

/*@@envVar:HMI_StWhl_Sw_Back1_Psd:*/
on EnvVar HMI_StWhl_Sw_Back1_Psd
{
    if( ( getValue( Env_Stress__StresstestMainActiv ) == 0 )   &&
        ( getValue( HMI__NM_EIS_AutomaticNM_Switching ) == 0 )    )
    {
        _SetCommRequest( cStWhlButtonNMRequest );
        setTimer( t_StWhlButtonNMCancelTimer, c_NMCancelTimer_05sec ); // 5 seconds for auto-shut-off
    }
    _mStWhl_Sw_Stat_AR.StWhl_Sw_Back1_Psd.phys = getValue(this);
    _StWhl_Sw_Stat_AR_SpontanFlag = 1;
}
/*@@end*/

/*@@envVar:HMI_StWhl_Sw_Back2_Psd:*/
on EnvVar HMI_StWhl_Sw_Back2_Psd
{
    if( ( getValue( Env_Stress__StresstestMainActiv ) == 0 )   &&
        ( getValue( HMI__NM_EIS_AutomaticNM_Switching ) == 0 )    )
    {
        _SetCommRequest( cStWhlButtonNMRequest );
        setTimer( t_StWhlButtonNMCancelTimer, c_NMCancelTimer_05sec ); // 5 seconds for auto-shut-off
    }
    _mStWhl_Sw_Stat_AR.StWhl_Sw_Back2_Psd.phys = getValue(this);
    _StWhl_Sw_Stat_AR_SpontanFlag = 1;
}
/*@@end*/

/*@@envVar:HMI_StWhl_Sw_Minus_Psd:*/
on EnvVar HMI_StWhl_Sw_Minus_Psd
{
    if( ( getValue( Env_Stress__StresstestMainActiv ) == 0 )   &&
        ( getValue( HMI__NM_EIS_AutomaticNM_Switching ) == 0 )    )
    {
        _SetCommRequest( cStWhlButtonNMRequest );
        setTimer( t_StWhlButtonNMCancelTimer, c_NMCancelTimer_05sec ); // 5 seconds for auto-shut-off
    }
    _mStWhl_Sw_Stat_AR.StWhl_Sw_Minus_Psd.phys = getValue(this);
    _StWhl_Sw_Stat_AR_SpontanFlag = 1;
}
/*@@end*/

/*@@envVar:HMI_StWhl_Sw_Mute_Psd:*/
on EnvVar HMI_StWhl_Sw_Mute_Psd
{
    if( ( getValue( Env_Stress__StresstestMainActiv ) == 0 )   &&
        ( getValue( HMI__NM_EIS_AutomaticNM_Switching ) == 0 )    )
    {
        _SetCommRequest( cStWhlButtonNMRequest );
        setTimer( t_StWhlButtonNMCancelTimer, c_NMCancelTimer_05sec ); // 5 seconds for auto-shut-off
    }
    _mStWhl_Sw_Stat_AR.StWhl_Sw_Mute_Psd.phys = getValue(this);
    _StWhl_Sw_Stat_AR_SpontanFlag = 1;
}
/*@@end*/

/*@@envVar:HMI_StWhl_Sw_Ok1_Psd:*/
on EnvVar HMI_StWhl_Sw_Ok1_Psd
{
    if( ( getValue( Env_Stress__StresstestMainActiv ) == 0 )   &&
        ( getValue( HMI__NM_EIS_AutomaticNM_Switching ) == 0 )    )
    {
        _SetCommRequest( cStWhlButtonNMRequest );
        setTimer( t_StWhlButtonNMCancelTimer, c_NMCancelTimer_05sec ); // 5 seconds for auto-shut-off
    }
    _mStWhl_Sw_Stat_AR.StWhl_Sw_Ok1_Psd.phys = getValue(this);
    _StWhl_Sw_Stat_AR_SpontanFlag = 1;
}
/*@@end*/

/*@@envVar:HMI_StWhl_Sw_Ok2_Psd:*/
on EnvVar HMI_StWhl_Sw_Ok2_Psd
{
    if( ( getValue( Env_Stress__StresstestMainActiv ) == 0 )   &&
        ( getValue( HMI__NM_EIS_AutomaticNM_Switching ) == 0 )    )
    {
        _SetCommRequest( cStWhlButtonNMRequest );
        setTimer( t_StWhlButtonNMCancelTimer, c_NMCancelTimer_05sec ); // 5 seconds for auto-shut-off
    }
    _mStWhl_Sw_Stat_AR.StWhl_Sw_Ok2_Psd.phys = getValue(this);
    _StWhl_Sw_Stat_AR_SpontanFlag = 1;
}
/*@@end*/

/*@@envVar:HMI_StWhl_Sw_Plus_Psd:*/
on EnvVar HMI_StWhl_Sw_Plus_Psd
{
    if( ( getValue( Env_Stress__StresstestMainActiv ) == 0 )   &&
        ( getValue( HMI__NM_EIS_AutomaticNM_Switching ) == 0 )    )
    {
        _SetCommRequest( cStWhlButtonNMRequest );
        setTimer( t_StWhlButtonNMCancelTimer, c_NMCancelTimer_05sec ); // 5 seconds for auto-shut-off
    }
    _mStWhl_Sw_Stat_AR.StWhl_Sw_Plus_Psd.phys = getValue(this);
    _StWhl_Sw_Stat_AR_SpontanFlag = 1;
}
/*@@end*/

/*@@envVar:HMI_StWhl_Sw_PTT_Psd:*/
on EnvVar HMI_StWhl_Sw_PTT_Psd
{
    if( ( getValue( Env_Stress__StresstestMainActiv ) == 0 )   &&
        ( getValue( HMI__NM_EIS_AutomaticNM_Switching ) == 0 )    )
    {
        _SetCommRequest( cStWhlButtonNMRequest );
        setTimer( t_StWhlButtonNMCancelTimer, c_NMCancelTimer_05sec ); // 5 seconds for auto-shut-off
    }
    _mStWhl_Sw_Stat_AR.StWhl_Sw_PTT_Psd.phys = getValue(this);
    _StWhl_Sw_Stat_AR_SpontanFlag = 1;
}
/*@@end*/

/*@@envVar:HMI_StWhl_Sw_TelEnd_Psd:*/
on EnvVar HMI_StWhl_Sw_TelEnd_Psd
{
    if( ( getValue( Env_Stress__StresstestMainActiv ) == 0 )   &&
        ( getValue( HMI__NM_EIS_AutomaticNM_Switching ) == 0 )    )
    {
        _SetCommRequest( cStWhlButtonNMRequest );
        setTimer( t_StWhlButtonNMCancelTimer, c_NMCancelTimer_05sec ); // 5 seconds for auto-shut-off
    }
    _mStWhl_Sw_Stat_AR.StWhl_Sw_TelEnd_Psd.phys = getValue(this);
    _StWhl_Sw_Stat_AR_SpontanFlag = 1;
}
/*@@end*/

/*@@envVar:HMI_StWhl_Sw_TelSend_Psd:*/
on EnvVar HMI_StWhl_Sw_TelSend_Psd
{
    if( ( getValue( Env_Stress__StresstestMainActiv ) == 0 )   &&
        ( getValue( HMI__NM_EIS_AutomaticNM_Switching ) == 0 )    )
    {
        _SetCommRequest( cStWhlButtonNMRequest );
        setTimer( t_StWhlButtonNMCancelTimer, c_NMCancelTimer_05sec ); // 5 seconds for auto-shut-off
    }
    _mStWhl_Sw_Stat_AR.StWhl_Sw_TelSend_Psd.phys = getValue(this);
    _StWhl_Sw_Stat_AR_SpontanFlag = 1;
}
/*@@end*/

/*@@envVar:HMI_Vol_Rq_SWSP:*/
on EnvVar HMI_Vol_Rq_SWSP
{
    _mStWhl_Sw_Stat_AR.Vol_Rq_SWSP.phys = getValue(this);
    _StWhl_Sw_Stat_AR_SpontanFlag = 1;
}
/*@@end*/

/*@@caplFunc:TC_Disp_Rq_ECM_AR_check_output():*/
TC_Disp_Rq_ECM_AR_check_output()
{
    if( !getValue( HMI__STMSG_TC_Disp_Rq_ECM_AR ) )
    {
        // Botschaft TC_Disp_Rq_ECM ID: 331 --- Sendeart 0 cyclicX --- 
        _TC_Disp_Rq_ECM_AR_Cnt--;
        if( _TC_Disp_Rq_ECM_AR_Cnt < 1 )
        {
            // Zyklus abgelaufen, Nachricht senden
            TC_Disp_Rq_ECM_AR_next_values();
            if( _TC_Disp_Rq_ECM_AR_TC_FuelType_ActState == 0 )
            {
                putValue( HMI_TC_FuelType_TC_DISP_RQ, _TC_Disp_Rq_ECM_AR_TC_FuelType_ActState );
                _mTC_Disp_Rq_ECM_AR.TC_FuelType_TC_DISP_RQ.phys = getValue( HMI_TC_FuelType_TC_DISP_RQ);
                _mTC_Disp_Rq_ECM_AR.TC_GasFuelCons.phys = getValue( HMI_TC_GasFuelCons);
                _mTC_Disp_Rq_ECM_AR.TC_GasFuelCons_Reset.phys = getValue( HMI_TC_GasFuelCons_Reset );
                _mTC_Disp_Rq_ECM_AR.TC_GasFuelCons_Start.phys = getValue( HMI_TC_GasFuelCons_Start );
                _mTC_Disp_Rq_ECM_AR.TC_GasFuelTankLvl_Min_50.phys = getValue( HMI_TC_GasFuelTankLvl_Min_50 );
                _mTC_Disp_Rq_ECM_AR.TC_GasFuelTankRng.phys = getValue( HMI_TC_GasFuelTankRng);
            }
            if( _TC_Disp_Rq_ECM_AR_TC_FuelType_ActState == 1 )
            {
                putValue( HMI_TC_FuelType_TC_DISP_RQ, _TC_Disp_Rq_ECM_AR_TC_FuelType_ActState );
                _mTC_Disp_Rq_ECM_AR.TC_FuelType_TC_DISP_RQ.phys = getValue( HMI_TC_FuelType_TC_DISP_RQ);
                _mTC_Disp_Rq_ECM_AR.TC_LiquidFuelCons.phys = getValue( HMI_TC_LiquidFuelCons);
                _mTC_Disp_Rq_ECM_AR.TC_LiquidFuelCons_Reset.phys = getValue( HMI_TC_LiquidFuelCons_Reset );
                _mTC_Disp_Rq_ECM_AR.TC_LiquidFuelCons_Start.phys = getValue( HMI_TC_LiquidFuelCons_Start );
                _mTC_Disp_Rq_ECM_AR.TC_LiquidFuelTankLvl_Min_50.phys = getValue( HMI_TC_LiquidFuelTankLvl_Min_50 );
                _mTC_Disp_Rq_ECM_AR.TC_LiquidFuelTankRng.phys = getValue( HMI_TC_LiquidFuelTankRng);
                _mTC_Disp_Rq_ECM_AR.TC_SkipRng_Disp_Rq.phys = getValue( HMI_TC_SkipRng_Disp_Rq_LiqFuel );
            }
            if( _TC_Disp_Rq_ECM_AR_TC_FuelType_ActState == 2 )
            {
                putValue( HMI_TC_FuelType_TC_DISP_RQ, _TC_Disp_Rq_ECM_AR_TC_FuelType_ActState );
                _mTC_Disp_Rq_ECM_AR.TC_FuelType_TC_DISP_RQ.phys = getValue( HMI_TC_FuelType_TC_DISP_RQ );
                _mTC_Disp_Rq_ECM_AR.TC_LiquidFuelTankLvl_Min_50.phys = getValue( HMI_TC_ElecEnergyLvl_Min_50 );
                _mTC_Disp_Rq_ECM_AR.TC_LiquidFuelTankRng.phys = getValue( HMI_TC_ElecEnergyRng );
                _mTC_Disp_Rq_ECM_AR.TC_LiquidFuelCons_Reset.phys = getValue( HMI_TC_ElecEnergyCons_Reset );
                _mTC_Disp_Rq_ECM_AR.TC_LiquidFuelCons_Start.phys = getValue( HMI_TC_ElecEnergyCons_Start );
                _mTC_Disp_Rq_ECM_AR.TC_LiquidFuelCons.phys = getValue( HMI_TC_ElecEnergyCons );
                _mTC_Disp_Rq_ECM_AR.TC_SkipRng_Disp_Rq.phys = getValue( HMI_TC_SkipRng_Disp_Rq_Elec );
            }
            if( _TC_Disp_Rq_ECM_AR_TC_FuelType_ActState == 3 )
            {
                putValue( HMI_TC_FuelType_TC_DISP_RQ, _TC_Disp_Rq_ECM_AR_TC_FuelType_ActState );
                _mTC_Disp_Rq_ECM_AR.TC_FuelType_TC_DISP_RQ.phys = getValue( HMI_TC_FuelType_TC_DISP_RQ );
                _mTC_Disp_Rq_ECM_AR.TC_LiquidFuelTankLvl_Min_50.phys = 0;
                _mTC_Disp_Rq_ECM_AR.TC_LiquidFuelTankRng.phys = 2047;
                _mTC_Disp_Rq_ECM_AR.TC_LiquidFuelCons_Reset.phys = 102.3;
                _mTC_Disp_Rq_ECM_AR.TC_LiquidFuelCons_Start.phys = 102.3;
                _mTC_Disp_Rq_ECM_AR.TC_LiquidFuelCons.phys = 102.3;
                _mTC_Disp_Rq_ECM_AR.TC_SkipRng_Disp_Rq.phys = 0;
            }

            TC_Disp_Rq_ECM_AR_output();
            _TC_Disp_Rq_ECM_AR_Cnt = _TC_Disp_Rq_ECM_AR_CycleCount;
        }
    }
}
/*@@end*/

/*@@caplFunc:TC_Disp_Rq_ECM_AR_init():*/
TC_Disp_Rq_ECM_AR_init()
{   /* Botschaft TC_Disp_Rq_ECM_AR ID: 331 --- Sendeart 0 cyclicX --- 
BA_ "ApplMessage" BO_ 331 0;
BA_ "NmAsrMessage" BO_ 331 0;
BA_ "GenMsgMinAcceptLength" BO_ 331 8;
BA_ "GenMsgILSupport" BO_ 331 0;
BA_ "DiagState" BO_ 331 0;
BA_ "DiagRequest" BO_ 331 0;
BA_ "DiagResponse" BO_ 331 0;
BA_ "GenMsgStartValue" BO_ 331 "0";
BA_ "GenMsgStartDelayTime" BO_ 331 0;
BA_ "GenMsgCycleTime" BO_ 331 40;
BA_ "GenMsgSendType" BO_ 331 0;
    */
    _TC_Disp_Rq_ECM_AR_Timebase =           c_tDBKomTimer_20ms;
    _TC_Disp_Rq_ECM_AR_CycleCount =         40 / _TC_Disp_Rq_ECM_AR_Timebase;
    _TC_Disp_Rq_ECM_AR_StartDelay =          0 / _TC_Disp_Rq_ECM_AR_Timebase;
    _TC_Disp_Rq_ECM_AR_Cnt = _TC_Disp_Rq_ECM_AR_StartDelay;
    _TC_Disp_Rq_ECM_AR_SigActivity = 0;

    putValue( HMI__STMSGSD_TC_Disp_Rq_ECM_AR, _TC_Disp_Rq_ECM_AR_StartDelay * _TC_Disp_Rq_ECM_AR_Timebase );

    _mTC_Disp_Rq_ECM_AR.TC_PN14_RecupPwr.phys = getValue( HMI_TC_PN14_RecupPwr );
    _mTC_Disp_Rq_ECM_AR.ZeroEmission_Actv.phys = getValue( HMI_ZeroEmission_Actv );
    _mTC_Disp_Rq_ECM_AR.TC_FuelType_TC_DISP_RQ.phys = getValue( HMI_TC_FuelType_TC_DISP_RQ );
    _mTC_Disp_Rq_ECM_AR.TC_GasFuelCons.phys = getValue( HMI_TC_GasFuelCons );
    _mTC_Disp_Rq_ECM_AR.TC_GasFuelCons_Reset.phys = getValue( HMI_TC_GasFuelCons_Reset );
    _mTC_Disp_Rq_ECM_AR.TC_GasFuelCons_Start.phys = getValue( HMI_TC_GasFuelCons_Start );
    _mTC_Disp_Rq_ECM_AR.TC_GasFuelTankLvl_Min_50.phys = getValue( HMI_TC_GasFuelTankLvl_Min_50 );
    _mTC_Disp_Rq_ECM_AR.TC_GasFuelTankRng.phys = getValue( HMI_TC_GasFuelTankRng );
    _mTC_Disp_Rq_ECM_AR.TC_SkipRng_Disp_Rq.phys = getValue( HMI_TC_SkipRng_Disp_Rq_LiqFuel );
    _mTC_Disp_Rq_ECM_AR.TC_LiquidFuelCons.phys = getValue( HMI_TC_LiquidFuelCons );
    _mTC_Disp_Rq_ECM_AR.TC_LiquidFuelCons_Reset.phys = getValue( HMI_TC_LiquidFuelCons_Reset );
    _mTC_Disp_Rq_ECM_AR.TC_LiquidFuelCons_Start.phys = getValue( HMI_TC_LiquidFuelCons_Start );
    _mTC_Disp_Rq_ECM_AR.TC_LiquidFuelTankLvl_Min_50.phys = getValue( HMI_TC_LiquidFuelTankLvl_Min_50 );
    _mTC_Disp_Rq_ECM_AR.TC_LiquidFuelTankRng.phys = getValue( HMI_TC_LiquidFuelTankRng );
    _mTC_Disp_Rq_ECM_AR.TC_SkipRng_Disp_Rq.phys = getValue( HMI_TC_SkipRng_Disp_Rq_LiqFuel );
    _mTC_Disp_Rq_ECM_AR.TC_ElecEnergyCons.phys = getValue( HMI_TC_ElecEnergyCons );
    _mTC_Disp_Rq_ECM_AR.TC_ElecEnergyCons_Reset.phys = getValue( HMI_TC_ElecEnergyCons_Reset );
    _mTC_Disp_Rq_ECM_AR.TC_ElecEnergyCons_Start.phys = getValue( HMI_TC_ElecEnergyCons_Start );
    _mTC_Disp_Rq_ECM_AR.TC_ElecEnergyLvl_Min_50.phys = getValue( HMI_TC_ElecEnergyLvl_Min_50 );
    _mTC_Disp_Rq_ECM_AR.TC_ElecEnergyRng.phys = getValue( HMI_TC_ElecEnergyRng );
    _mTC_Disp_Rq_ECM_AR.TC_SkipRng_Disp_Rq.phys = getValue( HMI_TC_SkipRng_Disp_Rq_LiqFuel );
//    _TC_Disp_Rq_ECM_ARTC_FuelTypeActState = TC_Disp_Rq_ECM_AR_Change( _TC_Disp_Rq_ECM_ARTC_FuelTypeActState, _mTC_Disp_Rq_ECM_AR.TC_FuelType_TC_DISP_RQ, 3);
    putValue( HMI_TC_FuelType, _TC_Disp_Rq_ECM_AR_TC_FuelType_ActState );
}
/*@@end*/

/*@@caplFunc:TC_Disp_Rq_ECM_AR_next_values():*/
TC_Disp_Rq_ECM_AR_next_values()
{
    if( ( getValue( HMI_TC_FuelType_TC_DISP_RQ_Liquid ) == 0 ) &     // 1
        ( getValue( HMI_TC_FuelType_TC_DISP_RQ_Gas    ) == 0 ) &     // 0
        ( getValue( HMI_TC_FuelType_TC_DISP_RQ_Elec   ) == 0 )    )   // 2
    {
        _TC_Disp_Rq_ECM_AR_TC_FuelType_ActState = 3;  //SNA
        return;
    }
    else
    if( _TC_Disp_Rq_ECM_AR_TC_FuelType_ActState == 3 )  //SNA
        _TC_Disp_Rq_ECM_AR_TC_FuelType_ActState = 0;

    if( _TC_Disp_Rq_ECM_AR_TC_FuelType_ActState == 0 )    // Gas
    {
        if( getValue( HMI_TC_FuelType_TC_DISP_RQ_Liquid ) == 1 )   // 1
        {
            _TC_Disp_Rq_ECM_AR_TC_FuelType_ActState = 1;  // Liquid
            return;
        }
        if( getValue( HMI_TC_FuelType_TC_DISP_RQ_Elec ) == 1 )     // 2
        {
            _TC_Disp_Rq_ECM_AR_TC_FuelType_ActState = 2;  // Elec
            return;
        }
        return; // no change, only one type active
    }

    if( _TC_Disp_Rq_ECM_AR_TC_FuelType_ActState == 1 )    // Liquid
    {
        if( getValue( HMI_TC_FuelType_TC_DISP_RQ_Elec ) == 1 )   // 1
        {
            _TC_Disp_Rq_ECM_AR_TC_FuelType_ActState = 2;  // Elec
            return;
        }
        if( getValue( HMI_TC_FuelType_TC_DISP_RQ_Gas ) == 1 )     // 2
        {
            _TC_Disp_Rq_ECM_AR_TC_FuelType_ActState = 0;  // Gas
            return;
        }
        return; // no change, only one type active
    }
    if( _TC_Disp_Rq_ECM_AR_TC_FuelType_ActState == 2 )    // Elec
    {
        if( getValue( HMI_TC_FuelType_TC_DISP_RQ_Gas ) == 1 )   // 1
        {
            _TC_Disp_Rq_ECM_AR_TC_FuelType_ActState = 0;  // Gas
            return;
        }
        if( getValue( HMI_TC_FuelType_TC_DISP_RQ_Liquid ) == 1 )     // 2
        {
            _TC_Disp_Rq_ECM_AR_TC_FuelType_ActState = 1;  // Liquid
            return;
        }
        return; // no change, only one type active
    }
}
/*@@end*/

/*@@caplFunc:TC_Disp_Rq_ECM_AR_output():*/
TC_Disp_Rq_ECM_AR_output()
{
    output( _mTC_Disp_Rq_ECM_AR );
}
/*@@end*/

/*@@caplFunc:TC_Disp_Rq_ECM_AR_saveEnvVars(dword):*/
TC_Disp_Rq_ECM_AR_saveEnvVars( dword hFile )
{
    filePutString("\n// Knoten EIS: TC_Disp_Rq_ECM_AR\n", 31, hFile );
    snprintf( buffer, elcount( buffer ), "0.0000 HMI__STMSG_TC_Disp_Rq_ECM_AR := %X\n", getValue( HMI__STMSG_TC_Disp_Rq_ECM_AR ) );    filePutString( buffer, elcount( buffer ), hFile );
    snprintf( buffer, elcount( buffer ), "0.0000 HMI__STMSGT_TC_Disp_Rq_ECM_AR := %X\n", getValue( HMI__STMSGT_TC_Disp_Rq_ECM_AR ) );    filePutString( buffer, elcount( buffer ), hFile );
    snprintf( buffer, elcount( buffer ), "0.0000 HMI_TC_PN14_RecupPwr := %X\n", getValue( HMI_TC_PN14_RecupPwr ) );    filePutString( buffer, elcount( buffer ), hFile );
    snprintf( buffer, elcount( buffer ), "0.0000 HMI_ZeroEmission_Actv := %X\n", getValue( HMI_ZeroEmission_Actv ) );    filePutString( buffer, elcount( buffer ), hFile );
    snprintf( buffer, elcount( buffer ), "0.0000 HMI_TC_FuelType_TC_DISP_RQ := %X\n", getValue( HMI_TC_FuelType_TC_DISP_RQ ) );    filePutString( buffer, elcount( buffer ), hFile );
    snprintf( buffer, elcount( buffer ), "0.0000 HMI_TC_GasFuelCons := %X\n", getValue( HMI_TC_GasFuelCons ) );    filePutString( buffer, elcount( buffer ), hFile );
    snprintf( buffer, elcount( buffer ), "0.0000 HMI_TC_GasFuelCons_Reset := %X\n", getValue( HMI_TC_GasFuelCons_Reset ) );    filePutString( buffer, elcount( buffer ), hFile );
    snprintf( buffer, elcount( buffer ), "0.0000 HMI_TC_GasFuelCons_Start := %X\n", getValue( HMI_TC_GasFuelCons_Start ) );    filePutString( buffer, elcount( buffer ), hFile );
    snprintf( buffer, elcount( buffer ), "0.0000 HMI_TC_GasFuelTankLvl_Min_50 := %X\n", getValue( HMI_TC_GasFuelTankLvl_Min_50 ) );    filePutString( buffer, elcount( buffer ), hFile );
    snprintf( buffer, elcount( buffer ), "0.0000 HMI_TC_GasFuelTankRng := %X\n", getValue( HMI_TC_GasFuelTankRng ) );    filePutString( buffer, elcount( buffer ), hFile );
    snprintf( buffer, elcount( buffer ), "0.0000 HMI_TC_LiquidFuelConsRecup := %X\n", getValue( HMI_TC_LiquidFuelConsRecup ) );    filePutString( buffer, elcount( buffer ), hFile );
    snprintf( buffer, elcount( buffer ), "0.0000 HMI_TC_SkipRng_Disp_Rq := %X\n", getValue( HMI_TC_SkipRng_Disp_Rq_LiqFuel ) );    filePutString( buffer, elcount( buffer ), hFile );
    snprintf( buffer, elcount( buffer ), "0.0000 HMI_TC_LiquidFuelCons_Start := %X\n", getValue( HMI_TC_LiquidFuelCons_Start ) );    filePutString( buffer, elcount( buffer ), hFile );
    snprintf( buffer, elcount( buffer ), "0.0000 HMI_TC_LiquidFuelCons_Reset := %X\n", getValue( HMI_TC_LiquidFuelCons_Reset ) );    filePutString( buffer, elcount( buffer ), hFile );
    snprintf( buffer, elcount( buffer ), "0.0000 HMI_TC_LiquidFuelCons := %X\n", getValue( HMI_TC_LiquidFuelCons ) );    filePutString( buffer, elcount( buffer ), hFile );
    snprintf( buffer, elcount( buffer ), "0.0000 HMI_TC_LiquidFuelTankLvl_Min_50 := %X\n", getValue( HMI_TC_LiquidFuelTankLvl_Min_50 ) );    filePutString( buffer, elcount( buffer ), hFile );
    snprintf( buffer, elcount( buffer ), "0.0000 HMI_TC_LiquidFuelTankRng := %X\n", getValue( HMI_TC_LiquidFuelTankRng ) );    filePutString( buffer, elcount( buffer ), hFile );
    snprintf( buffer, elcount( buffer ), "0.0000 HMI_TC_SkipRng_Disp_Rq := %X\n", getValue( HMI_TC_SkipRng_Disp_Rq_LiqFuel ) );    filePutString( buffer, elcount( buffer ), hFile );
    snprintf( buffer, elcount( buffer ), "0.0000 HMI_TC_ElecEnergyCons_Start := %X\n", getValue( HMI_TC_ElecEnergyCons_Start ) );    filePutString( buffer, elcount( buffer ), hFile );
    snprintf( buffer, elcount( buffer ), "0.0000 HMI_TC_ElecEnergyCons_Reset := %X\n", getValue( HMI_TC_ElecEnergyCons_Reset ) );    filePutString( buffer, elcount( buffer ), hFile );
    snprintf( buffer, elcount( buffer ), "0.0000 HMI_TC_ElecEnergyCons := %X\n", getValue( HMI_TC_ElecEnergyCons ) );    filePutString( buffer, elcount( buffer ), hFile );
    snprintf( buffer, elcount( buffer ), "0.0000 HMI_TC_ElecEnergyLvl_Min_50 := %X\n", getValue( HMI_TC_ElecEnergyLvl_Min_50 ) );    filePutString( buffer, elcount( buffer ), hFile );
    snprintf( buffer, elcount( buffer ), "0.0000 HMI_TC_ElecEnergyRng := %X\n", getValue( HMI_TC_ElecEnergyRng ) );    filePutString( buffer, elcount( buffer ), hFile );
    snprintf( buffer, elcount( buffer ), "0.0000 HMI_TC_SkipRng_Disp_Rq := %X\n", getValue( HMI_TC_SkipRng_Disp_Rq_LiqFuel ) );    filePutString( buffer, elcount( buffer ), hFile );
}
/*@@end*/

/*@@timer:_tTC_Disp_Rq_ECM_AR:*/
on timer _tTC_Disp_Rq_ECM_AR
{
    putValue( HMI__STMSG_TC_Disp_Rq_ECM_AR, 0 );
}
/*@@end*/

/*@@envVar:HMI__STMSG_TC_Disp_Rq_ECM_AR:*/
on EnvVar HMI__STMSG_TC_Disp_Rq_ECM_AR
{
    long tDelay;
    if( getValue( this ) == 2 )
    {
        tDelay = getValue( HMI__STMSGT_TC_Disp_Rq_ECM_AR );
        if( tDelay > 0)    
            setTimer( _tTC_Disp_Rq_ECM_AR, tDelay );
        else
            putValue( HMI__STMSG_TC_Disp_Rq_ECM_AR, 0 );
    }
}
/*@@end*/

/*@@envVar:HMI_ZeroEmission_Actv:*/
on envVar HMI_ZeroEmission_Actv
{
    _mTC_Disp_Rq_ECM_AR.ZeroEmission_Actv.phys = getValue(this);
}
/*@@end*/

/*@@envVar:HMI_TC_PN14_RecupPwr:*/
on EnvVar HMI_TC_PN14_RecupPwr
{
    _mTC_Disp_Rq_ECM_AR.TC_PN14_RecupPwr.phys = getValue(this);
}
/*@@end*/

/*@@envVar:HMI_TC_GasFuelCons:*/
on EnvVar HMI_TC_GasFuelCons
{
    _mTC_Disp_Rq_ECM_AR.TC_GasFuelCons.phys = getValue(this);
}
/*@@end*/

/*@@envVar:HMI_TC_GasFuelCons_Reset:*/
on EnvVar HMI_TC_GasFuelCons_Reset
{
    _mTC_Disp_Rq_ECM_AR.TC_GasFuelCons_Reset.phys = getValue(this);
}
/*@@end*/

/*@@envVar:HMI_TC_GasFuelCons_Start:*/
on EnvVar HMI_TC_GasFuelCons_Start
{
    _mTC_Disp_Rq_ECM_AR.TC_GasFuelCons_Start.phys = getValue(this);
}
/*@@end*/

/*@@envVar:HMI_TC_GasFuelTankRng:*/
on EnvVar HMI_TC_GasFuelTankRng
{
    _mTC_Disp_Rq_ECM_AR.TC_GasFuelTankRng.phys = getValue(this);
}
/*@@end*/

/*@@envVar:HMI_TC_GasFuelTankLvl_Min_50:*/
on EnvVar HMI_TC_GasFuelTankLvl_Min_50
{
    _mTC_Disp_Rq_ECM_AR.TC_GasFuelTankLvl_Min_50.phys = getValue(this);
}
/*@@end*/

/*@@envVar:HMI_TC_LiquidFuelCons:*/
on EnvVar HMI_TC_LiquidFuelCons
{
    _mTC_Disp_Rq_ECM_AR.TC_LiquidFuelCons.phys = getValue(this);
}
/*@@end*/

/*@@envVar:HMI_TC_LiquidFuelCons_Reset:*/
on EnvVar HMI_TC_LiquidFuelCons_Reset
{
    _mTC_Disp_Rq_ECM_AR.TC_LiquidFuelCons_Reset.phys = getValue(this);
}
/*@@end*/

/*@@envVar:HMI_TC_LiquidFuelCons_Start:*/
on EnvVar HMI_TC_LiquidFuelCons_Start
{
    _mTC_Disp_Rq_ECM_AR.TC_LiquidFuelCons_Start.phys = getValue(this);
}
/*@@end*/

/*@@envVar:HMI_TC_LiquidFuelTankRng:*/
on EnvVar HMI_TC_LiquidFuelTankRng
{
    _mTC_Disp_Rq_ECM_AR.TC_LiquidFuelTankRng.phys = getValue(this);
}
/*@@end*/

/*@@envVar:HMI_TC_LiquidFuelTankLvl_Min_50:*/
on EnvVar HMI_TC_LiquidFuelTankLvl_Min_50
{
    _mTC_Disp_Rq_ECM_AR.TC_LiquidFuelTankLvl_Min_50.phys = getValue(this);
}
/*@@end*/

/*@@envVar:HMI_TC_LiquidFuelConsRecup:*/
on EnvVar HMI_TC_LiquidFuelConsRecup
{
    _mTC_Disp_Rq_ECM_AR.TC_LiquidFuelConsRecup.phys = getValue(this);
}
/*@@end*/

/*@@envVar:HMI_TC_ElecEnergyCons:*/
on EnvVar HMI_TC_ElecEnergyCons
{
    _mTC_Disp_Rq_ECM_AR.TC_ElecEnergyCons.phys = getValue(this);
}
/*@@end*/

/*@@envVar:HMI_TC_ElecEnergyCons_Reset:*/
on EnvVar HMI_TC_ElecEnergyCons_Reset
{
    _mTC_Disp_Rq_ECM_AR.TC_ElecEnergyCons_Reset.phys = getValue(this);
}
/*@@end*/

/*@@envVar:HMI_TC_ElecEnergyCons_Start:*/
on EnvVar HMI_TC_ElecEnergyCons_Start
{
    _mTC_Disp_Rq_ECM_AR.TC_ElecEnergyCons_Start.phys = getValue(this);
}
/*@@end*/

/*@@envVar:HMI_TC_ElecEnergyLvl_Min_50:*/
on EnvVar HMI_TC_ElecEnergyLvl_Min_50
{
    _mTC_Disp_Rq_ECM_AR.TC_ElecEnergyLvl_Min_50.phys = getValue(this);
}
/*@@end*/

/*@@envVar:HMI_TC_ElecEnergyRng:*/
on EnvVar HMI_TC_ElecEnergyRng
{
    _mTC_Disp_Rq_ECM_AR.TC_ElecEnergyRng.phys = getValue(this);
}
/*@@end*/

/*@@envVar:HMI_TC_SkipRng_Disp_Rq_Elec:*/
on EnvVar HMI_TC_SkipRng_Disp_Rq_Elec
{
    _mTC_Disp_Rq_ECM_AR.TC_SkipRng_Disp_Rq.phys = getValue(this);
}
/*@@end*/

/*@@caplFunc:TC_EBBC_Disp_Rq_ECM_AR_check_output():*/
TC_EBBC_Disp_Rq_ECM_AR_check_output()
{
    if( !getValue( HMI__STMSG_TC_EBBC_Disp_Rq_ECM_AR ) )
    {
        // Botschaft TC_EBBC_Disp_Rq_ECM_AR ID: 333 --- Sendeart 0 cyclicX --- 
        _TC_EBBC_Disp_Rq_ECM_AR_Cnt--;
        if( _TC_EBBC_Disp_Rq_ECM_AR_Cnt < 1 )
        {
            TC_EBBC_Disp_Rq_ECM_AR_output(); // Nachricht wg. abgelaufenem Zyklus ausgeben
            _TC_EBBC_Disp_Rq_ECM_AR_Cnt = _TC_EBBC_Disp_Rq_ECM_AR_CycleCount; // Zyklus-Zähler zurücksetzen
        }
    }
}
/*@@end*/

/*@@caplFunc:TC_EBBC_Disp_Rq_ECM_AR_init():*/
TC_EBBC_Disp_Rq_ECM_AR_init()
{   /* Botschaft TC_EBBC_Disp_Rq_ECM_AR ID: 333 --- Sendeart 0 cyclicX --- 
BA_ "ApplMessage" BO_ 333 0;
BA_ "NmAsrMessage" BO_ 333 0;
BA_ "GenMsgMinAcceptLength" BO_ 333 8;
BA_ "GenMsgILSupport" BO_ 333 1;
BA_ "DiagState" BO_ 333 0;
BA_ "DiagRequest" BO_ 333 0;
BA_ "DiagResponse" BO_ 333 0;
BA_ "GenMsgStartValue" BO_ 333 "0";
BA_ "GenMsgCycleTime" BO_ 333 100;
BA_ "GenMsgSendType" BO_ 333 0;
    */
    _TC_EBBC_Disp_Rq_ECM_AR_Timebase =        c_tDBKomTimer_20ms;
    _TC_EBBC_Disp_Rq_ECM_AR_CycleCount =    100 / _TC_EBBC_Disp_Rq_ECM_AR_Timebase;
    _TC_EBBC_Disp_Rq_ECM_AR_StartDelay =      0 / _TC_EBBC_Disp_Rq_ECM_AR_Timebase;
    _TC_EBBC_Disp_Rq_ECM_AR_Cnt = _TC_EBBC_Disp_Rq_ECM_AR_StartDelay;

    putValue( HMI__STMSGSD_TC_EBBC_Disp_Rq_ECM_AR, _TC_EBBC_Disp_Rq_ECM_AR_StartDelay * _TC_EBBC_Disp_Rq_ECM_AR_Timebase );

    _mTC_EBBC_Disp_Rq_ECM_AR.TC_EBBC_AvgFuelCons1.phys = getValue( HMI_TC_EBBC_AvgFuelCons1 );
    _mTC_EBBC_Disp_Rq_ECM_AR.TC_EBBC_AvgFuelCons2.phys = getValue( HMI_TC_EBBC_AvgFuelCons2 );
    _mTC_EBBC_Disp_Rq_ECM_AR.TC_EBBC_AvgRecupLvl1.phys = getValue( HMI_TC_EBBC_AvgRecupLvl1 );
    _mTC_EBBC_Disp_Rq_ECM_AR.TC_EBBC_AvgRecupLvl2.phys = getValue( HMI_TC_EBBC_AvgRecupLvl2 );
    _mTC_EBBC_Disp_Rq_ECM_AR.TC_EBBC_DispCnt1.phys = getValue( HMI_TC_EBBC_DispCnt1 );
    _mTC_EBBC_Disp_Rq_ECM_AR.TC_EBBC_DispCnt2.phys = getValue( HMI_TC_EBBC_DispCnt2 );
    _mTC_EBBC_Disp_Rq_ECM_AR.TC_EBBC_DispIdx.phys = getValue( HMI_TC_EBBC_DispIdx );
    _mTC_EBBC_Disp_Rq_ECM_AR.TC_EBBC_FuelCons.phys = getValue( HMI_TC_EBBC_FuelCons );
}
/*@@end*/

/*@@caplFunc:TC_EBBC_Disp_Rq_ECM_AR_output():*/
TC_EBBC_Disp_Rq_ECM_AR_output(void)
{
    output( _mTC_EBBC_Disp_Rq_ECM_AR );
}
/*@@end*/

/*@@caplFunc:TC_EBBC_Disp_Rq_ECM_AR_saveEnvVars(dword):*/
TC_EBBC_Disp_Rq_ECM_AR_saveEnvVars( dword hFile )
{
    filePutString("\n// Knoten EIS: TC_EBBC_Disp_Rq_ECM_AR\n", 36, hFile );
    snprintf( buffer, elcount( buffer ), "0.0000 HMI__STMSG_TC_EBBC_Disp_Rq_ECM := %X\n", getValue( HMI__STMSG_TC_EBBC_Disp_Rq_ECM_AR ) );        filePutString( buffer, elcount( buffer ), hFile );
    snprintf( buffer, elcount( buffer ), "0.0000 HMI__STMSGT_TC_EBBC_Disp_Rq_ECM := %X\n", getValue( HMI__STMSGT_TC_EBBC_Disp_Rq_ECM_AR ) );        filePutString( buffer, elcount( buffer ), hFile );
    snprintf( buffer, elcount( buffer ), "0.0000 HMI_TC_EBBC_AvgFuelCons1 := %f\n", getValue( HMI_TC_EBBC_AvgFuelCons1 ) );        filePutString( buffer, elcount( buffer ), hFile );
    snprintf( buffer, elcount( buffer ), "0.0000 HMI_TC_EBBC_AvgFuelCons2 := %f\n", getValue( HMI_TC_EBBC_AvgFuelCons2 ) );        filePutString( buffer, elcount( buffer ), hFile );
    snprintf( buffer, elcount( buffer ), "0.0000 HMI_TC_EBBC_AvgRecupLvl1 := %f\n", getValue( HMI_TC_EBBC_AvgRecupLvl1 ) );        filePutString( buffer, elcount( buffer ), hFile );
    snprintf( buffer, elcount( buffer ), "0.0000 HMI_TC_EBBC_AvgRecupLvl2 := %f\n", getValue( HMI_TC_EBBC_AvgRecupLvl2 ) );        filePutString( buffer, elcount( buffer ), hFile );
    snprintf( buffer, elcount( buffer ), "0.0000 HMI_TC_EBBC_DispCnt1 := %f\n", getValue( HMI_TC_EBBC_DispCnt1 ) );        filePutString( buffer, elcount( buffer ), hFile );
    snprintf( buffer, elcount( buffer ), "0.0000 HMI_TC_EBBC_DispCnt2 := %f\n", getValue( HMI_TC_EBBC_DispCnt2 ) );        filePutString( buffer, elcount( buffer ), hFile );
    snprintf( buffer, elcount( buffer ), "0.0000 HMI_TC_EBBC_DispIdx := %f\n", getValue( HMI_TC_EBBC_DispIdx ) );        filePutString( buffer, elcount( buffer ), hFile );
    snprintf( buffer, elcount( buffer ), "0.0000 HMI_TC_EBBC_FuelCons := %f\n", getValue( HMI_TC_EBBC_FuelCons ) );        filePutString( buffer, elcount( buffer ), hFile );
}
/*@@end*/

/*@@timer:_tTC_EBBC_Disp_Rq_ECM_AR:*/
on timer _tTC_EBBC_Disp_Rq_ECM_AR
{
    putValue( HMI__STMSG_TC_EBBC_Disp_Rq_ECM_AR, 0 );
}
/*@@end*/

/*@@envVar:HMI__STMSG_TC_EBBC_Disp_Rq_ECM_AR:*/
on EnvVar HMI__STMSG_TC_EBBC_Disp_Rq_ECM_AR
{
    long tDelay;
    if( getValue( this ) == 2 )
    {
        tDelay = getValue( HMI__STMSGT_TC_EBBC_Disp_Rq_ECM_AR );
        if( tDelay > 0)    
            setTimer( _tTC_EBBC_Disp_Rq_ECM_AR, tDelay );
        else
            putValue( HMI__STMSG_TC_EBBC_Disp_Rq_ECM_AR, 0 );
    }
}
/*@@end*/

/*@@envVar:HMI_TC_EBBC_AvgFuelCons1:*/
on EnvVar HMI_TC_EBBC_AvgFuelCons1
{
    _mTC_EBBC_Disp_Rq_ECM_AR.TC_EBBC_AvgFuelCons1.phys = getValue(this);
}
/*@@end*/

/*@@envVar:HMI_TC_EBBC_AvgFuelCons2:*/
on EnvVar HMI_TC_EBBC_AvgFuelCons2
{
    _mTC_EBBC_Disp_Rq_ECM_AR.TC_EBBC_AvgFuelCons2.phys = getValue(this);
}
/*@@end*/

/*@@envVar:HMI_TC_EBBC_AvgRecupLvl1:*/
on EnvVar HMI_TC_EBBC_AvgRecupLvl1
{
    _mTC_EBBC_Disp_Rq_ECM_AR.TC_EBBC_AvgRecupLvl1.phys = getValue(this);
}
/*@@end*/

/*@@envVar:HMI_TC_EBBC_AvgRecupLvl2:*/
on EnvVar HMI_TC_EBBC_AvgRecupLvl2
{
    _mTC_EBBC_Disp_Rq_ECM_AR.TC_EBBC_AvgRecupLvl2.phys = getValue(this);
}
/*@@end*/

/*@@envVar:HMI_TC_EBBC_DispCnt1:*/
on EnvVar HMI_TC_EBBC_DispCnt1
{
    _mTC_EBBC_Disp_Rq_ECM_AR.TC_EBBC_DispCnt1.phys = getValue(this);
}
/*@@end*/

/*@@envVar:HMI_TC_EBBC_DispCnt2:*/
on EnvVar HMI_TC_EBBC_DispCnt2
{
    _mTC_EBBC_Disp_Rq_ECM_AR.TC_EBBC_DispCnt2.phys = getValue(this);
}
/*@@end*/

/*@@envVar:HMI_TC_EBBC_DispIdx:*/
on EnvVar HMI_TC_EBBC_DispIdx
{
    _mTC_EBBC_Disp_Rq_ECM_AR.TC_EBBC_DispIdx.phys = getValue(this);
}
/*@@end*/

/*@@envVar:HMI_TC_EBBC_FuelCons:*/
on EnvVar HMI_TC_EBBC_FuelCons
{
    _mTC_EBBC_Disp_Rq_ECM_AR.TC_EBBC_FuelCons.phys = getValue(this);
}
/*@@end*/

/*@@caplFunc:TC_EEBBC_Disp_Rq_AR_check_output():*/
TC_EEBBC_Disp_Rq_AR_check_output()
{
    if( !getValue( HMI__STMSG_TC_EEBBC_Disp_Rq_AR ) )
    {
        // Botschaft TC_EEBBC_Disp_Rq_AR ID: 647 --- Sendeart 0 cyclicX --- 
        _TC_EEBBC_Disp_Rq_AR_Cnt--;
        if( _TC_EEBBC_Disp_Rq_AR_Cnt < 1 )
        {
            TC_EEBBC_Disp_Rq_AR_output(); // Nachricht wg. abgelaufenem Zyklus ausgeben
            _TC_EEBBC_Disp_Rq_AR_Cnt = _TC_EEBBC_Disp_Rq_AR_CycleCount; // Zyklus-Zähler zurücksetzen
        }
    }
}
/*@@end*/

/*@@caplFunc:TC_EEBBC_Disp_Rq_AR_init():*/
TC_EEBBC_Disp_Rq_AR_init()
{   /* Botschaft TC_EEBBC_Disp_Rq_AR ID: 647 --- Sendeart 0 cyclicX --- 
BA_ "ApplMessage" BO_ 647 0;
BA_ "NmAsrMessage" BO_ 647 0;
BA_ "GenMsgMinAcceptLength" BO_ 647 8;
BA_ "GenMsgILSupport" BO_ 647 1;
BA_ "DiagState" BO_ 647 0;
BA_ "DiagRequest" BO_ 647 0;
BA_ "DiagResponse" BO_ 647 0;
BA_ "GenMsgStartValue" BO_ 647 "0";
BA_ "GenMsgCycleTime" BO_ 647 100;
BA_ "GenMsgSendType" BO_ 647 0;
    */
    _TC_EEBBC_Disp_Rq_AR_Timebase =        c_tDBKomTimer_20ms;
    _TC_EEBBC_Disp_Rq_AR_CycleCount =    100 / _TC_EEBBC_Disp_Rq_AR_Timebase;
    _TC_EEBBC_Disp_Rq_AR_StartDelay =      0 / _TC_EEBBC_Disp_Rq_AR_Timebase;
    _TC_EEBBC_Disp_Rq_AR_Cnt = _TC_EEBBC_Disp_Rq_AR_StartDelay;

    putValue( HMI__STMSGSD_TC_EEBBC_Disp_Rq_AR, _TC_EEBBC_Disp_Rq_AR_StartDelay * _TC_EEBBC_Disp_Rq_AR_Timebase );

    _mTC_EEBBC_Disp_Rq_AR.TC_EEBBC_AvgEnergyCons1.phys = getValue( HMI_TC_EEBBC_AvgEnergyCons1 );
    _mTC_EEBBC_Disp_Rq_AR.TC_EEBBC_AvgEnergyCons2.phys = getValue( HMI_TC_EEBBC_AvgEnergyCons2 );
    _mTC_EEBBC_Disp_Rq_AR.TC_EEBBC_DispCnt1.phys = getValue( HMI_TC_EEBBC_DispCnt1 );
    _mTC_EEBBC_Disp_Rq_AR.TC_EEBBC_DispCnt2.phys = getValue( HMI_TC_EEBBC_DispCnt2 );
    _mTC_EEBBC_Disp_Rq_AR.TC_EEBBC_DispIdx.phys = getValue( HMI_TC_EEBBC_DispIdx );
    _mTC_EEBBC_Disp_Rq_AR.TC_EEBBC_DrvProg1.phys = getValue( HMI_TC_EEBBC_DrvProg1 );
    _mTC_EEBBC_Disp_Rq_AR.TC_EEBBC_DrvProg2.phys = getValue( HMI_TC_EEBBC_DrvProg2 );
    _mTC_EEBBC_Disp_Rq_AR.TC_EEBBC_OprtnMd1.phys = getValue( HMI_TC_EEBBC_OprtnMd1 );
    _mTC_EEBBC_Disp_Rq_AR.TC_EEBBC_OprtnMd2.phys = getValue( HMI_TC_EEBBC_OprtnMd2 );
    _mTC_EEBBC_Disp_Rq_AR.TC_EEBBC_TmRng.phys = getValue( HMI_TC_EEBBC_TmRng );
}
/*@@end*/

/*@@caplFunc:TC_EEBBC_Disp_Rq_AR_output():*/
TC_EEBBC_Disp_Rq_AR_output(void)
{
    output( _mTC_EEBBC_Disp_Rq_AR );
}
/*@@end*/

/*@@caplFunc:TC_EEBBC_Disp_Rq_AR_saveEnvVars(dword):*/
TC_EEBBC_Disp_Rq_AR_saveEnvVars( dword hFile )
{
    filePutString("\n// Knoten EIS: TC_EEBBC_Disp_Rq_AR\n", 36, hFile );
    snprintf( buffer, elcount( buffer ), "0.0000 HMI__STMSG_TC_EEBBC_Disp_Rq_AR := %X\n", getValue( HMI__STMSG_TC_EEBBC_Disp_Rq_AR ) );        filePutString( buffer, elcount( buffer ), hFile );
    snprintf( buffer, elcount( buffer ), "0.0000 HMI__STMSGT_TC_EEBBC_Disp_Rq_AR := %X\n", getValue( HMI__STMSGT_TC_EEBBC_Disp_Rq_AR ) );        filePutString( buffer, elcount( buffer ), hFile );
    snprintf( buffer, elcount( buffer ), "0.0000 HMI_TC_EEBBC_AvgEnergyCons1 := %f\n", getValue( HMI_TC_EEBBC_AvgEnergyCons1 ) );        filePutString( buffer, elcount( buffer ), hFile );
    snprintf( buffer, elcount( buffer ), "0.0000 HMI_TC_EEBBC_AvgEnergyCons2 := %f\n", getValue( HMI_TC_EEBBC_AvgEnergyCons2 ) );        filePutString( buffer, elcount( buffer ), hFile );
    snprintf( buffer, elcount( buffer ), "0.0000 HMI_TC_EEBBC_DispCnt1 := %f\n", getValue( HMI_TC_EEBBC_DispCnt1 ) );        filePutString( buffer, elcount( buffer ), hFile );
    snprintf( buffer, elcount( buffer ), "0.0000 HMI_TC_EEBBC_DispCnt2 := %f\n", getValue( HMI_TC_EEBBC_DispCnt2 ) );        filePutString( buffer, elcount( buffer ), hFile );
    snprintf( buffer, elcount( buffer ), "0.0000 HMI_TC_EEBBC_DispIdx := %f\n", getValue( HMI_TC_EEBBC_DispIdx ) );        filePutString( buffer, elcount( buffer ), hFile );
    snprintf( buffer, elcount( buffer ), "0.0000 HMI_TC_EEBBC_DrvProg1 := %f\n", getValue( HMI_TC_EEBBC_DrvProg1 ) );        filePutString( buffer, elcount( buffer ), hFile );
    snprintf( buffer, elcount( buffer ), "0.0000 HMI_TC_EEBBC_DrvProg2 := %f\n", getValue( HMI_TC_EEBBC_DrvProg2 ) );        filePutString( buffer, elcount( buffer ), hFile );
    snprintf( buffer, elcount( buffer ), "0.0000 HMI_TC_EEBBC_OprtnMd1 := %f\n", getValue( HMI_TC_EEBBC_OprtnMd1 ) );        filePutString( buffer, elcount( buffer ), hFile );
    snprintf( buffer, elcount( buffer ), "0.0000 HMI_TC_EEBBC_OprtnMd2 := %f\n", getValue( HMI_TC_EEBBC_OprtnMd2 ) );        filePutString( buffer, elcount( buffer ), hFile );
    snprintf( buffer, elcount( buffer ), "0.0000 HMI_TC_EEBBC_TmRng := %f\n", getValue( HMI_TC_EEBBC_TmRng ) );        filePutString( buffer, elcount( buffer ), hFile );
}
/*@@end*/

/*@@timer:_tTC_EEBBC_Disp_Rq_AR:*/
on timer _tTC_EEBBC_Disp_Rq_AR
{
    putValue( HMI__STMSG_TC_EEBBC_Disp_Rq_AR, 0 );
}
/*@@end*/

/*@@envVar:HMI__STMSG_TC_EEBBC_Disp_Rq_AR:*/
on EnvVar HMI__STMSG_TC_EEBBC_Disp_Rq_AR
{
    long tDelay;
    if( getValue( this ) == 2 )
    {
        tDelay = getValue( HMI__STMSGT_TC_EEBBC_Disp_Rq_AR );
        if( tDelay > 0)    
            setTimer( _tTC_EEBBC_Disp_Rq_AR, tDelay );
        else
            putValue( HMI__STMSG_TC_EEBBC_Disp_Rq_AR, 0 );
    }
}
/*@@end*/

/*@@envVar:HMI_TC_EEBBC_AvgEnergyCons1:*/
on EnvVar HMI_TC_EEBBC_AvgEnergyCons1
{
    _mTC_EEBBC_Disp_Rq_AR.TC_EEBBC_AvgEnergyCons1.phys = getValue(this);
}
/*@@end*/

/*@@envVar:HMI_TC_EEBBC_AvgEnergyCons2:*/
on EnvVar HMI_TC_EEBBC_AvgEnergyCons2
{
    _mTC_EEBBC_Disp_Rq_AR.TC_EEBBC_AvgEnergyCons2.phys = getValue(this);
}
/*@@end*/

/*@@envVar:HMI_TC_EEBBC_DispCnt1:*/
on EnvVar HMI_TC_EEBBC_DispCnt1
{
    _mTC_EEBBC_Disp_Rq_AR.TC_EEBBC_DispCnt1.phys = getValue(this);
}
/*@@end*/

/*@@envVar:HMI_TC_EEBBC_DispCnt2:*/
on EnvVar HMI_TC_EEBBC_DispCnt2
{
    _mTC_EEBBC_Disp_Rq_AR.TC_EEBBC_DispCnt2.phys = getValue(this);
}
/*@@end*/

/*@@envVar:HMI_TC_EEBBC_DispIdx:*/
on EnvVar HMI_TC_EEBBC_DispIdx
{
    _mTC_EEBBC_Disp_Rq_AR.TC_EEBBC_DispIdx.phys = getValue(this);
}
/*@@end*/

/*@@envVar:HMI_TC_EEBBC_DrvProg1:*/
on EnvVar HMI_TC_EEBBC_DrvProg1
{
    _mTC_EEBBC_Disp_Rq_AR.TC_EEBBC_DrvProg1.phys = getValue(this);
}
/*@@end*/

/*@@envVar:HMI_TC_EEBBC_DrvProg2:*/
on EnvVar HMI_TC_EEBBC_DrvProg2
{
    _mTC_EEBBC_Disp_Rq_AR.TC_EEBBC_DrvProg2.phys = getValue(this);
}
/*@@end*/

/*@@envVar:HMI_TC_EEBBC_OprtnMd1:*/
on EnvVar HMI_TC_EEBBC_OprtnMd1
{
    _mTC_EEBBC_Disp_Rq_AR.TC_EEBBC_OprtnMd1.phys = getValue(this);
}
/*@@end*/

/*@@envVar:HMI_TC_EEBBC_OprtnMd2:*/
on EnvVar HMI_TC_EEBBC_OprtnMd2
{
    _mTC_EEBBC_Disp_Rq_AR.TC_EEBBC_OprtnMd2.phys = getValue(this);
}
/*@@end*/

/*@@envVar:HMI_TC_EEBBC_TmRng:*/
on EnvVar HMI_TC_EEBBC_TmRng
{
    _mTC_EEBBC_Disp_Rq_AR.TC_EEBBC_TmRng.phys = getValue(this);
}
/*@@end*/

/*@@caplFunc:TCM_Disp_Rq_AMG_AR_check_output():*/
TCM_Disp_Rq_AMG_AR_check_output()
{
    if( !getValue( HMI__STMSG_TCM_Disp_Rq_AMG_AR ) )
    {
        // Botschaft TCM_Disp_Rq_AMG_AR ID: 653 --- Sendeart 5 cyclicAndSpontanWithDelay --- 
        if( _TCM_Disp_Rq_AMG_AR_DelayCnt > 0) _TCM_Disp_Rq_AMG_AR_DelayCnt--; // Mindestsendeabstand
        _TCM_Disp_Rq_AMG_AR_Cnt--;
        if( _TCM_Disp_Rq_AMG_AR_Cnt < 1 )
        {
            if( _TCM_Disp_Rq_AMG_AR_DelayCnt < 1 )
            {
                // Nachricht wg. abgelaufenem Zyklus ausgeben (Mindestsendeabstand eingehalten)
                TCM_Disp_Rq_AMG_AR_output();
                 _TCM_Disp_Rq_AMG_AR_SpontanFlag = 0; // Spontan-Flag zurücksetzen
                _TCM_Disp_Rq_AMG_AR_DelayCnt = _TCM_Disp_Rq_AMG_AR_MinDelay;
            }
            else
            {
                // Spontanflag setzen damit nach Ablauf Mindestsendeabstand gesendet wird
                 _TCM_Disp_Rq_AMG_AR_SpontanFlag = 1;
            }
            _TCM_Disp_Rq_AMG_AR_Cnt = _TCM_Disp_Rq_AMG_AR_CycleCount; // Zyklus-Zähler zurücksetzen
        }
        else if( _TCM_Disp_Rq_AMG_AR_SpontanFlag)
        {
            if( _TCM_Disp_Rq_AMG_AR_DelayCnt < 1 )
            {
                // Nachricht wg. spontaner Änderung ausgeben (Mindestsendeabstand eingehalten)
                TCM_Disp_Rq_AMG_AR_output();
                _TCM_Disp_Rq_AMG_AR_SpontanFlag = 0; // Spontan-Flag zurücksetzen
                _TCM_Disp_Rq_AMG_AR_DelayCnt = _TCM_Disp_Rq_AMG_AR_MinDelay;
            }
        }
    }
}
/*@@end*/

/*@@caplFunc:TCM_Disp_Rq_AMG_AR_init():*/
TCM_Disp_Rq_AMG_AR_init()
{   /* Botschaft TCM_Disp_Rq_AMG_AR ID: 653 --- Sendeart 5 cyclicAndSpontanWithDelay --- 
BA_ "ApplMessage" BO_ 653 0;
BA_ "NmAsrMessage" BO_ 653 0;
BA_ "GenMsgMinAcceptLength" BO_ 653 8;
BA_ "GenMsgILSupport" BO_ 653 1;
BA_ "DiagState" BO_ 653 0;
BA_ "DiagRequest" BO_ 653 0;
BA_ "DiagResponse" BO_ 653 0;
BA_ "GenMsgStartValue" BO_ 653 "0";
BA_ "GenMsgDelayTime" BO_ 653 40;
BA_ "GenMsgNrOfRepetitions" BO_ 653 0;
BA_ "GenMsgCycleTime" BO_ 653 200;
BA_ "GenMsgSendType" BO_ 653 5;
    */
    _TCM_Disp_Rq_AMG_AR_Timebase =        c_tDBKomTimer_20ms;
    _TCM_Disp_Rq_AMG_AR_CycleCount =     200 / _TCM_Disp_Rq_AMG_AR_Timebase;
    _TCM_Disp_Rq_AMG_AR_StartDelay =       0 / _TCM_Disp_Rq_AMG_AR_Timebase;
    _TCM_Disp_Rq_AMG_AR_MinDelay =        40 / _TCM_Disp_Rq_AMG_AR_Timebase;
    _TCM_Disp_Rq_AMG_AR_Cnt = _TCM_Disp_Rq_AMG_AR_StartDelay;
    _TCM_Disp_Rq_AMG_AR_SpontanFlag = 0;
    _TCM_Disp_Rq_AMG_AR_DelayCnt = 0;

    putValue( HMI__STMSGSD_TCM_Disp_Rq_AMG_AR, _TCM_Disp_Rq_AMG_AR_StartDelay * _TCM_Disp_Rq_AMG_AR_Timebase );

    _mTCM_Disp_Rq_AMG_AR.TCM_TxLED_Disp_Rq.phys = getValue( HMI_TCM_TxLED_Disp_Rq );
    _mTCM_Disp_Rq_AMG_AR.TCM_TxShift_Disp_Rq.phys = getValue( HMI_TCM_TxShift_Disp_Rq );
    _mTCM_Disp_Rq_AMG_AR.TxBurnOut_Stat.phys = getValue( HMI_TxBurnOut_Stat );
}
/*@@end*/

/*@@caplFunc:TCM_Disp_Rq_AMG_AR_output():*/
TCM_Disp_Rq_AMG_AR_output(void)
{
    output( _mTCM_Disp_Rq_AMG_AR );
}
/*@@end*/

/*@@caplFunc:TCM_Disp_Rq_AMG_AR_saveEnvVars(dword):*/
TCM_Disp_Rq_AMG_AR_saveEnvVars( dword hFile )
{
    filePutString("\n// Knoten EIS: TCM_Disp_Rq_AMG_AR\n", 28, hFile );
    snprintf( buffer, elcount( buffer ), "0.0000 HMI__STMSG_TCM_Disp_Rq_AMG_AR := %X\n", getValue( HMI__STMSG_TCM_Disp_Rq_AMG_AR ) );        filePutString( buffer, elcount( buffer ), hFile );
    snprintf( buffer, elcount( buffer ), "0.0000 HMI__STMSGT_TCM_Disp_Rq_AMG_AR := %X\n", getValue( HMI__STMSGT_TCM_Disp_Rq_AMG_AR ) );        filePutString( buffer, elcount( buffer ), hFile );
    snprintf( buffer, elcount( buffer ), "0.0000 HMI_TCM_TxLED_Disp_Rq := %X\n", getValue( HMI_TCM_TxLED_Disp_Rq ) );        filePutString( buffer, elcount( buffer ), hFile );
    snprintf( buffer, elcount( buffer ), "0.0000 HMI_TCM_TxShift_Disp_Rq := %X\n", getValue( HMI_TCM_TxShift_Disp_Rq ) );        filePutString( buffer, elcount( buffer ), hFile );
    snprintf( buffer, elcount( buffer ), "0.0000 HMI_TxBurnOut_Stat := %X\n", getValue( HMI_TxBurnOut_Stat ) );        filePutString( buffer, elcount( buffer ), hFile );
}
/*@@end*/

/*@@timer:_tTCM_Disp_Rq_AMG_AR:*/
on timer _tTCM_Disp_Rq_AMG_AR
{
    putValue( HMI__STMSG_TCM_Disp_Rq_AMG_AR, 0 );
}
/*@@end*/

/*@@envVar:HMI__STMSG_TCM_Disp_Rq_AMG_AR:*/
on EnvVar HMI__STMSG_TCM_Disp_Rq_AMG_AR
{
    long tDelay;
    if( getValue( this ) == 2 )
    {
        tDelay = getValue( HMI__STMSGT_TCM_Disp_Rq_AMG_AR );
        if( tDelay > 0)    
            setTimer( _tTCM_Disp_Rq_AMG_AR, tDelay );
        else
            putValue( HMI__STMSG_TCM_Disp_Rq_AMG_AR, 0 );
    }
}
/*@@end*/

/*@@envVar:HMI_TCM_TxLED_Disp_Rq:*/
on EnvVar HMI_TCM_TxLED_Disp_Rq
{
    _mTCM_Disp_Rq_AMG_AR.TCM_TxLED_Disp_Rq.phys = getValue(this);
    _TCM_Disp_Rq_AMG_AR_SpontanFlag = 1;
}
/*@@end*/

/*@@envVar:HMI_TCM_TxShift_Disp_Rq:*/
on EnvVar HMI_TCM_TxShift_Disp_Rq
{
    _mTCM_Disp_Rq_AMG_AR.TCM_TxShift_Disp_Rq.phys = getValue(this);
    _TCM_Disp_Rq_AMG_AR_SpontanFlag = 1;
}
/*@@end*/

/*@@envVar:HMI_TxBurnOut_Stat:*/
on EnvVar HMI_TxBurnOut_Stat
{
    _mTCM_Disp_Rq_AMG_AR.TxBurnOut_Stat.phys = getValue(this);
    _TCM_Disp_Rq_AMG_AR_SpontanFlag = 1;
}
/*@@end*/

/*@@caplFunc:Teleaid_WRN_AR_check_output():*/
Teleaid_WRN_AR_check_output()
{
    if( !getValue( HMI__STMSG_Teleaid_WRN_AR ) )
    {
        // Botschaft Teleaid_WRN_AR ID: 1199 --- Sendeart 5 cyclicAndSpontanWithDelay --- 
        _Teleaid_WRN_AR_Cnt--;
        if( _Teleaid_WRN_AR_Cnt < 1 )
        {
            // Nachricht wg. abgelaufenem Zyklus ausgeben
            Teleaid_WRN_AR_output();
            _Teleaid_WRN_AR_Cnt = _Teleaid_WRN_AR_CycleCount; // Zyklus-Zähler zurücksetzen
            _Teleaid_WRN_AR_SpontanFlag = 0; // Spontan-Flag zurücksetzen
        }
        else if( _Teleaid_WRN_AR_SpontanFlag)
        {
            // Nachricht wg. spontaner Änderung ausgeben
            Teleaid_WRN_AR_output();
            _Teleaid_WRN_AR_SpontanFlag = 0; // Spontan-Flag zurücksetzen
        }
        // Botschaft Teleaid_WRN_AR --- Sendeart 5 cyclicAndSpontanWithDelay --- 
    }
}
/*@@end*/

/*@@caplFunc:Teleaid_WRN_AR_init():*/
Teleaid_WRN_AR_init()
{   /* Botschaft Teleaid_WRN_AR ID: 1199 --- Sendeart 5 cyclicAndSpontanWithDelay --- 
BA_ "ApplMessage" BO_ 1199 0;
BA_ "NmAsrMessage" BO_ 1199 0;
BA_ "GenMsgMinAcceptLength" BO_ 1199 4;
BA_ "GenMsgILSupport" BO_ 1199 1;
BA_ "DiagState" BO_ 1199 0;
BA_ "DiagRequest" BO_ 1199 0;
BA_ "DiagResponse" BO_ 1199 0;
BA_ "GenMsgStartValue" BO_ 1199 "0";
BA_ "GenMsgDelayTime" BO_ 1199 5;
BA_ "GenMsgNrOfRepetitions" BO_ 1199 0;
BA_ "GenMsgCycleTime" BO_ 1199 500;
BA_ "GenMsgSendType" BO_ 1199 5;
    */
    _Teleaid_WRN_AR_Timebase =          c_tDBKomTimer_20ms;
    _Teleaid_WRN_AR_CycleCount =       500 / _Teleaid_WRN_AR_Timebase;
    _Teleaid_WRN_AR_StartDelay =         0 / _Teleaid_WRN_AR_Timebase;
    _Teleaid_WRN_AR_Cnt = _Teleaid_WRN_AR_StartDelay;
    _Teleaid_WRN_AR_SpontanFlag = 0;

    putValue( HMI__STMSGSD_Teleaid_WRN_AR, _Teleaid_WRN_AR_StartDelay * _Teleaid_WRN_AR_Timebase );

    _mTeleaid_WRN_AR.Teleaid_Call_Stat.phys = getValue( HMI_Teleaid_Call_Stat );
    _mTeleaid_WRN_AR.Teleaid_Field_STR.phys = getValue( HMI_Teleaid_Field_STR );
    _mTeleaid_WRN_AR.Teleaid_HU_POP.phys = getValue( HMI_Teleaid_HU_POP );
    _mTeleaid_WRN_AR.Teleaid_IP_ERR.phys = getValue( HMI_Teleaid_IP_ERR );
    _mTeleaid_WRN_AR.Teleaid_Net_TYP.phys = getValue( HMI_Teleaid_Net_TYP );
                putValue( HMI_Teleaid_RD_A, 0 );
    _mTeleaid_WRN_AR.Teleaid_RD_A.phys = getValue( HMI_Teleaid_RD_A );
    _mTeleaid_WRN_AR.Teleaid_RD_DC.phys = getValue( HMI_Teleaid_RD_DC );
    _mTeleaid_WRN_AR.Teleaid_RD_L.phys = getValue( HMI_Teleaid_RD_L );
    _mTeleaid_WRN_AR.Teleaid_RD_UL.phys = getValue( HMI_Teleaid_RD_UL );
    _mTeleaid_WRN_AR.Teleaid_TA_DEF.phys = getValue( HMI_Teleaid_TA_DEF );
    _mTeleaid_WRN_AR.Teleaid_TA_NA.phys = getValue( HMI_Teleaid_TA_NA );
    _mTeleaid_WRN_AR.Teleaid_TR_A.phys = getValue( HMI_Teleaid_TR_A );
}
/*@@end*/

/*@@caplFunc:Teleaid_WRN_AR_output():*/
Teleaid_WRN_AR_output(void)
{
    output( _mTeleaid_WRN_AR );
}
/*@@end*/

/*@@caplFunc:Teleaid_WRN_AR_saveEnvVars(dword):*/
Teleaid_WRN_AR_saveEnvVars( dword hFile )
{
    filePutString("\n// Knoten EIS: Teleaid_WRN_AR\n", 28, hFile );
    snprintf( buffer, elcount( buffer ), "0.0000 HMI__STMSG_Teleaid_WRN := %X\n", getValue( HMI__STMSG_Teleaid_WRN_AR ) );        filePutString( buffer, elcount( buffer ), hFile );
    snprintf( buffer, elcount( buffer ), "0.0000 HMI__STMSGT_Teleaid_WRN := %X\n", getValue( HMI__STMSGT_Teleaid_WRN_AR ) );        filePutString( buffer, elcount( buffer ), hFile );
    snprintf( buffer, elcount( buffer ), "0.0000 HMI_Teleaid_Call_Stat := %X\n", getValue( HMI_Teleaid_Call_Stat ) );        filePutString( buffer, elcount( buffer ), hFile );
    snprintf( buffer, elcount( buffer ), "0.0000 HMI_Teleaid_Field_STR := %X\n", getValue( HMI_Teleaid_Field_STR ) );        filePutString( buffer, elcount( buffer ), hFile );
    snprintf( buffer, elcount( buffer ), "0.0000 HMI_Teleaid_HU_POP := %X\n", getValue( HMI_Teleaid_HU_POP ) );        filePutString( buffer, elcount( buffer ), hFile );
    snprintf( buffer, elcount( buffer ), "0.0000 HMI_Teleaid_IP_ERR := %X\n", getValue( HMI_Teleaid_IP_ERR ) );        filePutString( buffer, elcount( buffer ), hFile );
    snprintf( buffer, elcount( buffer ), "0.0000 HMI_Teleaid_Net_TYP := %X\n", getValue( HMI_Teleaid_Net_TYP ) );        filePutString( buffer, elcount( buffer ), hFile );
    snprintf( buffer, elcount( buffer ), "0.0000 HMI_Teleaid_RD_A := %X\n", getValue( HMI_Teleaid_RD_A ) );        filePutString( buffer, elcount( buffer ), hFile );
    snprintf( buffer, elcount( buffer ), "0.0000 HMI_Teleaid_RD_DC := %X\n", getValue( HMI_Teleaid_RD_DC ) );        filePutString( buffer, elcount( buffer ), hFile );
    snprintf( buffer, elcount( buffer ), "0.0000 HMI_Teleaid_RD_L := %X\n", getValue( HMI_Teleaid_RD_L ) );        filePutString( buffer, elcount( buffer ), hFile );
    snprintf( buffer, elcount( buffer ), "0.0000 HMI_Teleaid_RD_UL := %X\n", getValue( HMI_Teleaid_RD_UL ) );        filePutString( buffer, elcount( buffer ), hFile );
    snprintf( buffer, elcount( buffer ), "0.0000 HMI_Teleaid_TA_DEF := %X\n", getValue( HMI_Teleaid_TA_DEF ) );        filePutString( buffer, elcount( buffer ), hFile );
    snprintf( buffer, elcount( buffer ), "0.0000 HMI_Teleaid_TA_NA := %X\n", getValue( HMI_Teleaid_TA_NA ) );        filePutString( buffer, elcount( buffer ), hFile );
    snprintf( buffer, elcount( buffer ), "0.0000 HMI_Teleaid_TR_A := %X\n", getValue( HMI_Teleaid_TR_A ) );        filePutString( buffer, elcount( buffer ), hFile );
}
/*@@end*/

/*@@timer:_tTeleaid_WRN_AR:*/
on timer _tTeleaid_WRN_AR
{
    putValue( HMI__STMSG_Teleaid_WRN_AR, 0 );
}
/*@@end*/

/*@@envVar:HMI__STMSG_Teleaid_WRN_AR:*/
on EnvVar HMI__STMSG_Teleaid_WRN_AR
{
    long tDelay;
    if( getValue( this ) == 2 )
    {
        tDelay = getValue( HMI__STMSGT_Teleaid_WRN_AR );
        if( tDelay > 0)    
            setTimer( _tTeleaid_WRN_AR, tDelay );
        else
            putValue( HMI__STMSG_Teleaid_WRN_AR, 0 );
    }
}
/*@@end*/

/*@@envVar:HMI_Teleaid_Call_Stat:*/
on EnvVar HMI_Teleaid_Call_Stat
{
    _mTeleaid_WRN_AR.Teleaid_Call_Stat.phys = getValue(this);
    _Teleaid_WRN_AR_SpontanFlag = 1;
}
/*@@end*/

/*@@envVar:HMI_Teleaid_Field_STR:*/
on EnvVar HMI_Teleaid_Field_STR
{
    _mTeleaid_WRN_AR.Teleaid_Field_STR.phys = getValue(this);
    _Teleaid_WRN_AR_SpontanFlag = 1;
}
/*@@end*/

/*@@envVar:HMI_Teleaid_HU_POP:*/
on EnvVar HMI_Teleaid_HU_POP
{
    _mTeleaid_WRN_AR.Teleaid_HU_POP.phys = getValue(this);
    _Teleaid_WRN_AR_SpontanFlag = 1;
}
/*@@end*/

/*@@envVar:HMI_Teleaid_IP_ERR:*/
on EnvVar HMI_Teleaid_IP_ERR
{
    _mTeleaid_WRN_AR.Teleaid_IP_ERR.phys = getValue(this);
    _Teleaid_WRN_AR_SpontanFlag = 1;
}
/*@@end*/

/*@@envVar:HMI_Teleaid_Net_TYP:*/
on EnvVar HMI_Teleaid_Net_TYP
{
    _mTeleaid_WRN_AR.Teleaid_Net_TYP.phys = getValue(this);
    _Teleaid_WRN_AR_SpontanFlag = 1;
}
/*@@end*/

/*@@envVar:HMI_Teleaid_RD_A:*/
on EnvVar HMI_Teleaid_RD_A
{
    _mTeleaid_WRN_AR.Teleaid_RD_A.phys = getValue(this);
    _Teleaid_WRN_AR_SpontanFlag = 1;
}
/*@@end*/

/*@@envVar:HMI_Teleaid_RD_DC:*/
on EnvVar HMI_Teleaid_RD_DC
{
    _mTeleaid_WRN_AR.Teleaid_RD_DC.phys = getValue(this);
    _Teleaid_WRN_AR_SpontanFlag = 1;
}
/*@@end*/

/*@@envVar:HMI_Teleaid_RD_L:*/
on EnvVar HMI_Teleaid_RD_L
{
    _mTeleaid_WRN_AR.Teleaid_RD_L.phys = getValue(this);
    _Teleaid_WRN_AR_SpontanFlag = 1;
}
/*@@end*/

/*@@envVar:HMI_Teleaid_RD_UL:*/
on EnvVar HMI_Teleaid_RD_UL
{
    _mTeleaid_WRN_AR.Teleaid_RD_UL.phys = getValue(this);
    _Teleaid_WRN_AR_SpontanFlag = 1;
}
/*@@end*/

/*@@envVar:HMI_Teleaid_TA_DEF:*/
on EnvVar HMI_Teleaid_TA_DEF
{
    _mTeleaid_WRN_AR.Teleaid_TA_DEF.phys = getValue(this);
    _Teleaid_WRN_AR_SpontanFlag = 1;
}
/*@@end*/

/*@@envVar:HMI_Teleaid_TA_NA:*/
on EnvVar HMI_Teleaid_TA_NA
{
    _mTeleaid_WRN_AR.Teleaid_TA_NA.phys = getValue(this);
    _Teleaid_WRN_AR_SpontanFlag = 1;
}
/*@@end*/

/*@@envVar:HMI_Teleaid_TR_A:*/
on EnvVar HMI_Teleaid_TR_A
{
    _mTeleaid_WRN_AR.Teleaid_TR_A.phys = getValue(this);
    _Teleaid_WRN_AR_SpontanFlag = 1;
}
/*@@end*/

/*@@caplFunc:TP_COM_TGW_Adapt_check_output():*/
TP_COM_TGW_Adapt_check_output()
{
    if( !getValue( HMI__STMSG_TP_COM_TGW_Adapt ) )
    {
        // Botschaft TP_COM_TGW_Adapt ID: 702 --- Sendeart 1 spontanX --- 
        if( _TP_COM_TGW_Adapt_SpontanFlag )
        {
            TP_COM_TGW_Adapt_output(); // Nachricht wg. spontaner Änderung ausgeben
            _TP_COM_TGW_Adapt_SpontanFlag = 0; // Spontan-Flag zurücksetzen
        }
    }
}
/*@@end*/

/*@@caplFunc:TP_COM_TGW_Adapt_getValue():*/
void TP_COM_TGW_Adapt_getValue(void)
{
    _mTP_COM_TGW_Adapt.byte( 0 ) = getValue( HMI_TP_COM_TGW_Adapt_0 );
    _mTP_COM_TGW_Adapt.byte( 1 ) = getValue( HMI_TP_COM_TGW_Adapt_1 );
    _mTP_COM_TGW_Adapt.byte( 2 ) = getValue( HMI_TP_COM_TGW_Adapt_2 );
    _mTP_COM_TGW_Adapt.byte( 3 ) = getValue( HMI_TP_COM_TGW_Adapt_3 );
    _mTP_COM_TGW_Adapt.byte( 4 ) = getValue( HMI_TP_COM_TGW_Adapt_4 );
    _mTP_COM_TGW_Adapt.byte( 5 ) = getValue( HMI_TP_COM_TGW_Adapt_5 );
    _mTP_COM_TGW_Adapt.byte( 6 ) = getValue( HMI_TP_COM_TGW_Adapt_6 );
    _mTP_COM_TGW_Adapt.byte( 7 ) = getValue( HMI_TP_COM_TGW_Adapt_7 );
}
/*@@end*/

/*@@caplFunc:TP_COM_TGW_Adapt_init():*/
TP_COM_TGW_Adapt_init()
{
   /* Botschaft TP_COM_TGW_Adapt ID: 698 --- Sendeart 1 spontanX --- 
BA_ "ApplMessage" BO_ 698 0;
BA_ "NmAsrMessage" BO_ 698 0;
BA_ "GenMsgMinAcceptLength" BO_ 698 8;
BA_ "GenMsgILSupport" BO_ 698 0;
BA_ "DiagState" BO_ 698 0;
BA_ "DiagRequest" BO_ 698 0;
BA_ "DiagResponse" BO_ 698 0;
BA_ "GenMsgStartValue" BO_ 698 "0";
    */
    _TP_COM_TGW_Adapt_Timebase =        c_tDBKomTimer_5ms;
    _TP_COM_TGW_Adapt_SpontanFlag = 0;

    TP_COM_TGW_Adapt_getValue();
}
/*@@end*/

/*@@caplFunc:TP_COM_TGW_Adapt_output():*/
TP_COM_TGW_Adapt_output()
{
    output( _mTP_COM_TGW_Adapt );
}
/*@@end*/

/*@@caplFunc:TP_COM_TGW_Adapt_saveEnvVars(dword):*/
TP_COM_TGW_Adapt_saveEnvVars( dword hFile )
{
    filePutString("\n// Knoten EIS: TP_COM_TGW_Adapt\n", 27, hFile );
    snprintf( buffer, elcount( buffer ), "0.0000 HMI__STMSG_TP_COM_TGW_Adapt := %X\n", getValue( HMI__STMSG_TP_COM_TGW_Adapt) );    filePutString( buffer, elcount( buffer ), hFile );
    snprintf( buffer, elcount( buffer ), "0.0000 HMI__STMSGT_TP_COM_TGW_Adapt := %X\n", getValue( HMI__STMSGT_TP_COM_TGW_Adapt) );    filePutString( buffer, elcount( buffer ), hFile );
    snprintf( buffer, elcount( buffer ), "0.0000 HMI_TP_COM_TGW_Adapt_0 := %X\n", getValue( HMI_TP_COM_TGW_Adapt_0 ) );    filePutString( buffer, elcount( buffer ), hFile );
    snprintf( buffer, elcount( buffer ), "0.0000 HMI_TP_COM_TGW_Adapt_1 := %X\n", getValue( HMI_TP_COM_TGW_Adapt_1 ) );    filePutString( buffer, elcount( buffer ), hFile );
    snprintf( buffer, elcount( buffer ), "0.0000 HMI_TP_COM_TGW_Adapt_2 := %X\n", getValue( HMI_TP_COM_TGW_Adapt_2 ) );    filePutString( buffer, elcount( buffer ), hFile );
    snprintf( buffer, elcount( buffer ), "0.0000 HMI_TP_COM_TGW_Adapt_3 := %X\n", getValue( HMI_TP_COM_TGW_Adapt_3 ) );    filePutString( buffer, elcount( buffer ), hFile );
    snprintf( buffer, elcount( buffer ), "0.0000 HMI_TP_COM_TGW_Adapt_4 := %X\n", getValue( HMI_TP_COM_TGW_Adapt_4 ) );    filePutString( buffer, elcount( buffer ), hFile );
    snprintf( buffer, elcount( buffer ), "0.0000 HMI_TP_COM_TGW_Adapt_5 := %X\n", getValue( HMI_TP_COM_TGW_Adapt_5 ) );    filePutString( buffer, elcount( buffer ), hFile );
    snprintf( buffer, elcount( buffer ), "0.0000 HMI_TP_COM_TGW_Adapt_6 := %X\n", getValue( HMI_TP_COM_TGW_Adapt_6 ) );    filePutString( buffer, elcount( buffer ), hFile );
    snprintf( buffer, elcount( buffer ), "0.0000 HMI_TP_COM_TGW_Adapt_7 := %X\n", getValue( HMI_TP_COM_TGW_Adapt_7 ) );    filePutString( buffer, elcount( buffer ), hFile );
}
/*@@end*/

/*@@timer:_tTP_COM_TGW_Adapt:*/
on timer _tTP_COM_TGW_Adapt
{
    putValue( HMI__STMSG_TP_COM_TGW_Adapt, 0 );
}
/*@@end*/

/*@@envVar:HMI__STMSG_TP_COM_TGW_Adapt:*/
on EnvVar HMI__STMSG_TP_COM_TGW_Adapt
{
    long tDelay;
    if( getValue( this ) == 2 )
    {
        tDelay = getValue( HMI__STMSGT_TP_COM_TGW_Adapt );
        if( tDelay > 0 )    
            setTimer( _tTP_COM_TGW_Adapt, tDelay );
        else
            putValue( HMI__STMSG_TP_COM_TGW_Adapt, 0 );
    }
}
/*@@end*/

/*@@envVar:HMI_TP_COM_TGW_Adapt_Send:*/
on EnvVar HMI_TP_COM_TGW_Adapt_Send
{
    TP_COM_TGW_Adapt_getValue();
    _TP_COM_TGW_Adapt_SpontanFlag = 1;
}
/*@@end*/

/*@@caplFunc:TP_EIS_IC_SecOdo_check_output():*/
TP_EIS_IC_SecOdo_check_output()
{
    if( !getValue( HMI__STMSG_TP_EIS_IC_SecOdo ) )
    {
        // Botschaft TP_EIS_IC_SecOdo ID: 359 --- Sendeart 1 spontanX --- 
        if( _TP_EIS_IC_SecOdo_SpontanFlag )
        {
            TP_EIS_IC_SecOdo_output(); // Nachricht wg. spontaner Änderung ausgeben
            _TP_EIS_IC_SecOdo_SpontanFlag = 0; // Spontan-Flag zurücksetzen
        }
    }
}
/*@@end*/

/*@@caplFunc:TP_EIS_IC_SecOdo_getValue():*/
void TP_EIS_IC_SecOdo_getValue(void)
{
    _mTP_EIS_IC_SecOdo.byte( 0 ) = getValue( HMI_TP_EIS_IC_SecOdo_0 );
    _mTP_EIS_IC_SecOdo.byte( 1 ) = getValue( HMI_TP_EIS_IC_SecOdo_1 );
    _mTP_EIS_IC_SecOdo.byte( 2 ) = getValue( HMI_TP_EIS_IC_SecOdo_2 );
    _mTP_EIS_IC_SecOdo.byte( 3 ) = getValue( HMI_TP_EIS_IC_SecOdo_3 );
    _mTP_EIS_IC_SecOdo.byte( 4 ) = getValue( HMI_TP_EIS_IC_SecOdo_4 );
    _mTP_EIS_IC_SecOdo.byte( 5 ) = getValue( HMI_TP_EIS_IC_SecOdo_5 );
    _mTP_EIS_IC_SecOdo.byte( 6 ) = getValue( HMI_TP_EIS_IC_SecOdo_6 );
    _mTP_EIS_IC_SecOdo.byte( 7 ) = getValue( HMI_TP_EIS_IC_SecOdo_7 );
}
/*@@end*/

/*@@caplFunc:TP_EIS_IC_SecOdo_init():*/
TP_EIS_IC_SecOdo_init()
{   /* Botschaft TP_EIS_IC_SecOdo ID: 359 --- Sendeart 1 spontanX --- 
BA_ "ApplMessage" BO_ 359 0;
BA_ "NmAsrMessage" BO_ 359 0;
BA_ "GenMsgMinAcceptLength" BO_ 359 8;
BA_ "GenMsgILSupport" BO_ 359 0;
BA_ "DiagState" BO_ 359 0;
BA_ "DiagRequest" BO_ 359 0;
BA_ "DiagResponse" BO_ 359 0;
BA_ "GenMsgStartValue" BO_ 359 "0";
    */
    _TP_EIS_IC_SecOdo_Timebase =        c_tDBKomTimer_5ms;
    _TP_EIS_IC_SecOdo_SpontanFlag = 0;

    TP_EIS_IC_SecOdo_getValue();
}
/*@@end*/

/*@@caplFunc:TP_EIS_IC_SecOdo_output():*/
TP_EIS_IC_SecOdo_output()
{
    output( _mTP_EIS_IC_SecOdo );
}
/*@@end*/

/*@@caplFunc:TP_EIS_IC_SecOdo_saveEnvVars(dword):*/
TP_EIS_IC_SecOdo_saveEnvVars( dword hFile )
{
    filePutString("\n// Knoten EIS: TP_EIS_IC_SecOdo\n", 32, hFile );
    snprintf( buffer, elcount( buffer ), "0.0000 HMI__STMSG_TP_EIS_IC_SecOdo := %X\n", getValue( HMI__STMSG_TP_EIS_IC_SecOdo ) );        filePutString( buffer, elcount( buffer ), hFile );
    snprintf( buffer, elcount( buffer ), "0.0000 HMI__STMSGT_TP_EIS_IC_SecOdo := %X\n", getValue( HMI__STMSGT_TP_EIS_IC_SecOdo ) );        filePutString( buffer, elcount( buffer ), hFile );
    snprintf( buffer, elcount( buffer ), "0.0000 HMI_TP_EIS_IC_SecOdo_0 := %X\n", getValue( HMI_TP_EIS_IC_SecOdo_0 ) );        filePutString( buffer, elcount( buffer ), hFile );
    snprintf( buffer, elcount( buffer ), "0.0000 HMI_TP_EIS_IC_SecOdo_1 := %X\n", getValue( HMI_TP_EIS_IC_SecOdo_1 ) );        filePutString( buffer, elcount( buffer ), hFile );
    snprintf( buffer, elcount( buffer ), "0.0000 HMI_TP_EIS_IC_SecOdo_2 := %X\n", getValue( HMI_TP_EIS_IC_SecOdo_2 ) );        filePutString( buffer, elcount( buffer ), hFile );
    snprintf( buffer, elcount( buffer ), "0.0000 HMI_TP_EIS_IC_SecOdo_3 := %X\n", getValue( HMI_TP_EIS_IC_SecOdo_3 ) );        filePutString( buffer, elcount( buffer ), hFile );
    snprintf( buffer, elcount( buffer ), "0.0000 HMI_TP_EIS_IC_SecOdo_4 := %X\n", getValue( HMI_TP_EIS_IC_SecOdo_4 ) );        filePutString( buffer, elcount( buffer ), hFile );
    snprintf( buffer, elcount( buffer ), "0.0000 HMI_TP_EIS_IC_SecOdo_5 := %X\n", getValue( HMI_TP_EIS_IC_SecOdo_5 ) );        filePutString( buffer, elcount( buffer ), hFile );
    snprintf( buffer, elcount( buffer ), "0.0000 HMI_TP_EIS_IC_SecOdo_6 := %X\n", getValue( HMI_TP_EIS_IC_SecOdo_6 ) );        filePutString( buffer, elcount( buffer ), hFile );
    snprintf( buffer, elcount( buffer ), "0.0000 HMI_TP_EIS_IC_SecOdo_7 := %X\n", getValue( HMI_TP_EIS_IC_SecOdo_7 ) );        filePutString( buffer, elcount( buffer ), hFile );
}
/*@@end*/

/*@@timer:_tTP_EIS_IC_SecOdo:*/
on timer _tTP_EIS_IC_SecOdo
{
    putValue( HMI__STMSG_TP_EIS_IC_SecOdo, 0 );
}
/*@@end*/

/*@@envVar:HMI__STMSG_TP_EIS_IC_SecOdo:*/
on EnvVar HMI__STMSG_TP_EIS_IC_SecOdo
{
    long tDelay;
    if( getValue( this ) == 2 )
    {
        tDelay = getValue( HMI__STMSGT_TP_EIS_IC_SecOdo );
        if( tDelay > 0 )    
            setTimer( _tTP_EIS_IC_SecOdo, tDelay );
        else
            putValue( HMI__STMSG_TP_EIS_IC_SecOdo, 0 );
    }
}
/*@@end*/

/*@@envVar:HMI_TP_EIS_IC_SecOdo_Send:*/
on EnvVar HMI_TP_EIS_IC_SecOdo_Send
{
    TP_EIS_IC_SecOdo_getValue();
    _TP_EIS_IC_SecOdo_SpontanFlag = 1;
}
/*@@end*/

/*@@caplFunc:TP_MPM_TGW_Nav_check_output():*/
TP_MPM_TGW_Nav_check_output()
{
    if( !getValue( HMI__STMSG_TP_MPM_TGW_Nav ) )
    {
        // Botschaft TP_MPM_TGW_Nav ID: 664 --- Sendeart 0 cyclicX --- 
        if( _TP_MPM_TGW_Nav_SpontanFlag )
        {
            TP_MPM_TGW_Nav_output(); // Nachricht wg. request ausgeben
            _TP_MPM_TGW_Nav_SpontanFlag = 0;
        }
    }
}
/*@@end*/

/*@@caplFunc:TP_MPM_TGW_Nav_getValue():*/
void TP_MPM_TGW_Nav_getValue(void)
{
    _mTP_MPM_TGW_Nav.byte( 0 ) = getValue( HMI_TP_MPM_TGW_Nav_0 );
    _mTP_MPM_TGW_Nav.byte( 1 ) = getValue( HMI_TP_MPM_TGW_Nav_1 );
    _mTP_MPM_TGW_Nav.byte( 2 ) = getValue( HMI_TP_MPM_TGW_Nav_2 );
    _mTP_MPM_TGW_Nav.byte( 3 ) = getValue( HMI_TP_MPM_TGW_Nav_3 );
    _mTP_MPM_TGW_Nav.byte( 4 ) = getValue( HMI_TP_MPM_TGW_Nav_4 );
    _mTP_MPM_TGW_Nav.byte( 5 ) = getValue( HMI_TP_MPM_TGW_Nav_5 );
    _mTP_MPM_TGW_Nav.byte( 6 ) = getValue( HMI_TP_MPM_TGW_Nav_6 );
    _mTP_MPM_TGW_Nav.byte( 7 ) = getValue( HMI_TP_MPM_TGW_Nav_7 );
}
/*@@end*/

/*@@caplFunc:TP_MPM_TGW_Nav_init():*/
TP_MPM_TGW_Nav_init()
{   /* Botschaft TP_MPM_TGW_Nav ID: 745 --- Sendeart 0 cyclicX --- 
BA_ "ApplMessage" BO_ 745 0;
BA_ "NmAsrMessage" BO_ 745 0;
BA_ "GenMsgMinAcceptLength" BO_ 745 8;
BA_ "GenMsgILSupport" BO_ 745 0;
BA_ "DiagState" BO_ 745 0;
BA_ "DiagRequest" BO_ 745 0;
BA_ "DiagResponse" BO_ 745 0;
BA_ "GenMsgStartValue" BO_ 745 "0";
    */
    _TP_MPM_TGW_Nav_Timebase =        c_tDBKomTimer_20ms;
    _TP_MPM_TGW_Nav_SpontanFlag = 0;

    TP_MPM_TGW_Nav_getValue();
}
/*@@end*/

/*@@caplFunc:TP_MPM_TGW_Nav_output():*/
TP_MPM_TGW_Nav_output(void)
{
    output( _mTP_MPM_TGW_Nav );
}
/*@@end*/

/*@@caplFunc:TP_MPM_TGW_Nav_saveEnvVars(dword):*/
TP_MPM_TGW_Nav_saveEnvVars( dword hFile )
{
    filePutString("\n// Knoten EIS: TP_MPM_TGW_Nav\n", 28, hFile );
    snprintf( buffer, elcount( buffer ), "0.0000 HMI__STMSG_TP_MPM_TGW_Nav := %X\n", getValue( HMI__STMSG_TP_MPM_TGW_Nav ) );        filePutString( buffer, elcount( buffer ), hFile );
    snprintf( buffer, elcount( buffer ), "0.0000 HMI__STMSGT_TP_MPM_TGW_Nav := %X\n", getValue( HMI__STMSGT_TP_MPM_TGW_Nav ) );        filePutString( buffer, elcount( buffer ), hFile );
    snprintf( buffer, elcount( buffer ), "0.0000 HMI_TP_MPM_TGW_Nav_0 := %X\n", getValue( HMI_TP_MPM_TGW_Nav_0) );        filePutString( buffer, elcount( buffer ), hFile );
    snprintf( buffer, elcount( buffer ), "0.0000 HMI_TP_MPM_TGW_Nav_1 := %X\n", getValue( HMI_TP_MPM_TGW_Nav_1) );        filePutString( buffer, elcount( buffer ), hFile );
    snprintf( buffer, elcount( buffer ), "0.0000 HMI_TP_MPM_TGW_Nav_2 := %X\n", getValue( HMI_TP_MPM_TGW_Nav_2) );        filePutString( buffer, elcount( buffer ), hFile );
    snprintf( buffer, elcount( buffer ), "0.0000 HMI_TP_MPM_TGW_Nav_3 := %X\n", getValue( HMI_TP_MPM_TGW_Nav_3) );        filePutString( buffer, elcount( buffer ), hFile );
    snprintf( buffer, elcount( buffer ), "0.0000 HMI_TP_MPM_TGW_Nav_4 := %X\n", getValue( HMI_TP_MPM_TGW_Nav_4 ) );        filePutString( buffer, elcount( buffer ), hFile );
    snprintf( buffer, elcount( buffer ), "0.0000 HMI_TP_MPM_TGW_Nav_5 := %X\n", getValue( HMI_TP_MPM_TGW_Nav_5 ) );        filePutString( buffer, elcount( buffer ), hFile );
    snprintf( buffer, elcount( buffer ), "0.0000 HMI_TP_MPM_TGW_Nav_6 := %X\n", getValue( HMI_TP_MPM_TGW_Nav_6) );        filePutString( buffer, elcount( buffer ), hFile );
    snprintf( buffer, elcount( buffer ), "0.0000 HMI_TP_MPM_TGW_Nav_7 := %X\n", getValue( HMI_TP_MPM_TGW_Nav_7) );        filePutString( buffer, elcount( buffer ), hFile );
}
/*@@end*/

/*@@timer:_tTP_MPM_TGW_Nav:*/
on timer _tTP_MPM_TGW_Nav
{
    putValue( HMI__STMSG_TP_MPM_TGW_Nav, 0 );
}
/*@@end*/

/*@@envVar:HMI__STMSG_TP_MPM_TGW_Nav:*/
on EnvVar HMI__STMSG_TP_MPM_TGW_Nav
{
    long tDelay;
    if( getValue( this ) == 2 )
    {
        tDelay = getValue( HMI__STMSGT_TP_MPM_TGW_Nav );
        if( tDelay > 0)    
            setTimer( _tTP_MPM_TGW_Nav, tDelay );
        else
            putValue( HMI__STMSG_TP_MPM_TGW_Nav, 0 );
    }
}
/*@@end*/

/*@@envVar:HMI_TP_MPM_TGW_Nav_Send:*/
on EnvVar HMI_TP_MPM_TGW_Nav_Send
{
    if( getValue( this ) )
    {
        TP_MPM_TGW_Nav_getValue();
    }
}
/*@@end*/

/*@@caplFunc:TP_PARK_TGW_check_output():*/
TP_PARK_TGW_check_output()
{
    if( !getValue( HMI__STMSG_TP_PARK_TGW ) )
    {
        // Botschaft TP_PARK_TGW ID: 664 --- Sendeart 1 spontanX --- 
        if( _TP_PARK_TGW_SpontanFlag )
        {
            TP_PARK_TGW_output(); // Nachricht wg. spontaner Änderung ausgeben
            _TP_PARK_TGW_SpontanFlag = 0; // Spontan-Flag zurücksetzen
        }
    }
}
/*@@end*/

/*@@caplFunc:TP_PARK_TGW_getValue():*/
void TP_PARK_TGW_getValue(void)
{
    _mTP_PARK_TGW.byte( 0 ) = getValue( HMI_TP_PARK_TGW_0 );
    _mTP_PARK_TGW.byte( 1 ) = getValue( HMI_TP_PARK_TGW_1 );
    _mTP_PARK_TGW.byte( 2 ) = getValue( HMI_TP_PARK_TGW_2 );
    _mTP_PARK_TGW.byte( 3 ) = getValue( HMI_TP_PARK_TGW_3 );
    _mTP_PARK_TGW.byte( 4 ) = getValue( HMI_TP_PARK_TGW_4 );
    _mTP_PARK_TGW.byte( 5 ) = getValue( HMI_TP_PARK_TGW_5 );
    _mTP_PARK_TGW.byte( 6 ) = getValue( HMI_TP_PARK_TGW_6 );
    _mTP_PARK_TGW.byte( 7 ) = getValue( HMI_TP_PARK_TGW_7 );
}
/*@@end*/

/*@@caplFunc:TP_PARK_TGW_init():*/
TP_PARK_TGW_init()
{
   /* Botschaft TP_PARK_TGW ID: 662 --- Sendeart 0 cyclicX --- 
BA_ "ApplMessage" BO_ 662 0;
BA_ "NmAsrMessage" BO_ 662 0;
BA_ "GenMsgMinAcceptLength" BO_ 662 8;
BA_ "GenMsgILSupport" BO_ 662 0;
BA_ "DiagState" BO_ 662 0;
BA_ "DiagRequest" BO_ 662 0;
BA_ "DiagResponse" BO_ 662 0;
BA_ "GenMsgStartValue" BO_ 662 "0";
    */
    _TP_PARK_TGW_Timebase =        c_tDBKomTimer_5ms;
    _TP_PARK_TGW_SpontanFlag = 0;

    TP_PARK_TGW_getValue();
}
/*@@end*/

/*@@caplFunc:TP_PARK_TGW_output():*/
TP_PARK_TGW_output()
{
    output( _mTP_PARK_TGW );
}
/*@@end*/

/*@@caplFunc:TP_PARK_TGW_saveEnvVars(dword):*/
TP_PARK_TGW_saveEnvVars( dword hFile )
{
    filePutString("\n// Knoten EIS: TP_PARK_TGW\n", 32, hFile );
    snprintf( buffer, elcount( buffer ), "0.0000 HMI__STMSG_TP_PARK_TGW := %X\n", getValue( HMI__STMSG_TP_PARK_TGW ) );    filePutString( buffer, elcount( buffer ), hFile );
    snprintf( buffer, elcount( buffer ), "0.0000 HMI__STMSGT_TP_PARK_TGW := %X\n", getValue( HMI__STMSGT_TP_PARK_TGW ) );    filePutString( buffer, elcount( buffer ), hFile );
    snprintf( buffer, elcount( buffer ), "0.0000 HMI_TP_PARK_TGW_0 := %X\n", getValue( HMI_TP_PARK_TGW_0 ) );    filePutString( buffer, elcount( buffer ), hFile );
    snprintf( buffer, elcount( buffer ), "0.0000 HMI_TP_PARK_TGW_1 := %X\n", getValue( HMI_TP_PARK_TGW_1 ) );    filePutString( buffer, elcount( buffer ), hFile );
    snprintf( buffer, elcount( buffer ), "0.0000 HMI_TP_PARK_TGW_2 := %X\n", getValue( HMI_TP_PARK_TGW_2 ) );    filePutString( buffer, elcount( buffer ), hFile );
    snprintf( buffer, elcount( buffer ), "0.0000 HMI_TP_PARK_TGW_3 := %X\n", getValue( HMI_TP_PARK_TGW_3 ) );    filePutString( buffer, elcount( buffer ), hFile );
    snprintf( buffer, elcount( buffer ), "0.0000 HMI_TP_PARK_TGW_4 := %X\n", getValue( HMI_TP_PARK_TGW_4 ) );    filePutString( buffer, elcount( buffer ), hFile );
    snprintf( buffer, elcount( buffer ), "0.0000 HMI_TP_PARK_TGW_5 := %X\n", getValue( HMI_TP_PARK_TGW_5 ) );    filePutString( buffer, elcount( buffer ), hFile );
    snprintf( buffer, elcount( buffer ), "0.0000 HMI_TP_PARK_TGW_6 := %X\n", getValue( HMI_TP_PARK_TGW_6 ) );    filePutString( buffer, elcount( buffer ), hFile );
    snprintf( buffer, elcount( buffer ), "0.0000 HMI_TP_PARK_TGW_7 := %X\n", getValue( HMI_TP_PARK_TGW_7 ) );    filePutString( buffer, elcount( buffer ), hFile );
}
/*@@end*/

/*@@timer:_tTP_PARK_TGW:*/
on timer _tTP_PARK_TGW
{
    putValue( HMI__STMSG_TP_PARK_TGW, 0 );
}
/*@@end*/

/*@@envVar:HMI__STMSG_TP_PARK_TGW:*/
on EnvVar HMI__STMSG_TP_PARK_TGW
{
    long tDelay;
    if( getValue( this ) == 2 )
    {
        tDelay = getValue( HMI__STMSGT_TP_PARK_TGW );
        if( tDelay > 0 )    
            setTimer( _tTP_PARK_TGW, tDelay );
        else
            putValue( HMI__STMSG_TP_PARK_TGW, 0 );
    }
}
/*@@end*/

/*@@envVar:HMI_TP_PARK_TGW_Send:*/
on EnvVar HMI_TP_PARK_TGW_Send
{
    TP_PARK_TGW_getValue();
    _TP_PARK_TGW_SpontanFlag = 1;
}
/*@@end*/

/*@@caplFunc:TP_TELEAID_TGW_check_output():*/
TP_TELEAID_TGW_check_output()
{
    if( !getValue( HMI__STMSG_TP_TELEAID_TGW ) )
    {
        // Botschaft TP_TELEAID_TGW ID: 739 --- Sendeart 1 spontanX --- 
        if( _TP_TELEAID_TGW_SpontanFlag )
        {
            output( _mTP_TELEAID_TGW ); // Nachricht wg. spontaner Änderung ausgeben
            _TP_TELEAID_TGW_SpontanFlag = 0; // Spontan-Flag zurücksetzen
        }
    }
}
/*@@end*/

/*@@caplFunc:TP_TELEAID_TGW_getValue():*/
void TP_TELEAID_TGW_getValue(void)
{
    _mTP_TELEAID_TGW.byte( 0 ) = getValue( HMI_TP_TELEAID_TGW_0 );
    _mTP_TELEAID_TGW.byte( 1 ) = getValue( HMI_TP_TELEAID_TGW_1 );
    _mTP_TELEAID_TGW.byte( 2 ) = getValue( HMI_TP_TELEAID_TGW_2 );
    _mTP_TELEAID_TGW.byte( 3 ) = getValue( HMI_TP_TELEAID_TGW_3 );
    _mTP_TELEAID_TGW.byte( 4 ) = getValue( HMI_TP_TELEAID_TGW_4 );
    _mTP_TELEAID_TGW.byte( 5 ) = getValue( HMI_TP_TELEAID_TGW_5 );
    _mTP_TELEAID_TGW.byte( 6 ) = getValue( HMI_TP_TELEAID_TGW_6 );
    _mTP_TELEAID_TGW.byte( 7 ) = getValue( HMI_TP_TELEAID_TGW_7 );
}
/*@@end*/

/*@@caplFunc:TP_TELEAID_TGW_init():*/
TP_TELEAID_TGW_init()
{
   /* Botschaft TP_TELEAID_TGW ID: 739 --- Sendeart 0 cyclicX --- 
BA_ "ApplMessage" BO_ 739 0;
BA_ "NmAsrMessage" BO_ 739 0;
BA_ "GenMsgMinAcceptLength" BO_ 739 8;
BA_ "GenMsgILSupport" BO_ 739 0;
BA_ "DiagState" BO_ 739 0;
BA_ "DiagRequest" BO_ 739 0;
BA_ "DiagResponse" BO_ 739 0;
BA_ "GenMsgStartValue" BO_ 739 "0";
    */
    _TP_TELEAID_TGW_Timebase =        c_tDBKomTimer_5ms;
    _TP_TELEAID_TGW_SpontanFlag = 0;

    TP_TELEAID_TGW_getValue();
}
/*@@end*/

/*@@caplFunc:TP_TELEAID_TGW_output():*/
TP_TELEAID_TGW_output()
{
    output( _mTP_TELEAID_TGW );
}
/*@@end*/

/*@@caplFunc:TP_TELEAID_TGW_saveEnvVars(dword):*/
TP_TELEAID_TGW_saveEnvVars( dword hFile )
{
    filePutString("\n// Knoten EIS: TP_TELEAID_TGW\n", 32, hFile );
    snprintf( buffer, elcount( buffer ), "0.0000 HMI__STMSG_TP_TELEAID_TGW := %X\n", getValue( HMI__STMSG_TP_TELEAID_TGW ) );    filePutString( buffer, elcount( buffer ), hFile );
    snprintf( buffer, elcount( buffer ), "0.0000 HMI__STMSGT_TP_TELEAID_TGW := %X\n", getValue( HMI__STMSGT_TP_TELEAID_TGW ) );    filePutString( buffer, elcount( buffer ), hFile );
    snprintf( buffer, elcount( buffer ), "0.0000 HMI_TP_TELEAID_TGW_0 := %X\n", getValue( HMI_TP_TELEAID_TGW_0 ) );    filePutString( buffer, elcount( buffer ), hFile );
    snprintf( buffer, elcount( buffer ), "0.0000 HMI_TP_TELEAID_TGW_1 := %X\n", getValue( HMI_TP_TELEAID_TGW_1 ) );    filePutString( buffer, elcount( buffer ), hFile );
    snprintf( buffer, elcount( buffer ), "0.0000 HMI_TP_TELEAID_TGW_2 := %X\n", getValue( HMI_TP_TELEAID_TGW_2 ) );    filePutString( buffer, elcount( buffer ), hFile );
    snprintf( buffer, elcount( buffer ), "0.0000 HMI_TP_TELEAID_TGW_3 := %X\n", getValue( HMI_TP_TELEAID_TGW_3 ) );    filePutString( buffer, elcount( buffer ), hFile );
    snprintf( buffer, elcount( buffer ), "0.0000 HMI_TP_TELEAID_TGW_4 := %X\n", getValue( HMI_TP_TELEAID_TGW_4 ) );    filePutString( buffer, elcount( buffer ), hFile );
    snprintf( buffer, elcount( buffer ), "0.0000 HMI_TP_TELEAID_TGW_5 := %X\n", getValue( HMI_TP_TELEAID_TGW_5 ) );    filePutString( buffer, elcount( buffer ), hFile );
    snprintf( buffer, elcount( buffer ), "0.0000 HMI_TP_TELEAID_TGW_6 := %X\n", getValue( HMI_TP_TELEAID_TGW_6 ) );    filePutString( buffer, elcount( buffer ), hFile );
    snprintf( buffer, elcount( buffer ), "0.0000 HMI_TP_TELEAID_TGW_7 := %X\n", getValue( HMI_TP_TELEAID_TGW_7 ) );    filePutString( buffer, elcount( buffer ), hFile );
}
/*@@end*/

/*@@timer:_tTP_TELEAID_TGW:*/
on timer _tTP_TELEAID_TGW
{
    putValue( HMI__STMSG_TP_TELEAID_TGW, 0 );
}
/*@@end*/

/*@@envVar:HMI__STMSG_TP_TELEAID_TGW:*/
on EnvVar HMI__STMSG_TP_TELEAID_TGW
{
    long tDelay;
    if( getValue( this ) == 2 )
    {
        tDelay = getValue( HMI__STMSGT_TP_TELEAID_TGW );
        if( tDelay > 0 )    
            setTimer( _tTP_TELEAID_TGW, tDelay );
        else
            putValue( HMI__STMSG_TP_TELEAID_TGW, 0 );
    }
}
/*@@end*/

/*@@envVar:HMI_TP_TELEAID_TGW_Send:*/
on EnvVar HMI_TP_TELEAID_TGW_Send
{
    TP_TELEAID_TGW_getValue();
    _TP_TELEAID_TGW_SpontanFlag = 1;
}
/*@@end*/

/*@@caplFunc:TP_WPT_IC_check_output():*/
TP_WPT_IC_check_output()
{
    if( !getValue( HMI__STMSG_TP_WPT_IC ) )
    {
        // Botschaft TP_WPT_IC ID: 1230 --- Sendeart 1 spontanX --- 
        if( _TP_WPT_IC_SpontanFlag )
        {
            output( _mTP_WPT_IC ); // Nachricht wg. spontaner Änderung ausgeben
            _TP_WPT_IC_SpontanFlag = 0; // Spontan-Flag zurücksetzen
        }
    }
}
/*@@end*/

/*@@caplFunc:TP_WPT_IC_getValue():*/
void TP_WPT_IC_getValue(void)
{
    _mTP_WPT_IC.byte( 0 ) = getValue( HMI_TP_WPT_IC_0 );
    _mTP_WPT_IC.byte( 1 ) = getValue( HMI_TP_WPT_IC_1 );
    _mTP_WPT_IC.byte( 2 ) = getValue( HMI_TP_WPT_IC_2 );
    _mTP_WPT_IC.byte( 3 ) = getValue( HMI_TP_WPT_IC_3 );
    _mTP_WPT_IC.byte( 4 ) = getValue( HMI_TP_WPT_IC_4 );
    _mTP_WPT_IC.byte( 5 ) = getValue( HMI_TP_WPT_IC_5 );
    _mTP_WPT_IC.byte( 6 ) = getValue( HMI_TP_WPT_IC_6 );
    _mTP_WPT_IC.byte( 7 ) = getValue( HMI_TP_WPT_IC_7 );
}
/*@@end*/

/*@@caplFunc:TP_WPT_IC_init():*/
TP_WPT_IC_init()
{
   /* Botschaft TP_WPT_IC ID: 1230 --- Sendeart 0 cyclicX --- 
BA_ "ApplMessage" BO_ 1230 0;
BA_ "NmAsrMessage" BO_ 1230 0;
BA_ "GenMsgMinAcceptLength" BO_ 1230 8;
BA_ "GenMsgILSupport" BO_ 1230 0;
BA_ "DiagState" BO_ 1230 0;
BA_ "DiagRequest" BO_ 1230 0;
BA_ "DiagResponse" BO_ 1230 0;
BA_ "GenMsgStartValue" BO_ 1230 "0";
    */
    _TP_WPT_IC_Timebase =        c_tDBKomTimer_5ms;
    _TP_WPT_IC_SpontanFlag = 0;

    TP_WPT_IC_getValue();
}
/*@@end*/

/*@@caplFunc:TP_WPT_IC_output():*/
TP_WPT_IC_output()
{
    output( _mTP_WPT_IC );
}
/*@@end*/

/*@@caplFunc:TP_WPT_IC_saveEnvVars(dword):*/
TP_WPT_IC_saveEnvVars( dword hFile )
{
    filePutString("\n// Knoten EIS: TP_WPT_IC\n", 32, hFile );
    snprintf( buffer, elcount( buffer ), "0.0000 HMI__STMSG_TP_WPT_IC := %X\n", getValue( HMI__STMSG_TP_WPT_IC ) );    filePutString( buffer, elcount( buffer ), hFile );
    snprintf( buffer, elcount( buffer ), "0.0000 HMI__STMSGT_TP_WPT_IC := %X\n", getValue( HMI__STMSGT_TP_WPT_IC ) );    filePutString( buffer, elcount( buffer ), hFile );
    snprintf( buffer, elcount( buffer ), "0.0000 HMI_TP_WPT_IC_0 := %X\n", getValue( HMI_TP_WPT_IC_0 ) );    filePutString( buffer, elcount( buffer ), hFile );
    snprintf( buffer, elcount( buffer ), "0.0000 HMI_TP_WPT_IC_1 := %X\n", getValue( HMI_TP_WPT_IC_1 ) );    filePutString( buffer, elcount( buffer ), hFile );
    snprintf( buffer, elcount( buffer ), "0.0000 HMI_TP_WPT_IC_2 := %X\n", getValue( HMI_TP_WPT_IC_2 ) );    filePutString( buffer, elcount( buffer ), hFile );
    snprintf( buffer, elcount( buffer ), "0.0000 HMI_TP_WPT_IC_3 := %X\n", getValue( HMI_TP_WPT_IC_3 ) );    filePutString( buffer, elcount( buffer ), hFile );
    snprintf( buffer, elcount( buffer ), "0.0000 HMI_TP_WPT_IC_4 := %X\n", getValue( HMI_TP_WPT_IC_4 ) );    filePutString( buffer, elcount( buffer ), hFile );
    snprintf( buffer, elcount( buffer ), "0.0000 HMI_TP_WPT_IC_5 := %X\n", getValue( HMI_TP_WPT_IC_5 ) );    filePutString( buffer, elcount( buffer ), hFile );
    snprintf( buffer, elcount( buffer ), "0.0000 HMI_TP_WPT_IC_6 := %X\n", getValue( HMI_TP_WPT_IC_6 ) );    filePutString( buffer, elcount( buffer ), hFile );
    snprintf( buffer, elcount( buffer ), "0.0000 HMI_TP_WPT_IC_7 := %X\n", getValue( HMI_TP_WPT_IC_7 ) );    filePutString( buffer, elcount( buffer ), hFile );
}
/*@@end*/

/*@@timer:_tTP_WPT_IC:*/
on timer _tTP_WPT_IC
{
    putValue( HMI__STMSG_TP_WPT_IC, 0 );
}
/*@@end*/

/*@@envVar:HMI__STMSG_TP_WPT_IC:*/
on EnvVar HMI__STMSG_TP_WPT_IC
{
    long tDelay;
    if( getValue( this ) == 2 )
    {
        tDelay = getValue( HMI__STMSGT_TP_WPT_IC );
        if( tDelay > 0 )    
            setTimer( _tTP_WPT_IC, tDelay );
        else
            putValue( HMI__STMSG_TP_WPT_IC, 0 );
    }
}
/*@@end*/

/*@@envVar:HMI_TP_WPT_IC_Send:*/
on EnvVar HMI_TP_WPT_IC_Send
{
    TP_WPT_IC_getValue();
    _TP_WPT_IC_SpontanFlag = 1;
}
/*@@end*/

/*@@caplFunc:TP_WPT_TGW_check_output():*/
TP_WPT_TGW_check_output()
{
    if( !getValue( HMI__STMSG_TP_WPT_TGW ) )
    {
        // Botschaft TP_WPT_TGW ID: 643 --- Sendeart 1 spontanX --- 
        if( _TP_WPT_TGW_SpontanFlag )
        {
            output( _mTP_WPT_TGW ); // Nachricht wg. spontaner Änderung ausgeben
            _TP_WPT_TGW_SpontanFlag = 0; // Spontan-Flag zurücksetzen
        }
    }
}
/*@@end*/

/*@@caplFunc:TP_WPT_TGW_getValue():*/
void TP_WPT_TGW_getValue(void)
{
    _mTP_WPT_TGW.byte( 0 ) = getValue( HMI_TP_WPT_TGW_0 );
    _mTP_WPT_TGW.byte( 1 ) = getValue( HMI_TP_WPT_TGW_1 );
    _mTP_WPT_TGW.byte( 2 ) = getValue( HMI_TP_WPT_TGW_2 );
    _mTP_WPT_TGW.byte( 3 ) = getValue( HMI_TP_WPT_TGW_3 );
    _mTP_WPT_TGW.byte( 4 ) = getValue( HMI_TP_WPT_TGW_4 );
    _mTP_WPT_TGW.byte( 5 ) = getValue( HMI_TP_WPT_TGW_5 );
    _mTP_WPT_TGW.byte( 6 ) = getValue( HMI_TP_WPT_TGW_6 );
    _mTP_WPT_TGW.byte( 7 ) = getValue( HMI_TP_WPT_TGW_7 );
}
/*@@end*/

/*@@caplFunc:TP_WPT_TGW_init():*/
TP_WPT_TGW_init()
{
   /* Botschaft TP_WPT_TGW ID: 643 --- Sendeart 0 cyclicX --- 
BA_ "ApplMessage" BO_ 643 0;
BA_ "NmAsrMessage" BO_ 643 0;
BA_ "GenMsgMinAcceptLength" BO_ 643 8;
BA_ "GenMsgILSupport" BO_ 643 0;
BA_ "DiagState" BO_ 643 0;
BA_ "DiagRequest" BO_ 643 0;
BA_ "DiagResponse" BO_ 643 0;
BA_ "GenMsgStartValue" BO_ 643 "0";
    */
    _TP_WPT_TGW_Timebase =        c_tDBKomTimer_5ms;
    _TP_WPT_TGW_SpontanFlag = 0;

    TP_WPT_TGW_getValue();
}
/*@@end*/

/*@@caplFunc:TP_WPT_TGW_output():*/
TP_WPT_TGW_output()
{
    output( _mTP_WPT_TGW );
}
/*@@end*/

/*@@caplFunc:TP_WPT_TGW_saveEnvVars(dword):*/
TP_WPT_TGW_saveEnvVars( dword hFile )
{
    filePutString("\n// Knoten EIS: TP_WPT_TGW\n", 32, hFile );
    snprintf( buffer, elcount( buffer ), "0.0000 HMI__STMSG_TP_WPT_TGW := %X\n", getValue( HMI__STMSG_TP_WPT_TGW ) );    filePutString( buffer, elcount( buffer ), hFile );
    snprintf( buffer, elcount( buffer ), "0.0000 HMI__STMSGT_TP_WPT_TGW := %X\n", getValue( HMI__STMSGT_TP_WPT_TGW ) );    filePutString( buffer, elcount( buffer ), hFile );
    snprintf( buffer, elcount( buffer ), "0.0000 HMI_TP_WPT_TGW_0 := %X\n", getValue( HMI_TP_WPT_TGW_0 ) );    filePutString( buffer, elcount( buffer ), hFile );
    snprintf( buffer, elcount( buffer ), "0.0000 HMI_TP_WPT_TGW_1 := %X\n", getValue( HMI_TP_WPT_TGW_1 ) );    filePutString( buffer, elcount( buffer ), hFile );
    snprintf( buffer, elcount( buffer ), "0.0000 HMI_TP_WPT_TGW_2 := %X\n", getValue( HMI_TP_WPT_TGW_2 ) );    filePutString( buffer, elcount( buffer ), hFile );
    snprintf( buffer, elcount( buffer ), "0.0000 HMI_TP_WPT_TGW_3 := %X\n", getValue( HMI_TP_WPT_TGW_3 ) );    filePutString( buffer, elcount( buffer ), hFile );
    snprintf( buffer, elcount( buffer ), "0.0000 HMI_TP_WPT_TGW_4 := %X\n", getValue( HMI_TP_WPT_TGW_4 ) );    filePutString( buffer, elcount( buffer ), hFile );
    snprintf( buffer, elcount( buffer ), "0.0000 HMI_TP_WPT_TGW_5 := %X\n", getValue( HMI_TP_WPT_TGW_5 ) );    filePutString( buffer, elcount( buffer ), hFile );
    snprintf( buffer, elcount( buffer ), "0.0000 HMI_TP_WPT_TGW_6 := %X\n", getValue( HMI_TP_WPT_TGW_6 ) );    filePutString( buffer, elcount( buffer ), hFile );
    snprintf( buffer, elcount( buffer ), "0.0000 HMI_TP_WPT_TGW_7 := %X\n", getValue( HMI_TP_WPT_TGW_7 ) );    filePutString( buffer, elcount( buffer ), hFile );
}
/*@@end*/

/*@@timer:_tTP_WPT_TGW:*/
on timer _tTP_WPT_TGW
{
    putValue( HMI__STMSG_TP_WPT_TGW, 0 );
}
/*@@end*/

/*@@envVar:HMI__STMSG_TP_WPT_TGW:*/
on EnvVar HMI__STMSG_TP_WPT_TGW
{
    long tDelay;
    if( getValue( this ) == 2 )
    {
        tDelay = getValue( HMI__STMSGT_TP_WPT_TGW );
        if( tDelay > 0 )    
            setTimer( _tTP_WPT_TGW, tDelay );
        else
            putValue( HMI__STMSG_TP_WPT_TGW, 0 );
    }
}
/*@@end*/

/*@@envVar:HMI_TP_WPT_TGW_Send:*/
on EnvVar HMI_TP_WPT_TGW_Send
{
    TP_WPT_TGW_getValue();
    _TP_WPT_TGW_SpontanFlag = 1;
}
/*@@end*/

/*@@caplFunc:Trailer_Stat_AR_check_output():*/
Trailer_Stat_AR_check_output()
{
    if( !getValue( HMI__STMSG_Trailer_Stat_AR ) )
    {
        // Botschaft Trailer_Stat_AR ID: 865 --- Sendeart 5 cyclicAndSpontanWithDelay --- 
        _Trailer_Stat_AR_Cnt--;
        if( _Trailer_Stat_AR_Cnt < 1 )
        {
            // Nachricht wg. abgelaufenem Zyklus ausgeben
            Trailer_Stat_AR_output();
            _Trailer_Stat_AR_Cnt = _Trailer_Stat_AR_CycleCount; // Zyklus-Zähler zurücksetzen
            _Trailer_Stat_AR_SpontanFlag = 0; // Spontan-Flag zurücksetzen
        }
        else if( _Trailer_Stat_AR_SpontanFlag)
        {
            // Nachricht wg. spontaner Änderung ausgeben
            Trailer_Stat_AR_output();
            _Trailer_Stat_AR_SpontanFlag = 0; // Spontan-Flag zurücksetzen
        }
    }
}
/*@@end*/

/*@@caplFunc:Trailer_Stat_AR_init():*/
Trailer_Stat_AR_init()
{   /* Botschaft Trailer_Stat_AR ID: 865 --- Sendeart 5 cyclicAndSpontanWithDelay --- 
BA_ "ApplMessage" BO_ 865 0;
BA_ "NmAsrMessage" BO_ 865 0;
BA_ "GenMsgMinAcceptLength" BO_ 865 8;
BA_ "GenMsgILSupport" BO_ 865 1;
BA_ "DiagState" BO_ 865 0;
BA_ "DiagRequest" BO_ 865 0;
BA_ "DiagResponse" BO_ 865 0;
BA_ "GenMsgStartValue" BO_ 865 "0";
BA_ "GenMsgDelayTime" BO_ 865 5;
BA_ "GenMsgNrOfRepetitions" BO_ 865 0;
BA_ "GenMsgCycleTime" BO_ 865 500;
BA_ "GenMsgSendType" BO_ 865 5;
    */
    _Trailer_Stat_AR_Timebase =       c_tDBKomTimer_20ms;
    _Trailer_Stat_AR_CycleCount =    500 / _Trailer_Stat_AR_Timebase;
    _Trailer_Stat_AR_StartDelay =      0 / _Trailer_Stat_AR_Timebase;
    _Trailer_Stat_AR_Cnt = _Trailer_Stat_AR_StartDelay;
    _Trailer_Stat_AR_SpontanFlag= 0;

    putValue( HMI__STMSGSD_Trailer_Stat_AR, _Trailer_Stat_AR_StartDelay * _Trailer_Stat_AR_Timebase );

    _mTrailer_Stat_AR.BrkLmpStyle.phys = getValue( HMI_BrkLmpStyle );
    _mTrailer_Stat_AR.ElecTrlrHtch_Disengg.phys = getValue( HMI_ElecTrlrHtch_Disengg );
    _mTrailer_Stat_AR.ElecTrlrHtch_PosnChg_Actv.phys = getValue( HMI_ElecTrlrHtch_PosnChg_Actv );
    _mTrailer_Stat_AR.ElecTrlrHtch_Stat_UB.phys = getValue( HMI_ElecTrlrHtch_Stat_UB );
    _mTrailer_Stat_AR.EmgLgtPath_Flt_TM.phys = getValue( HMI_EmgLgtPath_Flt_TM );
    _mTrailer_Stat_AR.Rsrv1_ElecTrlrHtch_Stat.phys = getValue( HMI_Rsrv1_ElecTrlrHtch_Stat );
    _mTrailer_Stat_AR.TM_FogLmp_Stat.phys = getValue( HMI_TM_FogLmp_Stat );
    _mTrailer_Stat_AR.Trlr_Stat.phys = getValue( HMI_Trlr_Stat );
    _mTrailer_Stat_AR.Trlr_Term54_Flt.phys = getValue( HMI_Trlr_Term54_Flt );
    _mTrailer_Stat_AR.TrlrBrkLmp_Flt.phys = getValue( HMI_TrlrBrkLmp_Flt );
    _mTrailer_Stat_AR.TrlrHtch_Flt.phys = getValue( HMI_TrlrHtch_Flt );
    _mTrailer_Stat_AR.TrlrTlLmp_Lt_Flt.phys = getValue( HMI_TrlrTlLmp_Lt_Flt );
    _mTrailer_Stat_AR.TrlrTlLmp_Rt_Flt.phys = getValue( HMI_TrlrTlLmp_Rt_Flt );
    _mTrailer_Stat_AR.TrlrTurnLmp_Lt_Flt.phys = getValue( HMI_TrlrTurnLmp_Lt_Flt );
    _mTrailer_Stat_AR.TrlrTurnLmp_Rt_Flt.phys = getValue( HMI_TrlrTurnLmp_Rt_Flt );
}
/*@@end*/

/*@@caplFunc:Trailer_Stat_AR_output():*/
void Trailer_Stat_AR_output(void)
{
    byte crc;
    byte SQC_help;

    if( !getValue( HMI_SQC_ElecTrlrHtch_Stat_Auto ) )
    {
        // berechne message counter
        SQC_help = getValue( HMI_SQC_ElecTrlrHtch_Stat );
        if( SQC_help >= 15 ) SQC_help = 0;
        else SQC_help++;
        putValue( HMI_SQC_ElecTrlrHtch_Stat, SQC_help );
        _mTrailer_Stat_AR.SQC_ElecTrlrHtch_Stat = SQC_help;
    }
    else
          _mTrailer_Stat_AR.SQC_ElecTrlrHtch_Stat = getValue( HMI_SQC_ElecTrlrHtch_Stat );

    if( getValue( HMI_CRC_ElecTrlrHtch_Stat_Profile_02 ) )
    {
        if( !getValue( HMI_CRC_ElecTrlrHtch_Stat_Auto ) )
        {   // CRC according Profile_02 ( W213 )
            // berechne crc
            crc = 0xFF;
//            crc = crctable_profile02[ crc ^ _mTrailer_Stat_AR.byte( 0 ) ];  CRC
            crc = crctable_profile02[crc ^ _mTrailer_Stat_AR.byte( 1 )];
            // crc = crctable_profile02[crc ^ _mTrailer_Stat_AR.byte( 2 )];
            // crc = crctable_profile02[crc ^ _mTrailer_Stat_AR.byte( 3 )];
            // crc = crctable_profile02[crc ^ _mTrailer_Stat_AR.byte( 4 )];
            // crc = crctable_profile02[crc ^ _mTrailer_Stat_AR.byte( 5 )];
            // crc = crctable_profile02[crc ^ _mTrailer_Stat_AR.byte( 6 )];
            // crc = crctable_profile02[crc ^ _mTrailer_Stat_AR.byte( 7 )];
            crc = crctable_profile02[ crc ^ _Trailer_Stat_AR_CRC_Offset[ _mTrailer_Stat_AR.SQC_ElecTrlrHtch_Stat ] ]; // load offset
            crc = (crc ^ 0xFF);
            if( getValue(  HMI_CRC_ElecTrlrHtch_Stat_Invalid ) )
                crc++;
            _mTrailer_Stat_AR.CRC_ElecTrlrHtch_Stat = crc;
            putValue( HMI_CRC_ElecTrlrHtch_Stat, crc );
        }
        else
            _mTrailer_Stat_AR.CRC_ElecTrlrHtch_Stat = getValue( HMI_CRC_ElecTrlrHtch_Stat );
    }
    output( _mTrailer_Stat_AR );
}
/*@@end*/

/*@@caplFunc:Trailer_Stat_AR_saveEnvVars(dword):*/
Trailer_Stat_AR_saveEnvVars( dword hFile )
{
    filePutString("\n// Knoten EIS: Trailer_Stat_AR\n", 29, hFile );
    snprintf( buffer, elcount( buffer ), "0.0000 HMI__STMSG_Trailer_Stat_AR := %X\n", getValue( HMI__STMSG_Trailer_Stat_AR ) );        filePutString( buffer, elcount( buffer ), hFile );
    snprintf( buffer, elcount( buffer ), "0.0000 HMI__STMSGT_Trailer_Stat_AR := %X\n", getValue( HMI__STMSGT_Trailer_Stat_AR ) );        filePutString( buffer, elcount( buffer ), hFile );
    snprintf( buffer, elcount( buffer ), "0.0000 HMI_BrkLmpStyle := %X\n", getValue( HMI_BrkLmpStyle ) );        filePutString( buffer, elcount( buffer ), hFile );
    snprintf( buffer, elcount( buffer ), "0.0000 HMI_CRC_ElecTrlrHtch_Stat := %X\n", getValue( HMI_CRC_ElecTrlrHtch_Stat ) );        filePutString( buffer, elcount( buffer ), hFile );
    snprintf( buffer, elcount( buffer ), "0.0000 HMI_CRC_ElecTrlrHtch_Stat_Auto := %X\n", getValue( HMI_CRC_ElecTrlrHtch_Stat_Auto ) );        filePutString( buffer, elcount( buffer ), hFile );
    snprintf( buffer, elcount( buffer ), "0.0000 HMI_CRC_ElecTrlrHtch_Stat_Profile_02 := %X\n", getValue( HMI_CRC_ElecTrlrHtch_Stat_Profile_02 ) );        filePutString( buffer, elcount( buffer ), hFile );
    snprintf( buffer, elcount( buffer ), "0.0000 HMI_ElecTrlrHtch_Disengg := %X\n", getValue( HMI_ElecTrlrHtch_Disengg ) );        filePutString( buffer, elcount( buffer ), hFile );
    snprintf( buffer, elcount( buffer ), "0.0000 HMI_ElecTrlrHtch_PosnChg_Actv := %X\n", getValue( HMI_ElecTrlrHtch_PosnChg_Actv ) );        filePutString( buffer, elcount( buffer ), hFile );
    snprintf( buffer, elcount( buffer ), "0.0000 HMI_ElecTrlrHtch_Stat_UB := %X\n", getValue( HMI_ElecTrlrHtch_Stat_UB ) );        filePutString( buffer, elcount( buffer ), hFile );
    snprintf( buffer, elcount( buffer ), "0.0000 HMI_EmgLgtPath_Flt_TM := %X\n", getValue( HMI_EmgLgtPath_Flt_TM ) );        filePutString( buffer, elcount( buffer ), hFile );
    snprintf( buffer, elcount( buffer ), "0.0000 HMI_Rsrv1_ElecTrlrHtch_Stat := %X\n", getValue( HMI_Rsrv1_ElecTrlrHtch_Stat ) );        filePutString( buffer, elcount( buffer ), hFile );
    snprintf( buffer, elcount( buffer ), "0.0000 HMI_SQC_ElecTrlrHtch_Stat := %X\n", getValue( HMI_SQC_ElecTrlrHtch_Stat ) );        filePutString( buffer, elcount( buffer ), hFile );
    snprintf( buffer, elcount( buffer ), "0.0000 HMI_SQC_ElecTrlrHtch_Stat_Auto := %X\n", getValue( HMI_SQC_ElecTrlrHtch_Stat_Auto ) );        filePutString( buffer, elcount( buffer ), hFile );
    snprintf( buffer, elcount( buffer ), "0.0000 HMI_TM_FogLmp_Stat := %X\n", getValue( HMI_TM_FogLmp_Stat ) );        filePutString( buffer, elcount( buffer ), hFile );
    snprintf( buffer, elcount( buffer ), "0.0000 HMI_Trlr_Stat := %X\n", getValue( HMI_Trlr_Stat ) );        filePutString( buffer, elcount( buffer ), hFile );
    snprintf( buffer, elcount( buffer ), "0.0000 HMI_Trlr_Term54_Flt := %X\n", getValue( HMI_Trlr_Term54_Flt ) );        filePutString( buffer, elcount( buffer ), hFile );
    snprintf( buffer, elcount( buffer ), "0.0000 HMI_TrlrBrkLmp_Flt := %X\n", getValue( HMI_TrlrBrkLmp_Flt ) );        filePutString( buffer, elcount( buffer ), hFile );
    snprintf( buffer, elcount( buffer ), "0.0000 HMI_TrlrHtch_Flt := %X\n", getValue( HMI_TrlrHtch_Flt ) );        filePutString( buffer, elcount( buffer ), hFile );
    snprintf( buffer, elcount( buffer ), "0.0000 HMI_TrlrTlLmp_Lt_Flt := %X\n", getValue( HMI_TrlrTlLmp_Lt_Flt ) );        filePutString( buffer, elcount( buffer ), hFile );
    snprintf( buffer, elcount( buffer ), "0.0000 HMI_TrlrTlLmp_Rt_Flt := %X\n", getValue( HMI_TrlrTlLmp_Rt_Flt ) );        filePutString( buffer, elcount( buffer ), hFile );
    snprintf( buffer, elcount( buffer ), "0.0000 HMI_TrlrTurnLmp_Lt_Flt := %X\n", getValue( HMI_TrlrTurnLmp_Lt_Flt ) );        filePutString( buffer, elcount( buffer ), hFile );
    snprintf( buffer, elcount( buffer ), "0.0000 HMI_TrlrTurnLmp_Rt_Flt := %X\n", getValue( HMI_TrlrTurnLmp_Rt_Flt ) );        filePutString( buffer, elcount( buffer ), hFile );
}
/*@@end*/

/*@@timer:_tTrailer_Stat_AR:*/
on timer _tTrailer_Stat_AR
{
    putValue( HMI__STMSG_Trailer_Stat_AR, 0 );
}
/*@@end*/

/*@@envVar:HMI__STMSG_Trailer_Stat_AR:*/
on EnvVar HMI__STMSG_Trailer_Stat_AR
{
    long tDelay;
    if( getValue( this ) == 2 )
    {
        tDelay = getValue( HMI__STMSGT_Trailer_Stat_AR );
        if( tDelay > 0)    
            setTimer( _tTrailer_Stat_AR, tDelay );
        else
            putValue( HMI__STMSG_Trailer_Stat_AR, 0 );
    }
}
/*@@end*/

/*@@envVar:HMI_BrkLmpStyle:*/
on EnvVar HMI_BrkLmpStyle
{
    _mTrailer_Stat_AR.BrkLmpStyle.phys = getValue(this);
    _Trailer_Stat_AR_SpontanFlag = 1;
}
/*@@end*/

/*@@envVar:HMI_ElecTrlrHtch_Disengg:*/
on EnvVar HMI_ElecTrlrHtch_Disengg
{
    _mTrailer_Stat_AR.ElecTrlrHtch_Disengg.phys = getValue(this);
    _Trailer_Stat_AR_SpontanFlag = 1;
}
/*@@end*/

/*@@envVar:HMI_ElecTrlrHtch_PosnChg_Actv:*/
on EnvVar HMI_ElecTrlrHtch_PosnChg_Actv
{
    _mTrailer_Stat_AR.ElecTrlrHtch_PosnChg_Actv.phys = getValue(this);
    _Trailer_Stat_AR_SpontanFlag = 1;
}
/*@@end*/

/*@@envVar:HMI_ElecTrlrHtch_Stat_UB:*/
on EnvVar HMI_ElecTrlrHtch_Stat_UB
{
    _mTrailer_Stat_AR.ElecTrlrHtch_Stat_UB.phys = getValue(this);
    _Trailer_Stat_AR_SpontanFlag = 1;
}
/*@@end*/

/*@@envVar:HMI_EmgLgtPath_Flt_TM:*/
on EnvVar HMI_EmgLgtPath_Flt_TM
{
    _mTrailer_Stat_AR.EmgLgtPath_Flt_TM.phys = getValue(this);
    _Trailer_Stat_AR_SpontanFlag = 1;
}
/*@@end*/

/*@@envVar:HMI_Rsrv1_ElecTrlrHtch_Stat:*/
on EnvVar HMI_Rsrv1_ElecTrlrHtch_Stat
{
    _mTrailer_Stat_AR.Rsrv1_ElecTrlrHtch_Stat.phys = getValue(this);
    _Trailer_Stat_AR_SpontanFlag = 1;
}
/*@@end*/

/*@@envVar:HMI_TM_FogLmp_Stat:*/
on EnvVar HMI_TM_FogLmp_Stat
{
    _mTrailer_Stat_AR.TM_FogLmp_Stat.phys = getValue(this);
    _Trailer_Stat_AR_SpontanFlag = 1;
}
/*@@end*/

/*@@envVar:HMI_Trlr_Stat:*/
on EnvVar HMI_Trlr_Stat
{
    _mTrailer_Stat_AR.Trlr_Stat.phys = getValue(this);
    _Trailer_Stat_AR_SpontanFlag = 1;
}
/*@@end*/

/*@@envVar:HMI_Trlr_Term54_Flt:*/
on EnvVar HMI_Trlr_Term54_Flt
{
    _mTrailer_Stat_AR.Trlr_Term54_Flt.phys = getValue(this);
    _Trailer_Stat_AR_SpontanFlag = 1;
}
/*@@end*/

/*@@envVar:HMI_TrlrBrkLmp_Flt:*/
on EnvVar HMI_TrlrBrkLmp_Flt
{
    _mTrailer_Stat_AR.TrlrBrkLmp_Flt.phys = getValue(this);
    _Trailer_Stat_AR_SpontanFlag = 1;
}
/*@@end*/

/*@@envVar:HMI_TrlrHtch_Flt:*/
on EnvVar HMI_TrlrHtch_Flt
{
    _mTrailer_Stat_AR.TrlrHtch_Flt.phys = getValue(this);
    _Trailer_Stat_AR_SpontanFlag = 1;
}
/*@@end*/

/*@@envVar:HMI_TrlrTlLmp_Lt_Flt:*/
on EnvVar HMI_TrlrTlLmp_Lt_Flt
{
    _mTrailer_Stat_AR.TrlrTlLmp_Lt_Flt.phys = getValue(this);
    _Trailer_Stat_AR_SpontanFlag = 1;
}
/*@@end*/

/*@@envVar:HMI_TrlrTlLmp_Rt_Flt:*/
on EnvVar HMI_TrlrTlLmp_Rt_Flt
{
    _mTrailer_Stat_AR.TrlrTlLmp_Rt_Flt.phys = getValue(this);
    _Trailer_Stat_AR_SpontanFlag = 1;
}
/*@@end*/

/*@@envVar:HMI_TrlrTurnLmp_Lt_Flt:*/
on EnvVar HMI_TrlrTurnLmp_Lt_Flt
{
    _mTrailer_Stat_AR.TrlrTurnLmp_Lt_Flt.phys = getValue(this);
    _Trailer_Stat_AR_SpontanFlag = 1;
}
/*@@end*/

/*@@envVar:HMI_TrlrTurnLmp_Rt_Flt:*/
on EnvVar HMI_TrlrTurnLmp_Rt_Flt
{
    _mTrailer_Stat_AR.TrlrTurnLmp_Rt_Flt.phys = getValue(this);
    _Trailer_Stat_AR_SpontanFlag = 1;
}
/*@@end*/

/*@@caplFunc:TSA_Disp_Rq1_AR_check_output():*/
TSA_Disp_Rq1_AR_check_output()
{
    if( !getValue( HMI__STMSG_TSA_Disp_Rq1_AR ) )
    {
        // Botschaft TSA_Disp_Rq1_AR ID: 213 --- Sendeart 5 cyclicAndSpontanWithDelay --- 
        if( _TSA_Disp_Rq1_AR_DelayCnt > 0) _TSA_Disp_Rq1_AR_DelayCnt--; // Mindestsendeabstand
        _TSA_Disp_Rq1_AR_Cnt--;
        if( _TSA_Disp_Rq1_AR_Cnt < 1 )
        {
            if( _TSA_Disp_Rq1_AR_DelayCnt < 1 )
            {
                // Nachricht wg. abgelaufenem Zyklus ausgeben (Mindestsendeabstand eingehalten)
                TSA_Disp_Rq1_AR_output();
                 _TSA_Disp_Rq1_AR_SpontanFlag = 0; // Spontan-Flag zurücksetzen
                _TSA_Disp_Rq1_AR_DelayCnt = _TSA_Disp_Rq1_AR_MinDelay;
            }
            else
            {
                // Spontanflag setzen damit nach Ablauf Mindestsendeabstand gesendet wird
                 _TSA_Disp_Rq1_AR_SpontanFlag = 1;
            }
            _TSA_Disp_Rq1_AR_Cnt = _TSA_Disp_Rq1_AR_CycleCount; // Zyklus-Zähler zurücksetzen
        }
        else if( _TSA_Disp_Rq1_AR_SpontanFlag)
        {
            if( _TSA_Disp_Rq1_AR_DelayCnt < 1 )
            {
                // Nachricht wg. spontaner Änderung ausgeben (Mindestsendeabstand eingehalten)
                TSA_Disp_Rq1_AR_output();
                _TSA_Disp_Rq1_AR_SpontanFlag = 0; // Spontan-Flag zurücksetzen
                _TSA_Disp_Rq1_AR_DelayCnt = _TSA_Disp_Rq1_AR_MinDelay;
            }
        }
    }
}
/*@@end*/

/*@@caplFunc:TSA_Disp_Rq1_AR_init():*/
TSA_Disp_Rq1_AR_init()
{    /* Botschaft TSA_Disp_Rq1_AR ID: 213 --- Sendeart 5 cyclicAndSpontanWithDelay --- 
BA_ "ApplMessage" BO_ 213 0;
BA_ "NmAsrMessage" BO_ 213 0;
BA_ "GenMsgMinAcceptLength" BO_ 213 8;
BA_ "GenMsgILSupport" BO_ 213 1;
BA_ "DiagState" BO_ 213 0;
BA_ "DiagRequest" BO_ 213 0;
BA_ "DiagResponse" BO_ 213 0;
BA_ "GenMsgStartValue" BO_ 213 "0";
BA_ "GenMsgDelayTime" BO_ 213 50;
BA_ "GenMsgNrOfRepetitions" BO_ 213 0;
BA_ "GenMsgCycleTime" BO_ 213 200;
BA_ "GenMsgSendType" BO_ 213 5;
    */
    _TSA_Disp_Rq1_AR_Timebase =       c_tDBKomTimer_5ms;
    _TSA_Disp_Rq1_AR_CycleCount =    200 / _TSA_Disp_Rq1_AR_Timebase;
    _TSA_Disp_Rq1_AR_StartDelay =      0 / _TSA_Disp_Rq1_AR_Timebase;
    _TSA_Disp_Rq1_AR_MinDelay =       50 / _TSA_Disp_Rq1_AR_Timebase;
    _TSA_Disp_Rq1_AR_Cnt = _TSA_Disp_Rq1_AR_StartDelay;
    _TSA_Disp_Rq1_AR_SpontanFlag = 0;
    _TSA_Disp_Rq1_AR_DelayCnt = 0;

    putValue( HMI__STMSGSD_TSA_Disp_Rq1_AR, _TSA_Disp_Rq1_AR_StartDelay * _TSA_Disp_Rq1_AR_Timebase );

    _mTSA_Disp_Rq1_AR.CrossWalk_Warn_Rq.phys = getValue( HMI_CrossWalk_Warn_Rq );
    _mTSA_Disp_Rq1_AR.PMA_Pass_Warn_Rq.phys = getValue( HMI_PMA_Pass_Warn_Rq );
    _mTSA_Disp_Rq1_AR.PMA_Warn_Rq.phys = getValue( HMI_PMA_Warn_Rq );
    _mTSA_Disp_Rq1_AR.RoadWork_Warn_Rq.phys = getValue( HMI_RoadWork_Warn_Rq );
    _mTSA_Disp_Rq1_AR.SLA_SpdWarn_DispType.phys = getValue( HMI_SLA_SpdWarn_DispType );
    _mTSA_Disp_Rq1_AR.SLA_SpdWarn_IconDisp_Rq.phys = getValue( HMI_SLA_SpdWarn_IconDisp_Rq );
    _mTSA_Disp_Rq1_AR.SLA_SpdWarn_Rq_V2.phys = getValue( HMI_SLA_SpdWarn_Rq_V2 );
    _mTSA_Disp_Rq1_AR.SLA_Warn_Rq.phys = getValue( HMI_SLA_Warn_Rq );
    _mTSA_Disp_Rq1_AR.SLA_WarnSpd_Unit.phys = getValue( HMI_SLA_WarnSpd_Unit );
    _mTSA_Disp_Rq1_AR.SLA_WarnSpd_Val_V2.phys = getValue( HMI_SLA_WarnSpd_Val_V2 );
    _mTSA_Disp_Rq1_AR.SLA_WarnSpdNxt_Dist.phys = getValue( HMI_SLA_WarnSpdNxt_Dist );
    _mTSA_Disp_Rq1_AR.SLA_WarnSpdNxt_Type.phys = getValue( HMI_SLA_WarnSpdNxt_Type );
    _mTSA_Disp_Rq1_AR.SLA_WarnSpdNxt_Val.phys = getValue( HMI_SLA_WarnSpdNxt_Val );
    _mTSA_Disp_Rq1_AR.TSA_HU_DispMd_Stat.phys = getValue( HMI_TSA_HU_DispMd_Stat );
    _mTSA_Disp_Rq1_AR.TSA_IC_DispMd_Stat.phys = getValue( HMI_TSA_IC_DispMd_Stat );
    _mTSA_Disp_Rq1_AR.TSA_SpdWarnMd_Stat.phys = getValue( HMI_TSA_SpdWarnMd_Stat );
    _mTSA_Disp_Rq1_AR.TSA_SpdWarnOffset.phys = getValue( HMI_TSA_SpdWarnOffset );
    _mTSA_Disp_Rq1_AR.TSA_Stat.phys = getValue( HMI_TSA_Stat );
    _mTSA_Disp_Rq1_AR.TSA_WarnMd_Stat.phys = getValue( HMI_TSA_WarnMd_Stat );
    _mTSA_Disp_Rq1_AR.WWA_Warn_Rq.phys = getValue( HMI_WWA_Warn_Rq );
}
/*@@end*/

/*@@caplFunc:TSA_Disp_Rq1_AR_output():*/
TSA_Disp_Rq1_AR_output()
{
    output( _mTSA_Disp_Rq1_AR );
}
/*@@end*/

/*@@caplFunc:TSA_Disp_Rq1_AR_saveEnvVars(dword):*/
TSA_Disp_Rq1_AR_saveEnvVars( dword hFile )
{
    filePutString("\n// Knoten EIS: TSA_Disp_Rq1_AR\n", 29, hFile );
    snprintf( buffer, elcount( buffer ), "0.0000 HMI__STMSG_TSA_Disp_Rq1 := %X\n", getValue( HMI__STMSG_TSA_Disp_Rq1_AR ) );    filePutString( buffer, elcount( buffer ), hFile );
    snprintf( buffer, elcount( buffer ), "0.0000 HMI__STMSGT_TSA_Disp_Rq1 := %X\n", getValue( HMI__STMSGT_TSA_Disp_Rq1_AR ) );    filePutString( buffer, elcount( buffer ), hFile );
    snprintf( buffer, elcount( buffer ), "0.0000 HMI_CrossWalk_Warn_Rq := %X\n", getValue( HMI_CrossWalk_Warn_Rq ) );    filePutString( buffer, elcount( buffer ), hFile );
    snprintf( buffer, elcount( buffer ), "0.0000 HMI_PMA_Pass_Warn_Rq := %X\n", getValue( HMI_PMA_Pass_Warn_Rq ) );    filePutString( buffer, elcount( buffer ), hFile );
    snprintf( buffer, elcount( buffer ), "0.0000 HMI_PMA_Warn_Rq := %X\n", getValue( HMI_PMA_Warn_Rq ) );    filePutString( buffer, elcount( buffer ), hFile );
    snprintf( buffer, elcount( buffer ), "0.0000 HMI_RoadWork_Warn_Rq := %X\n", getValue( HMI_RoadWork_Warn_Rq ) );    filePutString( buffer, elcount( buffer ), hFile );
    snprintf( buffer, elcount( buffer ), "0.0000 HMI_SLA_SpdWarn_DispType := %X\n", getValue( HMI_SLA_SpdWarn_DispType ) );    filePutString( buffer, elcount( buffer ), hFile );
    snprintf( buffer, elcount( buffer ), "0.0000 HMI_SLA_SpdWarn_IconDisp_Rq := %X\n", getValue( HMI_SLA_SpdWarn_IconDisp_Rq ) );    filePutString( buffer, elcount( buffer ), hFile );
    snprintf( buffer, elcount( buffer ), "0.0000 HMI_SLA_SpdWarn_Rq_V2 := %X\n", getValue( HMI_SLA_SpdWarn_Rq_V2 ) );    filePutString( buffer, elcount( buffer ), hFile );
    snprintf( buffer, elcount( buffer ), "0.0000 HMI_SLA_Warn_Rq := %X\n", getValue( HMI_SLA_Warn_Rq ) );    filePutString( buffer, elcount( buffer ), hFile );
    snprintf( buffer, elcount( buffer ), "0.0000 HMI_SLA_WarnSpd_Unit := %X\n", getValue( HMI_SLA_WarnSpd_Unit ) );    filePutString( buffer, elcount( buffer ), hFile );
    snprintf( buffer, elcount( buffer ), "0.0000 HMI_SLA_WarnSpd_Val_V2 := %X\n", getValue( HMI_SLA_WarnSpd_Val_V2 ) );    filePutString( buffer, elcount( buffer ), hFile );
    snprintf( buffer, elcount( buffer ), "0.0000 HMI_SLA_WarnSpdNxt_Dist := %X\n", getValue( HMI_SLA_WarnSpdNxt_Dist ) );    filePutString( buffer, elcount( buffer ), hFile );
    snprintf( buffer, elcount( buffer ), "0.0000 HMI_SLA_WarnSpdNxt_Type := %X\n", getValue( HMI_SLA_WarnSpdNxt_Type ) );    filePutString( buffer, elcount( buffer ), hFile );
    snprintf( buffer, elcount( buffer ), "0.0000 HMI_SLA_WarnSpdNxt_Val := %X\n", getValue( HMI_SLA_WarnSpdNxt_Val ) );    filePutString( buffer, elcount( buffer ), hFile );
    snprintf( buffer, elcount( buffer ), "0.0000 HMI_TSA_HU_DispMd_Stat := %X\n", getValue( HMI_TSA_HU_DispMd_Stat ) );    filePutString( buffer, elcount( buffer ), hFile );
    snprintf( buffer, elcount( buffer ), "0.0000 HMI_TSA_IC_DispMd_Stat := %X\n", getValue( HMI_TSA_IC_DispMd_Stat ) );    filePutString( buffer, elcount( buffer ), hFile );
    snprintf( buffer, elcount( buffer ), "0.0000 HMI_TSA_SpdWarnMd_Stat := %X\n", getValue( HMI_TSA_SpdWarnMd_Stat ) );    filePutString( buffer, elcount( buffer ), hFile );
    snprintf( buffer, elcount( buffer ), "0.0000 HMI_TSA_SpdWarnOffset := %X\n", getValue( HMI_TSA_SpdWarnOffset ) );    filePutString( buffer, elcount( buffer ), hFile );
    snprintf( buffer, elcount( buffer ), "0.0000 HMI_TSA_Stat := %X\n", getValue( HMI_TSA_Stat ) );    filePutString( buffer, elcount( buffer ), hFile );
    snprintf( buffer, elcount( buffer ), "0.0000 HMI_TSA_WarnMd_Stat := %X\n", getValue( HMI_TSA_WarnMd_Stat ) );    filePutString( buffer, elcount( buffer ), hFile );
    snprintf( buffer, elcount( buffer ), "0.0000 HMI_WWA_Warn_Rq := %X\n", getValue( HMI_WWA_Warn_Rq ) );    filePutString( buffer, elcount( buffer ), hFile );
}
/*@@end*/

/*@@timer:_tTSA_Disp_Rq1_AR:*/
on timer _tTSA_Disp_Rq1_AR
{
    putValue( HMI__STMSG_TSA_Disp_Rq1_AR, 0 );
}
/*@@end*/

/*@@envVar:HMI__STMSG_TSA_Disp_Rq1_AR:*/
on EnvVar HMI__STMSG_TSA_Disp_Rq1_AR
{
    long tDelay;
    if( getValue( this ) == 2 )
    {
        tDelay = getValue( HMI__STMSGT_TSA_Disp_Rq1_AR );
        if( tDelay > 0)    
            setTimer( _tTSA_Disp_Rq1_AR, tDelay );
        else
            putValue( HMI__STMSG_TSA_Disp_Rq1_AR, 0 );
    }
}
/*@@end*/

/*@@envVar:HMI_CrossWalk_Warn_Rq:*/
on EnvVar HMI_CrossWalk_Warn_Rq
{
    _mTSA_Disp_Rq1_AR.CrossWalk_Warn_Rq.phys = getValue(this);
    _TSA_Disp_Rq1_AR_SpontanFlag = 1;
}
/*@@end*/

/*@@envVar:HMI_PMA_Pass_Warn_Rq:*/
on EnvVar HMI_PMA_Pass_Warn_Rq
{
    _mTSA_Disp_Rq1_AR.PMA_Pass_Warn_Rq.phys = getValue(this);
    _TSA_Disp_Rq1_AR_SpontanFlag = 1;
}
/*@@end*/

/*@@envVar:HMI_PMA_Warn_Rq:*/
on EnvVar HMI_PMA_Warn_Rq
{
    _mTSA_Disp_Rq1_AR.PMA_Warn_Rq.phys = getValue(this);
    _TSA_Disp_Rq1_AR_SpontanFlag = 1;
}
/*@@end*/

/*@@envVar:HMI_RoadWork_Warn_Rq:*/
on EnvVar HMI_RoadWork_Warn_Rq
{
    _mTSA_Disp_Rq1_AR.RoadWork_Warn_Rq.phys = getValue(this);
    _TSA_Disp_Rq1_AR_SpontanFlag = 1;
}
/*@@end*/

/*@@envVar:HMI_SLA_SpdWarn_DispType:*/
on EnvVar HMI_SLA_SpdWarn_DispType
{
    _mTSA_Disp_Rq1_AR.SLA_SpdWarn_DispType.phys = getValue(this);
    _TSA_Disp_Rq1_AR_SpontanFlag = 1;
}
/*@@end*/

/*@@envVar:HMI_SLA_SpdWarn_IconDisp_Rq:*/
on EnvVar HMI_SLA_SpdWarn_IconDisp_Rq
{
    _mTSA_Disp_Rq1_AR.SLA_SpdWarn_IconDisp_Rq.phys = getValue(this);
    _TSA_Disp_Rq1_AR_SpontanFlag = 1;
}
/*@@end*/

/*@@envVar:HMI_SLA_SpdWarn_Rq_V2:*/
on EnvVar HMI_SLA_SpdWarn_Rq_V2
{
    _mTSA_Disp_Rq1_AR.SLA_SpdWarn_Rq_V2.phys = getValue(this);
    _TSA_Disp_Rq1_AR_SpontanFlag = 1;
}
/*@@end*/

/*@@envVar:HMI_SLA_Warn_Rq:*/
on EnvVar HMI_SLA_Warn_Rq
{
    _mTSA_Disp_Rq1_AR.SLA_Warn_Rq.phys = getValue(this);
    _TSA_Disp_Rq1_AR_SpontanFlag = 1;
}
/*@@end*/

/*@@envVar:HMI_SLA_WarnSpd_Unit:*/
on EnvVar HMI_SLA_WarnSpd_Unit
{
    _mTSA_Disp_Rq1_AR.SLA_WarnSpd_Unit.phys = getValue(this);
    _TSA_Disp_Rq1_AR_SpontanFlag = 1;
}
/*@@end*/

/*@@envVar:HMI_SLA_WarnSpd_Val_V2:*/
on EnvVar HMI_SLA_WarnSpd_Val_V2
{
    _mTSA_Disp_Rq1_AR.SLA_WarnSpd_Val_V2.phys = getValue(this);
    _TSA_Disp_Rq1_AR_SpontanFlag = 1;
}
/*@@end*/

/*@@envVar:HMI_SLA_WarnSpdNxt_Dist:*/
on EnvVar HMI_SLA_WarnSpdNxt_Dist
{
    _mTSA_Disp_Rq1_AR.SLA_WarnSpdNxt_Dist.phys = getValue(this);
    _TSA_Disp_Rq1_AR_SpontanFlag = 1;
}
/*@@end*/

/*@@envVar:HMI_SLA_WarnSpdNxt_Type:*/
on EnvVar HMI_SLA_WarnSpdNxt_Type
{
    _mTSA_Disp_Rq1_AR.SLA_WarnSpdNxt_Type.phys = getValue(this);
    _TSA_Disp_Rq1_AR_SpontanFlag = 1;
}
/*@@end*/

/*@@envVar:HMI_SLA_WarnSpdNxt_Val:*/
on EnvVar HMI_SLA_WarnSpdNxt_Val
{
    _mTSA_Disp_Rq1_AR.SLA_WarnSpdNxt_Val.phys = getValue(this);
    _TSA_Disp_Rq1_AR_SpontanFlag = 1;
}
/*@@end*/

/*@@envVar:HMI_TSA_HU_DispMd_Stat:*/
on EnvVar HMI_TSA_HU_DispMd_Stat
{
    _mTSA_Disp_Rq1_AR.TSA_HU_DispMd_Stat.phys = getValue(this);
    _TSA_Disp_Rq1_AR_SpontanFlag = 1;
}
/*@@end*/

/*@@envVar:HMI_TSA_IC_DispMd_Stat:*/
on EnvVar HMI_TSA_IC_DispMd_Stat
{
    _mTSA_Disp_Rq1_AR.TSA_IC_DispMd_Stat.phys = getValue(this);
    _TSA_Disp_Rq1_AR_SpontanFlag = 1;
}
/*@@end*/

/*@@envVar:HMI_TSA_SpdWarnMd_Stat:*/
on EnvVar HMI_TSA_SpdWarnMd_Stat
{
    _mTSA_Disp_Rq1_AR.TSA_SpdWarnMd_Stat.phys = getValue(this);
    _TSA_Disp_Rq1_AR_SpontanFlag = 1;
}
/*@@end*/

/*@@envVar:HMI_TSA_SpdWarnOffset:*/
on EnvVar HMI_TSA_SpdWarnOffset
{
    _mTSA_Disp_Rq1_AR.TSA_SpdWarnOffset.phys = getValue(this);
    _TSA_Disp_Rq1_AR_SpontanFlag = 1;
}
/*@@end*/

/*@@envVar:HMI_TSA_Stat:*/
on EnvVar HMI_TSA_Stat
{
    _mTSA_Disp_Rq1_AR.TSA_Stat.phys = getValue(this);
    _TSA_Disp_Rq1_AR_SpontanFlag = 1;
}
/*@@end*/

/*@@envVar:HMI_TSA_WarnMd_Stat:*/
on EnvVar HMI_TSA_WarnMd_Stat
{
    _mTSA_Disp_Rq1_AR.TSA_WarnMd_Stat.phys = getValue(this);
    _TSA_Disp_Rq1_AR_SpontanFlag = 1;
}
/*@@end*/

/*@@envVar:HMI_WWA_Warn_Rq:*/
on EnvVar HMI_WWA_Warn_Rq
{
    _mTSA_Disp_Rq1_AR.WWA_Warn_Rq.phys = getValue(this);
    _TSA_Disp_Rq1_AR_SpontanFlag = 1;
}
/*@@end*/

/*@@caplFunc:TSA_Disp_Rq2_AR_check_output():*/
TSA_Disp_Rq2_AR_check_output()
{
    if( !getValue( HMI__STMSG_TSA_Disp_Rq2_AR ) )
    {
        // Botschaft TSA_Disp_Rq2_AR ID: 1051 --- Sendeart 0 cyclicX --- 
        _TSA_Disp_Rq2_AR_Cnt--;
        if( _TSA_Disp_Rq2_AR_Cnt == 1 )
        {
            putValue( HMI__STMSDT_TSA_Disp_Rq2_AR, 1 );
        }
        if( _TSA_Disp_Rq2_AR_Cnt < 1 )
        {
            putValue( HMI__STMSDT_TSA_Disp_Rq2_AR, 0 );
            // Nachricht wg. abgelaufenem Zyklus ausgeben
            TSA_Disp_Rq2_AR_output();
            // Zyklus-Zähler zurücksetzen
            _TSA_Disp_Rq2_AR_Cnt = _TSA_Disp_Rq2_AR_CycleCount;
        }
    }
}
/*@@end*/

/*@@caplFunc:TSA_Disp_Rq2_AR_init():*/
TSA_Disp_Rq2_AR_init()
{   /* Botschaft TSA_Disp_Rq2_AR ID: 1051 --- Sendeart 0 cyclicX --- 
BA_ "ApplMessage" BO_ 1051 0;
BA_ "NmAsrMessage" BO_ 1051 0;
BA_ "GenMsgMinAcceptLength" BO_ 1051 8;
BA_ "GenMsgILSupport" BO_ 1051 1;
BA_ "DiagState" BO_ 1051 0;
BA_ "DiagRequest" BO_ 1051 0;
BA_ "DiagResponse" BO_ 1051 0;
BA_ "GenMsgStartValue" BO_ 1051 "0";
BA_ "GenMsgCycleTime" BO_ 1051 200;
BA_ "GenMsgSendType" BO_ 1051 0;
    */
    _TSA_Disp_Rq2_AR_Timebase =       c_tDBKomTimer_20ms;
    _TSA_Disp_Rq2_AR_CycleCount =    200 / _TSA_Disp_Rq2_AR_Timebase;
    _TSA_Disp_Rq2_AR_StartDelay =      0 / _TSA_Disp_Rq2_AR_Timebase;
    _TSA_Disp_Rq2_AR_Cnt = _TSA_Disp_Rq2_AR_StartDelay;
    _TSA_Disp_Rq2_AR_framecount = 0;

    putValue( HMI__STMSGSD_TSA_Disp_Rq2_AR, _TSA_Disp_Rq2_AR_StartDelay * _TSA_Disp_Rq2_AR_Timebase );

    _mTSA_Disp_Rq2_AR.TSA_Disp_Rq2_Data1.phys = getValue( HMI_TSA_Disp_Rq2_Data1 );
    _mTSA_Disp_Rq2_AR.TSA_Disp_Rq2_Data2.phys = getValue( HMI_TSA_Disp_Rq2_Data2 );
    _mTSA_Disp_Rq2_AR.TSA_Disp_Rq2_Data3.phys = getValue( HMI_TSA_Disp_Rq2_Data3 );
    _mTSA_Disp_Rq2_AR.TSA_Disp_Rq2_Data4.phys = getValue( HMI_TSA_Disp_Rq2_Data4 );
    _mTSA_Disp_Rq2_AR.TSA_Disp_Rq2_Data5.phys = getValue( HMI_TSA_Disp_Rq2_Data5 );
    _mTSA_Disp_Rq2_AR.TSA_Disp_Rq2_Data6.phys = getValue( HMI_TSA_Disp_Rq2_Data6 );
    _mTSA_Disp_Rq2_AR.TSA_Disp_Rq2_Data7.phys = getValue( HMI_TSA_Disp_Rq2_Data7 );
    _mTSA_Disp_Rq2_AR.TSA_Disp_Rq2_Data8.phys = getValue( HMI_TSA_Disp_Rq2_Data8 );
}
/*@@end*/

/*@@caplFunc:TSA_Disp_Rq2_AR_output():*/
void TSA_Disp_Rq2_AR_output(void)
{
    if( getValue( HMI__STMSG_Manual_TSA_Disp_Rq2_AR ) )
/*    {
        _mTSA_Disp_Rq2_AR.TSA_Disp_Rq2_Data1 = getvalue( HMI_TSA_Disp_Rq2_Data1 );
        _mTSA_Disp_Rq2_AR.TSA_Disp_Rq2_Data2 = getvalue( HMI_TSA_Disp_Rq2_Data2 );
        _mTSA_Disp_Rq2_AR.TSA_Disp_Rq2_Data3 = getvalue( HMI_TSA_Disp_Rq2_Data3 );
        _mTSA_Disp_Rq2_AR.TSA_Disp_Rq2_Data4 = getvalue( HMI_TSA_Disp_Rq2_Data4 );
        _mTSA_Disp_Rq2_AR.TSA_Disp_Rq2_Data5 = getvalue( HMI_TSA_Disp_Rq2_Data5 );
        _mTSA_Disp_Rq2_AR.TSA_Disp_Rq2_Data6 = getvalue( HMI_TSA_Disp_Rq2_Data6 );
        _mTSA_Disp_Rq2_AR.TSA_Disp_Rq2_Data7 = getvalue( HMI_TSA_Disp_Rq2_Data7 );
        _mTSA_Disp_Rq2_AR.TSA_Disp_Rq2_Data8 = getvalue( HMI_TSA_Disp_Rq2_Data8 );
    }
    else*/
    {
        if( _TSA_Disp_Rq2_AR_framecount == 1 )
        {
            putValue( HMI_TSA_Disp_Rq2_Data1, getvalue( Env_TSA_DISP_RQ2_10_Byte0 ) );
            putValue( HMI_TSA_Disp_Rq2_Data2, getvalue( Env_TSA_DISP_RQ2_10_Byte1 ) );
            putValue( HMI_TSA_Disp_Rq2_Data3, getvalue( Env_TSA_DISP_RQ2_10_Byte2 ) );
            putValue( HMI_TSA_Disp_Rq2_Data4, getvalue( Env_TSA_DISP_RQ2_10_Byte3 ) );
            putValue( HMI_TSA_Disp_Rq2_Data5, getvalue( Env_TSA_DISP_RQ2_10_Byte4 ) );
            putValue( HMI_TSA_Disp_Rq2_Data6, getvalue( Env_TSA_DISP_RQ2_10_Byte5 ) );
            putValue( HMI_TSA_Disp_Rq2_Data7, getvalue( Env_TSA_DISP_RQ2_10_Byte6 ) );
            putValue( HMI_TSA_Disp_Rq2_Data8, getvalue( Env_TSA_DISP_RQ2_10_Byte7 ) );
            if( getValue( Env_TSA_DISP_RQ2_21_Aktiv ) )
                _TSA_Disp_Rq2_AR_framecount = 3;
            else
                _TSA_Disp_Rq2_AR_framecount = 2;
        }

        if( _TSA_Disp_Rq2_AR_framecount == 2 )
        {
            putValue( HMI_TSA_Disp_Rq2_Data1, getvalue( Env_TSA_DISP_RQ2_20_Byte0 ) );
            putValue( HMI_TSA_Disp_Rq2_Data2, getvalue( Env_TSA_DISP_RQ2_20_Byte1 ) );
            putValue( HMI_TSA_Disp_Rq2_Data3, getvalue( Env_TSA_DISP_RQ2_20_Byte2 ) );
            putValue( HMI_TSA_Disp_Rq2_Data4, getvalue( Env_TSA_DISP_RQ2_20_Byte3 ) );
            putValue( HMI_TSA_Disp_Rq2_Data5, getvalue( Env_TSA_DISP_RQ2_20_Byte4 ) );
            putValue( HMI_TSA_Disp_Rq2_Data6, getvalue( Env_TSA_DISP_RQ2_20_Byte5 ) );
            putValue( HMI_TSA_Disp_Rq2_Data7, getvalue( Env_TSA_DISP_RQ2_20_Byte6 ) );
            putValue( HMI_TSA_Disp_Rq2_Data8, getvalue( Env_TSA_DISP_RQ2_20_Byte7 ) );
            _TSA_Disp_Rq2_AR_framecount = 1;
        }

        if( _TSA_Disp_Rq2_AR_framecount == 3 )
        {
            putValue( HMI_TSA_Disp_Rq2_Data1, getvalue( Env_TSA_DISP_RQ2_21_Byte0 ) );
            putValue( HMI_TSA_Disp_Rq2_Data2, getvalue( Env_TSA_DISP_RQ2_21_Byte1 ) );
            putValue( HMI_TSA_Disp_Rq2_Data3, getvalue( Env_TSA_DISP_RQ2_21_Byte2 ) );
            putValue( HMI_TSA_Disp_Rq2_Data4, getvalue( Env_TSA_DISP_RQ2_21_Byte3 ) );
            putValue( HMI_TSA_Disp_Rq2_Data5, getvalue( Env_TSA_DISP_RQ2_21_Byte4 ) );
            putValue( HMI_TSA_Disp_Rq2_Data6, getvalue( Env_TSA_DISP_RQ2_21_Byte5 ) );
            putValue( HMI_TSA_Disp_Rq2_Data7, getvalue( Env_TSA_DISP_RQ2_21_Byte6 ) );
            putValue( HMI_TSA_Disp_Rq2_Data8, getvalue( Env_TSA_DISP_RQ2_21_Byte7 ) );
            _TSA_Disp_Rq2_AR_framecount = 1;
        }
    }
    output( _mTSA_Disp_Rq2_AR );
}
/*@@end*/

/*@@caplFunc:TSA_Disp_Rq2_AR_saveEnvVars(dword):*/
TSA_Disp_Rq2_AR_saveEnvVars( dword hFile )
{
    filePutString("\n// Knoten EIS: TSA_Disp_Rq2\n", 29, hFile );
    snprintf( buffer, elcount( buffer ), "0.0000 HMI__STMSG_TSA_Disp_Rq2_AR := %X\n", getValue( HMI__STMSG_TSA_Disp_Rq2_AR ) );        filePutString( buffer, elcount( buffer ), hFile );
    snprintf( buffer, elcount( buffer ), "0.0000 HMI__STMSGT_TSA_Disp_Rq2_AR := %X\n", getValue( HMI__STMSGT_TSA_Disp_Rq2_AR ) );        filePutString( buffer, elcount( buffer ), hFile );
    snprintf( buffer, elcount( buffer ), "0.0000 HMI_TSA_Disp_Rq2_Data1 := %X\n", getValue( HMI_TSA_Disp_Rq2_Data1 ) );        filePutString( buffer, elcount( buffer ), hFile );
    snprintf( buffer, elcount( buffer ), "0.0000 HMI_TSA_Disp_Rq2_Data2 := %X\n", getValue( HMI_TSA_Disp_Rq2_Data2 ) );        filePutString( buffer, elcount( buffer ), hFile );
    snprintf( buffer, elcount( buffer ), "0.0000 HMI_TSA_Disp_Rq2_Data3 := %X\n", getValue( HMI_TSA_Disp_Rq2_Data3 ) );        filePutString( buffer, elcount( buffer ), hFile );
    snprintf( buffer, elcount( buffer ), "0.0000 HMI_TSA_Disp_Rq2_Data4 := %X\n", getValue( HMI_TSA_Disp_Rq2_Data4 ) );        filePutString( buffer, elcount( buffer ), hFile );
    snprintf( buffer, elcount( buffer ), "0.0000 HMI_TSA_Disp_Rq2_Data5 := %X\n", getValue( HMI_TSA_Disp_Rq2_Data5 ) );        filePutString( buffer, elcount( buffer ), hFile );
    snprintf( buffer, elcount( buffer ), "0.0000 HMI_TSA_Disp_Rq2_Data6 := %X\n", getValue( HMI_TSA_Disp_Rq2_Data6 ) );        filePutString( buffer, elcount( buffer ), hFile );
    snprintf( buffer, elcount( buffer ), "0.0000 HMI_TSA_Disp_Rq2_Data7 := %X\n", getValue( HMI_TSA_Disp_Rq2_Data7 ) );        filePutString( buffer, elcount( buffer ), hFile );
    snprintf( buffer, elcount( buffer ), "0.0000 HMI_TSA_Disp_Rq2_Data8 := %X\n", getValue( HMI_TSA_Disp_Rq2_Data8 ) );        filePutString( buffer, elcount( buffer ), hFile );
}
/*@@end*/

/*@@timer:_tTSA_Disp_Rq2_AR:*/
on timer _tTSA_Disp_Rq2_AR
{
    putValue( HMI__STMSG_TSA_Disp_Rq2_AR, 0 );
}
/*@@end*/

/*@@envVar:HMI__STMSG_TSA_Disp_Rq2_AR:*/
on EnvVar HMI__STMSG_TSA_Disp_Rq2_AR
{
    long tDelay;
    if( getValue( this ) == 2 )
    {
        tDelay = getValue( HMI__STMSGT_TSA_Disp_Rq2_AR );
        if( tDelay > 0)    
            setTimer( _tTSA_Disp_Rq2_AR, tDelay );
        else
            putValue( HMI__STMSG_TSA_Disp_Rq2_AR, 0 );
    }
}
/*@@end*/

/*@@envVar:HMI_TSA_Disp_Rq2_Data1:*/
on EnvVar HMI_TSA_Disp_Rq2_Data1
{
    _mTSA_Disp_Rq2_AR.TSA_Disp_Rq2_Data1.phys = getValue(this);
}
/*@@end*/

/*@@envVar:HMI_TSA_Disp_Rq2_Data2:*/
on EnvVar HMI_TSA_Disp_Rq2_Data2
{
    _mTSA_Disp_Rq2_AR.TSA_Disp_Rq2_Data2.phys = getValue(this);
}
/*@@end*/

/*@@envVar:HMI_TSA_Disp_Rq2_Data3:*/
on EnvVar HMI_TSA_Disp_Rq2_Data3
{
    _mTSA_Disp_Rq2_AR.TSA_Disp_Rq2_Data3.phys = getValue(this);
}
/*@@end*/

/*@@envVar:HMI_TSA_Disp_Rq2_Data4:*/
on EnvVar HMI_TSA_Disp_Rq2_Data4
{
    _mTSA_Disp_Rq2_AR.TSA_Disp_Rq2_Data4.phys = getValue(this);
}
/*@@end*/

/*@@envVar:HMI_TSA_Disp_Rq2_Data5:*/
on EnvVar HMI_TSA_Disp_Rq2_Data5
{
    _mTSA_Disp_Rq2_AR.TSA_Disp_Rq2_Data5.phys = getValue(this);
}
/*@@end*/

/*@@envVar:HMI_TSA_Disp_Rq2_Data6:*/
on EnvVar HMI_TSA_Disp_Rq2_Data6
{
    _mTSA_Disp_Rq2_AR.TSA_Disp_Rq2_Data6.phys = getValue(this);
}
/*@@end*/

/*@@envVar:HMI_TSA_Disp_Rq2_Data7:*/
on EnvVar HMI_TSA_Disp_Rq2_Data7
{
    _mTSA_Disp_Rq2_AR.TSA_Disp_Rq2_Data7.phys = getValue(this);
}
/*@@end*/

/*@@envVar:HMI_TSA_Disp_Rq2_Data8:*/
on EnvVar HMI_TSA_Disp_Rq2_Data8
{
    _mTSA_Disp_Rq2_AR.TSA_Disp_Rq2_Data8.phys = getValue(this);
}
/*@@end*/

/*@@caplFunc:VehDyn_Stat1_AR_check_output():*/
VehDyn_Stat1_AR_check_output()
{
    if( !getValue( HMI__STMSG_VehDyn_Stat1_AR ) )
    {
        // Botschaft VehDyn_Stat1_AR ID: 148 --- Sendeart 0 cyclicX --- 
        _VehDyn_Stat1_AR_Cnt--;
        if( _VehDyn_Stat1_AR_Cnt < 1 )
        {
            // Nachricht wg. abgelaufenem Zyklus ausgeben
            VehDyn_Stat1_AR_output();
            // Zyklus-Zähler zurücksetzen
            _VehDyn_Stat1_AR_Cnt = _VehDyn_Stat1_AR_CycleCount;
        }
    }
}
/*@@end*/

/*@@caplFunc:VehDyn_Stat1_AR_init():*/
VehDyn_Stat1_AR_init()
{   /* Botschaft VehDyn_Stat1_AR ID: 148 --- Sendeart 0 cyclicX --- 
BA_ "ApplMessage" BO_ 148 0;
BA_ "NmAsrMessage" BO_ 148 0;
BA_ "GenMsgMinAcceptLength" BO_ 148 8;
BA_ "GenMsgILSupport" BO_ 148 1;
BA_ "DiagState" BO_ 148 0;
BA_ "DiagRequest" BO_ 148 0;
BA_ "DiagResponse" BO_ 148 0;
BA_ "GenMsgStartValue" BO_ 148 "0";
BA_ "GenMsgStartDelayTime" BO_ 148 0;
BA_ "GenMsgCycleTime" BO_ 148 20;
BA_ "GenMsgSendType" BO_ 148 0;
    */
    _VehDyn_Stat1_AR_Timebase =      c_tDBKomTimer_20ms;
    _VehDyn_Stat1_AR_CycleCount =     20 / _VehDyn_Stat1_AR_Timebase;
    _VehDyn_Stat1_AR_StartDelay =      0 / _VehDyn_Stat1_AR_Timebase;
    _VehDyn_Stat1_AR_Cnt = _VehDyn_Stat1_AR_StartDelay;

    putValue( HMI__STMSGSD_VehDyn_Stat1_AR, _VehDyn_Stat1_AR_StartDelay * _VehDyn_Stat1_AR_Timebase );


    _mVehDyn_Stat1_AR.Rsrv1_VehDyn_Stat1.phys = getValue( HMI_Rsrv1_VehDyn_Stat1 );
    _mVehDyn_Stat1_AR.SPCR_Excpt_Rq_V2.phys = getValue( HMI_SPCR_Excpt_Rq_V2 );
    _mVehDyn_Stat1_AR.SPCR_Md.phys = getValue( HMI_SPCR_Md );
    _mVehDyn_Stat1_AR.SPCR_Sp_Stat.phys = getValue( HMI_SPCR_Sp_Stat );
    _mVehDyn_Stat1_AR.VehAccel_X_V2.phys = getValue( HMI_VehAccel_X_V2 );
    _mVehDyn_Stat1_AR.VehAccel_X_Offset.phys = getValue( HMI_VehAccel_X_Offset );
    _mVehDyn_Stat1_AR.VehAccel_X_Qual.phys = getValue( HMI_VehAccel_X_Qual );
    _mVehDyn_Stat1_AR.VehAccel_Y_V2.phys = getValue( HMI_VehAccel_Y_V2 );
    _mVehDyn_Stat1_AR.VehAccel_Y_Offset.phys = getValue( HMI_VehAccel_Y_Offset );
    _mVehDyn_Stat1_AR.VehAccel_Y_Qual.phys = getValue( HMI_VehAccel_Y_Qual );
}
/*@@end*/

/*@@caplFunc:VehDyn_Stat1_AR_output():*/
void VehDyn_Stat1_AR_output(void)
{
    byte crc;
    byte SQC_help;

    if( !getValue( HMI_SQC_VehDyn_Stat1_Auto ) )
    {
        // berechne message counter
        SQC_help = getValue( HMI_SQC_VehDyn_Stat1 );
        if( SQC_help >= 15 ) SQC_help = 0;
        else SQC_help++;
        putValue( HMI_SQC_VehDyn_Stat1, SQC_help );
        _mVehDyn_Stat1_AR.SQC_VehDyn_Stat1 = SQC_help;
    }
    else
          _mVehDyn_Stat1_AR.SQC_VehDyn_Stat1 = getValue( HMI_SQC_VehDyn_Stat1 );

    if( getValue( HMI_CRC_VehDyn_Stat1_Profile_02 ) )
    {
        if( !getValue( HMI_CRC_VehDyn_Stat1_Auto ) )
        {   // CRC according Profile_02 ( W213 )
            // berechne crc
            crc = 0xFF;
//          crc = crctable_profile02[ crc ^ _mVehDyn_Stat1_AR.byte( 0 ) ];
            crc = crctable_profile02[ crc ^ _mVehDyn_Stat1_AR.byte( 1 ) ];
            crc = crctable_profile02[ crc ^ _mVehDyn_Stat1_AR.byte( 2 ) ];
            crc = crctable_profile02[ crc ^ _mVehDyn_Stat1_AR.byte( 3 ) ];
            crc = crctable_profile02[ crc ^ _mVehDyn_Stat1_AR.byte( 4 ) ];
            crc = crctable_profile02[ crc ^ _mVehDyn_Stat1_AR.byte( 5 ) ];
            crc = crctable_profile02[ crc ^ _mVehDyn_Stat1_AR.byte( 6 ) ];
            crc = crctable_profile02[ crc ^ _mVehDyn_Stat1_AR.byte( 7 ) ];
            crc = crctable_profile02[ crc ^ _VehDyn_Stat1_AR_CRC_Offset[ _mVehDyn_Stat1_AR.SQC_VehDyn_Stat1 ] ]; // load offset
            crc = (crc ^ 0xFF);
            if( getValue(  HMI_CRC_VehDyn_Stat1_Invalid ) )
                crc++;
            _mVehDyn_Stat1_AR.CRC_VehDyn_Stat1 = crc;
            putValue( HMI_CRC_VehDyn_Stat1, crc );
        }
        else
            _mVehDyn_Stat1_AR.CRC_VehDyn_Stat1 = getValue( HMI_CRC_VehDyn_Stat1 );
    }
    else
    {
        if( !getValue( HMI_CRC_VehDyn_Stat1_Auto ) )
        {   // CRC according to SAE1850 ( W222 )
            // berechne crc
            crc = 0xFF;
            crc = crctable[crc ^ _mVehDyn_Stat1_AR.byte( 1 )];
            crc = crctable[crc ^ _mVehDyn_Stat1_AR.byte( 2 )];
            crc = crctable[crc ^ _mVehDyn_Stat1_AR.byte( 3 )];
            crc = crctable[crc ^ _mVehDyn_Stat1_AR.byte( 4 )];
            crc = crctable[crc ^ _mVehDyn_Stat1_AR.byte( 5 )];
            crc = crctable[crc ^ _mVehDyn_Stat1_AR.byte( 6 )];
            crc = crctable[crc ^ _mVehDyn_Stat1_AR.byte( 7 )];
            crc = (crc ^ 0xFF);
            if( getValue(  HMI_CRC_VehDyn_Stat1_Invalid ) )
                crc++;
            _mVehDyn_Stat1_AR.CRC_VehDyn_Stat1 = crc;
            putValue( HMI_CRC_VehDyn_Stat1, crc );
        }
        else
            _mVehDyn_Stat1_AR.CRC_VehDyn_Stat1 = getValue( HMI_CRC_VehDyn_Stat1 );
    }
    output( _mVehDyn_Stat1_AR );
}
/*@@end*/

/*@@caplFunc:VehDyn_Stat1_AR_saveEnvVars(dword):*/
VehDyn_Stat1_AR_saveEnvVars( dword hFile )
{
    filePutString("\n// Knoten EIS: VehDyn_Stat1_AR\n", 33, hFile );
    snprintf( buffer, elcount( buffer ), "0.0000 HMI__STMSG_VehDyn_Stat1_AR := %X\n", getValue( HMI__STMSG_VehDyn_Stat1_AR ) );        filePutString( buffer, elcount( buffer ), hFile );
    snprintf( buffer, elcount( buffer ), "0.0000 HMI__STMSGT_VehDyn_Stat1_AR := %X\n", getValue( HMI__STMSGT_VehDyn_Stat1_AR ) );        filePutString( buffer, elcount( buffer ), hFile );
    snprintf( buffer, elcount( buffer ), "0.0000 HMI_BrkTrq_R := %X\n", getValue( HMI_BrkTrq_R ) );        filePutString( buffer, elcount( buffer ), hFile );
    snprintf( buffer, elcount( buffer ), "0.0000 HMI_CRC_VehDyn_Stat1 := %X\n", getValue( HMI_CRC_VehDyn_Stat1 ) );        filePutString( buffer, elcount( buffer ), hFile );
    snprintf( buffer, elcount( buffer ), "0.0000 HMI_CRC_VehDyn_Stat1_Auto := %X\n", getValue( HMI_CRC_VehDyn_Stat1_Auto ) );        filePutString( buffer, elcount( buffer ), hFile );
    snprintf( buffer, elcount( buffer ), "0.0000 HMI_EPKB_Enbl_Rq := %X\n", getValue( HMI_EPKB_Enbl_Rq ) );        filePutString( buffer, elcount( buffer ), hFile );
    snprintf( buffer, elcount( buffer ), "0.0000 HMI_PkBrk_Rq_SPCR := %X\n", getValue( HMI_PkBrk_Rq_SPCR ) );        filePutString( buffer, elcount( buffer ), hFile );
    snprintf( buffer, elcount( buffer ), "0.0000 HMI_Rsrv1_VehDyn_Stat1 := %X\n", getValue( HMI_Rsrv1_VehDyn_Stat1 ) );        filePutString( buffer, elcount( buffer ), hFile );
    snprintf( buffer, elcount( buffer ), "0.0000 HMI_SQC_VehDyn_Stat1 := %X\n", getValue( HMI_SQC_VehDyn_Stat1 ) );        filePutString( buffer, elcount( buffer ), hFile );
    snprintf( buffer, elcount( buffer ), "0.0000 HMI_SQC_VehDyn_Stat1_Auto := %X\n", getValue( HMI_SQC_VehDyn_Stat1_Auto ) );        filePutString( buffer, elcount( buffer ), hFile );
    snprintf( buffer, elcount( buffer ), "0.0000 HMI_VehAccel_X_V2 := %X\n", getValue( HMI_VehAccel_X_V2 ) );        filePutString( buffer, elcount( buffer ), hFile );
    snprintf( buffer, elcount( buffer ), "0.0000 HMI_VehAccel_X_Offset := %X\n", getValue( HMI_VehAccel_X_Offset ) );        filePutString( buffer, elcount( buffer ), hFile );
    snprintf( buffer, elcount( buffer ), "0.0000 HMI_VehAccel_X_Qual := %X\n", getValue( HMI_VehAccel_X_Qual ) );        filePutString( buffer, elcount( buffer ), hFile );
    snprintf( buffer, elcount( buffer ), "0.0000 HMI_VehAccel_Y_V2 := %X\n", getValue( HMI_VehAccel_Y_V2 ) );        filePutString( buffer, elcount( buffer ), hFile );
    snprintf( buffer, elcount( buffer ), "0.0000 HMI_VehAccel_Y_Offset := %X\n", getValue( HMI_VehAccel_Y_Offset ) );        filePutString( buffer, elcount( buffer ), hFile );
    snprintf( buffer, elcount( buffer ), "0.0000 HMI_VehAccel_Y_Qual := %X\n", getValue( HMI_VehAccel_Y_Qual ) );        filePutString( buffer, elcount( buffer ), hFile );
}
/*@@end*/

/*@@timer:_tVehDyn_Stat1_AR:*/
on timer _tVehDyn_Stat1_AR
{
    putValue( HMI__STMSG_VehDyn_Stat1_AR, 0 );
}
/*@@end*/

/*@@envVar:HMI__STMSG_VehDyn_Stat1_AR:*/
on EnvVar HMI__STMSG_VehDyn_Stat1_AR
{
    long tDelay;
    if( getValue( this ) == 2 )
    {
        tDelay = getValue( HMI__STMSGT_VehDyn_Stat1_AR );
        if( tDelay > 0)    
            setTimer( _tVehDyn_Stat1_AR, tDelay );
        else
            putValue( HMI__STMSG_VehDyn_Stat1_AR, 0 );
    }
}
/*@@end*/

/*@@envVar:HMI_Rsrv1_VehDyn_Stat1:*/
on EnvVar HMI_Rsrv1_VehDyn_Stat1
{
    _mVehDyn_Stat1_AR.Rsrv1_VehDyn_Stat1.phys = getValue(this);
}
/*@@end*/

/*@@envVar:HMI_SPCR_Excpt_Rq_V2:*/
on EnvVar HMI_SPCR_Excpt_Rq_V2
{
    _mVehDyn_Stat1_AR.SPCR_Excpt_Rq_V2.phys = getValue(this);
}
/*@@end*/

/*@@envVar:HMI_SPCR_Md:*/
on EnvVar HMI_SPCR_Md
{
    _mVehDyn_Stat1_AR.SPCR_Md.phys = getValue(this);
}
/*@@end*/

/*@@envVar:HMI_SPCR_Sp_Stat:*/
on EnvVar HMI_SPCR_Sp_Stat
{
    _mVehDyn_Stat1_AR.SPCR_Sp_Stat.phys = getValue(this);
}
/*@@end*/

/*@@envVar:HMI_VehAccel_X_V2:*/
on EnvVar HMI_VehAccel_X_V2
{
    _mVehDyn_Stat1_AR.VehAccel_X_V2.phys = getValue(this);
}
/*@@end*/

/*@@envVar:HMI_VehAccel_X_Offset:*/
on EnvVar HMI_VehAccel_X_Offset
{
    _mVehDyn_Stat1_AR.VehAccel_X_Offset.phys = getValue(this);
}
/*@@end*/

/*@@envVar:HMI_VehAccel_X_Qual:*/
on EnvVar HMI_VehAccel_X_Qual
{
    _mVehDyn_Stat1_AR.VehAccel_X_Qual.phys = getValue(this);
}
/*@@end*/

/*@@envVar:HMI_VehAccel_Y_V2:*/
on EnvVar HMI_VehAccel_Y_V2
{
    _mVehDyn_Stat1_AR.VehAccel_Y_V2.phys = getValue(this);
}
/*@@end*/

/*@@envVar:HMI_VehAccel_Y_Offset:*/
on EnvVar HMI_VehAccel_Y_Offset
{
    _mVehDyn_Stat1_AR.VehAccel_Y_Offset.phys = getValue(this);
}
/*@@end*/

/*@@envVar:HMI_VehAccel_Y_Qual:*/
on EnvVar HMI_VehAccel_Y_Qual
{
    _mVehDyn_Stat1_AR.VehAccel_Y_Qual.phys = getValue(this);
}
/*@@end*/

/*@@caplFunc:VehDyn_Stat2_AR_check_output():*/
VehDyn_Stat2_AR_check_output()
{
    if( !getValue( HMI__STMSG_VehDyn_Stat2_AR ) )
    {
        // Botschaft VehDyn_Stat2_AR ID: 150 --- Sendeart 0 cyclicX
        _VehDyn_Stat2_AR_Cnt--;
        if( _VehDyn_Stat2_AR_Cnt < 1 )
        {
            // Nachricht wg. abgelaufenem Zyklus ausgeben
            VehDyn_Stat2_AR_output();
            // Zyklus-Zähler zurücksetzen
            _VehDyn_Stat2_AR_Cnt = _VehDyn_Stat2_AR_CycleCount;
        }
    }
}
/*@@end*/

/*@@caplFunc:VehDyn_Stat2_AR_init():*/
VehDyn_Stat2_AR_init()
{   /* Botschaft VehDyn_Stat2_AR ID: 150 --- Sendeart 0 cyclicX --- 
BA_ "ApplMessage" BO_ 150 0;
BA_ "NmAsrMessage" BO_ 150 0;
BA_ "GenMsgMinAcceptLength" BO_ 150 8;
BA_ "GenMsgILSupport" BO_ 150 1;
BA_ "DiagState" BO_ 150 0;
BA_ "DiagRequest" BO_ 150 0;
BA_ "DiagResponse" BO_ 150 0;
BA_ "GenMsgStartValue" BO_ 150 "0";
BA_ "GenMsgStartDelayTime" BO_ 150 10;
BA_ "GenMsgCycleTime" BO_ 150 20;
BA_ "GenMsgSendType" BO_ 150 0;
    */
    _VehDyn_Stat2_AR_Timebase =      c_tDBKomTimer_20ms;
    _VehDyn_Stat2_AR_CycleCount =     20 / _VehDyn_Stat2_AR_Timebase;
    _VehDyn_Stat2_AR_StartDelay =     10 / _VehDyn_Stat2_AR_Timebase;
    _VehDyn_Stat2_AR_Cnt = _VehDyn_Stat2_AR_StartDelay;

    putValue( HMI__STMSGSD_VehDyn_Stat2_AR, _VehDyn_Stat2_AR_StartDelay * _VehDyn_Stat2_AR_Timebase );

    _mVehDyn_Stat2_AR.BrkTrq_R.phys = getValue( HMI_BrkTrq_R );
    _mVehDyn_Stat2_AR.EPKB_Enbl_Rq.phys = getValue( HMI_EPKB_Enbl_Rq );
    _mVehDyn_Stat2_AR.PkBrk_Rq_SPCR.phys = getValue( HMI_PkBrk_Rq_SPCR );
    _mVehDyn_Stat2_AR.HSA_Sys_Flt.phys = getValue( HMI_HSA_Sys_Flt );
    _mVehDyn_Stat2_AR.SPCR_AS_Dsabl.phys = getValue( HMI_SPCR_AS_Dsabl );
    _mVehDyn_Stat2_AR.SPCR_AS_Off_Rq.phys = getValue( HMI_SPCR_AS_Off_Rq );
    _mVehDyn_Stat2_AR.SPCR_Style.phys = getValue( HMI_SPCR_Style );
    _mVehDyn_Stat2_AR.SPCR_Veh_Immo.phys = getValue( HMI_SPCR_Veh_Immo );
    _mVehDyn_Stat2_AR.TxPkPosn_Rq_SPCR.phys = getValue( HMI_TxPkPosn_Rq_SPCR );
    _mVehDyn_Stat2_AR.VehYawRate_Raw.phys = getValue( HMI_VehYawRate_Raw );
    _mVehDyn_Stat2_AR.VehYawRate_Raw_Qual.phys = getValue( HMI_VehYawRate_Raw_Qual );
    _mVehDyn_Stat2_AR.VehYawRateOffset_V2.phys = getValue( HMI_VehYawRateOffset_V2 );
}
/*@@end*/

/*@@caplFunc:VehDyn_Stat2_AR_output():*/
void VehDyn_Stat2_AR_output(void)
{
    byte crc;
    byte SQC_help;

    if( !getValue( HMI_SQC_VehDyn_Stat2_Auto ) )
    {
        // berechne message counter
        SQC_help = getValue( HMI_SQC_VehDyn_Stat2 );
        if( SQC_help >= 15 ) SQC_help = 0;
        else SQC_help++;
        putValue( HMI_SQC_VehDyn_Stat2, SQC_help );
        _mVehDyn_Stat2_AR.SQC_VehDyn_Stat2 = SQC_help;
    }
    else
          _mVehDyn_Stat2_AR.SQC_VehDyn_Stat2 = getValue( HMI_SQC_VehDyn_Stat2 );

    if( getValue( HMI_CRC_VehDyn_Stat2_Profile_02 ) )
    {
        if( !getValue( HMI_CRC_VehDyn_Stat2_Auto ) )
        {   // CRC according Profile_02 ( W213 )
            // berechne crc
            crc = 0xFF;
//          crc = crctable_profile02[ crc ^ _mVehDyn_Stat2_AR.byte( 0 ) ];
            crc = crctable_profile02[ crc ^ _mVehDyn_Stat2_AR.byte( 1 )];
            crc = crctable_profile02[ crc ^ _mVehDyn_Stat2_AR.byte( 2 )];
            crc = crctable_profile02[ crc ^ _mVehDyn_Stat2_AR.byte( 3 )];
            crc = crctable_profile02[ crc ^ _mVehDyn_Stat2_AR.byte( 4 )];
            crc = crctable_profile02[ crc ^ _mVehDyn_Stat2_AR.byte( 5 )];
            crc = crctable_profile02[ crc ^ _mVehDyn_Stat2_AR.byte( 6 )];
            crc = crctable_profile02[ crc ^ _mVehDyn_Stat2_AR.byte( 7 )];
            crc = crctable_profile02[ crc ^ _VehDyn_Stat2_AR_CRC_Offset[ _mVehDyn_Stat2_AR.SQC_VehDyn_Stat2 ] ]; // load offset
            crc = (crc ^ 0xFF);
            if( getValue(  HMI_CRC_VehDyn_Stat2_Invalid ) )
                crc++;
            _mVehDyn_Stat2_AR.CRC_VehDyn_Stat2 = crc;
            putValue( HMI_CRC_VehDyn_Stat2, crc );
        }
        else
            _mVehDyn_Stat2_AR.CRC_VehDyn_Stat2 = getValue( HMI_CRC_VehDyn_Stat2 );
    }
    else
    {
        if( !getValue( HMI_CRC_VehDyn_Stat2_Auto ) )
        {   // CRC according to SAE1850 ( W222 )
            // berechne crc
            crc = 0xFF;
            crc = crctable[crc ^ _mVehDyn_Stat2_AR.byte( 1 )];
            crc = crctable[crc ^ _mVehDyn_Stat2_AR.byte( 2 )];
            crc = crctable[crc ^ _mVehDyn_Stat2_AR.byte( 3 )];
            crc = crctable[crc ^ _mVehDyn_Stat2_AR.byte( 4 )];
            crc = crctable[crc ^ _mVehDyn_Stat2_AR.byte( 5 )];
            crc = crctable[crc ^ _mVehDyn_Stat2_AR.byte( 6 )];
            crc = crctable[crc ^ _mVehDyn_Stat2_AR.byte( 7 )];
            crc = (crc ^ 0xFF);
            if( getValue(  HMI_CRC_VehDyn_Stat2_Invalid ) )
                crc++;
            _mVehDyn_Stat2_AR.CRC_VehDyn_Stat2 = crc;
            putValue( HMI_CRC_VehDyn_Stat2, crc );
        }
        else
            _mVehDyn_Stat2_AR.CRC_VehDyn_Stat2 = getValue( HMI_CRC_VehDyn_Stat2 );
    }
    output( _mVehDyn_Stat2_AR );
}
/*@@end*/

/*@@caplFunc:VehDyn_Stat2_AR_saveEnvVars(dword):*/
VehDyn_Stat2_AR_saveEnvVars( dword hFile )
{
    filePutString("\n// Knoten EIS: VehDyn_Stat2_AR\n", 33, hFile );
    snprintf( buffer, elcount( buffer ), "0.0000 HMI__STMSG_VehDyn_Stat2_AR := %X\n", getValue( HMI__STMSG_VehDyn_Stat2_AR ) );        filePutString( buffer, elcount( buffer ), hFile );
    snprintf( buffer, elcount( buffer ), "0.0000 HMI__STMSGT_VehDyn_Stat2_AR := %X\n", getValue( HMI__STMSGT_VehDyn_Stat2_AR ) );        filePutString( buffer, elcount( buffer ), hFile );
    snprintf( buffer, elcount( buffer ), "0.0000 HMI_CRC_VehDyn_Stat2 := %X\n", getValue( HMI_CRC_VehDyn_Stat2 ) );        filePutString( buffer, elcount( buffer ), hFile );
    snprintf( buffer, elcount( buffer ), "0.0000 HMI_CRC_VehDyn_Stat2_Auto := %X\n", getValue( HMI_CRC_VehDyn_Stat2_Auto ) );        filePutString( buffer, elcount( buffer ), hFile );
    snprintf( buffer, elcount( buffer ), "0.0000 HMI_HSA_Sys_Flt := %X\n", getValue( HMI_HSA_Sys_Flt ) );        filePutString( buffer, elcount( buffer ), hFile );
    snprintf( buffer, elcount( buffer ), "0.0000 HMI_SPCR_AS_Dsabl := %X\n", getValue( HMI_SPCR_AS_Dsabl ) );        filePutString( buffer, elcount( buffer ), hFile );
    snprintf( buffer, elcount( buffer ), "0.0000 HMI_SPCR_AS_Off_Rq := %X\n", getValue( HMI_SPCR_AS_Off_Rq ) );        filePutString( buffer, elcount( buffer ), hFile );
    snprintf( buffer, elcount( buffer ), "0.0000 HMI_SPCR_Excpt_Rq_V2 := %X\n", getValue( HMI_SPCR_Excpt_Rq_V2 ) );        filePutString( buffer, elcount( buffer ), hFile );
    snprintf( buffer, elcount( buffer ), "0.0000 HMI_SPCR_Md := %X\n", getValue( HMI_SPCR_Md ) );        filePutString( buffer, elcount( buffer ), hFile );
    snprintf( buffer, elcount( buffer ), "0.0000 HMI_SPCR_Sp_Stat := %X\n", getValue( HMI_SPCR_Sp_Stat ) );        filePutString( buffer, elcount( buffer ), hFile );
    snprintf( buffer, elcount( buffer ), "0.0000 HMI_SPCR_Style := %X\n", getValue( HMI_SPCR_Style ) );        filePutString( buffer, elcount( buffer ), hFile );
    snprintf( buffer, elcount( buffer ), "0.0000 HMI_SPCR_Veh_Immo := %X\n", getValue( HMI_SPCR_Veh_Immo ) );        filePutString( buffer, elcount( buffer ), hFile );
    snprintf( buffer, elcount( buffer ), "0.0000 HMI_SQC_VehDyn_Stat2 := %X\n", getValue( HMI_SQC_VehDyn_Stat2 ) );        filePutString( buffer, elcount( buffer ), hFile );
    snprintf( buffer, elcount( buffer ), "0.0000 HMI_SQC_VehDyn_Stat2_Auto := %X\n", getValue( HMI_SQC_VehDyn_Stat2_Auto ) );        filePutString( buffer, elcount( buffer ), hFile );
    snprintf( buffer, elcount( buffer ), "0.0000 HMI_TxPkPosn_Rq_SPCR := %X\n", getValue( HMI_TxPkPosn_Rq_SPCR ) );        filePutString( buffer, elcount( buffer ), hFile );
    snprintf( buffer, elcount( buffer ), "0.0000 HMI_VehYawRate_Raw := %X\n", getValue( HMI_VehYawRate_Raw ) );        filePutString( buffer, elcount( buffer ), hFile );
    snprintf( buffer, elcount( buffer ), "0.0000 HMI_VehYawRate_Raw_Qual := %X\n", getValue( HMI_VehYawRate_Raw_Qual ) );        filePutString( buffer, elcount( buffer ), hFile );
    snprintf( buffer, elcount( buffer ), "0.0000 HMI_VehYawRateOffset_V2 := %X\n", getValue( HMI_VehYawRateOffset_V2 ) );        filePutString( buffer, elcount( buffer ), hFile );
}
/*@@end*/

/*@@timer:_tVehDyn_Stat2_AR:*/
on timer _tVehDyn_Stat2_AR
{
    putValue( HMI__STMSG_VehDyn_Stat2_AR, 0 );
}
/*@@end*/

/*@@envVar:HMI__STMSG_VehDyn_Stat2_AR:*/
on EnvVar HMI__STMSG_VehDyn_Stat2_AR
{
    long tDelay;
    if( getValue( this ) == 2 )
    {
        tDelay = getValue( HMI__STMSGT_VehDyn_Stat2_AR );
        if( tDelay > 0)    
            setTimer( _tVehDyn_Stat2_AR, tDelay );
        else
            putValue( HMI__STMSG_VehDyn_Stat2_AR, 0 );
    }
}
/*@@end*/

/*@@envVar:HMI_BrkTrq_R:*/
on EnvVar HMI_BrkTrq_R
{
    _mVehDyn_Stat2_AR.BrkTrq_R.phys = getValue(this);
}
/*@@end*/

/*@@envVar:HMI_EPKB_Enbl_Rq:*/
on EnvVar HMI_EPKB_Enbl_Rq
{
    _mVehDyn_Stat2_AR.EPKB_Enbl_Rq.phys = getValue(this);
}
/*@@end*/

/*@@envVar:HMI_HSA_Sys_Flt:*/
on EnvVar HMI_HSA_Sys_Flt
{
    _mVehDyn_Stat2_AR.HSA_Sys_Flt.phys = getValue(this);
}
/*@@end*/

/*@@envVar:HMI_PkBrk_Rq_SPCR:*/
on EnvVar HMI_PkBrk_Rq_SPCR
{
    _mVehDyn_Stat2_AR.PkBrk_Rq_SPCR.phys = getValue(this);
}
/*@@end*/

/*@@envVar:HMI_SPCR_AS_Dsabl:*/
on EnvVar HMI_SPCR_AS_Dsabl
{
    _mVehDyn_Stat2_AR.SPCR_AS_Dsabl.phys = getValue(this);
}
/*@@end*/

/*@@envVar:HMI_SPCR_AS_Off_Rq:*/
on EnvVar HMI_SPCR_AS_Off_Rq
{
    _mVehDyn_Stat2_AR.SPCR_AS_Off_Rq.phys = getValue(this);
}
/*@@end*/

/*@@envVar:HMI_SPCR_Style:*/
on EnvVar HMI_SPCR_Style
{
    _mVehDyn_Stat2_AR.SPCR_Style.phys = getValue(this);
}
/*@@end*/

/*@@envVar:HMI_SPCR_Veh_Immo:*/
on EnvVar HMI_SPCR_Veh_Immo
{
    _mVehDyn_Stat2_AR.SPCR_Veh_Immo.phys = getValue(this);
}
/*@@end*/

/*@@envVar:HMI_TxPkPosn_Rq_SPCR:*/
on EnvVar HMI_TxPkPosn_Rq_SPCR
{
    _mVehDyn_Stat2_AR.TxPkPosn_Rq_SPCR.phys = getValue(this);
}
/*@@end*/

/*@@envVar:HMI_VehYawRate_Raw:*/
on EnvVar HMI_VehYawRate_Raw
{
    _mVehDyn_Stat2_AR.VehYawRate_Raw.phys = getValue(this);
}
/*@@end*/

/*@@envVar:HMI_VehYawRate_Raw_Qual:*/
on EnvVar HMI_VehYawRate_Raw_Qual
{
    _mVehDyn_Stat2_AR.VehYawRate_Raw_Qual.phys = getValue(this);
}
/*@@end*/

/*@@envVar:HMI_VehYawRateOffset_V2:*/
on EnvVar HMI_VehYawRateOffset_V2
{
    _mVehDyn_Stat2_AR.VehYawRateOffset_V2.phys = getValue(this);
}
/*@@end*/

/*@@caplFunc:VehLvl_Stat_AR_check_output():*/
VehLvl_Stat_AR_check_output()
{
    if( !getValue( HMI__STMSG_VehLvl_Stat_AR ) )
    {
        // Botschaft VehLvl_Stat_AR ID: 172 --- Sendeart 0 cyclicX --- 
        _VehLvl_Stat_AR_Cnt--;
        if( _VehLvl_Stat_AR_Cnt < 1 )
        {
            VehLvl_Stat_AR_output(); // Nachricht wg. abgelaufenem Zyklus ausgeben
            _VehLvl_Stat_AR_Cnt = _VehLvl_Stat_AR_CycleCount; // Zyklus-Zähler zurücksetzen
        }
    }
}
/*@@end*/

/*@@caplFunc:VehLvl_Stat_AR_init():*/
VehLvl_Stat_AR_init()
{   /* Botschaft VehLvl_Stat_AR ID: 172 --- Sendeart 0 cyclicX --- 
BA_ "ApplMessage" BO_ 172 0;
BA_ "NmAsrMessage" BO_ 172 0;
BA_ "GenMsgMinAcceptLength" BO_ 172 8;
BA_ "GenMsgILSupport" BO_ 172 1;
BA_ "DiagState" BO_ 172 0;
BA_ "DiagRequest" BO_ 172 0;
BA_ "DiagResponse" BO_ 172 0;
BA_ "GenMsgStartValue" BO_ 172 "0";
BA_ "GenMsgCycleTime" BO_ 172 20;
BA_ "GenMsgSendType" BO_ 172 0;
    */
    _VehLvl_Stat_AR_Timebase =         c_tDBKomTimer_20ms;
    _VehLvl_Stat_AR_CycleCount =      20 / _VehLvl_Stat_AR_Timebase;
    _VehLvl_Stat_AR_StartDelay =       0 / _VehLvl_Stat_AR_Timebase;
    _VehLvl_Stat_AR_Cnt = _VehLvl_Stat_AR_StartDelay;

    putValue( HMI__STMSGSD_VehLvl_Stat_AR, _VehLvl_Stat_AR_StartDelay * _VehLvl_Stat_AR_Timebase );

    _mVehLvl_Stat_AR.LvlCal_Exec.phys = getValue( HMI_LvlCal_Exec );
    _mVehLvl_Stat_AR.Rsrv1_VehLvl_Stat.phys = getValue( HMI_Rsrv1_VehLvl_Stat );
    _mVehLvl_Stat_AR.VehLoad_Stat.phys = getValue( HMI_VehLoad_Stat );
    _mVehLvl_Stat_AR.VehLoad_Stat_Vld.phys = getValue( HMI_VehLoad_Stat_Vld );
    _mVehLvl_Stat_AR.VehLvl_FL.phys = getValue( HMI_VehLvl_FL );
    _mVehLvl_Stat_AR.VehLvl_FR.phys = getValue( HMI_VehLvl_FR );
    _mVehLvl_Stat_AR.VehLvl_Rel.phys = getValue( HMI_VehLvl_Rel );
    _mVehLvl_Stat_AR.VehLvl_RL.phys = getValue( HMI_VehLvl_RL );
    _mVehLvl_Stat_AR.VehLvl_RR.phys = getValue( HMI_VehLvl_RR );
}
/*@@end*/

/*@@caplFunc:VehLvl_Stat_AR_output():*/
void VehLvl_Stat_AR_output(void)
{
    byte crc;
    byte SQC_help;

    if( !getValue( HMI_SQC_VehLvl_Stat_Auto ) )
    {
        // berechne message counter
        SQC_help = getValue( HMI_SQC_VehLvl_Stat );
        if( SQC_help >= 15 ) SQC_help = 0;
        else SQC_help++;
        putValue( HMI_SQC_VehLvl_Stat, SQC_help );
        _mVehLvl_Stat_AR.SQC_VehLvl_Stat = SQC_help;
    }
    else
          _mVehLvl_Stat_AR.SQC_VehLvl_Stat = getValue( HMI_SQC_VehLvl_Stat );

    if( getValue( HMI_CRC_VehLvl_Stat_Profile_02 ) )
    {
        if( !getValue( HMI_CRC_VehLvl_Stat_Auto ) )
        {   // CRC according Profile_02 ( W213 )
            // berechne crc
            crc = 0xFF;
//          crc = crctable_profile02[ crc ^ _mVehLvl_Stat_AR.byte( 0 ) ];
            crc = crctable_profile02[ crc ^ _mVehLvl_Stat_AR.byte( 1 ) ];
            crc = crctable_profile02[ crc ^ _mVehLvl_Stat_AR.byte( 2 ) ];
            crc = crctable_profile02[ crc ^ _mVehLvl_Stat_AR.byte( 3 ) ];
            crc = crctable_profile02[ crc ^ _mVehLvl_Stat_AR.byte( 4 ) ];
            crc = crctable_profile02[ crc ^ _mVehLvl_Stat_AR.byte( 5 ) ];
            crc = crctable_profile02[ crc ^ _mVehLvl_Stat_AR.byte( 6 ) ];
            crc = crctable_profile02[ crc ^ _mVehLvl_Stat_AR.byte( 7 ) ];
            crc = crctable_profile02[ crc ^ _VehLvl_Stat_AR_CRC_Offset[ _mVehLvl_Stat_AR.SQC_VehLvl_Stat ] ]; // load offset
            crc = (crc ^ 0xFF);
            if( getValue(  HMI_CRC_VehLvl_Stat_Invalid ) )
                crc++;
            _mVehLvl_Stat_AR.CRC_VehLvl_Stat = crc;
            putValue( HMI_CRC_VehLvl_Stat, crc );
        }
        else
            _mVehLvl_Stat_AR.CRC_VehLvl_Stat = getValue( HMI_CRC_VehLvl_Stat );
    }
    output( _mVehLvl_Stat_AR );
}
/*@@end*/

/*@@caplFunc:VehLvl_Stat_AR_saveEnvVars(dword):*/
VehLvl_Stat_AR_saveEnvVars( dword hFile )
{
        filePutString("\n// Knoten EIS: VehLvl_Stat_AR\n", 28, hFile );
        snprintf( buffer, elcount( buffer ), "0.0000 HMI__STMSG_VehLvl_Stat_AR := %X\n", getValue( HMI__STMSG_VehLvl_Stat_AR ) );        filePutString( buffer, elcount( buffer ), hFile );
        snprintf( buffer, elcount( buffer ), "0.0000 HMI__STMSGT_VehLvl_Stat_AR := %X\n", getValue( HMI__STMSGT_VehLvl_Stat_AR ) );        filePutString( buffer, elcount( buffer ), hFile );
        snprintf( buffer, elcount( buffer ), "0.0000 HMI_CRC_VehLvl_Stat := %X\n", getValue( HMI_CRC_VehLvl_Stat ) );        filePutString( buffer, elcount( buffer ), hFile );
        snprintf( buffer, elcount( buffer ), "0.0000 HMI_CRC_VehLvl_Stat_Auto := %X\n", getValue( HMI_CRC_VehLvl_Stat_Auto ) );        filePutString( buffer, elcount( buffer ), hFile );
        snprintf( buffer, elcount( buffer ), "0.0000 HMI_CRC_VehLvl_Stat_Profile_02     := %X\n", getValue( HMI_CRC_VehLvl_Stat_Profile_02 ) );        filePutString( buffer, elcount( buffer ), hFile );
        snprintf( buffer, elcount( buffer ), "0.0000 HMI_LvlCal_Exec := %X\n", getValue( HMI_LvlCal_Exec ) );        filePutString( buffer, elcount( buffer ), hFile );
        snprintf( buffer, elcount( buffer ), "0.0000 HMI_Rsrv1_VehLvl_Stat := %X\n", getValue( HMI_Rsrv1_VehLvl_Stat ) );        filePutString( buffer, elcount( buffer ), hFile );
        snprintf( buffer, elcount( buffer ), "0.0000 HMI_SQC_VehLvl_Stat := %X\n", getValue( HMI_SQC_VehLvl_Stat ) );        filePutString( buffer, elcount( buffer ), hFile );
        snprintf( buffer, elcount( buffer ), "0.0000 HMI_SQC_VehLvl_Stat_Auto := %X\n", getValue( HMI_SQC_VehLvl_Stat_Auto ) );        filePutString( buffer, elcount( buffer ), hFile );
        snprintf( buffer, elcount( buffer ), "0.0000 HMI_VehLoad_Stat := %X\n", getValue( HMI_VehLoad_Stat ) );        filePutString( buffer, elcount( buffer ), hFile );
        snprintf( buffer, elcount( buffer ), "0.0000 HMI_VehLoad_Stat_Vld := %X\n", getValue( HMI_VehLoad_Stat_Vld ) );        filePutString( buffer, elcount( buffer ), hFile );
        snprintf( buffer, elcount( buffer ), "0.0000 HMI_VehLvl_FL := %X\n", getValue( HMI_VehLvl_FL ) );        filePutString( buffer, elcount( buffer ), hFile );
        snprintf( buffer, elcount( buffer ), "0.0000 HMI_VehLvl_FR := %X\n", getValue( HMI_VehLvl_FR ) );        filePutString( buffer, elcount( buffer ), hFile );
        snprintf( buffer, elcount( buffer ), "0.0000 HMI_VehLvl_Rel := %X\n", getValue( HMI_VehLvl_Rel ) );        filePutString( buffer, elcount( buffer ), hFile );
        snprintf( buffer, elcount( buffer ), "0.0000 HMI_VehLvl_RL := %X\n", getValue( HMI_VehLvl_RL ) );        filePutString( buffer, elcount( buffer ), hFile );
        snprintf( buffer, elcount( buffer ), "0.0000 HMI_VehLvl_RR := %X\n", getValue( HMI_VehLvl_RR ) );        filePutString( buffer, elcount( buffer ), hFile );
}
/*@@end*/

/*@@timer:_tVehLvl_Stat_AR:*/
on timer _tVehLvl_Stat_AR
{
    putValue( HMI__STMSG_VehLvl_Stat_AR, 0 );
}
/*@@end*/

/*@@envVar:HMI__STMSG_VehLvl_Stat_AR:*/
on EnvVar HMI__STMSG_VehLvl_Stat_AR
{
    long tDelay;
    if( getValue( this ) == 2 )
    {
        tDelay = getValue( HMI__STMSGT_VehLvl_Stat_AR );
        if( tDelay > 0)    
            setTimer( _tVehLvl_Stat_AR, tDelay );
        else
            putValue( HMI__STMSG_VehLvl_Stat_AR, 0 );
    }
}
/*@@end*/

/*@@envVar:HMI_LvlCal_Exec:*/
on EnvVar HMI_LvlCal_Exec
{
    _mVehLvl_Stat_AR.LvlCal_Exec.phys = getValue(this);
}
/*@@end*/

/*@@envVar:HMI_Rsrv1_VehLvl_Stat:*/
on EnvVar HMI_Rsrv1_VehLvl_Stat
{
    _mVehLvl_Stat_AR.Rsrv1_VehLvl_Stat.phys = getValue(this);
}
/*@@end*/

/*@@envVar:HMI_VehLoad_Stat:*/
on EnvVar HMI_VehLoad_Stat
{
    _mVehLvl_Stat_AR.VehLoad_Stat.phys = getValue(this);
}
/*@@end*/

/*@@envVar:HMI_VehLoad_Stat_Vld:*/
on EnvVar HMI_VehLoad_Stat_Vld
{
    _mVehLvl_Stat_AR.VehLoad_Stat_Vld.phys = getValue(this);
}
/*@@end*/

/*@@envVar:HMI_VehLvl_FL:*/
on EnvVar HMI_VehLvl_FL
{
    _mVehLvl_Stat_AR.VehLvl_FL.phys = getValue(this);
}
/*@@end*/

/*@@envVar:HMI_VehLvl_FR:*/
on EnvVar HMI_VehLvl_FR
{
    _mVehLvl_Stat_AR.VehLvl_FR.phys = getValue(this);
}
/*@@end*/

/*@@envVar:HMI_VehLvl_Rel:*/
on EnvVar HMI_VehLvl_Rel
{
    _mVehLvl_Stat_AR.VehLvl_Rel.phys = getValue(this);
}
/*@@end*/

/*@@envVar:HMI_VehLvl_RL:*/
on EnvVar HMI_VehLvl_RL
{
    _mVehLvl_Stat_AR.VehLvl_RL.phys = getValue(this);
}
/*@@end*/

/*@@envVar:HMI_VehLvl_RR:*/
on EnvVar HMI_VehLvl_RR
{
    _mVehLvl_Stat_AR.VehLvl_RR.phys = getValue(this);
}
/*@@end*/

/*@@caplFunc:VehPwrMngmnt_EMM_Stat2_AR_check_output():*/
VehPwrMngmnt_EMM_Stat2_AR_check_output()
{
    if( !getValue( HMI__STMSG_VehPwrMngmnt_EMM_Stat2_AR ) )
    {
        // Botschaft VehPwrMngmnt_EMM_Stat2_AR ID: 1185 --- Sendeart 5 cyclicAndSpontanWithDelay --- 
        if( _VehPwrMngmnt_EMM_Stat2_AR_DelayCnt > 0) _VehPwrMngmnt_EMM_Stat2_AR_DelayCnt--; // Mindestsendeabstand
        _VehPwrMngmnt_EMM_Stat2_AR_Cnt--;
        if( _VehPwrMngmnt_EMM_Stat2_AR_Cnt < 1 )
        {
            if( _VehPwrMngmnt_EMM_Stat2_AR_DelayCnt < 1 )
            {
                // Nachricht wg. abgelaufenem Zyklus ausgeben (Mindestsendeabstand eingehalten)
                VehPwrMngmnt_EMM_Stat2_AR_output();
                _VehPwrMngmnt_EMM_Stat2_AR_SpontanFlag = 0; // Spontan-Flag zurücksetzen
                _VehPwrMngmnt_EMM_Stat2_AR_DelayCnt = _VehPwrMngmnt_EMM_Stat2_AR_MinDelay;
            }
            else
            {
                // Spontanflag setzen damit nach Ablauf Mindestsendeabstand gesendet wird
                 _VehPwrMngmnt_EMM_Stat2_AR_SpontanFlag = 1;
            }
            _VehPwrMngmnt_EMM_Stat2_AR_Cnt = _VehPwrMngmnt_EMM_Stat2_AR_CycleCount; // Zyklus-Zähler zurücksetzen
        }
        else if( _VehPwrMngmnt_EMM_Stat2_AR_SpontanFlag)
        {
            if( _VehPwrMngmnt_EMM_Stat2_AR_DelayCnt < 1 )
            {
                // Nachricht wg. spontaner Änderung ausgeben (Mindestsendeabstand eingehalten)
                VehPwrMngmnt_EMM_Stat2_AR_output();
                _VehPwrMngmnt_EMM_Stat2_AR_SpontanFlag = 0; // Spontan-Flag zurücksetzen
                _VehPwrMngmnt_EMM_Stat2_AR_DelayCnt = _VehPwrMngmnt_EMM_Stat2_AR_MinDelay;
            }
        }
    }
}
/*@@end*/

/*@@caplFunc:VehPwrMngmnt_EMM_Stat2_AR_init():*/
VehPwrMngmnt_EMM_Stat2_AR_init()
{   /* Botschaft VehPwrMngmnt_EMM_Stat2_AR ID: 1185 --- Sendeart 5 cyclicAndSpontanWithDelay --- 
BA_ "ApplMessage" BO_ 1185 0;
BA_ "NmAsrMessage" BO_ 1185 0;
BA_ "GenMsgMinAcceptLength" BO_ 1185 8;
BA_ "GenMsgILSupport" BO_ 1185 1;
BA_ "DiagState" BO_ 1185 0;
BA_ "DiagRequest" BO_ 1185 0;
BA_ "DiagResponse" BO_ 1185 0;
BA_ "GenMsgStartValue" BO_ 1185 "0";
BA_ "GenMsgDelayTime" BO_ 1185 200;
BA_ "GenMsgNrOfRepetitions" BO_ 1185 0;
BA_ "GenMsgCycleTime" BO_ 1185 1000;
BA_ "GenMsgSendType" BO_ 1185 5;
    */
    _VehPwrMngmnt_EMM_Stat2_AR_Timebase =      c_tDBKomTimer_20ms;
    _VehPwrMngmnt_EMM_Stat2_AR_CycleCount =   1000 / _VehPwrMngmnt_EMM_Stat2_AR_Timebase;
    _VehPwrMngmnt_EMM_Stat2_AR_StartDelay =      0 / _VehPwrMngmnt_EMM_Stat2_AR_Timebase;
    _VehPwrMngmnt_EMM_Stat2_AR_MinDelay =      200 / _VehPwrMngmnt_EMM_Stat2_AR_Timebase;
    _VehPwrMngmnt_EMM_Stat2_AR_Cnt = _VehPwrMngmnt_EMM_Stat2_AR_StartDelay;
    _VehPwrMngmnt_EMM_Stat2_AR_SpontanFlag = 0;
    _VehPwrMngmnt_EMM_Stat2_AR_DelayCnt = 0;

    putValue( HMI__STMSGSD_VehPwrMngmnt_EMM_Stat2_AR, _VehPwrMngmnt_EMM_Stat2_AR_StartDelay * _VehPwrMngmnt_EMM_Stat2_AR_Timebase );

    _mVehPwrMngmnt_EMM_Stat2_AR.EMM_DriveNoShift.phys = getValue( HMI_EMM_DriveNoShift );
    _mVehPwrMngmnt_EMM_Stat2_AR.EMM_TowProhibit_MsgDisp_Rq.phys = getValue( HMI_EMM_TowProhibit_MsgDisp_Rq );
    _mVehPwrMngmnt_EMM_Stat2_AR.PNHV_EnergyConsReset.phys = getValue( HMI_PNHV_EnergyConsReset );
    _mVehPwrMngmnt_EMM_Stat2_AR.PNHV_EnergyConsStart.phys = getValue( HMI_PNHV_EnergyConsStart );
    _mVehPwrMngmnt_EMM_Stat2_AR.PNHV_HV_WarnLmp_On_Rq.phys = getValue( HMI_PNHV_HV_WarnLmp_On_Rq );
    _mVehPwrMngmnt_EMM_Stat2_AR.PNHV_NoEngStart_Disp_Rq.phys = getValue( HMI_PNHV_NoEngStart_Disp_Rq );
    _mVehPwrMngmnt_EMM_Stat2_AR.PNHV_PN14_QuiesCurr_Md_Rq.phys = getValue( HMI_PNHV_PN14_QuiesCurr_Md_Rq );
    _mVehPwrMngmnt_EMM_Stat2_AR.PNHV_Term61_WarnIcon_Disp_Rq.phys = getValue( HMI_PNHV_Term61_WarnIcon_Disp_Rq );
    _mVehPwrMngmnt_EMM_Stat2_AR.Rsrv1_EMM_Disp_Rq.phys = getValue( HMI_Rsrv1_EMM_Disp_Rq );
}
/*@@end*/

/*@@caplFunc:VehPwrMngmnt_EMM_Stat2_AR_output():*/
VehPwrMngmnt_EMM_Stat2_AR_output(void)
{
    byte crc;
    byte SQC_help;

    if( !getValue( HMI_SQC_EMM_Disp_Rq_Auto ) )
    {
        // berechne message counter
        SQC_help = getValue( HMI_SQC_EMM_Disp_Rq );
        if( SQC_help >= 15 ) SQC_help = 0;
        else SQC_help++;
        putValue( HMI_SQC_EMM_Disp_Rq, SQC_help );
        _mVehPwrMngmnt_EMM_Stat2_AR.SQC_EMM_Disp_Rq = SQC_help;
    }
    else
          _mVehPwrMngmnt_EMM_Stat2_AR.SQC_EMM_Disp_Rq = getValue( HMI_SQC_EMM_Disp_Rq );

    if( getValue( HMI_CRC_EMM_Disp_Rq_Profile_02 ) )
    {
        if( !getValue( HMI_CRC_EMM_Disp_Rq_Auto ) )
        {   // CRC according Profile_02 ( W213 )
            // berechne crc
            crc = 0xFF;
//          crc = crctable_profile02[ crc ^ _mVehPwrMngmnt_EMM_Stat2_AR.byte( 0 ) ];
//            crc = crctable_profile02[crc ^ _mVehPwrMngmnt_EMM_Stat2_AR.byte( 1 )];
//            crc = crctable_profile02[crc ^ _mVehPwrMngmnt_EMM_Stat2_AR.byte( 2 )];
//            crc = crctable_profile02[crc ^ _mVehPwrMngmnt_EMM_Stat2_AR.byte( 3 )];
//            crc = crctable_profile02[crc ^ _mVehPwrMngmnt_EMM_Stat2_AR.byte( 4 )];
//            crc = crctable_profile02[crc ^ _mVehPwrMngmnt_EMM_Stat2_AR.byte( 5 )];  CRC
            crc = crctable_profile02[crc ^ _mVehPwrMngmnt_EMM_Stat2_AR.byte( 6 )];
//            crc = crctable_profile02[crc ^ _mVehPwrMngmnt_EMM_Stat2_AR.byte( 7 )];
            crc = crctable_profile02[ crc ^ _VehPwrMngmnt_EMM_Stat2_AR_CRC_Offset[ _mVehPwrMngmnt_EMM_Stat2_AR.SQC_EMM_Disp_Rq ] ]; // load offset
            crc = (crc ^ 0xFF);
            if( getValue(  HMI_CRC_EMM_Disp_Rq_Invalid ) )
                crc++;
            _mVehPwrMngmnt_EMM_Stat2_AR.CRC_EMM_Disp_Rq = crc;
            putValue( HMI_CRC_EMM_Disp_Rq, crc );
        }
        else
            _mVehPwrMngmnt_EMM_Stat2_AR.CRC_EMM_Disp_Rq = getValue( HMI_CRC_EMM_Disp_Rq );
    }
    else
    {
        if( !getValue( HMI_CRC_EMM_Disp_Rq_Auto ) )
        {   // CRC according to SAE1850 ( W222 )
            // berechne crc
            crc = 0xFF;
//            crc = crctable[crc ^ _mVehPwrMngmnt_EMM_Stat2_AR.byte( 0 )];
//            crc = crctable[crc ^ _mVehPwrMngmnt_EMM_Stat2_AR.byte( 1 )];
//            crc = crctable[crc ^ _mVehPwrMngmnt_EMM_Stat2_AR.byte( 2 )];
//            crc = crctable[crc ^ _mVehPwrMngmnt_EMM_Stat2_AR.byte( 3 )];
//            crc = crctable[crc ^ _mVehPwrMngmnt_EMM_Stat2_AR.byte( 4 )];
//            crc = crctable[crc ^ _mVehPwrMngmnt_EMM_Stat2_AR.byte( 5 )];  CRC
            crc = crctable[crc ^ _mVehPwrMngmnt_EMM_Stat2_AR.byte( 6 )];
//            crc = crctable[crc ^ _mVehPwrMngmnt_EMM_Stat2_AR.byte( 7 )];
            crc = (crc ^ 0xFF);
            if( getValue(  HMI_CRC_EMM_Disp_Rq_Invalid ) )
                crc++;
            _mVehPwrMngmnt_EMM_Stat2_AR.CRC_EMM_Disp_Rq = crc;
            putValue( HMI_CRC_EMM_Disp_Rq, crc );
        }
        else
            _mVehPwrMngmnt_EMM_Stat2_AR.CRC_EMM_Disp_Rq = getValue( HMI_CRC_EMM_Disp_Rq );
    }
    output( _mVehPwrMngmnt_EMM_Stat2_AR );
}
/*@@end*/

/*@@caplFunc:VehPwrMngmnt_EMM_Stat2_AR_saveEnvVars(dword):*/
VehPwrMngmnt_EMM_Stat2_AR_saveEnvVars( dword hFile )
{
    filePutString("\n// Knoten EIS: VehPwrMngmnt_EMM_Stat2_AR\n", 28, hFile );
    snprintf( buffer, elcount( buffer ), "0.0000 HMI__STMSG_VehPwrMngmnt_EMM_Stat2_AR := %X\n", getValue( HMI__STMSG_VehPwrMngmnt_EMM_Stat2_AR ) );        filePutString( buffer, elcount( buffer ), hFile );
    snprintf( buffer, elcount( buffer ), "0.0000 HMI__STMSGT_VehPwrMngmnt_EMM_Stat2_AR := %X\n", getValue( HMI__STMSGT_VehPwrMngmnt_EMM_Stat2_AR ) );        filePutString( buffer, elcount( buffer ), hFile );
    snprintf( buffer, elcount( buffer ), "0.0000 HMI_CRC_EMM_Disp_Rq := %X\n", getValue( HMI_CRC_EMM_Disp_Rq ) );        filePutString( buffer, elcount( buffer ), hFile );
    snprintf( buffer, elcount( buffer ), "0.0000 HMI_CRC_EMM_Disp_Rq_Auto := %X\n", getValue( HMI_CRC_EMM_Disp_Rq_Auto ) );        filePutString( buffer, elcount( buffer ), hFile );
    snprintf( buffer, elcount( buffer ), "0.0000 HMI_CRC_EMM_Disp_Rq_Profile_02 := %X\n", getValue( HMI_CRC_EMM_Disp_Rq_Profile_02 ) );        filePutString( buffer, elcount( buffer ), hFile );
    snprintf( buffer, elcount( buffer ), "0.0000 HMI_EMM_DriveNoShift := %X\n", getValue( HMI_EMM_DriveNoShift ) );        filePutString( buffer, elcount( buffer ), hFile );
    snprintf( buffer, elcount( buffer ), "0.0000 HMI_EMM_TowProhibit_MsgDisp_Rq := %X\n", getValue( HMI_EMM_TowProhibit_MsgDisp_Rq ) );        filePutString( buffer, elcount( buffer ), hFile );
    snprintf( buffer, elcount( buffer ), "0.0000 HMI_PNHV_EnergyConsReset := %X\n", getValue( HMI_PNHV_EnergyConsReset ) );        filePutString( buffer, elcount( buffer ), hFile );
    snprintf( buffer, elcount( buffer ), "0.0000 HMI_PNHV_EnergyConsStart := %X\n", getValue( HMI_PNHV_EnergyConsStart ) );        filePutString( buffer, elcount( buffer ), hFile );
    snprintf( buffer, elcount( buffer ), "0.0000 HMI_PNHV_HV_WarnLmp_On_Rq := %X\n", getValue( HMI_PNHV_HV_WarnLmp_On_Rq ) );        filePutString( buffer, elcount( buffer ), hFile );
    snprintf( buffer, elcount( buffer ), "0.0000 HMI_PNHV_NoEngStart_Disp_Rq := %X\n", getValue( HMI_PNHV_NoEngStart_Disp_Rq ) );        filePutString( buffer, elcount( buffer ), hFile );
    snprintf( buffer, elcount( buffer ), "0.0000 HMI_PNHV_PN14_QuiesCurr_Md_Rq := %X\n", getValue( HMI_PNHV_PN14_QuiesCurr_Md_Rq ) );        filePutString( buffer, elcount( buffer ), hFile );
    snprintf( buffer, elcount( buffer ), "0.0000 HMI_PNHV_Term61_WarnIcon_Disp_Rq := %X\n", getValue( HMI_PNHV_Term61_WarnIcon_Disp_Rq ) );        filePutString( buffer, elcount( buffer ), hFile );
    snprintf( buffer, elcount( buffer ), "0.0000 HMI_Rsrv1_EMM_Disp_Rq := %X\n", getValue( HMI_Rsrv1_EMM_Disp_Rq ) );        filePutString( buffer, elcount( buffer ), hFile );
    snprintf( buffer, elcount( buffer ), "0.0000 HMI_SQC_EMM_Disp_Rq := %X\n", getValue( HMI_SQC_EMM_Disp_Rq ) );        filePutString( buffer, elcount( buffer ), hFile );
    snprintf( buffer, elcount( buffer ), "0.0000 HMI_SQC_EMM_Disp_Rq_Auto := %X\n", getValue( HMI_SQC_EMM_Disp_Rq_Auto ) );        filePutString( buffer, elcount( buffer ), hFile );
}
/*@@end*/

/*@@timer:_tVehPwrMngmnt_EMM_Stat2_AR:*/
on timer _tVehPwrMngmnt_EMM_Stat2_AR
{
    putValue( HMI__STMSG_VehPwrMngmnt_EMM_Stat2_AR, 0 );
}
/*@@end*/

/*@@envVar:HMI__STMSG_VehPwrMngmnt_EMM_Stat2_AR:*/
on EnvVar HMI__STMSG_VehPwrMngmnt_EMM_Stat2_AR
{
    long tDelay;
    if( getValue( this ) == 2 )
    {
        tDelay = getValue( HMI__STMSGT_VehPwrMngmnt_EMM_Stat2_AR );
        if( tDelay > 0)    
            setTimer( _tVehPwrMngmnt_EMM_Stat2_AR, tDelay );
        else
            putValue( HMI__STMSG_VehPwrMngmnt_EMM_Stat2_AR, 0 );
    }
}
/*@@end*/

/*@@envVar:HMI_EMM_DriveNoShift:*/
on EnvVar HMI_EMM_DriveNoShift
{
    _mVehPwrMngmnt_EMM_Stat2_AR.EMM_DriveNoShift.phys = getValue(this);
    _VehPwrMngmnt_EMM_Stat2_AR_SpontanFlag = 1;
}
/*@@end*/

/*@@envVar:HMI_EMM_TowProhibit_MsgDisp_Rq:*/
on EnvVar HMI_EMM_TowProhibit_MsgDisp_Rq
{
    _mVehPwrMngmnt_EMM_Stat2_AR.EMM_TowProhibit_MsgDisp_Rq.phys = getValue(this);
    _VehPwrMngmnt_EMM_Stat2_AR_SpontanFlag = 1;
}
/*@@end*/

/*@@envVar:HMI_PNHV_EnergyConsReset:*/
on EnvVar HMI_PNHV_EnergyConsReset
{
    _mVehPwrMngmnt_EMM_Stat2_AR.PNHV_EnergyConsReset.phys = getValue(this);
    _VehPwrMngmnt_EMM_Stat2_AR_SpontanFlag = 1;
}
/*@@end*/

/*@@envVar:HMI_PNHV_EnergyConsStart:*/
on EnvVar HMI_PNHV_EnergyConsStart
{
    _mVehPwrMngmnt_EMM_Stat2_AR.PNHV_EnergyConsStart.phys = getValue(this);
    _VehPwrMngmnt_EMM_Stat2_AR_SpontanFlag = 1;
}
/*@@end*/

/*@@envVar:HMI_PNHV_HV_WarnLmp_On_Rq:*/
on EnvVar HMI_PNHV_HV_WarnLmp_On_Rq
{
    _mVehPwrMngmnt_EMM_Stat2_AR.PNHV_HV_WarnLmp_On_Rq.phys = getValue(this);
    _VehPwrMngmnt_EMM_Stat2_AR_SpontanFlag = 1;
}
/*@@end*/

/*@@envVar:HMI_PNHV_NoEngStart_Disp_Rq:*/
on EnvVar HMI_PNHV_NoEngStart_Disp_Rq
{
    _mVehPwrMngmnt_EMM_Stat2_AR.PNHV_NoEngStart_Disp_Rq.phys = getValue(this);
    _VehPwrMngmnt_EMM_Stat2_AR_SpontanFlag = 1;
}
/*@@end*/

/*@@envVar:HMI_PNHV_PN14_QuiesCurr_Md_Rq:*/
on EnvVar HMI_PNHV_PN14_QuiesCurr_Md_Rq
{
    _mVehPwrMngmnt_EMM_Stat2_AR.PNHV_PN14_QuiesCurr_Md_Rq.phys = getValue(this);
    _VehPwrMngmnt_EMM_Stat2_AR_SpontanFlag = 1;
}
/*@@end*/

/*@@envVar:HMI_PNHV_Term61_WarnIcon_Disp_Rq:*/
on EnvVar HMI_PNHV_Term61_WarnIcon_Disp_Rq
{
    _mVehPwrMngmnt_EMM_Stat2_AR.PNHV_Term61_WarnIcon_Disp_Rq.phys = getValue(this);
    _VehPwrMngmnt_EMM_Stat2_AR_SpontanFlag = 1;
}
/*@@end*/

/*@@envVar:HMI_Rsrv1_EMM_Disp_Rq:*/
on EnvVar HMI_Rsrv1_EMM_Disp_Rq
{
    _mVehPwrMngmnt_EMM_Stat2_AR.Rsrv1_EMM_Disp_Rq.phys = getValue(this);
    _VehPwrMngmnt_EMM_Stat2_AR_SpontanFlag = 1;
}
/*@@end*/

/*@@caplFunc:VehSpd_X_AR_check_output():*/
VehSpd_X_AR_check_output()
{
    if( !getValue( HMI__STMSG_VehSpd_X_AR ) )
    {
        _VehSpd_X_AR_Cnt--;
        if( _VehSpd_X_AR_Cnt < 1 )
        {
            VehSpd_X_AR_output();  // Nachricht wg. abgelaufenem Zyklus ausgeben
            _VehSpd_X_AR_Cnt = _VehSpd_X_AR_CycleCount; // Zyklus-Zähler zurücksetzen
        }
    }
}
/*@@end*/

/*@@caplFunc:VehSpd_X_AR_init():*/
VehSpd_X_AR_init()
{   /* Botschaft VehSpd_X_AR ID: 152 --- Sendeart 0 cyclicX --- 
BA_ "ApplMessage" BO_ 152 0;
BA_ "NmAsrMessage" BO_ 152 0;
BA_ "GenMsgMinAcceptLength" BO_ 152 8;
BA_ "GenMsgILSupport" BO_ 152 1;
BA_ "DiagState" BO_ 152 0;
BA_ "DiagRequest" BO_ 152 0;
BA_ "DiagResponse" BO_ 152 0;
BA_ "GenMsgStartValue" BO_ 152 "0";
BA_ "GenMsgCycleTime" BO_ 152 20;
BA_ "GenMsgSendType" BO_ 152 0;
    */
    _VehSpd_X_AR_Timebase =      c_tDBKomTimer_20ms;
    _VehSpd_X_AR_CycleCount =     20 / _VehSpd_X_AR_Timebase;
    _VehSpd_X_AR_StartDelay =      0 / _VehSpd_X_AR_Timebase;
    _VehSpd_X_AR_Cnt = _VehSpd_X_AR_StartDelay;

    putValue( HMI__STMSGSD_VehSpd_X_AR, _VehSpd_X_AR_StartDelay * _VehSpd_X_AR_Timebase );

    _mVehSpd_X_AR.CRC_VehSpd_X.phys = getValue( HMI_CRC_VehSpd_X );
    _mVehSpd_X_AR.Rsrv1_VehSpd_X.phys = getValue( HMI_Rsrv1_VehSpd_X );
    _mVehSpd_X_AR.SQC_VehSpd_X.phys = getValue( HMI_SQC_VehSpd_X );
    _mVehSpd_X_AR.StWhl_Angl_CarvOffset.phys = getValue( HMI_StWhl_Angl_CarvOffset );
    _mVehSpd_X_AR.VehDrvDir_Stat.phys = getValue( HMI_VehDrvDir_Stat );
    _mVehSpd_X_AR.VehSp_Stat.phys = getValue( HMI_VehSp_Stat );
    _mVehSpd_X_AR.VehSpd_X.phys = getValue( HMI_VehSpd_X );
    _mVehSpd_X_AR.VehSpd_X_Max.phys = getValue( HMI_VehSpd_X_Max );
    _mVehSpd_X_AR.VehSpd_X_Min.phys = getValue( HMI_VehSpd_X_Min );
    _mVehSpd_X_AR.VehSpd_X_Qual.phys = getValue( HMI_VehSpd_X_Qual );
}
/*@@end*/

/*@@caplFunc:VehSpd_X_AR_output():*/
void VehSpd_X_AR_output(void)
{
    byte crc;
    byte SQC_help;

    if( !getValue( HMI_SQC_VehSpd_X_Auto ) )
    {
        // berechne message counter
        SQC_help = getValue( HMI_SQC_VehSpd_X );
        if( SQC_help >= 15 ) SQC_help = 0;
        else SQC_help++;
        putValue( HMI_SQC_VehSpd_X, SQC_help );
        _mVehSpd_X_AR.SQC_VehSpd_X = SQC_help;
    }
    else
          _mVehSpd_X_AR.SQC_VehSpd_X = getValue( HMI_SQC_VehSpd_X );

    if( getValue( HMI_CRC_VehSpd_X_Profile_02 ) )
    {
        if( !getValue( HMI_CRC_VehSpd_X_Auto ) )
        {   // CRC according Profile_02 ( W213 )
            // berechne crc
            crc = 0xFF;
//          crc = crctable_profile02[ crc ^ _mVehSpd_X_AR.byte( 0 ) ];
            crc = crctable_profile02[crc ^ _mVehSpd_X_AR.byte( 1 )];
            crc = crctable_profile02[crc ^ _mVehSpd_X_AR.byte( 2 )];
            crc = crctable_profile02[crc ^ _mVehSpd_X_AR.byte( 3 )];
            crc = crctable_profile02[crc ^ _mVehSpd_X_AR.byte( 4 )];
            crc = crctable_profile02[crc ^ _mVehSpd_X_AR.byte( 5 )];
            crc = crctable_profile02[crc ^ _mVehSpd_X_AR.byte( 6 )];
            crc = crctable_profile02[crc ^ _mVehSpd_X_AR.byte( 7 )];
            crc = crctable_profile02[ crc ^ _VehSpd_X_AR_CRC_Offset[ _mVehSpd_X_AR.SQC_VehSpd_X ] ]; // load offset
            crc = (crc ^ 0xFF);
            if( getValue(  HMI_CRC_VehSpd_X_Invalid ) )
                crc++;
            _mVehSpd_X_AR.CRC_VehSpd_X = crc;
            putValue( HMI_CRC_VehSpd_X, crc );
        }
        else
            _mVehSpd_X_AR.CRC_VehSpd_X = getValue( HMI_CRC_VehSpd_X );
    }
    else
    {
        if( !getValue( HMI_CRC_VehSpd_X_Auto ) )
        {   // CRC according to SAE1850 ( W222 )
            // berechne crc
            crc = 0xFF;
            crc = crctable[crc ^ _mVehSpd_X_AR.byte( 1 )];
            crc = crctable[crc ^ _mVehSpd_X_AR.byte( 2 )];
            crc = crctable[crc ^ _mVehSpd_X_AR.byte( 3 )];
            crc = crctable[crc ^ _mVehSpd_X_AR.byte( 4 )];
            crc = crctable[crc ^ _mVehSpd_X_AR.byte( 5 )];
            crc = crctable[crc ^ _mVehSpd_X_AR.byte( 6 )];
            crc = crctable[crc ^ _mVehSpd_X_AR.byte( 7 )];
            crc = (crc ^ 0xFF);
            if( getValue(  HMI_CRC_VehSpd_X_Invalid ) )
                crc++;
            _mVehSpd_X_AR.CRC_VehSpd_X = crc;
            putValue( HMI_CRC_VehSpd_X, crc );
        }
        else
            _mVehSpd_X_AR.CRC_VehSpd_X = getValue( HMI_CRC_VehSpd_X );
    }
    output( _mVehSpd_X_AR );
}
/*@@end*/

/*@@caplFunc:VehSpd_X_AR_saveEnvVars(dword):*/
VehSpd_X_AR_saveEnvVars( dword hFile )
{
    filePutString("\n// Knoten EIS: VehSpd_X_AR\n", 28, hFile );
    snprintf( buffer, elcount( buffer ), "0.0000 HMI__STMSG_VehSpd_X_AR := %X\n", getValue( HMI__STMSG_VehSpd_X_AR ) );        filePutString( buffer, elcount( buffer ), hFile );
    snprintf( buffer, elcount( buffer ), "0.0000 HMI__STMSGT_VehSpd_X_AR := %X\n", getValue( HMI__STMSGT_VehSpd_X_AR ) );        filePutString( buffer, elcount( buffer ), hFile );
    snprintf( buffer, elcount( buffer ), "0.0000 HMI_CRC_VehSpd_X := %X\n", getValue( HMI_CRC_VehSpd_X ) );        filePutString( buffer, elcount( buffer ), hFile );
    snprintf( buffer, elcount( buffer ), "0.0000 HMI_Rsrv1_VehSpd_X := %X\n", getValue( HMI_Rsrv1_VehSpd_X ) );        filePutString( buffer, elcount( buffer ), hFile );
    snprintf( buffer, elcount( buffer ), "0.0000 HMI_SQC_VehSpd_X := %X\n", getValue( HMI_SQC_VehSpd_X ) );        filePutString( buffer, elcount( buffer ), hFile );
    snprintf( buffer, elcount( buffer ), "0.0000 HMI_StWhl_Angl_CarvOffset := %X\n", getValue( HMI_StWhl_Angl_CarvOffset ) );        filePutString( buffer, elcount( buffer ), hFile );
    snprintf( buffer, elcount( buffer ), "0.0000 HMI_VehDrvDir_Stat := %X\n", getValue( HMI_VehDrvDir_Stat ) );        filePutString( buffer, elcount( buffer ), hFile );
    snprintf( buffer, elcount( buffer ), "0.0000 HMI_VehSp_Stat := %X\n", getValue( HMI_VehSp_Stat ) );        filePutString( buffer, elcount( buffer ), hFile );
    snprintf( buffer, elcount( buffer ), "0.0000 HMI_VehSpd_X := %X\n", getValue( HMI_VehSpd_X ) );        filePutString( buffer, elcount( buffer ), hFile );
    snprintf( buffer, elcount( buffer ), "0.0000 HMI_VehSpd_X_Max := %X\n", getValue( HMI_VehSpd_X_Max ) );        filePutString( buffer, elcount( buffer ), hFile );
    snprintf( buffer, elcount( buffer ), "0.0000 HMI_VehSpd_X_Min := %X\n", getValue( HMI_VehSpd_X_Min ) );        filePutString( buffer, elcount( buffer ), hFile );
    snprintf( buffer, elcount( buffer ), "0.0000 HMI_VehSpd_X_Qual := %X\n", getValue( HMI_VehSpd_X_Qual ) );        filePutString( buffer, elcount( buffer ), hFile );
}
/*@@end*/

/*@@timer:_tVehSpd_X_AR:*/
on timer _tVehSpd_X_AR
{
    putValue( HMI__STMSG_VehSpd_X_AR, 0 );
}
/*@@end*/

/*@@envVar:HMI__STMSG_VehSpd_X_AR:*/
on EnvVar HMI__STMSG_VehSpd_X_AR
{
    long tDelay;
    if( getValue( this ) == 2 )
    {
        tDelay = getValue( HMI__STMSGT_VehSpd_X_AR );
        if( tDelay > 0)    
            setTimer( _tVehSpd_X_AR, tDelay );
        else
            putValue( HMI__STMSG_VehSpd_X_AR, 0 );
    }
}
/*@@end*/

/*@@envVar:HMI_CRC_VehSpd_X:*/
on EnvVar HMI_CRC_VehSpd_X
{
    _mVehSpd_X_AR.CRC_VehSpd_X.phys = getValue(this);
}
/*@@end*/

/*@@envVar:HMI_Rsrv1_VehSpd_X:*/
on EnvVar HMI_Rsrv1_VehSpd_X
{
    _mVehSpd_X_AR.Rsrv1_VehSpd_X.phys = getValue(this);
}
/*@@end*/

/*@@envVar:HMI_SQC_VehSpd_X:*/
on EnvVar HMI_SQC_VehSpd_X
{
    _mVehSpd_X_AR.SQC_VehSpd_X.phys = getValue(this);
}
/*@@end*/

/*@@envVar:HMI_StWhl_Angl_CarvOffset:*/
on EnvVar HMI_StWhl_Angl_CarvOffset
{
    _mVehSpd_X_AR.StWhl_Angl_CarvOffset.phys = getValue(this);
}
/*@@end*/

/*@@envVar:HMI_VehDrvDir_Stat:*/
on EnvVar HMI_VehDrvDir_Stat
{
    _mVehSpd_X_AR.VehDrvDir_Stat.phys = getValue(this);
}
/*@@end*/

/*@@envVar:HMI_VehSp_Stat:*/
on EnvVar HMI_VehSp_Stat
{
    _mVehSpd_X_AR.VehSp_Stat.phys = getValue(this);
}
/*@@end*/

/*@@envVar:HMI_VehSpd_X:*/
on EnvVar HMI_VehSpd_X
{
    _mVehSpd_X_AR.VehSpd_X.phys = getValue(this);
}
/*@@end*/

/*@@envVar:HMI_VehSpd_X_Max:*/
on EnvVar HMI_VehSpd_X_Max
{
    _mVehSpd_X_AR.VehSpd_X_Max.phys = getValue(this);
}
/*@@end*/

/*@@envVar:HMI_VehSpd_X_Min:*/
on EnvVar HMI_VehSpd_X_Min
{
    _mVehSpd_X_AR.VehSpd_X_Min.phys = getValue(this);
}
/*@@end*/

/*@@envVar:HMI_VehSpd_X_Qual:*/
on EnvVar HMI_VehSpd_X_Qual
{
    _mVehSpd_X_AR.VehSpd_X_Qual.phys = getValue(this);
}
/*@@end*/

/*@@caplFunc:VIN_AR_check_output():*/
VIN_AR_check_output()
{
    if( !getValue( HMI__STMSG_VIN_AR ) )
    {
        // Botschaft VIN_AR ID: 113 --- Sendeart 1 spontanX --- 
        if( _VIN_AR_SpontanFlag)
        {
            VIN_AR_output(); // Nachricht wg. spontaner Änderung ausgeben
            _VIN_AR_SpontanFlag = 0; // Spontan-Flag zurücksetzen
        }
    }
}
/*@@end*/

/*@@caplFunc:VIN_AR_init():*/
VIN_AR_init()
{   /* Botschaft VIN_AR ID: 113 --- Sendeart 1 spontanX --- 
BA_ "ApplMessage" BO_ 113 0;
BA_ "NmAsrMessage" BO_ 113 0;
BA_ "GenMsgMinAcceptLength" BO_ 113 8;
BA_ "GenMsgILSupport" BO_ 113 1;
BA_ "DiagState" BO_ 113 0;
BA_ "DiagRequest" BO_ 113 0;
BA_ "DiagResponse" BO_ 113 0;
BA_ "GenMsgStartValue" BO_ 113 "0";
BA_ "GenMsgDelayTime" BO_ 113 5;
BA_ "GenMsgNrOfRepetitions" BO_ 113 0;
BA_ "GenMsgSendType" BO_ 113 1;
    */
    _VIN_AR_Timebase =      c_tDBKomTimer_20ms;
    _VIN_AR_SpontanFlag = 0;

    _mVIN_AR.VIN_Data1.phys = getValue( HMI_VIN_Data1 );
    _mVIN_AR.VIN_Data2.phys = getValue( HMI_VIN_Data2 );
    _mVIN_AR.VIN_Data3.phys = getValue( HMI_VIN_Data3 );
    _mVIN_AR.VIN_Data4.phys = getValue( HMI_VIN_Data4 );
    _mVIN_AR.VIN_Data5.phys = getValue( HMI_VIN_Data5 );
    _mVIN_AR.VIN_Data6.phys = getValue( HMI_VIN_Data6 );
    _mVIN_AR.VIN_Data7.phys = getValue( HMI_VIN_Data7 );
    _mVIN_AR.VIN_MsgPart.phys = getValue( HMI_VIN_MsgPart );
}
/*@@end*/

/*@@caplFunc:VIN_AR_output():*/
VIN_AR_output(void)
{
    output( _mVIN_AR );
}
/*@@end*/

/*@@caplFunc:VIN_AR_saveEnvVars(dword):*/
VIN_AR_saveEnvVars( dword hFile )
{
    filePutString("\n// Knoten EIS: VIN_AR\n", 24, hFile );
    snprintf( buffer, elcount( buffer ), "0.0000 HMI__STMSG_VehIdNr := %X\n", getValue( HMI__STMSG_VIN_AR ) );        filePutString( buffer, elcount( buffer ), hFile );
    snprintf( buffer, elcount( buffer ), "0.0000 HMI__STMSGT_VehIdNr := %X\n", getValue( HMI__STMSGT_VIN_AR ) );        filePutString( buffer, elcount( buffer ), hFile );
    snprintf( buffer, elcount( buffer ), "0.0000 HMI_VIN_Data1 := %X\n", getValue( HMI_VIN_Data1 ) );        filePutString( buffer, elcount( buffer ), hFile );
    snprintf( buffer, elcount( buffer ), "0.0000 HMI_VIN_Data2 := %X\n", getValue( HMI_VIN_Data2 ) );        filePutString( buffer, elcount( buffer ), hFile );
    snprintf( buffer, elcount( buffer ), "0.0000 HMI_VIN_Data3 := %X\n", getValue( HMI_VIN_Data3 ) );        filePutString( buffer, elcount( buffer ), hFile );
    snprintf( buffer, elcount( buffer ), "0.0000 HMI_VIN_Data4 := %X\n", getValue( HMI_VIN_Data4 ) );        filePutString( buffer, elcount( buffer ), hFile );
    snprintf( buffer, elcount( buffer ), "0.0000 HMI_VIN_Data5 := %X\n", getValue( HMI_VIN_Data5 ) );        filePutString( buffer, elcount( buffer ), hFile );
    snprintf( buffer, elcount( buffer ), "0.0000 HMI_VIN_Data6 := %X\n", getValue( HMI_VIN_Data6 ) );        filePutString( buffer, elcount( buffer ), hFile );
    snprintf( buffer, elcount( buffer ), "0.0000 HMI_VIN_Data7 := %X\n", getValue( HMI_VIN_Data7 ) );        filePutString( buffer, elcount( buffer ), hFile );
    snprintf( buffer, elcount( buffer ), "0.0000 HMI_VIN_MsgPart := %X\n", getValue( HMI_VIN_MsgPart ) );        filePutString( buffer, elcount( buffer ), hFile );
}
/*@@end*/

/*@@timer:_tVIN_AR:*/
on timer _tVIN_AR
{
    putValue( HMI__STMSG_VIN_AR, 0 );
}
/*@@end*/

/*@@envVar:HMI__STMSG_VIN_AR:*/
on EnvVar HMI__STMSG_VIN_AR
{
    long tDelay;
    if( getValue( this ) == 2 )
    {
        tDelay = getValue( HMI__STMSGT_VIN_AR );
        if( tDelay > 0)    
            setTimer( _tVIN_AR, tDelay );
        else
            putValue( HMI__STMSG_VIN_AR, 0 );
    }
}
/*@@end*/

/*@@envVar:HMI_VIN_Data1:*/
on EnvVar HMI_VIN_Data1
{
    _mVIN_AR.VIN_Data1.phys = getValue(this);
    _VIN_AR_SpontanFlag = 1;
}
/*@@end*/

/*@@envVar:HMI_VIN_Data2:*/
on EnvVar HMI_VIN_Data2
{
    _mVIN_AR.VIN_Data2.phys = getValue(this);
    _VIN_AR_SpontanFlag = 1;
}
/*@@end*/

/*@@envVar:HMI_VIN_Data3:*/
on EnvVar HMI_VIN_Data3
{
    _mVIN_AR.VIN_Data3.phys = getValue(this);
    _VIN_AR_SpontanFlag = 1;
}
/*@@end*/

/*@@envVar:HMI_VIN_Data4:*/
on EnvVar HMI_VIN_Data4
{
    _mVIN_AR.VIN_Data4.phys = getValue(this);
    _VIN_AR_SpontanFlag = 1;
}
/*@@end*/

/*@@envVar:HMI_VIN_Data5:*/
on EnvVar HMI_VIN_Data5
{
    _mVIN_AR.VIN_Data5.phys = getValue(this);
    _VIN_AR_SpontanFlag = 1;
}
/*@@end*/

/*@@envVar:HMI_VIN_Data6:*/
on EnvVar HMI_VIN_Data6
{
    _mVIN_AR.VIN_Data6.phys = getValue(this);
    _VIN_AR_SpontanFlag = 1;
}
/*@@end*/

/*@@envVar:HMI_VIN_Data7:*/
on EnvVar HMI_VIN_Data7
{
    _mVIN_AR.VIN_Data7.phys = getValue(this);
    _VIN_AR_SpontanFlag = 1;
}
/*@@end*/

/*@@envVar:HMI_VIN_MsgPart:*/
on EnvVar HMI_VIN_MsgPart
{
    _mVIN_AR.VIN_MsgPart.phys = getValue(this);
    _VIN_AR_SpontanFlag = 1;
}
/*@@end*/

/*@@caplFunc:VTA_Event_Disp_AR_check_output():*/
VTA_Event_Disp_AR_check_output()
{
    if( !getValue( HMI__STMSG_VTA_Event_Disp_AR ) )
    {
        // Botschaft VTA_Event_Disp_AR ID: 1194 --- Sendeart 5 cyclicAndSpontanWithDelay --- 
        if( _VTA_Event_Disp_AR_DelayCnt > 0) _VTA_Event_Disp_AR_DelayCnt--; // Mindestsendeabstand
        _VTA_Event_Disp_AR_Cnt--;
        if( _VTA_Event_Disp_AR_Cnt < 1 )
        {
            if( _VTA_Event_Disp_AR_DelayCnt < 1 )
            {
                // Nachricht wg. abgelaufenem Zyklus ausgeben (Mindestsendeabstand eingehalten)
                VTA_Event_Disp_AR_output();
                _VTA_Event_Disp_AR_SpontanFlag = 0; // Spontan-Flag zurücksetzen
                _VTA_Event_Disp_AR_DelayCnt = _VTA_Event_Disp_AR_MinDelay;
            }
            else
            {
                // Spontanflag setzen damit nach Ablauf Mindestsendeabstand gesendet wird
                 _VTA_Event_Disp_AR_SpontanFlag = 1;
            }
            _VTA_Event_Disp_AR_Cnt = _VTA_Event_Disp_AR_CycleCount; // Zyklus-Zähler zurücksetzen
        }
        else if( _VTA_Event_Disp_AR_SpontanFlag)
        {
            if( _VTA_Event_Disp_AR_DelayCnt < 1 )
            {
                // Nachricht wg. spontaner Änderung ausgeben (Mindestsendeabstand eingehalten)
                VTA_Event_Disp_AR_output();
                _VTA_Event_Disp_AR_SpontanFlag = 0; // Spontan-Flag zurücksetzen
                _VTA_Event_Disp_AR_DelayCnt = _VehPwrMngmnt_EMM_Stat2_AR_MinDelay;
            }
        }
    }
}
/*@@end*/

/*@@caplFunc:VTA_Event_Disp_AR_init():*/
VTA_Event_Disp_AR_init()
{   /* Botschaft VTA_Event_Disp_AR ID: 1194 --- Sendeart 5 cyclicAndSpontanWithDelay --- 
BA_ "ApplMessage" BO_ 1194 0;
BA_ "NmAsrMessage" BO_ 1194 0;
BA_ "GenMsgMinAcceptLength" BO_ 1194 4;
BA_ "GenMsgILSupport" BO_ 1194 1;
BA_ "DiagState" BO_ 1194 0;
BA_ "DiagRequest" BO_ 1194 0;
BA_ "DiagResponse" BO_ 1194 0;
BA_ "GenMsgStartValue" BO_ 1194 "0";
BA_ "GenMsgDelayTime" BO_ 1194 100;
BA_ "GenMsgNrOfRepetition" BO_ 1194 0;
BA_ "GenMsgCycleTime" BO_ 1194 1000;
BA_ "GenMsgSendType" BO_ 1194 5;
    */
    _VTA_Event_Disp_AR_Timebase =      c_tDBKomTimer_20ms;
    _VTA_Event_Disp_AR_CycleCount =   1000 / _VTA_Event_Disp_AR_Timebase;
    _VTA_Event_Disp_AR_StartDelay =      0 / _VTA_Event_Disp_AR_Timebase;
    _VTA_Event_Disp_AR_MinDelay =      100 / _VTA_Event_Disp_AR_Timebase;
    _VTA_Event_Disp_AR_Cnt = _VTA_Event_Disp_AR_StartDelay;
    _VTA_Event_Disp_AR_SpontanFlag = 0;
    _VTA_Event_Disp_AR_DelayCnt = 0;

    putValue( HMI__STMSGSD_VTA_Event_Disp_AR, _VTA_Event_Disp_AR_StartDelay * _VTA_Event_Disp_AR_Timebase );

    _mVTA_Event_Disp_AR.VTA_Park_Event_Lvl.phys = getValue( HMI_VTA_Park_Event_Lvl );
    _mVTA_Event_Disp_AR.VTA_Park_Event_Rq.phys = getValue( HMI_VTA_Park_Event_Rq );
    _mVTA_Event_Disp_AR.VTA_Park_Event_Type.phys = getValue( HMI_VTA_Park_Event_Type );
}
/*@@end*/

/*@@caplFunc:VTA_Event_Disp_AR_output():*/
VTA_Event_Disp_AR_output(void)
{
    output( _mVTA_Event_Disp_AR );
}
/*@@end*/

/*@@caplFunc:VTA_Event_Disp_AR_saveEnvVars(dword):*/
VTA_Event_Disp_AR_saveEnvVars( dword hFile )
{
    filePutString("\n// Knoten EIS: VTA_Event_Disp_AR\n", 28, hFile );
    snprintf( buffer, elcount( buffer ), "0.0000 HMI__STMSG_VTA_Event_Disp_AR := %X\n", getValue( HMI__STMSG_VTA_Event_Disp_AR ) );        filePutString( buffer, elcount( buffer ), hFile );
    snprintf( buffer, elcount( buffer ), "0.0000 HMI__STMSGT_VTA_Event_Disp_AR := %X\n", getValue( HMI__STMSGT_VTA_Event_Disp_AR ) );        filePutString( buffer, elcount( buffer ), hFile );
    snprintf( buffer, elcount( buffer ), "0.0000 HMI_VTA_Park_Event_Lvl := %X\n", getValue( HMI_VTA_Park_Event_Lvl ) );        filePutString( buffer, elcount( buffer ), hFile );
    snprintf( buffer, elcount( buffer ), "0.0000 HMI_VTA_Park_Event_Rq := %X\n", getValue( HMI_VTA_Park_Event_Rq ) );        filePutString( buffer, elcount( buffer ), hFile );
    snprintf( buffer, elcount( buffer ), "0.0000 HMI_VTA_Park_Event_Type := %X\n", getValue( HMI_VTA_Park_Event_Type ) );        filePutString( buffer, elcount( buffer ), hFile );
}
/*@@end*/

/*@@timer:_tVTA_Event_Disp_AR:*/
on timer _tVTA_Event_Disp_AR
{
    putValue( HMI__STMSG_VTA_Event_Disp_AR, 0 );
}
/*@@end*/

/*@@envVar:HMI__STMSG_VTA_Event_Disp_AR:*/
on EnvVar HMI__STMSG_VTA_Event_Disp_AR
{
    long tDelay;
    if( getValue( this ) == 2 )
    {
        tDelay = getValue( HMI__STMSGT_VTA_Event_Disp_AR );
        if( tDelay > 0)    
            setTimer( _tVTA_Event_Disp_AR, tDelay );
        else
            putValue( HMI__STMSG_VTA_Event_Disp_AR, 0 );
    }
}
/*@@end*/

/*@@envVar:HMI_VTA_Park_Event_Lvl:*/
on EnvVar HMI_VTA_Park_Event_Lvl
{
    _mVTA_Event_Disp_AR.VTA_Park_Event_Lvl.phys = getValue(this);
    _VTA_Event_Disp_AR_SpontanFlag = 1;
}
/*@@end*/

/*@@envVar:HMI_VTA_Park_Event_Rq:*/
on EnvVar HMI_VTA_Park_Event_Rq
{
    _mVTA_Event_Disp_AR.VTA_Park_Event_Rq.phys = getValue(this);
    _VTA_Event_Disp_AR_SpontanFlag = 1;
}
/*@@end*/

/*@@envVar:HMI_VTA_Park_Event_Type:*/
on EnvVar HMI_VTA_Park_Event_Type
{
    _mVTA_Event_Disp_AR.VTA_Park_Event_Type.phys = getValue(this);
    _VTA_Event_Disp_AR_SpontanFlag = 1;
}
/*@@end*/

/*@@caplFunc:Whl_Lt_Stat_AR_check_output():*/
Whl_Lt_Stat_AR_check_output()
{
    if( !getValue( HMI__STMSG_Whl_Lt_Stat_AR ) )
    {
        // Botschaft Whl_Lt_Stat_AR ID: 161 --- Sendeart 0 cyclicX --- 
        _Whl_Lt_Stat_AR_Cnt--;
        if( _Whl_Lt_Stat_AR_Cnt < 1 )
        {
            // Nachricht wg. abgelaufenem Zyklus ausgeben
            Whl_Lt_Stat_AR_output();
            // Zyklus-Zähler zurücksetzen
            _Whl_Lt_Stat_AR_Cnt = _Whl_Lt_Stat_AR_CycleCount;
        }
    }
}
/*@@end*/

/*@@caplFunc:Whl_Lt_Stat_AR_init():*/
Whl_Lt_Stat_AR_init()
{   /* Botschaft Whl_Lt_Stat_AR ID: 161 --- Sendeart 0 cyclicX --- 
BA_ "ApplMessage" BO_ 161 0;
BA_ "NmAsrMessage" BO_ 161 0;
BA_ "GenMsgMinAcceptLength" BO_ 161 8;
BA_ "GenMsgILSupport" BO_ 161 1;
BA_ "DiagState" BO_ 161 0;
BA_ "DiagRequest" BO_ 161 0;
BA_ "DiagResponse" BO_ 161 0;
BA_ "GenMsgStartValue" BO_ 161 "0";
BA_ "GenMsgCycleTime" BO_ 161 20;
BA_ "GenMsgSendType" BO_ 161 0;
    */
    _Whl_Lt_Stat_AR_Timebase =      c_tDBKomTimer_20ms;
    _Whl_Lt_Stat_AR_CycleCount =    20 / _Whl_Lt_Stat_AR_Timebase;
    _Whl_Lt_Stat_AR_StartDelay =     0 / _Whl_Lt_Stat_AR_Timebase;
    _Whl_Lt_Stat_AR_Cnt = _Whl_Lt_Stat_AR_StartDelay;

    putValue( HMI__STMSGSD_Whl_Lt_Stat_AR, _Whl_Lt_Stat_AR_StartDelay * _Whl_Lt_Stat_AR_Timebase );

    _mWhl_Lt_Stat_AR.CRC_Whl_Lt_Stat.phys = getValue( HMI_CRC_Whl_Lt_Stat );
    _mWhl_Lt_Stat_AR.SQC_Whl_Lt_Stat.phys = getValue( HMI_SQC_Whl_Lt_Stat );
    _mWhl_Lt_Stat_AR.WhlDir_FL_Stat.phys = getValue( HMI_WhlDir_FL_Stat );
    _mWhl_Lt_Stat_AR.WhlDir_RL_Stat.phys = getValue( HMI_WhlDir_RL_Stat );
    _mWhl_Lt_Stat_AR.WhlPlsCnt_FL.phys = getValue( HMI_WhlPlsCnt_FL );
    _mWhl_Lt_Stat_AR.WhlPlsCnt_RL.phys = getValue( HMI_WhlPlsCnt_RL );
    _mWhl_Lt_Stat_AR.WhlRPM_FL.phys = getValue( HMI_WhlRPM_FL );
    _mWhl_Lt_Stat_AR.WhlRPM_FL_Qual.phys = getValue( HMI_WhlRPM_FL_Qual );
    _mWhl_Lt_Stat_AR.WhlRPM_RL.phys = getValue( HMI_WhlRPM_RL );
    _mWhl_Lt_Stat_AR.WhlRPM_RL_Qual.phys = getValue( HMI_WhlRPM_RL_Qual );
}
/*@@end*/

/*@@caplFunc:Whl_Lt_Stat_AR_output():*/
void Whl_Lt_Stat_AR_output(void)
{
    byte crc;
    byte SQC_help;

    if( !getValue( HMI_SQC_Whl_Lt_Stat_Auto ) )
    {
        // berechne message counter
        SQC_help = getValue( HMI_SQC_Whl_Lt_Stat );
        if( SQC_help >= 15 ) SQC_help = 0;
        else SQC_help++;
        putValue( HMI_SQC_Whl_Lt_Stat, SQC_help );
        _mWhl_Lt_Stat_AR.SQC_Whl_Lt_Stat = SQC_help;
    }
    else
          _mWhl_Lt_Stat_AR.SQC_Whl_Lt_Stat = getValue( HMI_SQC_Whl_Lt_Stat );

    if( getValue( HMI_CRC_Whl_Lt_Stat_Profile_02 ) )
    {
        if( !getValue( HMI_CRC_Whl_Lt_Stat_Auto ) )
        {   // CRC according Profile_02 ( W213 )
            // berechne crc
            crc = 0xFF;
//          crc = crctable_profile02[ crc ^ _mWhl_Lt_Stat_AR.byte( 0 ) ];
            crc = crctable_profile02[ crc ^ _mWhl_Lt_Stat_AR.byte( 1 ) ];
            crc = crctable_profile02[ crc ^ _mWhl_Lt_Stat_AR.byte( 2 ) ];
            crc = crctable_profile02[ crc ^ _mWhl_Lt_Stat_AR.byte( 3 ) ];
            crc = crctable_profile02[ crc ^ _mWhl_Lt_Stat_AR.byte( 4 ) ];
            crc = crctable_profile02[ crc ^ _mWhl_Lt_Stat_AR.byte( 5 ) ];
            crc = crctable_profile02[ crc ^ _mWhl_Lt_Stat_AR.byte( 6 ) ];
            crc = crctable_profile02[ crc ^ _mWhl_Lt_Stat_AR.byte( 7 ) ];
            crc = crctable_profile02[ crc ^ _Whl_Lt_Stat_AR_CRC_Offset[ _mWhl_Lt_Stat_AR.SQC_Whl_Lt_Stat ] ]; // load offset
            crc = (crc ^ 0xFF);
            if( getValue(  HMI_CRC_Whl_Lt_Stat_Invalid ) )
                crc++;
            _mWhl_Lt_Stat_AR.CRC_Whl_Lt_Stat = crc;
            putValue( HMI_CRC_Whl_Lt_Stat, crc );
        }
        else
            _mWhl_Lt_Stat_AR.CRC_Whl_Lt_Stat = getValue( HMI_CRC_Whl_Lt_Stat );
    }
    else
    {
        if( !getValue( HMI_CRC_Whl_Lt_Stat_Auto ) )
        {   // CRC according to SAE1850 ( W222 )
            // berechne crc
            crc = 0xFF;
            crc = crctable[crc ^ _mWhl_Lt_Stat_AR.byte( 1 )];
            crc = crctable[crc ^ _mWhl_Lt_Stat_AR.byte( 2 )];
            crc = crctable[crc ^ _mWhl_Lt_Stat_AR.byte( 3 )];
            crc = crctable[crc ^ _mWhl_Lt_Stat_AR.byte( 4 )];
            crc = crctable[crc ^ _mWhl_Lt_Stat_AR.byte( 5 )];
            crc = crctable[crc ^ _mWhl_Lt_Stat_AR.byte( 6 )];
            crc = crctable[crc ^ _mWhl_Lt_Stat_AR.byte( 7 )];
            crc = (crc ^ 0xFF);
            if( getValue(  HMI_CRC_Whl_Lt_Stat_Invalid ) )
                crc++;
            _mWhl_Lt_Stat_AR.CRC_Whl_Lt_Stat = crc;
            putValue( HMI_CRC_Whl_Lt_Stat, crc );
        }
        else
            _mWhl_Lt_Stat_AR.CRC_Whl_Lt_Stat = getValue( HMI_CRC_Whl_Lt_Stat );
    }
    output( _mWhl_Lt_Stat_AR );
}
/*@@end*/

/*@@caplFunc:Whl_Lt_Stat_AR_saveEnvVars(dword):*/
Whl_Lt_Stat_AR_saveEnvVars( dword hFile )
{
    filePutString("\n// Knoten EIS: Whl_Lt_Stat_AR\n", 28, hFile );
    snprintf( buffer, elcount( buffer ), "0.0000 HMI__STMSG_Whl_Lt_Stat := %X\n", getValue( HMI__STMSG_Whl_Lt_Stat_AR ) );        filePutString( buffer, elcount( buffer ), hFile );
    snprintf( buffer, elcount( buffer ), "0.0000 HMI__STMSGT_Whl_Lt_Stat := %X\n", getValue( HMI__STMSGT_Whl_Lt_Stat_AR ) );        filePutString( buffer, elcount( buffer ), hFile );
    snprintf( buffer, elcount( buffer ), "0.0000 HMI_CRC_Whl_Lt_Stat := %X\n", getValue( HMI_CRC_Whl_Lt_Stat ) );        filePutString( buffer, elcount( buffer ), hFile );
    snprintf( buffer, elcount( buffer ), "0.0000 HMI_CRC_Whl_Lt_Stat_Auto := %X\n", getValue( HMI_CRC_Whl_Lt_Stat_Auto ) );        filePutString( buffer, elcount( buffer ), hFile );
    snprintf( buffer, elcount( buffer ), "0.0000 HMI_SQC_Whl_Lt_Stat := %X\n", getValue( HMI_SQC_Whl_Lt_Stat ) );        filePutString( buffer, elcount( buffer ), hFile );
    snprintf( buffer, elcount( buffer ), "0.0000 HMI_SQC_Whl_Lt_Stat_Auto := %X\n", getValue( HMI_SQC_Whl_Lt_Stat_Auto ) );        filePutString( buffer, elcount( buffer ), hFile );
    snprintf( buffer, elcount( buffer ), "0.0000 HMI_WhlDir_FL_Stat := %X\n", getValue( HMI_WhlDir_FL_Stat ) );        filePutString( buffer, elcount( buffer ), hFile );
    snprintf( buffer, elcount( buffer ), "0.0000 HMI_WhlDir_RL_Stat := %X\n", getValue( HMI_WhlDir_RL_Stat ) );        filePutString( buffer, elcount( buffer ), hFile );
    snprintf( buffer, elcount( buffer ), "0.0000 HMI_WhlPlsCnt_FL := %X\n", getValue( HMI_WhlPlsCnt_FL ) );        filePutString( buffer, elcount( buffer ), hFile );
    snprintf( buffer, elcount( buffer ), "0.0000 HMI_WhlPlsCnt_RL := %X\n", getValue( HMI_WhlPlsCnt_RL ) );        filePutString( buffer, elcount( buffer ), hFile );
    snprintf( buffer, elcount( buffer ), "0.0000 HMI_WhlRPM_FL := %X\n", getValue( HMI_WhlRPM_FL ) );        filePutString( buffer, elcount( buffer ), hFile );
    snprintf( buffer, elcount( buffer ), "0.0000 HMI_WhlRPM_FL_Qual := %X\n", getValue( HMI_WhlRPM_FL_Qual ) );        filePutString( buffer, elcount( buffer ), hFile );
    snprintf( buffer, elcount( buffer ), "0.0000 HMI_WhlRPM_RL := %X\n", getValue( HMI_WhlRPM_RL ) );        filePutString( buffer, elcount( buffer ), hFile );
    snprintf( buffer, elcount( buffer ), "0.0000 HMI_WhlRPM_RL_Qual := %X\n", getValue( HMI_WhlRPM_RL_Qual ) );        filePutString( buffer, elcount( buffer ), hFile );
}
/*@@end*/

/*@@timer:_tWhl_Lt_Stat_AR:*/
on timer _tWhl_Lt_Stat_AR
{
    putValue( HMI__STMSG_Whl_Lt_Stat_AR, 0 );
}
/*@@end*/

/*@@envVar:HMI__STMSG_Whl_Lt_Stat_AR:*/
on EnvVar HMI__STMSG_Whl_Lt_Stat_AR
{
    long tDelay;
    if( getValue( this ) == 2 )
    {
        tDelay = getValue( HMI__STMSGT_Whl_Lt_Stat_AR );
        if( tDelay > 0)    
            setTimer( _tWhl_Lt_Stat_AR, tDelay );
        else
            putValue( HMI__STMSG_Whl_Lt_Stat_AR, 0 );
    }
}
/*@@end*/

/*@@envVar:HMI_WhlDir_FL_Stat:*/
on EnvVar HMI_WhlDir_FL_Stat
{
    _mWhl_Lt_Stat_AR.WhlDir_FL_Stat.phys = getValue(this);
}
/*@@end*/

/*@@envVar:HMI_WhlDir_RL_Stat:*/
on EnvVar HMI_WhlDir_RL_Stat
{
    _mWhl_Lt_Stat_AR.WhlDir_RL_Stat.phys = getValue(this);
}
/*@@end*/

/*@@envVar:HMI_WhlPlsCnt_FL:*/
on EnvVar HMI_WhlPlsCnt_FL
{
    _mWhl_Lt_Stat_AR.WhlPlsCnt_FL.phys = getValue(this);
}
/*@@end*/

/*@@envVar:HMI_WhlPlsCnt_RL:*/
on EnvVar HMI_WhlPlsCnt_RL
{
    _mWhl_Lt_Stat_AR.WhlPlsCnt_RL.phys = getValue(this);
}
/*@@end*/

/*@@envVar:HMI_WhlRPM_FL:*/
on EnvVar HMI_WhlRPM_FL
{
    _mWhl_Lt_Stat_AR.WhlRPM_FL.phys = getValue(this);
}
/*@@end*/

/*@@envVar:HMI_WhlRPM_FL_Qual:*/
on EnvVar HMI_WhlRPM_FL_Qual
{
    _mWhl_Lt_Stat_AR.WhlRPM_FL_Qual.phys = getValue(this);
}
/*@@end*/

/*@@envVar:HMI_WhlRPM_RL:*/
on EnvVar HMI_WhlRPM_RL
{
    _mWhl_Lt_Stat_AR.WhlRPM_RL.phys = getValue(this);
}
/*@@end*/

/*@@envVar:HMI_WhlRPM_RL_Qual:*/
on EnvVar HMI_WhlRPM_RL_Qual
{
    _mWhl_Lt_Stat_AR.WhlRPM_RL_Qual.phys = getValue(this);
}
/*@@end*/

/*@@caplFunc:Whl_Rt_Stat_AR_check_output():*/
Whl_Rt_Stat_AR_check_output()
{
    if( !getValue( HMI__STMSG_Whl_Rt_Stat_AR ) )
    {
        // Botschaft Whl_Rt_Stat_AR ID: 163 --- Sendeart 0 cyclicX --- 
        _Whl_Rt_Stat_AR_Cnt--;
        if( _Whl_Rt_Stat_AR_Cnt < 1 )
        {
            // Nachricht wg. abgelaufenem Zyklus ausgeben
            Whl_Rt_Stat_AR_output();
            // Zyklus-Zähler zurücksetzen
            _Whl_Rt_Stat_AR_Cnt = _Whl_Rt_Stat_AR_CycleCount;
        }
    }
}
/*@@end*/

/*@@caplFunc:Whl_Rt_Stat_AR_init():*/
Whl_Rt_Stat_AR_init()
{   /* Botschaft Whl_Rt_Stat_AR ID: 163 --- Sendeart 0 cyclicX --- 
BA_ "ApplMessage" BO_ 163 0;
BA_ "NmAsrMessage" BO_ 163 0;
BA_ "GenMsgMinAcceptLength" BO_ 163 8;
BA_ "GenMsgILSupport" BO_ 163 1;
BA_ "DiagState" BO_ 163 0;
BA_ "DiagRequest" BO_ 163 0;
BA_ "DiagResponse" BO_ 163 0;
BA_ "GenMsgStartValue" BO_ 163 "0";
BA_ "GenMsgCycleTime" BO_ 163 20;
BA_ "GenMsgSendType" BO_ 163 0;
    */
    _Whl_Rt_Stat_AR_Timebase =      c_tDBKomTimer_20ms;
    _Whl_Rt_Stat_AR_CycleCount =    20 / _Whl_Rt_Stat_AR_Timebase;
    _Whl_Rt_Stat_AR_StartDelay =     0 / _Whl_Rt_Stat_AR_Timebase;
    _Whl_Rt_Stat_AR_Cnt = _Whl_Rt_Stat_AR_StartDelay;

    putValue( HMI__STMSGSD_Whl_Rt_Stat_AR, _Whl_Rt_Stat_AR_StartDelay * _Whl_Rt_Stat_AR_Timebase );

    _mWhl_Rt_Stat_AR.CRC_Whl_Rt_Stat.phys = getValue( HMI_CRC_Whl_Rt_Stat );
    _mWhl_Rt_Stat_AR.SQC_Whl_Rt_Stat.phys = getValue( HMI_SQC_Whl_Rt_Stat );
    _mWhl_Rt_Stat_AR.WhlDir_FR_Stat.phys = getValue( HMI_WhlDir_FR_Stat );
    _mWhl_Rt_Stat_AR.WhlDir_RR_Stat.phys = getValue( HMI_WhlDir_RR_Stat );
    _mWhl_Rt_Stat_AR.WhlPlsCnt_FR.phys = getValue( HMI_WhlPlsCnt_FR );
    _mWhl_Rt_Stat_AR.WhlPlsCnt_RR.phys = getValue( HMI_WhlPlsCnt_RR );
    _mWhl_Rt_Stat_AR.WhlRPM_FR.phys = getValue( HMI_WhlRPM_FR );
    _mWhl_Rt_Stat_AR.WhlRPM_FR_Qual.phys = getValue( HMI_WhlRPM_FR_Qual );
    _mWhl_Rt_Stat_AR.WhlRPM_RR.phys = getValue( HMI_WhlRPM_RR );
    _mWhl_Rt_Stat_AR.WhlRPM_RR_Qual.phys = getValue( HMI_WhlRPM_RR_Qual );
}
/*@@end*/

/*@@caplFunc:Whl_Rt_Stat_AR_output():*/
void Whl_Rt_Stat_AR_output(void)
{
    byte crc;
    byte SQC_help;

    if( !getValue( HMI_SQC_Whl_Rt_Stat_Auto ) )
    {
        // berechne message counter
        SQC_help = getValue( HMI_SQC_Whl_Rt_Stat );
        if( SQC_help >= 15 ) SQC_help = 0;
        else SQC_help++;
        putValue( HMI_SQC_Whl_Rt_Stat, SQC_help );
        _mWhl_Rt_Stat_AR.SQC_Whl_Rt_Stat = SQC_help;
    }
    else
          _mWhl_Rt_Stat_AR.SQC_Whl_Rt_Stat = getValue( HMI_SQC_Whl_Rt_Stat );

    if( getValue( HMI_CRC_Whl_Rt_Stat_Profile_02 ) )
    {
        if( !getValue( HMI_CRC_Whl_Rt_Stat_Auto ) )
        {   // CRC according Profile_02 ( W213 )
            // berechne crc
            crc = 0xFF;
//          crc = crctable_profile02[ crc ^ _mWhl_Rt_Stat_AR.byte( 0 ) ];
            crc = crctable_profile02[ crc ^ _mWhl_Rt_Stat_AR.byte( 1 ) ];
            crc = crctable_profile02[ crc ^ _mWhl_Rt_Stat_AR.byte( 2 ) ];
            crc = crctable_profile02[ crc ^ _mWhl_Rt_Stat_AR.byte( 3 ) ];
            crc = crctable_profile02[ crc ^ _mWhl_Rt_Stat_AR.byte( 4 ) ];
            crc = crctable_profile02[ crc ^ _mWhl_Rt_Stat_AR.byte( 5 ) ];
            crc = crctable_profile02[ crc ^ _mWhl_Rt_Stat_AR.byte( 6 ) ];
            crc = crctable_profile02[ crc ^ _mWhl_Rt_Stat_AR.byte( 7 ) ];
            crc = crctable_profile02[ crc ^ _Whl_Rt_Stat_AR_CRC_Offset[ _mWhl_Rt_Stat_AR.SQC_Whl_Rt_Stat ] ]; // load offset
            crc = (crc ^ 0xFF);
            if( getValue(  HMI_CRC_Whl_Rt_Stat_Invalid ) )
                crc++;
            _mWhl_Rt_Stat_AR.CRC_Whl_Rt_Stat = crc;
            putValue( HMI_CRC_Whl_Rt_Stat, crc );
        }
        else
            _mWhl_Rt_Stat_AR.CRC_Whl_Rt_Stat = getValue( HMI_CRC_Whl_Rt_Stat );
    }
    else
    {
        if( !getValue( HMI_CRC_Whl_Rt_Stat_Auto ) )
        {   // CRC according to SAE1850 ( W222 )
            // berechne crc
            crc = 0xFF;
            crc = crctable[crc ^ _mWhl_Rt_Stat_AR.byte( 1 )];
            crc = crctable[crc ^ _mWhl_Rt_Stat_AR.byte( 2 )];
            crc = crctable[crc ^ _mWhl_Rt_Stat_AR.byte( 3 )];
            crc = crctable[crc ^ _mWhl_Rt_Stat_AR.byte( 4 )];
            crc = crctable[crc ^ _mWhl_Rt_Stat_AR.byte( 5 )];
            crc = crctable[crc ^ _mWhl_Rt_Stat_AR.byte( 6 )];
            crc = crctable[crc ^ _mWhl_Rt_Stat_AR.byte( 7 )];
            crc = (crc ^ 0xFF);
            if( getValue(  HMI_CRC_Whl_Rt_Stat_Invalid ) )
                crc++;
            _mWhl_Rt_Stat_AR.CRC_Whl_Rt_Stat = crc;
            putValue( HMI_CRC_Whl_Rt_Stat, crc );
        }
        else
            _mWhl_Rt_Stat_AR.CRC_Whl_Rt_Stat = getValue( HMI_CRC_Whl_Rt_Stat );
    }
    output( _mWhl_Rt_Stat_AR );
}
/*@@end*/

/*@@caplFunc:Whl_Rt_Stat_AR_saveEnvVars(dword):*/
Whl_Rt_Stat_AR_saveEnvVars( dword hFile )
{
    filePutString("\n// Knoten EIS: Whl_Rt_Stat_AR\n", 28, hFile );
    snprintf( buffer, elcount( buffer ), "0.0000 HMI__STMSG_Whl_Rt_Stat := %X\n", getValue( HMI__STMSG_Whl_Rt_Stat_AR ) );        filePutString( buffer, elcount( buffer ), hFile );
    snprintf( buffer, elcount( buffer ), "0.0000 HMI__STMSGT_Whl_Rt_Stat := %X\n", getValue( HMI__STMSGT_Whl_Rt_Stat_AR ) );        filePutString( buffer, elcount( buffer ), hFile );
    snprintf( buffer, elcount( buffer ), "0.0000 HMI_CRC_Whl_Rt_Stat := %X\n", getValue( HMI_CRC_Whl_Rt_Stat ) );        filePutString( buffer, elcount( buffer ), hFile );
    snprintf( buffer, elcount( buffer ), "0.0000 HMI_CRC_Whl_Rt_Stat_Auto := %X\n", getValue( HMI_CRC_Whl_Rt_Stat_Auto ) );        filePutString( buffer, elcount( buffer ), hFile );
    snprintf( buffer, elcount( buffer ), "0.0000 HMI_SQC_Whl_Rt_Stat := %X\n", getValue( HMI_SQC_Whl_Rt_Stat ) );        filePutString( buffer, elcount( buffer ), hFile );
    snprintf( buffer, elcount( buffer ), "0.0000 HMI_SQC_Whl_Rt_Stat_Auto := %X\n", getValue( HMI_SQC_Whl_Rt_Stat_Auto ) );        filePutString( buffer, elcount( buffer ), hFile );
    snprintf( buffer, elcount( buffer ), "0.0000 HMI_WhlDir_FR_Stat := %X\n", getValue( HMI_WhlDir_FR_Stat ) );        filePutString( buffer, elcount( buffer ), hFile );
    snprintf( buffer, elcount( buffer ), "0.0000 HMI_WhlDir_RR_Stat := %X\n", getValue( HMI_WhlDir_RR_Stat ) );        filePutString( buffer, elcount( buffer ), hFile );
    snprintf( buffer, elcount( buffer ), "0.0000 HMI_WhlPlsCnt_FR := %X\n", getValue( HMI_WhlPlsCnt_FR ) );        filePutString( buffer, elcount( buffer ), hFile );
    snprintf( buffer, elcount( buffer ), "0.0000 HMI_WhlPlsCnt_RR := %X\n", getValue( HMI_WhlPlsCnt_RR ) );        filePutString( buffer, elcount( buffer ), hFile );
    snprintf( buffer, elcount( buffer ), "0.0000 HMI_WhlRPM_FR := %X\n", getValue( HMI_WhlRPM_FR ) );        filePutString( buffer, elcount( buffer ), hFile );
    snprintf( buffer, elcount( buffer ), "0.0000 HMI_WhlRPM_FR_Qual := %X\n", getValue( HMI_WhlRPM_FR_Qual ) );        filePutString( buffer, elcount( buffer ), hFile );
    snprintf( buffer, elcount( buffer ), "0.0000 HMI_WhlRPM_RR := %X\n", getValue( HMI_WhlRPM_RR ) );        filePutString( buffer, elcount( buffer ), hFile );
    snprintf( buffer, elcount( buffer ), "0.0000 HMI_WhlRPM_RR_Qual := %X\n", getValue( HMI_WhlRPM_RR_Qual ) );        filePutString( buffer, elcount( buffer ), hFile );
}
/*@@end*/

/*@@timer:_tWhl_Rt_Stat_AR:*/
on timer _tWhl_Rt_Stat_AR
{
    putValue( HMI__STMSG_Whl_Rt_Stat_AR, 0 );
}
/*@@end*/

/*@@envVar:HMI__STMSG_Whl_Rt_Stat_AR:*/
on EnvVar HMI__STMSG_Whl_Rt_Stat_AR
{
    long tDelay;
    if( getValue( this ) == 2 )
    {
        tDelay = getValue( HMI__STMSGT_Whl_Rt_Stat_AR );
        if( tDelay > 0)    
            setTimer( _tWhl_Rt_Stat_AR, tDelay );
        else
            putValue( HMI__STMSG_Whl_Rt_Stat_AR, 0 );
    }
}
/*@@end*/

/*@@envVar:HMI_WhlDir_FR_Stat:*/
on EnvVar HMI_WhlDir_FR_Stat
{
    _mWhl_Rt_Stat_AR.WhlDir_FR_Stat.phys = getValue(this);
}
/*@@end*/

/*@@envVar:HMI_WhlDir_RR_Stat:*/
on EnvVar HMI_WhlDir_RR_Stat
{
    _mWhl_Rt_Stat_AR.WhlDir_RR_Stat.phys = getValue(this);
}
/*@@end*/

/*@@envVar:HMI_WhlPlsCnt_FR:*/
on EnvVar HMI_WhlPlsCnt_FR
{
    _mWhl_Rt_Stat_AR.WhlPlsCnt_FR.phys = getValue(this);
}
/*@@end*/

/*@@envVar:HMI_WhlPlsCnt_RR:*/
on EnvVar HMI_WhlPlsCnt_RR
{
    _mWhl_Rt_Stat_AR.WhlPlsCnt_RR.phys = getValue(this);
}
/*@@end*/

/*@@envVar:HMI_WhlRPM_FR:*/
on EnvVar HMI_WhlRPM_FR
{
    _mWhl_Rt_Stat_AR.WhlRPM_FR.phys = getValue(this);
}
/*@@end*/

/*@@envVar:HMI_WhlRPM_FR_Qual:*/
on EnvVar HMI_WhlRPM_FR_Qual
{
    _mWhl_Rt_Stat_AR.WhlRPM_FR_Qual.phys = getValue(this);
}
/*@@end*/

/*@@envVar:HMI_WhlRPM_RR:*/
on EnvVar HMI_WhlRPM_RR
{
    _mWhl_Rt_Stat_AR.WhlRPM_RR.phys = getValue(this);
}
/*@@end*/

/*@@envVar:HMI_WhlRPM_RR_Qual:*/
on EnvVar HMI_WhlRPM_RR_Qual
{
    _mWhl_Rt_Stat_AR.WhlRPM_RR_Qual.phys = getValue(this);
}
/*@@end*/

/*@@caplFunc:WhlPlsCnt_TPM_AR_check_output():*/
WhlPlsCnt_TPM_AR_check_output()
{
    if( !getValue( HMI__STMSG_WhlPlsCnt_TPM_AR ) )
    {
        // Botschaft WhlPlsCnt_TPM_AR ID: 233 --- Sendeart 0 cyclicX --- 
        _WhlPlsCnt_TPM_AR_Cnt--;
        if( _WhlPlsCnt_TPM_AR_Cnt < 1 )
        {
            // Nachricht wg. abgelaufenem Zyklus ausgeben
            WhlPlsCnt_TPM_AR_output();
            // Zyklus-Zähler zurücksetzen
            _WhlPlsCnt_TPM_AR_Cnt = _WhlPlsCnt_TPM_AR_CycleCount;
        }
    }
}
/*@@end*/

/*@@caplFunc:WhlPlsCnt_TPM_AR_init():*/
WhlPlsCnt_TPM_AR_init()
{   /* Botschaft WhlPlsCnt_TPM_AR ID: 233 --- Sendeart 0 cyclicX --- 
BA_ "ApplMessage" BO_ 233 0;
BA_ "NmAsrMessage" BO_ 233 0;
BA_ "GenMsgMinAcceptLength" BO_ 233 8;
BA_ "GenMsgILSupport" BO_ 233 1;
BA_ "DiagState" BO_ 233 0;
BA_ "DiagRequest" BO_ 233 0;
BA_ "DiagResponse" BO_ 233 0;
BA_ "GenMsgStartValue" BO_ 233 "0";
BA_ "GenMsgCycleTime" BO_ 233 20;
BA_ "GenMsgSendType" BO_ 233 0;
    */
    _WhlPlsCnt_TPM_AR_Timebase =      c_tDBKomTimer_20ms;
    _WhlPlsCnt_TPM_AR_CycleCount =     20 / _WhlPlsCnt_TPM_AR_Timebase;
    _WhlPlsCnt_TPM_AR_StartDelay =      0 / _WhlPlsCnt_TPM_AR_Timebase;
    _WhlPlsCnt_TPM_AR_Cnt = _WhlPlsCnt_TPM_AR_StartDelay;

    putValue( HMI__STMSGSD_WhlPlsCnt_TPM_AR, _WhlPlsCnt_TPM_AR_StartDelay * _WhlPlsCnt_TPM_AR_Timebase );

    _mWhlPlsCnt_TPM_AR.Rsrv1_WhlPlsCnt_TPM.phys = getValue( HMI_Rsrv1_WhlPlsCnt_TPM );
    _mWhlPlsCnt_TPM_AR.Rsrv2_WhlPlsCnt_TPM.phys = getValue( HMI_Rsrv2_WhlPlsCnt_TPM );
    _mWhlPlsCnt_TPM_AR.WhlPlsCnt_FL.phys = getValue( HMI_WhlPlsCnt_FL_TPM );
    _mWhlPlsCnt_TPM_AR.WhlPlsCnt_FR.phys = getValue( HMI_WhlPlsCnt_FR_TPM );
    _mWhlPlsCnt_TPM_AR.WhlPlsCnt_RL.phys = getValue( HMI_WhlPlsCnt_RL_TPM );
    _mWhlPlsCnt_TPM_AR.WhlPlsCnt_RR.phys = getValue( HMI_WhlPlsCnt_RR_TPM );
    _mWhlPlsCnt_TPM_AR.WhlPlsCnt_TmStmp.phys = getValue( HMI_WhlPlsCnt_TmStmp );
}
/*@@end*/

/*@@caplFunc:WhlPlsCnt_TPM_AR_output():*/
void WhlPlsCnt_TPM_AR_output(void)
{
    byte crc;
    byte SQC_help;

    if( !getValue( HMI_SQC_WhlPlsCnt_TPM_Auto ) )
    {
        // berechne message counter
        SQC_help = getValue( HMI_SQC_WhlPlsCnt_TPM );
        if( SQC_help >= 15 ) SQC_help = 0;
        else SQC_help++;
        putValue( HMI_SQC_WhlPlsCnt_TPM, SQC_help );
        _mWhlPlsCnt_TPM_AR.SQC_WhlPlsCnt_TPM = SQC_help;
    }
    else
          _mWhlPlsCnt_TPM_AR.SQC_WhlPlsCnt_TPM = getValue( HMI_SQC_WhlPlsCnt_TPM );

    if( getValue( HMI_CRC_WhlPlsCnt_TPM_Profile_02 ) )
    {
        if( !getValue( HMI_CRC_WhlPlsCnt_TPM_Auto ) )
        {   // CRC according Profile_02 ( W213 )
            // berechne crc
            crc = 0xFF;
//          crc = crctable_profile02[ crc ^ _mWhlPlsCnt_TPM_AR.byte( 0 ) ];
            crc = crctable_profile02[ crc ^ _mWhlPlsCnt_TPM_AR.byte( 1 )];
            crc = crctable_profile02[ crc ^ _mWhlPlsCnt_TPM_AR.byte( 2 )];
            crc = crctable_profile02[ crc ^ _mWhlPlsCnt_TPM_AR.byte( 3 )];
            crc = crctable_profile02[ crc ^ _mWhlPlsCnt_TPM_AR.byte( 4 )];
            crc = crctable_profile02[ crc ^ _mWhlPlsCnt_TPM_AR.byte( 5 )];
            crc = crctable_profile02[ crc ^ _mWhlPlsCnt_TPM_AR.byte( 6 )];
            crc = crctable_profile02[ crc ^ _mWhlPlsCnt_TPM_AR.byte( 7 )];
            crc = crctable_profile02[ crc ^ _WhlPlsCnt_TPM_AR_CRC_Offset[ _mWhlPlsCnt_TPM_AR.SQC_WhlPlsCnt_TPM ] ]; // load offset
            crc = (crc ^ 0xFF);
            if( getValue(  HMI_CRC_WhlPlsCnt_TPM_Invalid ) )
                crc++;
            _mWhlPlsCnt_TPM_AR.CRC_WhlPlsCnt_TPM = crc;
            putValue( HMI_CRC_WhlPlsCnt_TPM, crc );
        }
        else
            _mWhlPlsCnt_TPM_AR.CRC_WhlPlsCnt_TPM = getValue( HMI_CRC_WhlPlsCnt_TPM );
    }
    else
    {
        if( !getValue( HMI_CRC_WhlPlsCnt_TPM_Auto ) )
        {   // CRC according to SAE1850 ( W222 )
            // berechne crc
            crc = 0xFF;
            crc = crctable[crc ^ _mWhlPlsCnt_TPM_AR.byte( 1 )];
            crc = crctable[crc ^ _mWhlPlsCnt_TPM_AR.byte( 2 )];
            crc = crctable[crc ^ _mWhlPlsCnt_TPM_AR.byte( 3 )];
            crc = crctable[crc ^ _mWhlPlsCnt_TPM_AR.byte( 4 )];
            crc = crctable[crc ^ _mWhlPlsCnt_TPM_AR.byte( 5 )];
            crc = crctable[crc ^ _mWhlPlsCnt_TPM_AR.byte( 6 )];
            crc = crctable[crc ^ _mWhlPlsCnt_TPM_AR.byte( 7 )];
            crc = (crc ^ 0xFF);
            if( getValue(  HMI_CRC_WhlPlsCnt_TPM_Invalid ) )
                crc++;
            _mWhlPlsCnt_TPM_AR.CRC_WhlPlsCnt_TPM = crc;
            putValue( HMI_CRC_WhlPlsCnt_TPM, crc );
        }
        else
            _mWhlPlsCnt_TPM_AR.CRC_WhlPlsCnt_TPM = getValue( HMI_CRC_WhlPlsCnt_TPM );
    }
    output( _mWhlPlsCnt_TPM_AR );
}
/*@@end*/

/*@@caplFunc:WhlPlsCnt_TPM_AR_saveEnvVars(dword):*/
WhlPlsCnt_TPM_AR_saveEnvVars( dword hFile )
{
    filePutString("\n// Knoten EIS: WhlPlsCnt_TPM_AR\n", 28, hFile );
    snprintf( buffer, elcount( buffer ), "0.0000 HMI__STMSG_WhlPlsCnt_TPM_AR := %X\n", getValue( HMI__STMSG_WhlPlsCnt_TPM_AR ) );        filePutString( buffer, elcount( buffer ), hFile );
    snprintf( buffer, elcount( buffer ), "0.0000 HMI__STMSGT_WhlPlsCnt_TPM_AR := %X\n", getValue( HMI__STMSGT_WhlPlsCnt_TPM_AR ) );        filePutString( buffer, elcount( buffer ), hFile );
    snprintf( buffer, elcount( buffer ), "0.0000 HMI_CRC_WhlPlsCnt_TPM := %X\n", getValue( HMI_CRC_WhlPlsCnt_TPM ) );        filePutString( buffer, elcount( buffer ), hFile );
    snprintf( buffer, elcount( buffer ), "0.0000 HMI_CRC_WhlPlsCnt_TPM_Auto := %X\n", getValue( HMI_CRC_WhlPlsCnt_TPM_Auto ) );        filePutString( buffer, elcount( buffer ), hFile );
    snprintf( buffer, elcount( buffer ), "0.0000 HMI_CRC_WhlPlsCnt_TPM_Profile_02 := %X\n", getValue( HMI_CRC_WhlPlsCnt_TPM_Profile_02 ) );        filePutString( buffer, elcount( buffer ), hFile );
    snprintf( buffer, elcount( buffer ), "0.0000 HMI_Rsrv1_WhlPlsCnt_TPM := %X\n", getValue( HMI_Rsrv1_WhlPlsCnt_TPM ) );        filePutString( buffer, elcount( buffer ), hFile );
    snprintf( buffer, elcount( buffer ), "0.0000 HMI_Rsrv2_WhlPlsCnt_TPM := %X\n", getValue( HMI_Rsrv2_WhlPlsCnt_TPM ) );        filePutString( buffer, elcount( buffer ), hFile );
    snprintf( buffer, elcount( buffer ), "0.0000 HMI_SQC_WhlPlsCnt_TPM := %X\n", getValue( HMI_SQC_WhlPlsCnt_TPM ) );        filePutString( buffer, elcount( buffer ), hFile );
    snprintf( buffer, elcount( buffer ), "0.0000 HMI_SQC_WhlPlsCnt_TPM_Auto := %X\n", getValue( HMI_SQC_WhlPlsCnt_TPM_Auto ) );        filePutString( buffer, elcount( buffer ), hFile );
    snprintf( buffer, elcount( buffer ), "0.0000 HMI_WhlPlsCnt_FL := %X\n", getValue( HMI_WhlPlsCnt_FL_TPM ) );        filePutString( buffer, elcount( buffer ), hFile );
    snprintf( buffer, elcount( buffer ), "0.0000 HMI_WhlPlsCnt_FR := %X\n", getValue( HMI_WhlPlsCnt_FR_TPM ) );        filePutString( buffer, elcount( buffer ), hFile );
    snprintf( buffer, elcount( buffer ), "0.0000 HMI_WhlPlsCnt_RL := %X\n", getValue( HMI_WhlPlsCnt_RL_TPM ) );        filePutString( buffer, elcount( buffer ), hFile );
    snprintf( buffer, elcount( buffer ), "0.0000 HMI_WhlPlsCnt_RR := %X\n", getValue( HMI_WhlPlsCnt_RR_TPM ) );        filePutString( buffer, elcount( buffer ), hFile );
    snprintf( buffer, elcount( buffer ), "0.0000 HMI_WhlPlsCnt_TmStmp := %X\n", getValue( HMI_WhlPlsCnt_TmStmp ) );        filePutString( buffer, elcount( buffer ), hFile );
}
/*@@end*/

/*@@timer:_tWhlPlsCnt_TPM_AR:*/
on timer _tWhlPlsCnt_TPM_AR
{
    putValue( HMI__STMSG_WhlPlsCnt_TPM_AR, 0 );
}
/*@@end*/

/*@@envVar:HMI__STMSG_WhlPlsCnt_TPM_AR:*/
on EnvVar HMI__STMSG_WhlPlsCnt_TPM_AR
{
    long tDelay;
    if( getValue( this ) == 2 )
    {
        tDelay = getValue( HMI__STMSGT_WhlPlsCnt_TPM_AR );
        if( tDelay > 0)    
            setTimer( _tWhlPlsCnt_TPM_AR, tDelay );
        else
            putValue( HMI__STMSG_WhlPlsCnt_TPM_AR, 0 );
    }
}
/*@@end*/

/*@@envVar:HMI_Rsrv1_WhlPlsCnt_TPM:*/
on EnvVar HMI_Rsrv1_WhlPlsCnt_TPM
{
    _mWhlPlsCnt_TPM_AR.Rsrv1_WhlPlsCnt_TPM.phys = getValue(this);
}
/*@@end*/

/*@@envVar:HMI_Rsrv2_WhlPlsCnt_TPM:*/
on EnvVar HMI_Rsrv2_WhlPlsCnt_TPM
{
    _mWhlPlsCnt_TPM_AR.Rsrv2_WhlPlsCnt_TPM.phys = getValue(this);
}
/*@@end*/

/*@@envVar:HMI_WhlPlsCnt_FL_TPM:*/
on EnvVar HMI_WhlPlsCnt_FL_TPM
{
    _mWhlPlsCnt_TPM_AR.WhlPlsCnt_FL.phys = getValue(this);
}
/*@@end*/

/*@@envVar:HMI_WhlPlsCnt_FR_TPM:*/
on EnvVar HMI_WhlPlsCnt_FR_TPM
{
    _mWhlPlsCnt_TPM_AR.WhlPlsCnt_FR.phys = getValue(this);
}
/*@@end*/

/*@@envVar:HMI_WhlPlsCnt_RL_TPM:*/
on EnvVar HMI_WhlPlsCnt_RL_TPM
{
    _mWhlPlsCnt_TPM_AR.WhlPlsCnt_RL.phys = getValue(this);
}
/*@@end*/

/*@@envVar:HMI_WhlPlsCnt_RR_TPM:*/
on EnvVar HMI_WhlPlsCnt_RR_TPM
{
    _mWhlPlsCnt_TPM_AR.WhlPlsCnt_RR.phys = getValue(this);
}
/*@@end*/

/*@@envVar:HMI_WhlPlsCnt_TmStmp:*/
on EnvVar HMI_WhlPlsCnt_TmStmp
{
    _mWhlPlsCnt_TPM_AR.WhlPlsCnt_TmStmp.phys = getValue(this);
}
/*@@end*/

/*@@caplFunc:WIA_EngTrq_AR_check_output():*/
WIA_EngTrq_AR_check_output()
{
    if( !getValue( HMI__STMSG_WIA_EngTrq_AR ) )
    {
        // Botschaft WIA_EngTrq_AR ID: 1149 --- Sendeart 0 cyclicX --- 
        _WIA_EngTrq_AR_Cnt--;
        if( _WIA_EngTrq_AR_Cnt < 1 )
        {
            // Nachricht wg. abgelaufenem Zyklus ausgeben
            WIA_EngTrq_AR_output();
            // Zyklus-Zähler zurücksetzen
            _WIA_EngTrq_AR_Cnt = _WIA_EngTrq_AR_CycleCount;
        }
    }
}
/*@@end*/

/*@@caplFunc:WIA_EngTrq_AR_init():*/
WIA_EngTrq_AR_init()
{   /* Botschaft WIA_EngTrq_AR ID: 1149 --- Sendeart 0 cyclicX --- 
BA_ "ApplMessage" BO_ 1149 0;
BA_ "NmAsrMessage" BO_ 1149 0;
BA_ "GenMsgMinAcceptLength" BO_ 1149 6;
BA_ "GenMsgILSupport" BO_ 1149 1;
BA_ "DiagState" BO_ 1149 0;
BA_ "DiagRequest" BO_ 1149 0;
BA_ "DiagResponse" BO_ 1149 0;
BA_ "GenMsgStartValue" BO_ 1149 "0";
BA_ "GenMsgCycleTime" BO_ 1149 500;
BA_ "GenMsgSendType" BO_ 1149 0;
    */
    _WIA_EngTrq_AR_Timebase =      c_tDBKomTimer_20ms;
    _WIA_EngTrq_AR_CycleCount =   500 / _WIA_EngTrq_AR_Timebase;
    _WIA_EngTrq_AR_StartDelay =     0 / _WIA_EngTrq_AR_Timebase;
    _WIA_EngTrq_AR_Cnt = _WIA_EngTrq_AR_StartDelay;

    putValue( HMI__STMSGSD_WIA_EngTrq_AR, _WIA_EngTrq_AR_StartDelay * _WIA_EngTrq_AR_Timebase );

    _mWIA_EngTrq_AR.WIA_EngTrqMax.phys = getValue( HMI_WIA_EngTrqMax );
    _mWIA_EngTrq_AR.WIA_EngTrqMin.phys = getValue( HMI_WIA_EngTrqMin );
    _mWIA_EngTrq_AR.WIA_EngTrqStatic.phys = getValue( HMI_WIA_EngTrqStatic );
}
/*@@end*/

/*@@caplFunc:WIA_EngTrq_AR_output():*/
WIA_EngTrq_AR_output(void)
{
    output( _mWIA_EngTrq_AR );
}
/*@@end*/

/*@@caplFunc:WIA_EngTrq_AR_saveEnvVars(dword):*/
WIA_EngTrq_AR_saveEnvVars( dword hFile )
{
    filePutString("\n// Knoten EIS: WIA_EngTrq_AR\n", 25, hFile );
    snprintf( buffer, elcount( buffer ), "0.0000 HMI__STMSG_WIA_EngTrq_AR := %X\n", getValue( HMI__STMSG_WIA_EngTrq_AR ) );        filePutString ( buffer, elcount( buffer ), hFile );
    snprintf( buffer, elcount( buffer ), "0.0000 HMI__STMSGT_WIA_EngTrq_AR := %X\n", getValue( HMI__STMSGT_WIA_EngTrq_AR ) );        filePutString ( buffer, elcount( buffer ), hFile );
    snprintf( buffer, elcount( buffer ), "0.0000 HMI_WIA_EngTrqMax := %X\n", getValue( HMI_WIA_EngTrqMax ) );        filePutString ( buffer, elcount( buffer ), hFile );
    snprintf( buffer, elcount( buffer ), "0.0000 HMI_WIA_EngTrqMin := %X\n", getValue( HMI_WIA_EngTrqMin ) );        filePutString ( buffer, elcount( buffer ), hFile );
    snprintf( buffer, elcount( buffer ), "0.0000 HMI_WIA_EngTrqStatic := %X\n", getValue( HMI_WIA_EngTrqStatic ) );        filePutString ( buffer, elcount( buffer ), hFile );
}
/*@@end*/

/*@@timer:_tWIA_EngTrq_AR:*/
on timer _tWIA_EngTrq_AR
{
    putValue( HMI__STMSG_WIA_EngTrq_AR, 0 );
}
/*@@end*/

/*@@envVar:HMI__STMSG_WIA_EngTrq_AR:*/
on EnvVar HMI__STMSG_WIA_EngTrq_AR
{
    long tDelay;
    if( getValue( this ) == 2 )
    {
        tDelay = getValue( HMI__STMSGT_WIA_EngTrq_AR );
        if( tDelay > 0)    
            setTimer( _tWIA_EngTrq_AR, tDelay );
        else
            putValue( HMI__STMSG_WIA_EngTrq_AR, 0 );
    }
}
/*@@end*/

/*@@envVar:HMI_WIA_EngTrqMax:*/
on EnvVar HMI_WIA_EngTrqMax
{
    _mWIA_EngTrq_AR.WIA_EngTrqMax.phys = getValue(this);
}
/*@@end*/

/*@@envVar:HMI_WIA_EngTrqMin:*/
on EnvVar HMI_WIA_EngTrqMin
{
    _mWIA_EngTrq_AR.WIA_EngTrqMin.phys = getValue(this);
}
/*@@end*/

/*@@envVar:HMI_WIA_EngTrqStatic:*/
on EnvVar HMI_WIA_EngTrqStatic
{
    _mWIA_EngTrq_AR.WIA_EngTrqStatic.phys = getValue(this);
}
/*@@end*/

/*@@caplFunc:Wpr_Stat_AR_check_output():*/
Wpr_Stat_AR_check_output()
{
    if( !getValue( HMI__STMSG_Wpr_Stat_AR ) )
    {
        // Botschaft Wpr_Stat_AR ID: 845 --- Sendeart 5 cyclicAndSpontanWithDelay --- 
        _Wpr_Stat_AR_Cnt--;
        if( _Wpr_Stat_AR_Cnt < 1 )
        {
            // Nachricht wg. abgelaufenem Zyklus ausgeben
            Wpr_Stat_AR_output();
            _Wpr_Stat_AR_Cnt = _Wpr_Stat_AR_CycleCount; // Zyklus-Zähler zurücksetzen
            _Wpr_Stat_AR_SpontanFlag = 0; // Spontan-Flag zurücksetzen
        }
        else if( _Wpr_Stat_AR_SpontanFlag)
        {
            // Nachricht wg. spontaner Änderung ausgeben
            Wpr_Stat_AR_output();
            _Wpr_Stat_AR_SpontanFlag = 0; // Spontan-Flag zurücksetzen
        }
    }
}
/*@@end*/

/*@@caplFunc:Wpr_Stat_AR_init():*/
Wpr_Stat_AR_init()
{   /* Botschaft Wpr_Stat_AR ID: 845 --- Sendeart 5 cyclicAndSpontanWithDelay --- 
BA_ "ApplMessage" BO_ 845 0;
BA_ "NmAsrMessage" BO_ 845 0;
BA_ "GenMsgMinAcceptLength" BO_ 845 2;
BA_ "GenMsgILSupport" BO_ 845 1;
BA_ "DiagState" BO_ 845 0;
BA_ "DiagRequest" BO_ 845 0;
BA_ "DiagResponse" BO_ 845 0;
BA_ "GenMsgStartValue" BO_ 845 "0";
BA_ "GenMsgDelayTime" BO_ 845 5;
BA_ "GenMsgNrOfRepetitions" BO_ 845 0;
BA_ "GenMsgCycleTime" BO_ 845 1000;
BA_ "GenMsgSendType" BO_ 845 5;
    */
    _Wpr_Stat_AR_Timebase =        c_tDBKomTimer_20ms;
    _Wpr_Stat_AR_CycleCount =    1000 / _Wpr_Stat_AR_Timebase;
    _Wpr_Stat_AR_StartDelay =       0 / _Wpr_Stat_AR_Timebase;
    _Wpr_Stat_AR_Cnt = _Wpr_Stat_AR_StartDelay;
    _Wpr_Stat_AR_SpontanFlag = 0;

    putValue( HMI__STMSGSD_Wpr_Stat_AR, _Wpr_Stat_AR_StartDelay * _Wpr_Stat_AR_Timebase );

    _mWpr_Stat_AR.HL_Wash_Actv.phys = getValue( HMI_HL_Wash_Actv );
    _mWpr_Stat_AR.Splash.phys = getValue( HMI_Splash );
    _mWpr_Stat_AR.Wpr_R_Actv.phys = getValue( HMI_Wpr_R_Actv );
    _mWpr_Stat_AR.Wpr_R_On_Rq.phys = getValue( HMI_Wpr_R_On_Rq );
    _mWpr_Stat_AR.Wpr_Stat.phys = getValue( HMI_Wpr_Stat );
    _mWpr_Stat_AR.WprFltMsgDisp_Rq_WPRM.phys = getValue( HMI_WprFltMsgDisp_Rq_WPRM );
    _mWpr_Stat_AR.WprOutsdPkPosn.phys = getValue( HMI_WprOutsdPkPosn );
}
/*@@end*/

/*@@caplFunc:Wpr_Stat_AR_output():*/
Wpr_Stat_AR_output(void)
{
    output( _mWpr_Stat_AR );
}
/*@@end*/

/*@@caplFunc:Wpr_Stat_AR_saveEnvVars(dword):*/
Wpr_Stat_AR_saveEnvVars( dword hFile )
{
    filePutString("\n// Knoten EIS: Wpr_Stat_AR\n", 25, hFile );
    snprintf( buffer, elcount( buffer ), "0.0000 HMI__STMSG_Wpr_Stat_AR := %X\n", getValue( HMI__STMSG_Wpr_Stat_AR ) );        filePutString ( buffer, elcount( buffer ), hFile );
    snprintf( buffer, elcount( buffer ), "0.0000 HMI__STMSGT_Wpr_Stat_AR := %X\n", getValue( HMI__STMSGT_Wpr_Stat_AR ) );        filePutString ( buffer, elcount( buffer ), hFile );
    snprintf( buffer, elcount( buffer ), "0.0000 HMI_HL_Wash_Actv := %X\n", getValue( HMI_HL_Wash_Actv ) );        filePutString ( buffer, elcount( buffer ), hFile );
    snprintf( buffer, elcount( buffer ), "0.0000 HMI_Splash := %X\n", getValue( HMI_Splash ) );        filePutString ( buffer, elcount( buffer ), hFile );
    snprintf( buffer, elcount( buffer ), "0.0000 HMI_Wpr_R_Actv := %X\n", getValue( HMI_Wpr_R_Actv ) );        filePutString ( buffer, elcount( buffer ), hFile );
    snprintf( buffer, elcount( buffer ), "0.0000 HMI_Wpr_R_On_Rq := %X\n", getValue( HMI_Wpr_R_On_Rq ) );        filePutString ( buffer, elcount( buffer ), hFile );
    snprintf( buffer, elcount( buffer ), "0.0000 HMI_Wpr_Stat := %X\n", getValue( HMI_Wpr_Stat ) );        filePutString ( buffer, elcount( buffer ), hFile );
    snprintf( buffer, elcount( buffer ), "0.0000 HMI_WprFltMsgDisp_Rq_WPRM := %X\n", getValue( HMI_WprFltMsgDisp_Rq_WPRM ) );        filePutString ( buffer, elcount( buffer ), hFile );
    snprintf( buffer, elcount( buffer ), "0.0000 HMI_WprOutsdPkPosn := %X\n", getValue( HMI_WprOutsdPkPosn ) );        filePutString ( buffer, elcount( buffer ), hFile );
}
/*@@end*/

/*@@timer:_tWpr_Stat_AR:*/
on timer _tWpr_Stat_AR
{
    putValue( HMI__STMSG_Wpr_Stat_AR, 0 );
}
/*@@end*/

/*@@envVar:HMI__STMSG_Wpr_Stat_AR:*/
on EnvVar HMI__STMSG_Wpr_Stat_AR
{
    long tDelay;
    if( getValue( this ) == 2 )
    {
        tDelay = getValue( HMI__STMSGT_Wpr_Stat_AR );
        if( tDelay > 0)    
            setTimer( _tWpr_Stat_AR, tDelay );
        else
            putValue( HMI__STMSG_Wpr_Stat_AR, 0 );
    }
}
/*@@end*/

/*@@envVar:HMI_HL_Wash_Actv:*/
on EnvVar HMI_HL_Wash_Actv
{
    _mWpr_Stat_AR.HL_Wash_Actv.phys = getValue(this);
    _Wpr_Stat_AR_SpontanFlag = 1;
}
/*@@end*/

/*@@envVar:HMI_Splash:*/
on EnvVar HMI_Splash
{
    _mWpr_Stat_AR.Splash.phys = getValue(this);
    _Wpr_Stat_AR_SpontanFlag = 1;
}
/*@@end*/

/*@@envVar:HMI_Wpr_R_Actv:*/
on EnvVar HMI_Wpr_R_Actv
{
    _mWpr_Stat_AR.Wpr_R_Actv.phys = getValue(this);
    _Wpr_Stat_AR_SpontanFlag = 1;
}
/*@@end*/

/*@@envVar:HMI_Wpr_R_On_Rq:*/
on EnvVar HMI_Wpr_R_On_Rq
{
    _mWpr_Stat_AR.Wpr_R_On_Rq.phys = getValue(this);
    _Wpr_Stat_AR_SpontanFlag = 1;
}
/*@@end*/

/*@@envVar:HMI_Wpr_Stat:*/
on EnvVar HMI_Wpr_Stat
{
    _mWpr_Stat_AR.Wpr_Stat.phys = getValue(this);
    _Wpr_Stat_AR_SpontanFlag = 1;
}
/*@@end*/

/*@@envVar:HMI_WprFltMsgDisp_Rq_WPRM:*/
on EnvVar HMI_WprFltMsgDisp_Rq_WPRM
{
    _mWpr_Stat_AR.WprFltMsgDisp_Rq_WPRM.phys = getValue(this);
    _Wpr_Stat_AR_SpontanFlag = 1;
}
/*@@end*/

/*@@envVar:HMI_WprOutsdPkPosn:*/
on EnvVar HMI_WprOutsdPkPosn
{
    _mWpr_Stat_AR.WprOutsdPkPosn.phys = getValue(this);
    _Wpr_Stat_AR_SpontanFlag = 1;
}
/*@@end*/

/*@@caplFunc:WPT_Stat2_AR_check_output():*/
WPT_Stat2_AR_check_output()
{
    if( !getValue( HMI__STMSG_WPT_Stat2_AR ) )
    {
        // Botschaft WPT_Stat2_AR ID: 634 --- Sendeart 5 cyclicAndSpontanWithDelay --- 
        _WPT_Stat2_AR_Cnt--;
        if( _WPT_Stat2_AR_Cnt < 1 )
        {
            WPT_Stat2_AR_output(); // Nachricht wg. abgelaufenem Zyklus ausgeben
            _WPT_Stat2_AR_Cnt = _WPT_Stat2_AR_CycleCount; // Zyklus-Zähler zurücksetzen
            _WPT_Stat2_AR_SpontanFlag = 0; // Spontan-Flag zurücksetzen
        }
        else if( _WPT_Stat2_AR_SpontanFlag)
        {
            WPT_Stat2_AR_output(); // Nachricht wg. spontaner Änderung ausgeben
            _WPT_Stat2_AR_SpontanFlag = 0; // Spontan-Flag zurücksetzen
        }
    }
}
/*@@end*/

/*@@caplFunc:WPT_Stat2_AR_init():*/
WPT_Stat2_AR_init()
{   /* Botschaft WPT_Stat2_AR ID: 634 --- Sendeart 5 cyclicAndSpontanWithDelay --- 
BA_ "ApplMessage" BO_ 634 0;
BA_ "NmAsrMessage" BO_ 634 0;
BA_ "GenMsgMinAcceptLength" BO_ 634 8;
BA_ "GenMsgILSupport" BO_ 634 1;
BA_ "DiagState" BO_ 634 0;
BA_ "DiagRequest" BO_ 634 0;
BA_ "DiagResponse" BO_ 634 0;
BA_ "GenMsgStartValue" BO_ 634 "0";
BA_ "GenMsgDelayTime" BO_ 634 20;
BA_ "GenMsgNrOfRepetition" BO_ 634 0;
BA_ "GenMsgCycleTime" BO_ 634 200;
BA_ "GenMsgSendType" BO_ 634 5;
    */
    _WPT_Stat2_AR_Timebase =        c_tDBKomTimer_20ms;
    _WPT_Stat2_AR_CycleCount =     200 / _WPT_Stat2_AR_Timebase;
    _WPT_Stat2_AR_StartDelay =       0 / _WPT_Stat2_AR_Timebase;
    _WPT_Stat2_AR_Cnt = _WPT_Stat2_AR_StartDelay;
    _WPT_Stat2_AR_SpontanFlag = 0;

    putValue( HMI__STMSGSD_WPT_Stat2_AR, _WPT_Stat2_AR_StartDelay * _WPT_Stat2_AR_Timebase );

    _mWPT_Stat2_AR.WPT_GPM_CPM_Con_Stat.phys = getValue( HMI_WPT_GPM_CPM_Con_Stat );
    _mWPT_Stat2_AR.WPT_ObjDtct.phys = getValue( HMI_WPT_ObjDtct );
    _mWPT_Stat2_AR.WPT_Posn_DstrtnAngl.phys = getValue( HMI_WPT_Posn_DstrtnAngl );
    _mWPT_Stat2_AR.WPT_Posn_Stat.phys = getValue( HMI_WPT_Posn_Stat );
    _mWPT_Stat2_AR.WPT_Posn_Stat_Disp_Rq.phys = getValue( HMI_WPT_Posn_Stat_Disp_Rq );
    _mWPT_Stat2_AR.WPT_Posn_X_Disp_Rq.phys = getValue( HMI_WPT_Posn_X_Disp_Rq );
    _mWPT_Stat2_AR.WPT_Posn_Y_Disp_Rq.phys = getValue( HMI_WPT_Posn_Y_Disp_Rq );
    _mWPT_Stat2_AR.WPT_Sound_Rq.phys = getValue( HMI_WPT_Sound_Rq );
}
/*@@end*/

/*@@caplFunc:WPT_Stat2_AR_output():*/
WPT_Stat2_AR_output(void)
{
    output( _mWPT_Stat2_AR );
}
/*@@end*/

/*@@caplFunc:WPT_Stat2_AR_saveEnvVars(dword):*/
WPT_Stat2_AR_saveEnvVars( dword hFile )
{
    filePutString("\n// Knoten EIS: WPT_Stat2_AR\n", 25, hFile );
    snprintf( buffer, elcount( buffer ), "0.0000 HMI__STMSG_WPT_Stat2_AR := %X\n", getValue( HMI__STMSG_WPT_Stat2_AR ) );        filePutString ( buffer, elcount( buffer ), hFile );
    snprintf( buffer, elcount( buffer ), "0.0000 HMI__STMSGT_WPT_Stat2_AR := %X\n", getValue( HMI__STMSGT_WPT_Stat2_AR ) );        filePutString ( buffer, elcount( buffer ), hFile );
    snprintf( buffer, elcount( buffer ), "0.0000 HMI_WPT_GPM_CPM_Con_Stat := %X\n", getValue( HMI_WPT_GPM_CPM_Con_Stat ) );        filePutString ( buffer, elcount( buffer ), hFile );
    snprintf( buffer, elcount( buffer ), "0.0000 HMI_WPT_ObjDtct := %X\n", getValue( HMI_WPT_ObjDtct ) );        filePutString ( buffer, elcount( buffer ), hFile );
    snprintf( buffer, elcount( buffer ), "0.0000 HMI_WPT_Posn_DstrtnAngl := %X\n", getValue( HMI_WPT_Posn_DstrtnAngl ) );        filePutString ( buffer, elcount( buffer ), hFile );
    snprintf( buffer, elcount( buffer ), "0.0000 HMI_WPT_Posn_Stat := %X\n", getValue( HMI_WPT_Posn_Stat ) );        filePutString ( buffer, elcount( buffer ), hFile );
    snprintf( buffer, elcount( buffer ), "0.0000 HMI_WPT_Posn_Stat_Disp_Rq := %X\n", getValue( HMI_WPT_Posn_Stat_Disp_Rq ) );        filePutString ( buffer, elcount( buffer ), hFile );
    snprintf( buffer, elcount( buffer ), "0.0000 HMI_WPT_Posn_X_Disp_Rq := %X\n", getValue( HMI_WPT_Posn_X_Disp_Rq ) );        filePutString ( buffer, elcount( buffer ), hFile );
    snprintf( buffer, elcount( buffer ), "0.0000 HMI_WPT_Posn_Y_Disp_Rq := %X\n", getValue( HMI_WPT_Posn_Y_Disp_Rq ) );        filePutString ( buffer, elcount( buffer ), hFile );
    snprintf( buffer, elcount( buffer ), "0.0000 HMI_WPT_Sound_Rq := %X\n", getValue( HMI_WPT_Sound_Rq ) );        filePutString ( buffer, elcount( buffer ), hFile );
}
/*@@end*/

/*@@timer:_tWPT_Stat2_AR:*/
on timer _tWPT_Stat2_AR
{
    putValue( HMI__STMSG_WPT_Stat2_AR, 0 );
}
/*@@end*/

/*@@envVar:HMI__STMSG_WPT_Stat2_AR:*/
on EnvVar HMI__STMSG_WPT_Stat2_AR
{
    long tDelay;
    if( getValue( this ) == 2 )
    {
        tDelay = getValue( HMI__STMSGT_WPT_Stat2_AR );
        if( tDelay > 0)    
            setTimer( _tWPT_Stat2_AR, tDelay );
        else
            putValue( HMI__STMSG_WPT_Stat2_AR, 0 );
    }
}
/*@@end*/

/*@@envVar:HMI_WPT_GPM_CPM_Con_Stat:*/
on EnvVar HMI_WPT_GPM_CPM_Con_Stat
{
    _mWPT_Stat2_AR.WPT_GPM_CPM_Con_Stat.phys = getValue(this);
    _WPT_Stat2_AR_SpontanFlag = 1;
}
/*@@end*/

/*@@envVar:HMI_WPT_ObjDtct:*/
on EnvVar HMI_WPT_ObjDtct
{
    _mWPT_Stat2_AR.WPT_ObjDtct.phys = getValue(this);
    _WPT_Stat2_AR_SpontanFlag = 1;
}
/*@@end*/

/*@@envVar:HMI_WPT_Posn_DstrtnAngl:*/
on EnvVar HMI_WPT_Posn_DstrtnAngl
{
    _mWPT_Stat2_AR.WPT_Posn_DstrtnAngl.phys = getValue(this);
    _WPT_Stat2_AR_SpontanFlag = 1;
}
/*@@end*/

/*@@envVar:HMI_WPT_Posn_Stat:*/
on EnvVar HMI_WPT_Posn_Stat
{
    _mWPT_Stat2_AR.WPT_Posn_Stat.phys = getValue(this);
    _WPT_Stat2_AR_SpontanFlag = 1;
}
/*@@end*/

/*@@envVar:HMI_WPT_Posn_Stat_Disp_Rq:*/
on EnvVar HMI_WPT_Posn_Stat_Disp_Rq
{
    _mWPT_Stat2_AR.WPT_Posn_Stat_Disp_Rq.phys = getValue(this);
    _WPT_Stat2_AR_SpontanFlag = 1;
}
/*@@end*/

/*@@envVar:HMI_WPT_Posn_X_Disp_Rq:*/
on EnvVar HMI_WPT_Posn_X_Disp_Rq
{
    _mWPT_Stat2_AR.WPT_Posn_X_Disp_Rq.phys = getValue(this);
    _WPT_Stat2_AR_SpontanFlag = 1;
}
/*@@end*/

/*@@envVar:HMI_WPT_Posn_Y_Disp_Rq:*/
on EnvVar HMI_WPT_Posn_Y_Disp_Rq
{
    _mWPT_Stat2_AR.WPT_Posn_Y_Disp_Rq.phys = getValue(this);
    _WPT_Stat2_AR_SpontanFlag = 1;
}
/*@@end*/

/*@@envVar:HMI_WPT_Sound_Rq:*/
on EnvVar HMI_WPT_Sound_Rq
{
    _mWPT_Stat2_AR.WPT_Sound_Rq.phys = getValue(this);
    _WPT_Stat2_AR_SpontanFlag = 1;
}
/*@@end*/

