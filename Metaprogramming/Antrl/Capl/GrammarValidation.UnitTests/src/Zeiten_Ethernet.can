/*@!Encoding:1252*/
variables
{
  msTimer Uhr;
  long    localtime[9];
}

on start
{
  setTimerCyclic (Uhr, 100);
}

on timer Uhr
{
  if (@Env_time_Diagnose_Ethernet == 1)
  {
    getLocalTime(localtime);
    $UH_Jahr_XIX_Diagnose_01_XIX_E3V_VLAN_Infotainment      = localtime[5]+1900;
    $UH_Monat_XIX_Diagnose_01_XIX_E3V_VLAN_Infotainment     = localtime[4]+1;
    $UH_Tag_XIX_Diagnose_01_XIX_E3V_VLAN_Infotainment       = localtime[3];
    $UH_Stunde_XIX_Diagnose_01_XIX_E3V_VLAN_Infotainment    = localtime[2];
    $UH_Minute_XIX_Diagnose_01_XIX_E3V_VLAN_Infotainment    = localtime[1];
    $UH_Sekunde_XIX_Diagnose_01_XIX_E3V_VLAN_Infotainment   = localtime[0];
  }
}