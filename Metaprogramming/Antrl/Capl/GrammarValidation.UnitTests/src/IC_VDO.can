/*@!Encoding:1252*/
/*
Copyright ( C ) Continental AG 2012

Date of creation :  14.04.2011

Created by :                 Hans Jürgen Hipp


Version info

1.00	   10.2013	Inital versioning introduced
1.1	04.11.2013	HMI_2013_42a database

*/


variables
{
    const TRUE =      0xAA;
    const FALSE =     0x00;
    const cManual =   0x00;
    const cAuto =     0xAA;
    
    const byte VS30_with_HU    = 0x01;
    const byte VS30_without_HU = 0x00;
    
    /* Botschaft ActvComf_Rq_AR: 850 --- Sendeart 5 cyclicAndSpontanWithDelay --- 
BA_ "ApplMessage" BO_ 850 0;
BA_ "NmAsrMessage" BO_ 850 0;
BA_ "GenMsgMinAcceptLength" BO_ 850 8;
BA_ "GenMsgILSupport" BO_ 850 1;
BA_ "DiagState" BO_ 850 0;
BA_ "DiagRequest" BO_ 850 0;
BA_ "DiagResponse" BO_ 850 0;
BA_ "GenMsgStartValue" BO_ 850 "0";
BA_ "GenMsgStartDelayTime" BO_ 850 170;
BA_ "GenMsgDelayTime" BO_ 850 200;
BA_ "GenMsgNrOfRepetition" BO_ 850 0;
BA_ "GenMsgCycleTime" BO_ 850 1000;
BA_ "GenMsgSendType" BO_ 850 5;
*/
  
    word       _ActvComf_Rq_AR_CycleTime =           1000;
    const word _ActvComf_Rq_AR_OnEventDetectTime =    990;
    byte       _ActvComf_Rq_AR_OnEventTrap_Active =     0;
    msTimer    tActvComf_Rq_AR_OnEventTrap;
    msTimer    tActvComf_Rq_AR_OnEventIND;
	
	/* Botschaft Config_HU_Disp_Rq_AR: 1090 --- Sendeart 5 cyclicAndSpontanWithDelay --- 
BA_ "ApplMessage" BO_ 1090 0;
BA_ "NmAsrMessage" BO_ 1090 0;
BA_ "GenMsgMinAcceptLength" BO_ 1090 8;
BA_ "GenMsgILSupport" BO_ 1090 1;
BA_ "DiagState" BO_ 1090 0;
BA_ "DiagRequest" BO_ 1090 0;
BA_ "DiagResponse" BO_ 1090 0;
BA_ "GenMsgStartValue" BO_ 1090 "0";
BA_ "GenMsgStartDelayTime" BO_ 1090 230;
BA_ "GenMsgDelayTime" BO_ 1090 50;
BA_ "GenMsgNrOfRepetition" BO_ 1090 0;
BA_ "GenMsgCycleTime" BO_ 1090 1000;
BA_ "GenMsgSendType" BO_ 1090 5;	
*/
    word       _Config_HU_Disp_Rq_AR_CycleTime =           1000;
    const word _Config_HU_Disp_Rq_AR_OnEventDetectTime =    990;
    byte       _Config_HU_Disp_Rq_AR_OnEventTrap_Active =     0;
    msTimer    tConfig_HU_Disp_Rq_AR_OnEventTrap;
    msTimer    tConfig_HU_Disp_Rq_AR_OnEventIND;

  /* Botschaft Config_HU3_AR: 1123 --- Sendeart 5 cyclicAndSpontanWithDelay --- 
BA_ "ApplMessage" BO_ 1123 0;
BA_ "NmAsrMessage" BO_ 1123 0;
BA_ "GenMsgMinAcceptLength" BO_ 1123 8;
BA_ "GenMsgILSupport" BO_ 1123 1;
BA_ "DiagState" BO_ 1123 0;
BA_ "DiagRequest" BO_ 1123 0;
BA_ "DiagResponse" BO_ 1123 0;
BA_ "GenMsgStartValue" BO_ 1123 "0";
BA_ "GenMsgStartDelayTime" BO_ 1123 155;
BA_ "GenMsgDelayTime" BO_ 1123 50;
BA_ "GenMsgNrOfRepetition" BO_ 1123 0;
BA_ "GenMsgCycleTime" BO_ 1123 1000;
BA_ "GenMsgSendType" BO_ 1123 5;
*/
  
	  word       _Config_HU2_AR_CycleTime =           1000;
    const word _Config_HU2_AR_OnEventDetectTime =    990;
    byte       _Config_HU2_AR_OnEventTrap_Active =     0;
    msTimer    tConfig_HU2_AR_OnEventTrap;
    msTimer    tConfig_HU2_AR_OnEventIND;
  
	/* Botschaft Config_HU3_AR: 1188 --- Sendeart 5 cyclicAndSpontanWithDelay --- 
BA_ "ApplMessage" BO_ 1188 0;
BA_ "NmAsrMessage" BO_ 1188 0;
BA_ "GenMsgMinAcceptLength" BO_ 1188 8;
BA_ "GenMsgILSupport" BO_ 1188 1;
BA_ "DiagState" BO_ 1188 0;
BA_ "DiagRequest" BO_ 1188 0;
BA_ "DiagResponse" BO_ 1188 0;
BA_ "GenMsgStartValue" BO_ 1188 "0";
BA_ "GenMsgStartDelayTime" BO_ 1188 200;
BA_ "GenMsgDelayTime" BO_ 1188 20;
BA_ "GenMsgNrOfRepetition" BO_ 1188 0;
BA_ "GenMsgCycleTime" BO_ 1188 1000;
BA_ "GenMsgSendType" BO_ 1188 5;
*/	
	word       _Config_HU3_AR_CycleTime =           1000;
    const word _Config_HU3_AR_OnEventDetectTime =    990;
    byte       _Config_HU3_AR_OnEventTrap_Active =     0;
    msTimer    tConfig_HU3_AR_OnEventTrap;
    msTimer    tConfig_HU3_AR_OnEventIND;
	
	/* Botschaft Config_HU4_AR: 1124 --- Sendeart 5 cyclicAndSpontanWithDelay --- 
BA_ "ApplMessage" BO_ 1124 0;
BA_ "NmAsrMessage" BO_ 1124 0;
BA_ "GenMsgMinAcceptLength" BO_ 1124 8;
BA_ "GenMsgILSupport" BO_ 1124 1;
BA_ "DiagState" BO_ 1124 0;
BA_ "DiagRequest" BO_ 1124 0;
BA_ "DiagResponse" BO_ 1124 0;
BA_ "GenMsgStartValue" BO_ 1124 "0";
BA_ "GenMsgStartDelayTime" BO_ 1124 260;
BA_ "GenMsgDelayTime" BO_ 1124 50;
BA_ "GenMsgNrOfRepetition" BO_ 1124 0;
BA_ "GenMsgCycleTime" BO_ 1124 1000;
BA_ "GenMsgSendType" BO_ 1124 5;
*/	
	word       _Config_HU4_AR_CycleTime =           1000;
    const word _Config_HU4_AR_OnEventDetectTime =    990;
    byte       _Config_HU4_AR_OnEventTrap_Active =     0;
    msTimer    tConfig_HU4_AR_OnEventTrap;
    msTimer    tConfig_HU4_AR_OnEventIND;

	/* Botschaft Config_HU5_AR: 1124 --- Sendeart 5 cyclicAndSpontanWithDelay --- 
BA_ "ApplMessage" BO_ 1168 0;
BA_ "NmAsrMessage" BO_ 1168 0;
BA_ "GenMsgMinAcceptLength" BO_ 1168 8;
BA_ "GenMsgILSupport" BO_ 1168 1;
BA_ "DiagState" BO_ 1168 0;
BA_ "DiagRequest" BO_ 1168 0;
BA_ "DiagResponse" BO_ 1168 0;
BA_ "GenMsgStartValue" BO_ 1168 "0";
BA_ "GenMsgStartDelayTime" BO_ 1168 35;
BA_ "GenMsgDelayTime" BO_ 1168 50;
BA_ "GenMsgNrOfRepetition" BO_ 1168 0;
BA_ "GenMsgCycleTime" BO_ 1168 1000;
BA_ "GenMsgSendType" BO_ 1168 5;
*/	
	  word       _Config_HU5_AR_CycleTime =           1000;
    const word _Config_HU5_AR_OnEventDetectTime =    990;
    byte       _Config_HU5_AR_OnEventTrap_Active =     0;
    msTimer    tConfig_HU5_AR_OnEventTrap;
    msTimer    tConfig_HU5_AR_OnEventIND;	
	
	/* Botschaft Config_HU6_AR: 1168 --- Sendeart 5 cyclicAndSpontanWithDelay --- 
BA_ "ApplMessage" BO_ 1168 0;
BA_ "NmAsrMessage" BO_ 1168 0;
BA_ "GenMsgMinAcceptLength" BO_ 1168 8;
BA_ "GenMsgILSupport" BO_ 1168 1;
BA_ "DiagState" BO_ 1168 0;
BA_ "DiagRequest" BO_ 1168 0;
BA_ "DiagResponse" BO_ 1168 0;
BA_ "GenMsgStartValue" BO_ 1168 "0";
BA_ "GenMsgStartDelayTime" BO_ 1168 35;
BA_ "GenMsgDelayTime" BO_ 1168 50;
BA_ "GenMsgNrOfRepetition" BO_ 1168 0;
BA_ "GenMsgCycleTime" BO_ 1168 1000;
BA_ "GenMsgSendType" BO_ 1168 5;
*/	
	  word       _Config_HU6_AR_CycleTime =           1000;
    const word _Config_HU6_AR_OnEventDetectTime =    990;
    byte       _Config_HU6_AR_OnEventTrap_Active =     0;
    msTimer    tConfig_HU6_AR_OnEventTrap;
    msTimer    tConfig_HU6_AR_OnEventIND;
	
	/* Botschaft HU_DateTm_Rq_AR: 1019 --- Sendeart 5 cyclicAndSpontanWithDelay --- 
BA_ "ApplMessage" BO_ 1019 0;
BA_ "NmAsrMessage" BO_ 1019 0;
BA_ "GenMsgMinAcceptLength" BO_ 1019 8;
BA_ "GenMsgILSupport" BO_ 1019 1;
BA_ "DiagState" BO_ 1019 0;
BA_ "DiagRequest" BO_ 1019 0;
BA_ "DiagResponse" BO_ 1019 0;
BA_ "GenMsgStartValue" BO_ 1019 "0";
BA_ "GenMsgStartDelayTime" BO_ 1019 175;
BA_ "GenMsgDelayTime" BO_ 1019 100;
BA_ "GenMsgNrOfRepetition" BO_ 1019 0;
BA_ "GenMsgCycleTime" BO_ 1019 1000;
BA_ "GenMsgSendType" BO_ 1019 5;
*/
	  word       _HU_DateTm_Rq_AR_CycleTime =           1000;
    const word _HU_DateTm_Rq_AR_OnEventDetectTime =    990;
    byte       _HU_DateTm_Rq_AR_OnEventTrap_Active =     0;
    msTimer    tHU_DateTm_Rq_AR_OnEventTrap;
    msTimer    tHU_DateTm_Rq_AR_OnEventIND;  
  
    /* Botschaft Assyst_Rq_AR ID: 1187 --- Sendeart 5 cyclicAndSpontanWithDelay --- 
BA_ "ApplMessage" BO_ 1187 0;
BA_ "NmAsrMessage" BO_ 1187 0;
BA_ "GenMsgMinAcceptLength" BO_ 1187 3;
BA_ "GenMsgILSupport" BO_ 1187 1;
BA_ "DiagState" BO_ 1187 0;
BA_ "DiagRequest" BO_ 1187 0;
BA_ "DiagResponse" BO_ 1187 0;
BA_ "GenMsgStartValue" BO_ 1187 "0";
BA_ "GenMsgStartDelayTime" BO_ 1187 190;
BA_ "GenMsgDelayTime" BO_ 1187 20;
BA_ "GenMsgNrOfRepetitions" BO_ 1187 0;
BA_ "GenMsgCycleTime" BO_ 1187 1000;
BA_ "GenMsgSendType" BO_ 1187 5;
    */
    byte       _Assyst_Rq_AR_RXcounter;
    word       _Assyst_Rq_AR_CycleTime =           1000;
    const word _Assyst_Rq_AR_OnEventDetectTime =    990;
    byte       _Assyst_Rq_AR_OnEventTrap_Active =     0;
    msTimer    tAssyst_Rq_AR_OnEventTrap;
    msTimer    tAssyst_Rq_AR_OnEventIND;
    
    /* Botschaft BC_F_Stat4_AR ID: 661 --- Sendeart 5 cyclicAndSpontanWithDelay ---
BA_ "ApplMessage" BO_ 661 0;
BA_ "NmAsrMessage" BO_ 661 0;
BA_ "GenMsgMinAcceptLength" BO_ 661 4;
BA_ "GenMsgILSupport" BO_ 661 1;
BA_ "DiagState" BO_ 661 0;
BA_ "DiagRequest" BO_ 661 0;
BA_ "DiagResponse" BO_ 661 0;
BA_ "GenMsgStartValue" BO_ 661 "0";
BA_ "GenMsgStartDelayTime" BO_ 661 15;
BA_ "GenMsgDelayTime" BO_ 661 10;
BA_ "GenMsgNrOfRepetition" BO_ 661 0;
BA_ "GenMsgCycleTime" BO_ 661 100;
BA_ "GenMsgSendType" BO_ 661 5;
    */
    byte       _BC_F_Stat4_AR_RXcounter;
    word       _BC_F_Stat4_AR_CycleTime =            100;
    const word _BC_F_Stat4_AR_OnEventDetectTime =     90;
    byte       _BC_F_Stat4_AR_OnEventTrap_Active =     0;
    msTimer    tBC_F_Stat4_AR_OnEventTrap;
    msTimer    tBC_F_Stat4_AR_OnEventIND;
    
    /* Botschaft BLSM_Disp_Stat_AR ID: 157 --- Sendeart 2 --- 
BA_ "ApplMessage" BO_ 157 0;
BA_ "NmAsrMessage" BO_ 157 0;
BA_ "GenMsgMinAcceptLength" BO_ 157 8;
BA_ "GenMsgILSupport" BO_ 157 1;
BA_ "DiagState" BO_ 157 0;
BA_ "DiagRequest" BO_ 157 0;
BA_ "DiagResponse" BO_ 157 0;
BA_ "GenMsgStartValue" BO_ 157 "0";
BA_ "GenMsgStartDelayTime" BO_ 157 0;
BA_ "GenMsgDelayTime" BO_ 157 5;
BA_ "GenMsgCycleTime" BO_ 157 0;
BA_ "GenMsgCycleTimeActive" BO_ 157 20;
BA_ "GenMsgSendType" BO_ 157 2;
    */ 
    word       _BLSM_Disp_Stat_AR_CycleTime =           1000;
    const word _BLSM_Disp_Stat_AR_OnEventDetectTime =    990;
    byte       _BLSM_Disp_Stat_AR_OnEventTrap_Active =     0;
    msTimer    tBLSM_Disp_Stat_AR_OnEventTrap;
    msTimer    tBLSM_Disp_Stat_AR_OnEventIND;

    /* Botschaft Dimming_Stat_AR ID: 1081 --- Sendeart 5 cyclicAndSpontanWithDelay --- 
BA_ "ApplMessage" BO_ 1081 0;
BA_ "NmAsrMessage" BO_ 1081 0;
BA_ "GenMsgMinAcceptLength" BO_ 1081 4;
BA_ "GenMsgILSupport" BO_ 1081 1;
BA_ "DiagState" BO_ 1081 0;
BA_ "DiagRequest" BO_ 1081 0;
BA_ "DiagResponse" BO_ 1081 0;
BA_ "GenMsgStartValue" BO_ 1081 "0";
BA_ "GenMsgStartDelayTime" BO_ 1081 20;
BA_ "GenMsgDelayTime" BO_ 1081 50;
BA_ "GenMsgNrOfRepetitions" BO_ 1081 0;
BA_ "GenMsgCycleTime" BO_ 1081 200;
BA_ "GenMsgSendType" BO_ 1081 5;
    */ 
    word       _Dimming_Stat_AR_CycleTime =            200;
    byte       _Dimming_Stat_AR_CycleReduction =         0;
    byte      _cDimming_Stat_AR_CycleReductionValue =    5;
    const word _Dimming_Stat_AR_OnEventDetectTime =    190;
    byte       _Dimming_Stat_AR_OnEventTrap_Active =     0;
    msTimer    tDimming_Stat_AR_OnEventTrap;
    msTimer    tDimming_Stat_AR_OnEventIND;
    
    /* Botschaft Disp_IC_Rq_AR ID: 314 --- Sendeart 5 cyclicAndSpontanWithDelay --- 
BA_ "ApplMessage" BO_ 314 0;
BA_ "NmAsrMessage" BO_ 314 0;
BA_ "GenMsgMinAcceptLength" BO_ 314 6;
BA_ "GenMsgILSupport" BO_ 314 1;
BA_ "DiagState" BO_ 314 0;
BA_ "DiagRequest" BO_ 314 0;
BA_ "DiagResponse" BO_ 314 0;
BA_ "GenMsgStartValue" BO_ 314 "0";
BA_ "GenMsgStartDelayTime" BO_ 314 65;
BA_ "GenMsgDelayTime" BO_ 314 20;
BA_ "GenMsgNrOfRepetition" BO_ 314 0;
BA_ "GenMsgCycleTime" BO_ 314 100;
BA_ "GenMsgSendType" BO_ 314 5;
    */
    word       _Disp_IC_Rq_AR_CycleTime =            100;
    const word _Disp_IC_Rq_AR_OnEventDetectTime =     90;
    byte       _Disp_IC_Rq_AR_OnEventTrap_Active =     0;
    msTimer    tDisp_IC_Rq_AR_OnEventTrap;
    msTimer    tDisp_IC_Rq_AR_OnEventIND;
    
    /* Botschaft FlashOverTheAir_Disp_Stat_AR ID: 1219 --- Sendeart 5 cyclicAndSpontanWithDelay --- 
BA_ "ApplMessage" BO_ 1219 0;
BA_ "NmAsrMessage" BO_ 1219 0;
BA_ "GenMsgMinAcceptLength" BO_ 1219 2;
BA_ "GenMsgILSupport" BO_ 1219 1;
BA_ "DiagState" BO_ 1219 0;
BA_ "DiagRequest" BO_ 1219 0;
BA_ "DiagResponse" BO_ 1219 0;
BA_ "GenMsgStartValue" BO_ 1219 "0";
BA_ "GenMsgStartDelayTime" BO_ 1219 225;
BA_ "GenMsgDelayTime" BO_ 1219 100;
BA_ "GenMsgNrOfRepetition" BO_ 1219 0;
BA_ "GenMsgCycleTime" BO_ 1219 1000;
BA_ "GenMsgSendType" BO_ 1219 5;
    */
    word       _FlashOverTheAir_Disp_Stat_AR_CycleTime =           1000;
    const word _FlashOverTheAir_Disp_Stat_AR_OnEventDetectTime =    990;
    byte       _FlashOverTheAir_Disp_Stat_AR_OnEventTrap_Active =     0;
    msTimer    tFlashOverTheAir_Disp_Stat_AR_OnEventTrap;
    msTimer    tFlashOverTheAir_Disp_Stat_AR_OnEventIND;
    
    /* Botschaft HUD_Rq_IC_AR ID: 1139 --- Sendeart 5 cyclicAndSpontanWithDelay --- 
BA_ "ApplMessage" BO_ 1139 0;
BA_ "NmAsrMessage" BO_ 1139 0;
BA_ "GenMsgMinAcceptLength" BO_ 1139 8;
BA_ "GenMsgILSupport" BO_ 1139 1;
BA_ "DiagState" BO_ 1139 0;
BA_ "DiagRequest" BO_ 1139 0;
BA_ "DiagResponse" BO_ 1139 0;
BA_ "GenMsgStartValue" BO_ 1139 "0";
BA_ "GenMsgStartDelayTime" BO_ 1139 50;
BA_ "GenMsgDelayTime" BO_ 1139 40;
BA_ "GenMsgNrOfRepetitions" BO_ 1139 0;
BA_ "GenMsgCycleTime" BO_ 1139 1000;
BA_ "GenMsgSendType" BO_ 1139 5;
    */
    word       _HUD_Rq_IC_AR_CycleTime =           1000;
    byte       _HUD_Rq_IC_AR_CycleReduction =         0;
    byte      _cHUD_Rq_IC_AR_CycleReductionValue =    5;
    const word _HUD_Rq_IC_AR_OnEventDetectTime =    990;
    byte       _HUD_Rq_IC_AR_OnEventTrap_Active =     0;
    msTimer    tHUD_Rq_IC_AR_OnEventTrap;
    msTimer    tHUD_Rq_IC_AR_OnEventIND;

    /* Botschaft IC_AddDisp_VAN_AR ID: 1172 --- Sendeart 5 cyclicAndSpontanWithDelay --- 
BA_ "ApplMessage" BO_ 1172 0;
BA_ "NmAsrMessage" BO_ 1172 0;
BA_ "GenMsgMinAcceptLength" BO_ 1172 8;
BA_ "GenMsgILSupport" BO_ 1172 1;
BA_ "DiagState" BO_ 1172 0;
BA_ "DiagRequest" BO_ 1172 0;
BA_ "DiagResponse" BO_ 1172 0;
BA_ "GenMsgStartValue" BO_ 1172 "0";
BA_ "GenMsgStartDelayTime" BO_ 1172 80;
BA_ "GenMsgDelayTime" BO_ 1172 20;
BA_ "GenMsgNrOfRepetition" BO_ 1172 0;
BA_ "GenMsgCycleTime" BO_ 1172 1000;
BA_ "GenMsgSendType" BO_ 1172 5;
    */
    word       _IC_AddDisp_VAN_AR_CycleTime =           1000;
    const word _IC_AddDisp_VAN_AR_OnEventDetectTime =    990;
    byte       _IC_AddDisp_VAN_AR_OnEventTrap_Active =     0;
    msTimer    tIC_AddDisp_VAN_AR_OnEventTrap;
    msTimer    tIC_AddDisp_VAN_AR_OnEventIND;

    /* Botschaft IC_BasicInfo_AR ID: 777 --- Sendeart 5 cyclicAndSpontanWithDelay --- 
BA_ "ApplMessage" BO_ 777 0;
BA_ "NmAsrMessage" BO_ 777 0;
BA_ "GenMsgMinAcceptLength" BO_ 777 8;
BA_ "GenMsgILSupport" BO_ 777 1;
BA_ "DiagState" BO_ 777 0;
BA_ "DiagRequest" BO_ 777 0;
BA_ "DiagResponse" BO_ 777 0;
BA_ "GenMsgStartValue" BO_ 777 "0";
BA_ "GenMsgStartDelayTime" BO_ 777 295;
BA_ "GenMsgDelayTime" BO_ 777 100;
BA_ "GenMsgNrOfRepetitions" BO_ 777 0;
BA_ "GenMsgCycleTime" BO_ 777 1000;
BA_ "GenMsgSendType" BO_ 777 5;
    */
    word       _IC_BasicInfo_AR_CycleTime =           1000;
    byte       _IC_BasicInfo_AR_CycleReduction =         0;
    byte       _cIC_BasicInfo_AR_CycleReductionValue =    5;
    const word _IC_BasicInfo_AR_OnEventDetectTime =    990;
    byte       _IC_BasicInfo_AR_OnEventTrap_Active =     0;
    msTimer    tIC_BasicInfo_AR_OnEventTrap;
    msTimer    tIC_BasicInfo_AR_OnEventIND;

    /* Botschaft IC_DriveAssistSys_AR ID: 305 --- Sendeart 0 cyclicX --- 
BA_ "ApplMessage" BO_ 305 0;
BA_ "NmAsrMessage" BO_ 305 0;
BA_ "GenMsgMinAcceptLength" BO_ 305 8;
BA_ "GenMsgILSupport" BO_ 305 1;
BA_ "DiagState" BO_ 305 0;
BA_ "DiagRequest" BO_ 305 0;
BA_ "DiagResponse" BO_ 305 0;
BA_ "GenMsgStartValue" BO_ 305 "0";
BA_ "GenMsgStartDelayTime" BO_ 305 70;
BA_ "GenMsgCycleTime" BO_ 305 100;
BA_ "GenMsgSendType" BO_ 305 0;
    */
    // Botschaft IC_DriveAssistSys_AR --- Sendeart  --- 
    message IC_DriveAssistSys_AR _mIC_DriveAssistSys_AR;
    byte _IC_DriveAssistSys_AR_CRC_RollTestMd_SPCR_Stat_IC[16] = { 230, 165, 100,  35, 221, 156,  91,  26, 212, 147,  82,  17, 203, 138,  73,   8 };
//    msTimer _tIC_DriveAssistSys_AR;


    word       _IC_DriveAssistSys_AR_CycleTime =            100;
    byte       _IC_DriveAssistSys_AR_CycleReduction =         0;
    byte      _cIC_DriveAssistSys_AR_CycleReductionValue =   10;
    const word _IC_DriveAssistSys_AR_OnEventDetectTime =     90;
    byte       _IC_DriveAssistSys_AR_OnEventTrap_Active =     0;
    msTimer    tIC_DriveAssistSys_AR_OnEventTrap;
    msTimer    tIC_DriveAssistSys_AR_OnEventIND;

    /* Botschaft IC_Immobilizer_AR ID: 871 --- Sendeart 5 cyclicAndSpontanWithDelay --- 
BA_ "ApplMessage" BO_ 871 0;
BA_ "NmAsrMessage" BO_ 871 0;
BA_ "GenMsgMinAcceptLength" BO_ 871 8;
BA_ "GenMsgILSupport" BO_ 871 1;
BA_ "DiagState" BO_ 871 0;
BA_ "DiagRequest" BO_ 871 0;
BA_ "DiagResponse" BO_ 871 0;
BA_ "GenMsgStartValue" BO_ 871 "0";
BA_ "GenMsgStartDelayTime" BO_ 871 145;
BA_ "GenMsgDelayTime" BO_ 871 5;
BA_ "GenMsgNrOfRepetitions" BO_ 871 0;
BA_ "GenMsgCycleTime" BO_ 871 1000;
BA_ "GenMsgSendType" BO_ 871 5;
    */
    word       _IC_Immobilizer_AR_CycleTime =           1000;
    byte       _IC_Immobilizer_AR_CycleReduction =         0;
    byte      _cIC_Immobilizer_AR_CycleReductionValue =    5;
    const word _IC_Immobilizer_AR_OnEventDetectTime =    990;
    byte       _IC_Immobilizer_AR_OnEventTrap_Active =     0;
    msTimer    tIC_Immobilizer_AR_OnEventTrap;
    msTimer    tIC_Immobilizer_AR_OnEventIND;

    /* Botschaft IC_Stat_AR ID: 784 --- Sendeart 5 cyclicAndSpontanWithDelay --- 
BA_ "ApplMessage" BO_ 784 0;
BA_ "NmAsrMessage" BO_ 784 0;
BA_ "GenMsgMinAcceptLength" BO_ 784 8;
BA_ "GenMsgILSupport" BO_ 784 1;
BA_ "DiagState" BO_ 784 0;
BA_ "DiagRequest" BO_ 784 0;
BA_ "DiagResponse" BO_ 784 0;
BA_ "GenMsgStartValue" BO_ 784 "0";
BA_ "GenMsgStartDelayTime" BO_ 784 45;
BA_ "GenMsgDelayTime" BO_ 784 20;
BA_ "GenMsgNrOfRepetitions" BO_ 784 0;
BA_ "GenMsgCycleTime" BO_ 784 500;
BA_ "GenMsgSendType" BO_ 784 5;
    */
    word       _IC_Stat_AR_CycleTime =            500;
    byte       _IC_Stat_AR_CycleReduction =         0;
    byte      _cIC_Stat_AR_CycleReductionValue =    5;
    const word _IC_Stat_AR_OnEventDetectTime =    490;
    byte       _IC_Stat_AR_OnEventTrap_Active =     0;
    msTimer    tIC_Stat_AR_OnEventTrap;
    msTimer    tIC_Stat_AR_OnEventIND;

/* Botschaft PreCond_Rq_HU_AR ID: 771 --- Sendeart 5 cyclicAndSpontanWithDelay --- 
BA_ "ApplMessage" BO_ 771 0;
BA_ "NmAsrMessage" BO_ 771 0;
BA_ "GenMsgMinAcceptLength" BO_ 771 8;
BA_ "GenMsgILSupport" BO_ 771 1;
BA_ "DiagState" BO_ 771 0;
BA_ "DiagRequest" BO_ 771 0;
BA_ "DiagResponse" BO_ 771 0;
BA_ "GenMsgStartValue" BO_ 771 "0";
BA_ "GenMsgStartDelayTime" BO_ 771 45;
BA_ "GenMsgDelayTime" BO_ 771 20;
BA_ "GenMsgNrOfRepetitions" BO_ 771 0;
BA_ "GenMsgCycleTime" BO_ 771 100;
BA_ "GenMsgSendType" BO_ 771 5;
    */
    word       _PreCond_Rq_HU_AR_CycleTime =            1000;
    byte       _PreCond_Rq_HU_AR_CycleReduction =         0;
    byte      _cPreCond_Rq_HU_AR_CycleReductionValue =    5;
    const word _PreCond_Rq_HU_AR_OnEventDetectTime =    490;
    byte       _PreCond_Rq_HU_AR_OnEventTrap_Active =     0;
    msTimer    tPreCond_Rq_HU_AR_OnEventTrap;
    msTimer    tPreCond_Rq_HU_AR_OnEventIND;

    /* Botschaft IC_Settings_AR ID: 781 --- Sendeart 5 cyclicAndSpontanWithDelay --- 
BA_ "ApplMessage" BO_ 781 0;
BA_ "NmAsrMessage" BO_ 781 0;
BA_ "GenMsgMinAcceptLength" BO_ 781 8;
BA_ "GenMsgILSupport" BO_ 781 1;
BA_ "DiagState" BO_ 781 0;
BA_ "DiagRequest" BO_ 781 0;
BA_ "DiagResponse" BO_ 781 0;
BA_ "GenMsgStartValue" BO_ 781 "0";
BA_ "GenMsgStartDelayTime" BO_ 781 100;
BA_ "GenMsgDelayTime" BO_ 781 40;
BA_ "GenMsgNrOfRepetitions" BO_ 781 0;
BA_ "GenMsgCycleTime" BO_ 781 1000;
BA_ "GenMsgSendType" BO_ 781 5;
    */
    word       _IC_Settings_AR_CycleTime =           1000;
    byte       _IC_Settings_AR_CycleReduction =         0;
    byte      _cIC_Settings_AR_CycleReductionValue =    5;
    const word _IC_Settings_AR_OnEventDetectTime =    990;
    byte       _IC_Settings_AR_OnEventTrap_Active =     0;
    msTimer    tIC_Settings_AR_OnEventTrap;
    msTimer    tIC_Settings_AR_OnEventIND;

    /* Botschaft IC_StWheelSwitches_AR ID: 307 --- Sendeart 5 cyclicAndSpontanWithDelay --- 
BA_ "ApplMessage" BO_ 307 0;
BA_ "NmAsrMessage" BO_ 307 0;
BA_ "GenMsgMinAcceptLength" BO_ 307 8;
BA_ "GenMsgILSupport" BO_ 307 1;
BA_ "DiagState" BO_ 307 0;
BA_ "DiagRequest" BO_ 307 0;
BA_ "DiagResponse" BO_ 307 0;
BA_ "GenMsgStartValue" BO_ 307 "0";
BA_ "GenMsgStartDelayTime" BO_ 307 30;
BA_ "GenMsgDelayTime" BO_ 307 20;
BA_ "GenMsgNrOfRepetitions" BO_ 307 0;
BA_ "GenMsgCycleTime" BO_ 307 100;
BA_ "GenMsgSendType" BO_ 307 5;
    */
    word       _IC_StWheelSwitches_AR_CycleTime =            100;
    byte       _IC_StWheelSwitches_AR_CycleReduction =         0;
    byte      _cIC_StWheelSwitches_AR_CycleReductionValue =   10;
    const word _IC_StWheelSwitches_AR_OnEventDetectTime =     90;
    byte       _IC_StWheelSwitches_AR_OnEventTrap_Active =     0;
    msTimer    tIC_StWheelSwitches_AR_OnEventTrap;
    msTimer    tIC_StWheelSwitches_AR_OnEventIND;

    /* Botschaft IC_WIM_AR ID: 873 --- Sendeart 5 cyclicAndSpontanWithDelay --- 
BA_ "ApplMessage" BO_ 873 0;
BA_ "NmAsrMessage" BO_ 873 0;
BA_ "GenMsgMinAcceptLength" BO_ 873 8;
BA_ "GenMsgILSupport" BO_ 873 1;
BA_ "DiagState" BO_ 873 0;
BA_ "DiagRequest" BO_ 873 0;
BA_ "DiagResponse" BO_ 873 0;
BA_ "GenMsgStartValue" BO_ 873 "0";
BA_ "GenMsgStartDelayTime" BO_ 873 185;
BA_ "GenMsgDelayTime" BO_ 873 20;
BA_ "GenMsgNrOfRepetitions" BO_ 873 0;
BA_ "GenMsgCycleTime" BO_ 873 500;
BA_ "GenMsgSendType" BO_ 873 5;
    */
    word       _IC_WIM_AR_CycleTime =            500;
    byte       _IC_WIM_AR_CycleReduction =         0;
    byte      _cIC_WIM_AR_CycleReductionValue =    2;
    const word _IC_WIM_AR_OnEventDetectTime =    490;
    byte       _IC_WIM_AR_OnEventTrap_Active =     0;
    msTimer    tIC_WIM_AR_OnEventTrap;
    msTimer    tIC_WIM_AR_OnEventIND;

    /* Botschaft IC_WIM2_AR ID: 962 --- Sendeart 5 cyclicAndSpontanWithDelay --- 
BA_ "ApplMessage" BO_ 962 0;
BA_ "NmAsrMessage" BO_ 962 0;
BA_ "GenMsgMinAcceptLength" BO_ 962 8;
BA_ "GenMsgILSupport" BO_ 962 1;
BA_ "DiagState" BO_ 962 0;
BA_ "DiagRequest" BO_ 962 0;
BA_ "DiagResponse" BO_ 962 0;
BA_ "GenMsgStartValue" BO_ 962 "0";
BA_ "GenMsgStartDelayTime" BO_ 962 145;
BA_ "GenMsgDelayTime" BO_ 962 20;
BA_ "GenMsgNrOfRepetitions" BO_ 962 0;
BA_ "GenMsgCycleTime" BO_ 962 500;
BA_ "GenMsgSendType" BO_ 962 5;
    */
    word       _IC_WIM2_AR_CycleTime =            500;
    byte       _IC_WIM2_AR_CycleReduction =         0;
    byte      _cIC_WIM2_AR_CycleReductionValue =    2;
    const word _IC_WIM2_AR_OnEventDetectTime =    490;
    byte       _IC_WIM2_AR_OnEventTrap_Active =     0;
    msTimer    tIC_WIM2_AR_OnEventTrap;
    msTimer    tIC_WIM2_AR_OnEventIND;

    /* Botschaft ICH_Rq_IC_VAN_AR ID: 1169 --- Sendeart 5 cyclicAndSpontanWithDelay --- 
BA_ "ApplMessage" BO_ 1169 0;
BA_ "NmAsrMessage" BO_ 1169 0;
BA_ "GenMsgMinAcceptLength" BO_ 1169 8;
BA_ "GenMsgILSupport" BO_ 1169 1;
BA_ "DiagState" BO_ 1169 0;
BA_ "DiagRequest" BO_ 1169 0;
BA_ "DiagResponse" BO_ 1169 0;
BA_ "GenMsgStartValue" BO_ 1169 "0";
BA_ "GenMsgStartDelayTime" BO_ 1169 130;
BA_ "GenMsgDelayTime" BO_ 1169 5;
BA_ "GenMsgNrOfRepetition" BO_ 1169 0;
BA_ "GenMsgCycleTime" BO_ 1169 1000;
BA_ "GenMsgSendType" BO_ 1169 5;
    */
    word       _ICH_Rq_IC_VAN_AR_CycleTime =           1000;
    const word _ICH_Rq_IC_VAN_AR_OnEventDetectTime =    990;
    byte       _ICH_Rq_IC_VAN_AR_OnEventTrap_Active =     0;
    msTimer    tICH_Rq_IC_VAN_AR_OnEventTrap;
    msTimer    tICH_Rq_IC_VAN_AR_OnEventIND;

    /* Botschaft LDC_Disp_Stat_IC_AR ID: 867 --- Sendeart 5 cyclicAndSpontanWithDelay --- 
BA_ "ApplMessage" BO_ 867 0;
BA_ "NmAsrMessage" BO_ 867 0;
BA_ "GenMsgMinAcceptLength" BO_ 867 8;
BA_ "GenMsgILSupport" BO_ 867 1;
BA_ "DiagState" BO_ 867 0;
BA_ "DiagRequest" BO_ 867 0;
BA_ "DiagResponse" BO_ 867 0;
BA_ "GenMsgStartValue" BO_ 867 "0";
BA_ "GenMsgStartDelayTime" BO_ 867 125;
BA_ "GenMsgDelayTime" BO_ 867 10;
BA_ "GenMsgNrOfRepetitions" BO_ 867 0;
BA_ "GenMsgCycleTime" BO_ 867 200;
BA_ "GenMsgSendType" BO_ 867 5;
    */
    word       _LDC_Disp_Stat_IC_AR_CycleTime =            200;
    byte       _LDC_Disp_Stat_IC_AR_CycleReduction =         0;
    byte      _cLDC_Disp_Stat_IC_AR_CycleReductionValue =    5;
    const word _LDC_Disp_Stat_IC_AR_OnEventDetectTime =    190;
    byte       _LDC_Disp_Stat_IC_AR_OnEventTrap_Active =     0;
    msTimer    tLDC_Disp_Stat_IC_AR_OnEventTrap;
    msTimer    tLDC_Disp_Stat_IC_AR_OnEventIND;

    /* Botschaft Maintenance1_AR ID: 1217 --- Sendeart 0 cyclicX --- 
BA_ "ApplMessage" BO_ 1217 0;
BA_ "NmAsrMessage" BO_ 1217 0;
BA_ "GenMsgMinAcceptLength" BO_ 1217 8;
BA_ "GenMsgILSupport" BO_ 1217 1;
BA_ "DiagState" BO_ 1217 0;
BA_ "DiagRequest" BO_ 1217 0;
BA_ "DiagResponse" BO_ 1217 0;
BA_ "GenMsgStartValue" BO_ 1217 "0";
BA_ "GenMsgStartDelayTime" BO_ 1217 60;
BA_ "GenMsgCycleTime" BO_ 1217 5000;
BA_ "GenMsgSendType" BO_ 1217 0;
    */
    word       _Maintenance1_AR_CycleTime =           5000;
    byte       _Maintenance1_AR_CycleReduction =         0;
    byte      _cMaintenance1_AR_CycleReductionValue =    5;
    const word _Maintenance1_AR_OnEventDetectTime =    990;
    byte       _Maintenance1_AR_OnEventTrap_Active =     0;
    msTimer    tMaintenance1_AR_OnEventTrap;
    msTimer    tMaintenance1_AR_OnEventIND;

    /* Botschaft Maintenance2_AR ID: 1218 --- Sendeart 0 cyclicX --- 
BA_ "ApplMessage" BO_ 1218 0;
BA_ "NmAsrMessage" BO_ 1218 0;
BA_ "GenMsgMinAcceptLength" BO_ 1218 8;
BA_ "GenMsgILSupport" BO_ 1218 1;
BA_ "DiagState" BO_ 1218 0;
BA_ "DiagRequest" BO_ 1218 0;
BA_ "DiagResponse" BO_ 1218 0;
BA_ "GenMsgStartValue" BO_ 1218 "0";
BA_ "GenMsgStartDelayTime" BO_ 1218 120;
BA_ "GenMsgCycleTime" BO_ 1218 2000;
BA_ "GenMsgSendType" BO_ 1218 0;
    */
    word       _Maintenance2_AR_CycleTime =           2000;
    byte       _Maintenance2_AR_CycleReduction =         0;
    byte      _cMaintenance2_AR_CycleReductionValue =    5;
    const word _Maintenance2_AR_OnEventDetectTime =    990;
    byte       _Maintenance2_AR_OnEventTrap_Active =     0;
    msTimer    tMaintenance2_AR_OnEventTrap;
    msTimer    tMaintenance2_AR_OnEventIND;

    /* Botschaft Maintenance3_AR ID: 1222 --- Sendeart 0 cyclicX --- 
BA_ "ApplMessage" BO_ 1222 0;
BA_ "NmAsrMessage" BO_ 1222 0;
BA_ "GenMsgMinAcceptLength" BO_ 1222 8;
BA_ "GenMsgILSupport" BO_ 1222 1;
BA_ "DiagState" BO_ 1222 0;
BA_ "DiagRequest" BO_ 1222 0;
BA_ "DiagResponse" BO_ 1222 0;
BA_ "GenMsgStartValue" BO_ 1222 "0";
BA_ "GenMsgStartDelayTime" BO_ 1222 255;
BA_ "GenMsgCycleTime" BO_ 1222 5000;
BA_ "GenMsgSendType" BO_ 1222 0;
    */
    word       _Maintenance3_AR_CycleTime =           5000;
    byte       _Maintenance3_AR_CycleReduction =         0;
    byte      _cMaintenance3_AR_CycleReductionValue =    5;
    const word _Maintenance3_AR_OnEventDetectTime =    990;
    byte       _Maintenance3_AR_OnEventTrap_Active =     0;
    msTimer    tMaintenance3_AR_OnEventTrap;
    msTimer    tMaintenance3_AR_OnEventIND;

    // Meas_IC_1
    word       _Meas_IC_1_CycleTime =           1000;
    byte       _Meas_IC_1_CycleReduction =         0;
    byte      _cMeas_IC_1_CycleReductionValue =    5;
    const word _Meas_IC_1_OnEventDetectTime =    990;
    byte       _Meas_IC_1_OnEventTrap_Active =     0;
    msTimer    tMeas_IC_1_OnEventTrap;
    msTimer    tMeas_IC_1_OnEventIND;

    // Meas_IC_2
    word       _Meas_IC_2_CycleTime =           1000;
    byte       _Meas_IC_2_CycleReduction =         0;
    byte      _cMeas_IC_2_CycleReductionValue =    5;
    const word _Meas_IC_2_OnEventDetectTime =    990;
    byte       _Meas_IC_2_OnEventTrap_Active =     0;
    msTimer    tMeas_IC_2_OnEventTrap;
    msTimer    tMeas_IC_2_OnEventIND;

    // Meas_IC_3
    word       _Meas_IC_3_CycleTime =           1000;
    byte       _Meas_IC_3_CycleReduction =         0;
    byte      _cMeas_IC_3_CycleReductionValue =    5;
    const word _Meas_IC_3_OnEventDetectTime =    990;
    byte       _Meas_IC_3_OnEventTrap_Active =     0;
    msTimer    tMeas_IC_3_OnEventTrap;
    msTimer    tMeas_IC_3_OnEventIND;

    // Meas_IC_4
    word       _Meas_IC_4_CycleTime =           1000;
    byte       _Meas_IC_4_CycleReduction =         0;
    byte      _cMeas_IC_4_CycleReductionValue =    5;
    const word _Meas_IC_4_OnEventDetectTime =    990;
    byte       _Meas_IC_4_OnEventTrap_Active =     0;
    msTimer    tMeas_IC_4_OnEventTrap;
    msTimer    tMeas_IC_4_OnEventIND;

    // Meas_IC_5
    word       _Meas_IC_5_CycleTime =           1000;
    byte       _Meas_IC_5_CycleReduction =         0;
    byte      _cMeas_IC_5_CycleReductionValue =    5;
    const word _Meas_IC_5_OnEventDetectTime =    990;
    byte       _Meas_IC_5_OnEventTrap_Active =     0;
    msTimer    tMeas_IC_5_OnEventTrap;
    msTimer    tMeas_IC_5_OnEventIND;

    // Meas_IC_5
    word       _NM_IC_AR_CycleTime =           1000;
    byte       _NM_IC_AR_CycleReduction =         0;
    byte      _cNM_IC_AR_CycleReductionValue =    5;
    const word _NM_IC_AR_OnEventDetectTime =    990;
    byte       _NM_IC_AR_OnEventTrap_Active =     0;
    msTimer    tNM_IC_AR_OnEventTrap;
    msTimer    tNM_IC_AR_OnEventIND;

    /* Botschaft NV_Rq_IC_AR ID: 309 --- Sendeart 0 cyclicX --- 
BA_ "ApplMessage" BO_ 309 0;
BA_ "NmAsrMessage" BO_ 309 0;
BA_ "GenMsgMinAcceptLength" BO_ 309 8;
BA_ "GenMsgILSupport" BO_ 309 1;
BA_ "DiagState" BO_ 309 0;
BA_ "DiagRequest" BO_ 309 0;
BA_ "DiagResponse" BO_ 309 0;
BA_ "GenMsgStartValue" BO_ 309 "0";
BA_ "GenMsgStartDelayTime" BO_ 309 0;
BA_ "GenMsgCycleTime" BO_ 309 80;
BA_ "GenMsgSendType" BO_ 309 0;
    */
    word       _NV_Rq_IC_AR_CycleTime =             80;
    byte       _NV_Rq_IC_AR_CycleReduction =         0;
    byte      _cNV_Rq_IC_AR_CycleReductionValue =   13;
    const word _NV_Rq_IC_AR_OnEventDetectTime =     70;
    byte       _NV_Rq_IC_AR_OnEventTrap_Active =     0;
    msTimer    tNV_Rq_IC_AR_OnEventTrap;
    msTimer    tNV_Rq_IC_AR_OnEventIND;

    /* Botschaft Park_Disp_Rs_AR ID: 395 --- Sendeart 5 cyclicAndSpontanWithDelay --- 
BA_ "ApplMessage" BO_ 395 0;
BA_ "NmAsrMessage" BO_ 395 0;
BA_ "GenMsgMinAcceptLength" BO_ 395 8;
BA_ "GenMsgILSupport" BO_ 395 1;
BA_ "DiagState" BO_ 395 0;
BA_ "DiagRequest" BO_ 395 0;
BA_ "DiagResponse" BO_ 395 0;
BA_ "GenMsgStartValue" BO_ 395 "0";
BA_ "GenMsgStartDelayTime" BO_ 395 150;
BA_ "GenMsgDelayTime" BO_ 395 40;
BA_ "GenMsgNrOfRepetitions" BO_ 395 0;
BA_ "GenMsgCycleTime" BO_ 395 200;
BA_ "GenMsgSendType" BO_ 395 5;
    */
    message Park_Disp_Rs_AR _mPark_Disp_Rs_AR;
    byte _Park_Disp_Rs_AR_CRC_Park_Disp_Rs[16] = { 237, 249,  10,  22,  34,  46,  58,  70,  82,  94, 106, 118, 130, 142, 154, 166 };


    word       _Park_Disp_Rs_AR_CycleTime =            200;
    byte       _Park_Disp_Rs_AR_CycleReduction =         0;
    byte      _cPark_Disp_Rs_AR_CycleReductionValue =    5;
    const word _Park_Disp_Rs_AR_OnEventDetectTime =    190;
    byte       _Park_Disp_Rs_AR_OnEventTrap_Active =     0;
    msTimer    tPark_Disp_Rs_AR_OnEventTrap;
    msTimer    tPark_Disp_Rs_AR_OnEventIND;

    /* meaasge Pers_Stat_AR ID: 1082 --- Sendeart 5  --- 
BA_ "ApplMessage" BO_ 1082 0;
BA_ "NmAsrMessage" BO_ 1082 0;
BA_ "GenMsgMinAcceptLength" BO_ 1082 8;
BA_ "GenMsgILSupport" BO_ 1082 1;
BA_ "DiagState" BO_ 1082 0;
BA_ "DiagRequest" BO_ 1082 0;
BA_ "DiagResponse" BO_ 1082 0;
BA_ "GenMsgStartValue" BO_ 1082 "0";
BA_ "GenMsgStartDelayTime" BO_ 1082 150;
BA_ "GenMsgDelayTime" BO_ 1082 100;
BA_ "GenMsgNrOfRepetition" BO_ 1082 0;
BA_ "GenMsgCycleTime" BO_ 1082 500;
BA_ "GenMsgSendType" BO_ 1082 5;
    */

/*    word       _Pers_Stat_AR_CycleTime =            500;
    byte       _Pers_Stat_AR_CycleReduction =         0;
    byte      _cPers_Stat_AR_CycleReductionValue =    2;
    const word _Pers_Stat_AR_OnEventDetectTime =    490;
    byte       _Pers_Stat_AR_OnEventTrap_Active =     0;
    msTimer    tPers_Stat_AR_OnEventTrap;
    msTimer    tPers_Stat_AR_OnEventIND;
*/
    /* Botschaft ROE_IC ID: 2565816576 --- Sendeart 9  --- 
BA_ "ApplMessage" BO_ 2565816576 0;
BA_ "NmAsrMessage" BO_ 2565816576 0;
BA_ "GenMsgMinAcceptLength" BO_ 2565816576 8;
BA_ "GenMsgILSupport" BO_ 2565816576 1;
BA_ "DiagState" BO_ 2565816576 0;
BA_ "DiagRequest" BO_ 2565816576 0;
BA_ "DiagResponse" BO_ 2565816576 0;
BA_ "GenMsgStartValue" BO_ 2565816576 "0";
BA_ "GenMsgDelayTime" BO_ 2565816576 5;
BA_ "GenMsgNrOfRepetitions" BO_ 2565816576 0;
BA_ "GenMsgCycleTime" BO_ 2565816576 200;
BA_ "GenMsgSendType" BO_ 2565816576 9;
    */ 
    word       _ROE_IC_CycleTime =            200;
    byte       _ROE_IC_CycleReduction =         0;
    byte      _cROE_IC_CycleReductionValue =    5;
    const word _ROE_IC_OnEventDetectTime =    190;
    byte       _ROE_IC_OnEventTrap_Active =     0;
    msTimer    tROE_IC_OnEventTrap;
    msTimer    tROE_IC_OnEventIND;

    /* Botschaft RTC_Date_Time_AR ID: 779 --- Sendeart 5 cyclicAndSpontanWithDelay --- 
BA_ "ApplMessage" BO_ 779 0;
BA_ "NmAsrMessage" BO_ 779 0;
BA_ "GenMsgMinAcceptLength" BO_ 779 8;
BA_ "GenMsgILSupport" BO_ 779 1;
BA_ "DiagState" BO_ 779 0;
BA_ "DiagRequest" BO_ 779 0;
BA_ "DiagResponse" BO_ 779 0;
BA_ "GenMsgStartValue" BO_ 779 "0";
BA_ "GenMsgStartDelayTime" BO_ 779 250;
BA_ "GenMsgDelayTime" BO_ 779 40;
BA_ "GenMsgNrOfRepetitions" BO_ 779 0;
BA_ "GenMsgCycleTime" BO_ 779 1000;
BA_ "GenMsgSendType" BO_ 779 5;
    */
    word       _RTC_Date_Time_AR_CycleTime =           1000;
    byte       _RTC_Date_Time_AR_CycleReduction =         0;
    byte      _cRTC_Date_Time_AR_CycleReductionValue =    5;
    const word _RTC_Date_Time_AR_OnEventDetectTime =    990;
    byte       _RTC_Date_Time_AR_OnEventTrap_Active =     0;
    msTimer    tRTC_Date_Time_AR_OnEventTrap;
    msTimer    tRTC_Date_Time_AR_OnEventIND;

    /* Botschaft RTC_Stat1_AR ID: 1216 --- Sendeart 5 cyclicAndSpontanWithDelay --- 
BA_ "ApplMessage" BO_ 1216 0;
BA_ "NmAsrMessage" BO_ 1216 0;
BA_ "GenMsgMinAcceptLength" BO_ 1216 8;
BA_ "GenMsgILSupport" BO_ 1216 1;
BA_ "DiagState" BO_ 1216 0;
BA_ "DiagRequest" BO_ 1216 0;
BA_ "DiagResponse" BO_ 1216 0;
BA_ "GenMsgStartValue" BO_ 1216 "0";
BA_ "GenMsgStartDelayTime" BO_ 1216 260;
BA_ "GenMsgDelayTime" BO_ 1216 100;
BA_ "GenMsgNrOfRepetitions" BO_ 1216 0;
BA_ "GenMsgCycleTime" BO_ 1216 1000;
BA_ "GenMsgSendType" BO_ 1216 5;
    */
    word       _RTC_Stat1_AR_CycleTime =           1000;
    byte       _RTC_Stat1_AR_CycleReduction =         0;
    byte      _cRTC_Stat1_AR_CycleReductionValue =    5;
    const word _RTC_Stat1_AR_OnEventDetectTime =    990;
    byte       _RTC_Stat1_AR_OnEventTrap_Active =     0;
    msTimer    tRTC_Stat1_AR_OnEventTrap;
    msTimer    tRTC_Stat1_AR_OnEventIND;

    /* Botschaft TC_AddInfo1_AR ID: 974 --- Sendeart 0 cyclicX --- 
BA_ "ApplMessage" BO_ 974 0;
BA_ "NmAsrMessage" BO_ 974 0;
BA_ "GenMsgMinAcceptLength" BO_ 974 8;
BA_ "GenMsgILSupport" BO_ 974 1;
BA_ "DiagState" BO_ 974 0;
BA_ "DiagRequest" BO_ 974 0;
BA_ "DiagResponse" BO_ 974 0;
BA_ "GenMsgStartValue" BO_ 974 "0";
BA_ "GenMsgStartDelayTime" BO_ 974 190;
BA_ "GenMsgCycleTime" BO_ 974 1000;
BA_ "GenMsgSendType" BO_ 974 0;
    */
    word       _TC_AddInfo1_AR_CycleTime =           1000;
    byte       _TC_AddInfo1_AR_CycleReduction =         0;
    byte      _cTC_AddInfo1_AR_CycleReductionValue =    1;
    const word _TC_AddInfo1_AR_OnEventDetectTime =    980;
    byte       _TC_AddInfo1_AR_OnEventTrap_Active =     0;
    msTimer    tTC_AddInfo1_AR_OnEventTrap;
    msTimer    tTC_AddInfo1_AR_OnEventIND;

    /* Botschaft TC_AddInfo2_AR ID: 964 --- Sendeart 0 cyclicX --- 
BA_ "ApplMessage" BO_ 964 0;
BA_ "NmAsrMessage" BO_ 964 0;
BA_ "GenMsgMinAcceptLength" BO_ 964 8;
BA_ "GenMsgILSupport" BO_ 964 1;
BA_ "DiagState" BO_ 964 0;
BA_ "DiagRequest" BO_ 964 0;
BA_ "DiagResponse" BO_ 964 0;
BA_ "GenMsgStartValue" BO_ 964 "0";
BA_ "GenMsgStartDelayTime" BO_ 964 90;
BA_ "GenMsgCycleTime" BO_ 964 1000;
BA_ "GenMsgSendType" BO_ 964 0;
    */

    word       _TC_AddInfo2_AR_CycleTime =           1000;
    byte       _TC_AddInfo2_AR_CycleReduction =         0;
    byte      _cTC_AddInfo2_AR_CycleReductionValue =    1;
    const word _TC_AddInfo2_AR_OnEventDetectTime =    980;
    byte       _TC_AddInfo2_AR_OnEventTrap_Active =     0;
    msTimer    tTC_AddInfo2_AR_OnEventTrap;
    msTimer    tTC_AddInfo2_AR_OnEventIND;

    /* Botschaft TC_AddInfo3_AR ID: 966 --- Sendeart 0 cyclicX --- 
BA_ "ApplMessage" BO_ 966 0;
BA_ "NmAsrMessage" BO_ 966 0;
BA_ "GenMsgMinAcceptLength" BO_ 966 8;
BA_ "GenMsgILSupport" BO_ 966 1;
BA_ "DiagState" BO_ 966 0;
BA_ "DiagRequest" BO_ 966 0;
BA_ "DiagResponse" BO_ 966 0;
BA_ "GenMsgStartValue" BO_ 966 "0";
BA_ "GenMsgStartDelayTime" BO_ 966 185;
BA_ "GenMsgCycleTime" BO_ 966 1000;
BA_ "GenMsgSendType" BO_ 966 0;
    */
    word       _TC_AddInfo3_AR_CycleTime =           1000;
    byte       _TC_AddInfo3_AR_CycleReduction =         0;
    byte      _cTC_AddInfo3_AR_CycleReductionValue =    1;
    const word _TC_AddInfo3_AR_OnEventDetectTime =    980;
    byte       _TC_AddInfo3_AR_OnEventTrap_Active =     0;
    msTimer    tTC_AddInfo3_AR_OnEventTrap;
    msTimer    tTC_AddInfo3_AR_OnEventIND;

    /* Botschaft TC_Dist_AR ID: 311 --- Sendeart 0 cyclicX --- 
BA_ "ApplMessage" BO_ 311 0;
BA_ "NmAsrMessage" BO_ 311 0;
BA_ "GenMsgMinAcceptLength" BO_ 311 8;
BA_ "GenMsgILSupport" BO_ 311 0;
BA_ "DiagState" BO_ 311 0;
BA_ "DiagRequest" BO_ 311 0;
BA_ "DiagResponse" BO_ 311 0;
BA_ "GenMsgStartValue" BO_ 311 "0";
BA_ "GenMsgStartDelayTime" BO_ 311 110;
BA_ "GenMsgCycleTime" BO_ 311 100;
BA_ "GenMsgSendType" BO_ 311 0;
    */
    word       _TC_Dist_AR_CycleTime =            100;
    byte       _TC_Dist_AR_CycleReduction =         0;
    byte      _cTC_Dist_AR_CycleReductionValue =   10;
    const word _TC_Dist_AR_OnEventDetectTime =     90;
    byte       _TC_Dist_AR_OnEventTrap_Active =     0;
    msTimer    tTC_Dist_AR_OnEventTrap;
    msTimer    tTC_Dist_AR_OnEventIND;

  /* Botschaft TGW_COM_Call_Disp_Rq_AR ID: 710 --- Sendeart 5 cyclicAndSpontanWithDelay --- 
BA_ "ApplMessage" BO_ 710 0;
BA_ "NmAsrMessage" BO_ 710 0;
BA_ "GenMsgMinAcceptLength" BO_ 710 8;
BA_ "GenMsgILSupport" BO_ 710 1;
BA_ "DiagState" BO_ 710 0;
BA_ "DiagRequest" BO_ 710 0;
BA_ "DiagResponse" BO_ 710 0;
BA_ "GenMsgStartValue" BO_ 710 "0";
BA_ "GenMsgStartDelayTime" BO_ 710 265;
BA_ "GenMsgDelayTime" BO_ 710 50;
BA_ "GenMsgNrOfRepetition" BO_ 710 0;
BA_ "GenMsgCycleTime" BO_ 710 1000;
BA_ "GenMsgSendType" BO_ 710 5;
  */
	  word       _TGW_COM_Call_Disp_Rq_AR_CycleTime =           1000;
    const word _TGW_COM_Call_Disp_Rq_AR_OnEventDetectTime =    990;
    byte       _TGW_COM_Call_Disp_Rq_AR_OnEventTrap_Active =     0;
    msTimer    tTGW_COM_Call_Disp_Rq_AR_OnEventTrap;
    msTimer    tTGW_COM_Call_Disp_Rq_AR_OnEventIND;
    
    /* Botschaft TP_IC_EIS_SecOdo ID: 358 --- Sendeart 0 cyclicX --- 
BA_ "ApplMessage" BO_ 358 0;
BA_ "NmAsrMessage" BO_ 358 0;
BA_ "GenMsgMinAcceptLength" BO_ 358 8;
BA_ "GenMsgILSupport" BO_ 358 0;
BA_ "DiagState" BO_ 358 0;
BA_ "DiagRequest" BO_ 358 0;
BA_ "DiagResponse" BO_ 358 0;
BA_ "GenMsgStartValue" BO_ 358 "0";
    */
    word       _TP_IC_EIS_SecOdo_CycleTime =            100;
    byte       _TP_IC_EIS_SecOdo_CycleReduction =         0;
    byte      _cTP_IC_EIS_SecOdo_CycleReductionValue =   10;
    const word _TP_IC_EIS_SecOdo_OnEventDetectTime =     90;
    byte       _TP_IC_EIS_SecOdo_OnEventTrap_Active =     0;

    /* Botschaft TP_IC_TGW_Aud ID: 729 --- Sendeart 0 cyclicX --- 
BA_ "ApplMessage" BO_ 729 0;
BA_ "NmAsrMessage" BO_ 729 0;
BA_ "GenMsgMinAcceptLength" BO_ 729 8;
BA_ "GenMsgILSupport" BO_ 729 0;
BA_ "DiagState" BO_ 729 0;
BA_ "DiagRequest" BO_ 729 0;
BA_ "DiagResponse" BO_ 729 0;
BA_ "GenMsgStartValue" BO_ 729 "0";
    */
    word       _TP_IC_TGW_Aud_CycleTime =            100;
    byte       _TP_IC_TGW_Aud_CycleReduction =         0;
    byte      _cTP_IC_TGW_Aud_CycleReductionValue =   10;
    const word _TP_IC_TGW_Aud_OnEventDetectTime =     90;
    byte       _TP_IC_TGW_Aud_OnEventTrap_Active =     0;

    /* Botschaft TP_IC_TGW_HUD ID: 712 --- Sendeart 0 cyclicX --- 
BA_ "ApplMessage" BO_ 712 0;
BA_ "NmAsrMessage" BO_ 712 0;
BA_ "GenMsgMinAcceptLength" BO_ 712 8;
BA_ "GenMsgILSupport" BO_ 712 0;
BA_ "DiagState" BO_ 712 0;
BA_ "DiagRequest" BO_ 712 0;
BA_ "DiagResponse" BO_ 712 0;
BA_ "GenMsgStartValue" BO_ 712 "0";
    */
    word       _TP_IC_TGW_HUD_CycleTime =            100;
    byte       _TP_IC_TGW_HUD_CycleReduction =         0;
    byte      _cTP_IC_TGW_HUD_CycleReductionValue =   10;
    const word _TP_IC_TGW_HUD_OnEventDetectTime =     90;
    byte       _TP_IC_TGW_HUD_OnEventTrap_Active =     0;

    /* Botschaft TP_IC_TGW_Nav ID: 712 --- Sendeart 0 cyclicX --- 
BA_ "ApplMessage" BO_ 701 0;
BA_ "NmAsrMessage" BO_ 701 0;
BA_ "GenMsgMinAcceptLength" BO_ 701 8;
BA_ "GenMsgILSupport" BO_ 701 0;
BA_ "DiagState" BO_ 701 0;
BA_ "DiagRequest" BO_ 701 0;
BA_ "DiagResponse" BO_ 701 0;
BA_ "GenMsgStartValue" BO_ 701 "0";
    */
    word       _TP_IC_TGW_Nav_CycleTime =            100;
    byte       _TP_IC_TGW_Nav_CycleReduction =         0;
    byte      _cTP_IC_TGW_Nav_CycleReductionValue =   10;
    const word _TP_IC_TGW_Nav_OnEventDetectTime =     90;
    byte       _TP_IC_TGW_Nav_OnEventTrap_Active =     0;

    /* Botschaft TP_IC_TGW_Pers ID: 1278 --- Sendeart 0 cyclicX --- 
BA_ "ApplMessage" BO_ 1278 0;
BA_ "NmAsrMessage" BO_ 1278 0;
BA_ "GenMsgMinAcceptLength" BO_ 1278 8;
BA_ "GenMsgILSupport" BO_ 1278 0;
BA_ "DiagState" BO_ 1278 0;
BA_ "DiagRequest" BO_ 1278 0;
BA_ "DiagResponse" BO_ 1278 0;
BA_ "GenMsgStartValue" BO_ 1278 "255";
BA_ "TpTxIndex" BO_ 1278 6;
    */
    word       _TP_IC_TGW_Pers_CycleTime =            100;
    byte       _TP_IC_TGW_Pers_CycleReduction =         0;
    byte      _cTP_IC_TGW_Pers_CycleReductionValue =   10;
    const word _TP_IC_TGW_Pers_OnEventDetectTime =     90;
    byte       _TP_IC_TGW_Pers_OnEventTrap_Active =     0;

    /* Botschaft TP_IC_TGW_SCA ID: 749 --- Sendeart 0 cyclicX --- 
BA_ "ApplMessage" BO_ 749 0;
BA_ "NmAsrMessage" BO_ 749 0;
BA_ "GenMsgMinAcceptLength" BO_ 749 8;
BA_ "GenMsgILSupport" BO_ 749 0;
BA_ "DiagState" BO_ 749 0;
BA_ "DiagRequest" BO_ 749 0;
BA_ "DiagResponse" BO_ 749 0;
BA_ "GenMsgStartValue" BO_ 749 "0";
    */
    word       _TP_IC_TGW_SCA_CycleTime =            100;
    byte       _TP_IC_TGW_SCA_CycleReduction =         0;
    byte      _cTP_IC_TGW_SCA_CycleReductionValue =   10;
    const word _TP_IC_TGW_SCA_OnEventDetectTime =     90;
    byte       _TP_IC_TGW_SCA_OnEventTrap_Active =     0;

    /* Botschaft TP_IC_TGW_Tel ID: 705 --- Sendeart 0 cyclicX --- 
BA_ "ApplMessage" BO_ 705 0;
BA_ "NmAsrMessage" BO_ 705 0;
BA_ "GenMsgMinAcceptLength" BO_ 705 8;
BA_ "GenMsgILSupport" BO_ 705 0;
BA_ "DiagState" BO_ 705 0;
BA_ "DiagRequest" BO_ 705 0;
BA_ "DiagResponse" BO_ 705 0;
BA_ "GenMsgStartValue" BO_ 705 "0";
    */
    word       _TP_IC_TGW_Tel_CycleTime =            100;
    byte       _TP_IC_TGW_Tel_CycleReduction =         0;
    byte      _cTP_IC_TGW_Tel_CycleReductionValue =   10;
    const word _TP_IC_TGW_Tel_OnEventDetectTime =     90;
    byte       _TP_IC_TGW_Tel_OnEventTrap_Active =     0;

    /* Botschaft TP_IC_WPT ID: 1231 --- Sendeart 0 cyclicX --- 
BA_ "ApplMessage" BO_ 1231 0;
BA_ "NmAsrMessage" BO_ 1231 0;
BA_ "GenMsgMinAcceptLength" BO_ 1231 8;
BA_ "GenMsgILSupport" BO_ 1231 0;
BA_ "DiagState" BO_ 1231 0;
BA_ "DiagRequest" BO_ 1231 0;
BA_ "DiagResponse" BO_ 1231 0;
BA_ "GenMsgStartValue" BO_ 1231 "0";
    */
    word       _TP_IC_WPT_CycleTime =            100;
    byte       _TP_IC_WPT_CycleReduction =         0;
    byte      _cTP_IC_WPT_CycleReductionValue =   10;
    const word _TP_IC_WPT_OnEventDetectTime =     90;
    byte       _TP_IC_WPT_OnEventTrap_Active =     0;


    byte  crctable_profile02[256] = {
        0x00, 0x2F, 0x5E, 0x71, 0xBC, 0x93, 0xE2, 0xCD, 0x57, 0x78, 0x09, 0x26, 0xEB, 0xC4, 0xB5, 0x9A,
        0xAE, 0x81, 0xF0, 0xDF, 0x12, 0x3D, 0x4C, 0x63, 0xF9, 0xD6, 0xA7, 0x88, 0x45, 0x6A, 0x1B, 0x34,
        0x73, 0x5C, 0x2D, 0x02, 0xCF, 0xE0, 0x91, 0xBE, 0x24, 0x0B, 0x7A, 0x55, 0x98, 0xB7, 0xC6, 0xE9,
        0xDD, 0xF2, 0x83, 0xAC, 0x61, 0x4E, 0x3F, 0x10, 0x8A, 0xA5, 0xD4, 0xFB, 0x36, 0x19, 0x68, 0x47,
        0xE6, 0xC9, 0xB8, 0x97, 0x5A, 0x75, 0x04, 0x2B, 0xB1, 0x9E, 0xEF, 0xC0, 0x0D, 0x22, 0x53, 0x7C,
        0x48, 0x67, 0x16, 0x39, 0xF4, 0xDB, 0xAA, 0x85, 0x1F, 0x30, 0x41, 0x6E, 0xA3, 0x8C, 0xFD, 0xD2,
        0x95, 0xBA, 0xCB, 0xE4, 0x29, 0x06, 0x77, 0x58, 0xC2, 0xED, 0x9C, 0xB3, 0x7E, 0x51, 0x20, 0x0F,
        0x3B, 0x14, 0x65, 0x4A, 0x87, 0xA8, 0xD9, 0xF6, 0x6C, 0x43, 0x32, 0x1D, 0xD0, 0xFF, 0x8E, 0xA1,
        0xE3, 0xCC, 0xBD, 0x92, 0x5F, 0x70, 0x01, 0x2E, 0xB4, 0x9B, 0xEA, 0xC5, 0x08, 0x27, 0x56, 0x79,
        0x4D, 0x62, 0x13, 0x3C, 0xF1, 0xDE, 0xAF, 0x80, 0x1A, 0x35, 0x44, 0x6B, 0xA6, 0x89, 0xF8, 0xD7,
        0x90, 0xBF, 0xCE, 0xE1, 0x2C, 0x03, 0x72, 0x5D, 0xC7, 0xE8, 0x99, 0xB6, 0x7B, 0x54, 0x25, 0x0A,
        0x3E, 0x11, 0x60, 0x4F, 0x82, 0xAD, 0xDC, 0xF3, 0x69, 0x46, 0x37, 0x18, 0xD5, 0xFA, 0x8B, 0xA4,
        0x05, 0x2A, 0x5B, 0x74, 0xB9, 0x96, 0xE7, 0xC8, 0x52, 0x7D, 0x0C, 0x23, 0xEE, 0xC1, 0xB0, 0x9F,
        0xAB, 0x84, 0xF5, 0xDA, 0x17, 0x38, 0x49, 0x66, 0xFC, 0xD3, 0xA2, 0x8D, 0x40, 0x6F, 0x1E, 0x31,
        0x76, 0x59, 0x28, 0x07, 0xCA, 0xE5, 0x94, 0xBB, 0x21, 0x0E, 0x7F, 0x50, 0x9D, 0xB2, 0xC3, 0xEC,
        0xD8, 0xF7, 0x86, 0xA9, 0x64, 0x4B, 0x3A, 0x15, 0x8F, 0xA0, 0xD1, 0xFE, 0x33, 0x1C, 0x6D, 0x42
    };



}

on start
{
}

on message Assyst_Rq_AR
{
    byte bAliveCtr;

    putValue( HMI_Assyst_Can_SPServ, 	    this.Assyst_Can_SPServ.phys );
    putValue( HMI_Assyst_CurrOilQual_Para_V2,  this.Assyst_CurrOilQual_Para_V2.phys );
    putValue( HMI_Assyst_OilQuantMeas_Trgr, this.Assyst_OilQuantMeas_Trgr.phys );
    putValue( HMI_Assyst_SP3Serv_Trgr, 	    this.Assyst_SP3Serv_Trgr.phys );
    putValue( HMI_Assyst_VehHndOvr_Trgr,    this.Assyst_VehHndOvr_Trgr.phys );
    putValue( HMI_Assyst_SpServConf_Stat,    this.Assyst_SpServConf_Stat.phys );

// Evaluate if received message is on event 
    bAliveCtr = getValue( HMI__MSGAliveCtr_Assyst_Rq_AR );
    if( _Assyst_Rq_AR_OnEventTrap_Active )
    {
        putValue( HMI__MSG_OnEvent_Assyst_Rq_AR, 1 );
        cancelTimer( tAssyst_Rq_AR_OnEventIND );
        setTimer( tAssyst_Rq_AR_OnEventIND, 1000 );
    }
    else
    {
        if( bAliveCtr < 8 )
        {
            bAliveCtr = ( bAliveCtr + 1 ) & 0x07;
        }
        else
        {
            bAliveCtr = 0;
		}
        putValue( HMI__MSGAliveCtr_Assyst_Rq_AR, bAliveCtr );
        _Assyst_Rq_AR_OnEventTrap_Active = 1;
        setTimer( tAssyst_Rq_AR_OnEventTrap, _Assyst_Rq_AR_OnEventDetectTime );
    }
}

on timer tAssyst_Rq_AR_OnEventIND
{
    putValue( HMI__MSG_OnEvent_Assyst_Rq_AR, 0 );
}

on timer tAssyst_Rq_AR_OnEventTrap
{
    _Assyst_Rq_AR_OnEventTrap_Active = 0;
}

on message BC_F_Stat4_AR
{
    byte bAliveCtr;

    putValue( HMI_Airbag_LED_Stat_ASBM_UB, 	   this.Airbag_LED_Stat_ASBM_UB.phys );
    putValue( HMI_Airbag_P_LED_On_Stat_ASBM,        this.Airbag_P_LED_On_Stat_ASBM.phys );
    putValue( HMI_COD_Ind_LED_Stat_ASBM, 	   this.COD_Ind_LED_Stat_ASBM.phys );
    putValue( HMI_CRC_Airbag_LED_Stat_ASBM, 	   this.CRC_Airbag_LED_Stat_ASBM.phys );
    putValue( HMI_Rsrv1_Airbag_LED_Stat_ASBM,        this.Rsrv1_Airbag_LED_Stat_ASBM.phys );
    putValue( HMI_SQC_Airbag_LED_Stat_ASBM, 	   this.SQC_Airbag_LED_Stat_ASBM.phys );
    putValue( HMI_Text_LED_Stat_ASBM, 	   this.Text_LED_Stat_ASBM.phys );

// --- cyclicAndSpontanWithDelay 5 --- 100ms cycle time ---
// Evaluate if received message is on event 
    bAliveCtr = getValue( HMI__MSGAliveCtr_BC_F_Stat4_AR );
    putValue( HMI__MSG_OnEvent_BC_F_Stat4_AR, 1 );
    cancelTimer( tBC_F_Stat4_AR_OnEventIND );
    setTimer( tBC_F_Stat4_AR_OnEventIND, 1000 );
    if( bAliveCtr < 8 )
    {
        bAliveCtr = ( bAliveCtr + 1 ) & 0x07;
    }
    else
    {
        bAliveCtr = 0;
    }
    putValue( HMI__MSGAliveCtr_BC_F_Stat4_AR, bAliveCtr );
}

on timer tBC_F_Stat4_AR_OnEventIND
{
    putValue( HMI__MSG_OnEvent_BC_F_Stat4_AR, 0 );
}

on timer tBC_F_Stat4_AR_OnEventTrap
{
    _BC_F_Stat4_AR_OnEventTrap_Active = 0;
}

on message BLSM_Disp_Stat_AR
{
    byte bAliveCtr;

    putValue( HMI_BrkLnServMd_Actv, 	   this.BrkLnServMd_Actv.phys );
    putValue( HMI_BrkLnServMd_Back_Psd,    this.BrkLnServMd_Back_Psd.phys );
    putValue( HMI_BrkLnServMd_Dn_Psd, 	   this.BrkLnServMd_Dn_Psd.phys );
    putValue( HMI_BrkLnServMd_Lt_Psd, 	   this.BrkLnServMd_Lt_Psd.phys );
    putValue( HMI_BrkLnServMd_MsgDisp_Ack, this.BrkLnServMd_MsgDisp_Ack.phys );
    putValue( HMI_BrkLnServMd_Ok_Psd, 	   this.BrkLnServMd_Ok_Psd.phys );
    putValue( HMI_BrkLnServMd_Rt_Psd, 	   this.BrkLnServMd_Rt_Psd.phys );
    putValue( HMI_BrkLnServMd_Up_Psd, 	   this.BrkLnServMd_Up_Psd.phys );

// --- cyclicIfActive 2 --- 
// Evaluate if received message is on event 
    bAliveCtr = getValue( HMI__MSGAliveCtr_BLSM_Disp_Stat_AR );
    putValue( HMI__MSG_OnEvent_BLSM_Disp_Stat_AR, 1 );
    cancelTimer( tBLSM_Disp_Stat_AR_OnEventIND );
    setTimer( tBLSM_Disp_Stat_AR_OnEventIND, 1000 );
    if( bAliveCtr < 8 )
    {
        bAliveCtr = ( bAliveCtr + 1 ) & 0x07;
    }
    else
    {
        bAliveCtr = 0;
    }
    putValue( HMI__MSGAliveCtr_BLSM_Disp_Stat_AR, bAliveCtr );
}

on timer tBLSM_Disp_Stat_AR_OnEventIND
{
    putValue( HMI__MSG_OnEvent_BLSM_Disp_Stat_AR, 0 );
}

on timer tBLSM_Disp_Stat_AR_OnEventTrap
{
    _BLSM_Disp_Stat_AR_OnEventTrap_Active = 0;
}

on message Dimming_Stat_AR
{
    byte bAliveCtr;

    putValue( HMI_DispBrt_IC, this.DispBrt_IC.phys );
    putValue( HMI_FctIllLvl, this.FctIllLvl.phys );
    putValue( HMI_IP_Brt_IC, this.IP_Brt_IC.phys );
    putValue( HMI_SwIll_NightDay, this.SwIll_NightDay.phys );
    putValue( HMI_SwIllLvl, this.SwIllLvl.phys );
    putValue( HMI_SwIllLvl_Dim_Md, this.SwIllLvl_Dim_Md.phys );
    putValue( HMI_SwIllLvl_Stat_AMG, this.SwIllLvl_Stat_AMG.phys );

// --- cyclicAndSpontanWithDelay 5 --- 200ms cycle time ---
// Evaluate if received message is on event 
    bAliveCtr = getValue( HMI__MSGAliveCtr_Dimming_Stat_AR );
    if( _Dimming_Stat_AR_OnEventTrap_Active )
    {
        putValue( HMI__MSG_OnEvent_Dimming_Stat_AR, 1 );
        cancelTimer( tDimming_Stat_AR_OnEventIND );
        setTimer( tDimming_Stat_AR_OnEventIND, 1000 );
    }
    else
    {
        _Dimming_Stat_AR_CycleReduction++;
        if( _Dimming_Stat_AR_CycleReduction >= _cDimming_Stat_AR_CycleReductionValue )
        {
            _Dimming_Stat_AR_CycleReduction = 0;
            if( bAliveCtr < 8 )
            {
                bAliveCtr = ( bAliveCtr + 1 ) & 0x07;
            }
            else
            {
                bAliveCtr = 0;
            }
        }
        putValue( HMI__MSGAliveCtr_Dimming_Stat_AR, bAliveCtr );
        _Dimming_Stat_AR_OnEventTrap_Active = 1;
        setTimer( tDimming_Stat_AR_OnEventTrap, _Dimming_Stat_AR_OnEventDetectTime );
    }
}

on timer tDimming_Stat_AR_OnEventIND
{
    putValue( HMI__MSG_OnEvent_Dimming_Stat_AR, 0 );
}

on timer tDimming_Stat_AR_OnEventTrap
{
    _Dimming_Stat_AR_OnEventTrap_Active = 0;
}

on message Disp_IC_Rq_AR
{
    byte bAliveCtr;

    putValue( HMI_CRC_DISP_IC_Rq, 	   this.CRC_DISP_IC_Rq.phys );
    putValue( HMI_DISP_IC_BackLgt_Rq, 	   this.DISP_IC_BackLgt_Rq.phys );
    putValue( HMI_DISP_IC_Brt_Rq, 	   this.DISP_IC_Brt_Rq.phys );
    putValue( HMI_DISP_IC_BrtOffset_Rq, 	   this.DISP_IC_BrtOffset_Rq.phys );
    putValue( HMI_DISP_IC_On_Rq, 	   this.DISP_IC_On_Rq.phys );
    putValue( HMI_DISP_IC_SafeState_Rq, 	   this.DISP_IC_SafeState_Rq.phys );
    putValue( HMI_Rsrv1_DISP_IC_Rq, 	   this.Rsrv1_DISP_IC_Rq.phys );
    putValue( HMI_Rsrv2_DISP_IC_Rq, 	   this.Rsrv2_DISP_IC_Rq.phys );
    putValue( HMI_Rsrv3_DISP_IC_Rq, 	   this.Rsrv3_DISP_IC_Rq.phys );
    putValue( HMI_SQC_DISP_IC_Rq, 	   this.SQC_DISP_IC_Rq.phys );

// --- cyclicAndSpontanWithDelay 5 --- 100ms cycle time ---
// Evaluate if received message is on event 
    bAliveCtr = getValue( HMI__MSGAliveCtr_Disp_IC_Rq_AR );
    putValue( HMI__MSG_OnEvent_Disp_IC_Rq_AR, 1 );
    cancelTimer( tDisp_IC_Rq_AR_OnEventIND );
    setTimer( tDisp_IC_Rq_AR_OnEventIND, 1000 );
    if( bAliveCtr < 8 )
    {
        bAliveCtr = ( bAliveCtr + 1 ) & 0x07;
    }
    else
    {
        bAliveCtr = 0;
    }
    putValue( HMI__MSGAliveCtr_Disp_IC_Rq_AR, bAliveCtr );
}

on timer tDisp_IC_Rq_AR_OnEventIND
{
    putValue( HMI__MSG_OnEvent_Disp_IC_Rq_AR, 0 );
}

on timer tDisp_IC_Rq_AR_OnEventTrap
{
    _Disp_IC_Rq_AR_OnEventTrap_Active = 0;
}

on message FlashOverTheAir_Disp_Stat_AR
{
    byte bAliveCtr;

    putValue( HMI_FOTA_Disp_Stat, 	   this.FOTA_Disp_Stat.phys );

// --- cyclicAndSpontanWithDelay 5 --- 100ms cycle time ---
// Evaluate if received message is on event 
    bAliveCtr = getValue( HMI__MSGAliveCtr_FlashOverTheAir_Disp_Stat_AR );
    putValue( HMI__MSG_OnEvent_FlashOverTheAir_Disp_Stat_AR, 1 );
    cancelTimer( tFlashOverTheAir_Disp_Stat_AR_OnEventIND );
    setTimer( tFlashOverTheAir_Disp_Stat_AR_OnEventIND, 1000 );
    if( bAliveCtr < 8 )
    {
        bAliveCtr = ( bAliveCtr + 1 ) & 0x07;
    }
    else
    {
        bAliveCtr = 0;
    }
    putValue( HMI__MSGAliveCtr_FlashOverTheAir_Disp_Stat_AR, bAliveCtr );
}

on timer tFlashOverTheAir_Disp_Stat_AR_OnEventIND
{
    putValue( HMI__MSG_OnEvent_FlashOverTheAir_Disp_Stat_AR, 0 );
}

on timer tFlashOverTheAir_Disp_Stat_AR_OnEventTrap
{
    _FlashOverTheAir_Disp_Stat_AR_OnEventTrap_Active = 0;
}

on message HUD_Rq_IC_AR
{
    byte bAliveCtr;

    putValue( HMI_HUD_DispBrt_Rq, 		this.HUD_DispBrt_Rq.phys );
    putValue( HMI_HUD_Md_Rq, 			this.HUD_Md_Rq.phys );
    putValue( HMI_HUD_Posn_Rq, 			this.HUD_Posn_Rq.phys );

// --- cyclicAndSpontanWithDelay 5 --- 200ms cycle time ---
// Evaluate if received message is on event 
    bAliveCtr = getValue( HMI__MSGAliveCtr_HUD_Rq_IC_AR );
    if( _HUD_Rq_IC_AR_OnEventTrap_Active )
    {
        putValue( HMI__MSG_OnEvent_HUD_Rq_IC_AR, 1 );
        cancelTimer( tHUD_Rq_IC_AR_OnEventIND );
        setTimer( tHUD_Rq_IC_AR_OnEventIND, 1000 );
    }
    else
    {
        _HUD_Rq_IC_AR_CycleReduction++;
        if( _HUD_Rq_IC_AR_CycleReduction >= _cHUD_Rq_IC_AR_CycleReductionValue )
        {
            _HUD_Rq_IC_AR_CycleReduction = 0;
            if( bAliveCtr < 8 )
            {
                bAliveCtr = ( bAliveCtr + 1 ) & 0x07;
            }
            else
            {
                bAliveCtr = 0;
            }
        }
        putValue( HMI__MSGAliveCtr_HUD_Rq_IC_AR, bAliveCtr );
        _HUD_Rq_IC_AR_OnEventTrap_Active = 1;
        setTimer( tHUD_Rq_IC_AR_OnEventTrap, _HUD_Rq_IC_AR_OnEventDetectTime );
    }
}

on timer tHUD_Rq_IC_AR_OnEventIND
{
    putValue( HMI__MSG_OnEvent_HUD_Rq_IC_AR, 0 );
}

on timer tHUD_Rq_IC_AR_OnEventTrap
{
    _HUD_Rq_IC_AR_OnEventTrap_Active = 0;
}

on message IC_BasicInfo_AR
{
    byte bAliveCtr;

    putValue( HMI_AirTemp_Outsd_Disp, 		this.AirTemp_Outsd_Disp.phys );
    putValue( HMI_IC_TP_Alive, 				this.IC_TP_Alive.phys );//neu SLP10.08
    putValue( HMI_Odo, 						this.Odo.phys );
    putValue( HMI_UnitVehSpd, 				this.UnitVehSpd.phys );
    putValue( HMI_VehSpd_Disp, 				this.VehSpd_Disp.phys );

    if( ( getValue( Env_ODO_Takeover_For_TCO )              ) &&
        ( getValue( Env_ODO_Takeover_For_TCO_Inhibit ) == 0 )    )
    {
        if( this.Odo.phys != 1677721.5 )  // if not SNA
        {
            putValue( TCO_DIST_TOTAL, this.Odo.phys );
            putValue( Env_ODO_Takeover_For_TCO, 0 );
        }
    }
// --- cyclicAndSpontanWithDelay 5 --- 1000ms cycle time ---
// Evaluate if received message is on event 
    bAliveCtr = getValue( HMI__MSGAliveCtr_IC_BasicInfo_AR );
    if( _IC_BasicInfo_AR_OnEventTrap_Active )
    {
        putValue( HMI__MSG_OnEvent_IC_BasicInfo_AR, 1 );
        cancelTimer( tIC_BasicInfo_AR_OnEventIND );
        setTimer( tIC_BasicInfo_AR_OnEventIND, 1000 );
    }
    else
    {
        if( bAliveCtr < 8 )
        {
            bAliveCtr = ( bAliveCtr + 1 ) & 0x07;
        }
        else
        {
            bAliveCtr = 0;
		}
        putValue( HMI__MSGAliveCtr_IC_BasicInfo_AR, bAliveCtr );
        _IC_BasicInfo_AR_OnEventTrap_Active = 1;
        setTimer( tIC_BasicInfo_AR_OnEventTrap, _IC_BasicInfo_AR_OnEventDetectTime );
    }
}

on timer tIC_BasicInfo_AR_OnEventIND
{
    putValue( HMI__MSG_OnEvent_IC_BasicInfo_AR, 0 );
}

on timer tIC_BasicInfo_AR_OnEventTrap
{
    _IC_BasicInfo_AR_OnEventTrap_Active = 0;
}

on message IC_Immobilizer_AR
{
    byte bAliveCtr;

    putValue( HMI_KeyId_IC_V2, this.KeyId_IC_V2.phys );
    putValue( HMI_Odo_IC, this.Odo_IC.phys );

// --- cyclicAndSpontanWithDelay 5 --- 1000ms cycle time ---
// Evaluate if received message is on event 
    bAliveCtr = getValue( HMI__MSGAliveCtr_IC_Immobilizer_AR );
    if( _IC_Immobilizer_AR_OnEventTrap_Active )
    {
        putValue( HMI__MSG_OnEvent_IC_Immobilizer_AR, 1 );
        cancelTimer( tIC_Immobilizer_AR_OnEventIND );
        setTimer( tIC_Immobilizer_AR_OnEventIND, 1000 );
    }
    else
    {
        if( bAliveCtr < 8 )
        {
            bAliveCtr = ( bAliveCtr + 1 ) & 0x07;
        }
        else
        {
            bAliveCtr = 0;
		}
        putValue( HMI__MSGAliveCtr_IC_Immobilizer_AR, bAliveCtr );
        _IC_Immobilizer_AR_OnEventTrap_Active = 1;
        setTimer( tIC_Immobilizer_AR_OnEventTrap, _IC_Immobilizer_AR_OnEventDetectTime );
    }
}

on timer tIC_Immobilizer_AR_OnEventIND
{
    putValue( HMI__MSG_OnEvent_IC_Immobilizer_AR, 0 );
}

on timer tIC_Immobilizer_AR_OnEventTrap
{
    _IC_Immobilizer_AR_OnEventTrap_Active = 0;
}

on message IC_Settings_AR
{
    byte bAliveCtr;

    putValue( HMI_ExtFanTempIC_State,    this.ExtFanTempIC_State.phys );
    putValue( HMI_FTW_On_Rq, 		     this.FTW_On_Rq.phys );
    putValue( HMI_CPD_UsrActn_Rq, 		     this.CPD_UsrActn_Rq.phys );
    putValue( HMI_IHC_Md_Rq, 		     this.IHC_Md_Rq.phys );
    putValue( HMI_Preview_Md_Rq, 		this.Preview_Md_Rq.phys );
    putValue( HMI_SLA_SpdOffset_Rq_D_Unit,   this.SLA_SpdOffset_Rq_D_Unit.phys );
    putValue( HMI_SLA_SpdOffset_Rq_D_Val,    this.SLA_SpdOffset_Rq_D_Val.phys );
    putValue( HMI_TPM_Actv_Rq_V2, 		this.TPM_Actv_Rq_V2.phys );
    putValue( HMI_UnitPress_Rq, 		this.UnitPress_Rq.phys );
    putValue( HMI_UnitTemp_Rq, 			this.UnitTemp_Rq.phys );
	putValue( HMI_Pers_ActvSlotId_Rq, 		this.Pers_ActvSlotId_Rq.phys );
    putValue( HMI_RepairshopMode_Actv, 			this.RepairshopMode_Actv.phys );
    putValue( HMI_SAplus_SDTR_Md_Stat_IC, 			this.SAplus_SDTR_Md_Stat_IC.phys );
    putValue( HMI_SAplus_TSA_Md_Stat_IC, 			this.SAplus_TSA_Md_Stat_IC.phys );

// --- cyclicAndSpontanWithDelay 5 --- 1000ms cycle time ---
// Evaluate if received message is on event 
    bAliveCtr = getValue( HMI__MSGAliveCtr_IC_Settings_AR );
    if( _IC_Settings_AR_OnEventTrap_Active )
    {
        putValue( HMI__MSG_OnEvent_IC_Settings_AR, 1 );
        cancelTimer( tIC_Settings_AR_OnEventIND );
        setTimer( tIC_Settings_AR_OnEventIND, 1000 );
    }
    else
    {
        if( bAliveCtr < 8 )
        {
            bAliveCtr = ( bAliveCtr + 1 ) & 0x07;
        }
        else
        {
            bAliveCtr = 0;
		}
        putValue( HMI__MSGAliveCtr_IC_Settings_AR, bAliveCtr );
        _IC_Settings_AR_OnEventTrap_Active = 1;
        setTimer( tIC_Settings_AR_OnEventTrap, _IC_Settings_AR_OnEventDetectTime );
    }
}

on timer tIC_Settings_AR_OnEventIND
{
    putValue( HMI__MSG_OnEvent_IC_Settings_AR, 0 );
}

on timer tIC_Settings_AR_OnEventTrap
{
    _IC_Settings_AR_OnEventTrap_Active = 0;
}

on message IC_Stat_AR
{
    byte bAliveCtr;

    putValue( HMI_IC_AddSpeedo_Stat, 		     this.IC_AddSpeedo_Stat.phys );
	putValue( HMI_IC_AddSpeedoMenu_Rq, 		     this.IC_AddSpeedoMenu_Rq.phys );
	putValue( HMI_IC_DesignVar_Stat, 		     this.IC_DesignVar_Stat.phys );
    putValue( HMI_IC_DistUnit_Stat, 		     this.IC_DistUnit_Stat.phys );
    putValue( HMI_IC_TempDisp_Stat, 		     this.IC_TempDisp_Stat.phys );
    putValue( HMI_PIP_HUD_Add2_Rq, 		     this.PIP_HUD_Add2_Rq.phys );
    putValue( HMI_PIP_HUD_Add3_Rq, 		     this.PIP_HUD_Add3_Rq.phys );
    putValue( HMI_PIP_HUD_Add4_Rq, 		     this.PIP_HUD_Add4_Rq.phys );
    putValue( HMI_PIP_HUD_AMG_RaceApp_Rq, 		     this.PIP_HUD_AMG_RaceApp_Rq.phys );
    putValue( HMI_PIP_HUD_Apps_Rq, 		     this.PIP_HUD_Apps_Rq.phys );
    putValue( HMI_PIP_HUD_Audio_Rq, 		     this.PIP_HUD_Audio_Rq.phys );
    putValue( HMI_PIP_HUD_Navi_Rq, 		     this.PIP_HUD_Navi_Rq.phys );
    putValue( HMI_PIP_HUD_Phone_Rq, 		     this.PIP_HUD_Phone_Rq.phys );
    putValue( HMI_PIP_IC_Add2_Rq, 		     this.PIP_IC_Add2_Rq.phys );
    putValue( HMI_PIP_IC_Add3_Rq, 		     this.PIP_IC_Add3_Rq.phys );
    putValue( HMI_PIP_IC_Add4_Rq, 		     this.PIP_IC_Add4_Rq.phys );
    putValue( HMI_PIP_IC_AMG_RaceApp_Rq, 		     this.PIP_IC_AMG_RaceApp_Rq.phys );
    putValue( HMI_PIP_IC_Apps_Rq, 		     this.PIP_IC_Apps_Rq.phys );
    putValue( HMI_PIP_IC_Area_Rq, 		     this.PIP_IC_Area_Rq.phys );
    putValue( HMI_PIP_IC_Audio_Rq, 		     this.PIP_IC_Audio_Rq.phys );
    putValue( HMI_PIP_IC_Navi_Rq, 		     this.PIP_IC_Navi_Rq.phys );
    putValue( HMI_PIP_IC_Phone_Rq, 		     this.PIP_IC_Phone_Rq.phys );

    if( !getValue( Env_HU_Config_AutoSync ) && getValue( Env_HU_Config_AutoSync_Trigger ) )
    {
        putValue( HMI_IC_AddSpeedo_Rq, this.IC_AddSpeedo_Stat.phys );
        putValue( HMI_IC_DesignVar_Rq, this.IC_DesignVar_Stat.phys );
        putValue( HMI_IC_DistUnit_Rq,  this.IC_DistUnit_Stat.phys );
        putValue( HMI_IC_TempDisp_Rq,  this.IC_TempDisp_Stat.phys );
    }
    putValue( Env_HU_Config_AutoSync_Trigger, 0 );   //reset the trigger, will be rearmed by entering CAN-sleep

// --- cyclicAndSpontanWithDelay 5 --- 1000ms cycle time ---
// Evaluate if received message is on event 
    bAliveCtr = getValue( HMI__MSGAliveCtr_IC_Stat_AR );
    if( _IC_Stat_AR_OnEventTrap_Active )
    {
        putValue( HMI__MSG_OnEvent_IC_Stat_AR, 1 );
        cancelTimer( tIC_Stat_AR_OnEventIND );
        setTimer( tIC_Stat_AR_OnEventIND, 1000 );
    }
    else
    {
        if( bAliveCtr < 8 )
        {
            bAliveCtr = ( bAliveCtr + 1 ) & 0x07;
        }
        else
        {
            bAliveCtr = 0;
		}
        putValue( HMI__MSGAliveCtr_IC_Stat_AR, bAliveCtr );
        _IC_Stat_AR_OnEventTrap_Active = 1;
        setTimer( tIC_Stat_AR_OnEventTrap, _IC_Stat_AR_OnEventDetectTime );
    }
}

on timer tIC_Stat_AR_OnEventIND
{
    putValue( HMI__MSG_OnEvent_IC_Stat_AR, 0 );
}

on timer tIC_Stat_AR_OnEventTrap
{
    _IC_Stat_AR_OnEventTrap_Active = 0;
}

on message PreCond_Rq_HU_AR
{
    byte bAliveCtr;

    putValue( HMI_CmbstEngMaintMd_Rs, 		     		this.CmbstEngMaintMd_Rs.phys );
    putValue( HMI_HU_AutoUnlk_Rq, 		     			this.HU_AutoUnlk_Rq.phys );
    putValue( HMI_HU_BidiChrg_Rq, 		     			this.HU_BidiChrg_Rq.phys );
    putValue( HMI_HU_EcoChrg_Rq, 		     			this.HU_EcoChrg_Rq.phys );
    putValue( HMI_HU_InPos_Rq, 		     				this.HU_InPos_Rq.phys );
    putValue( HMI_HU_LocBsd_Rq, 		     			this.HU_LocBsd_Rq.phys );
    putValue( HMI_HU_MinSOC_Rq, 		     			this.HU_MinSOC_Rq.phys );
    putValue( HMI_HU_PreCond1_ManSet_Rq, 		     	this.HU_PreCond1_ManSet_Rq.phys );
    putValue( HMI_HU_PreCond2_ManSet_Rq, 		     	this.HU_PreCond2_ManSet_Rq.phys );
    putValue( HMI_HU_WeeklyProf_Rq, 		     		this.HU_WeeklyProf_Rq.phys );
    putValue( HMI_PreCond_AirFrshnr_CfgRq, 		     	this.PreCond_AirFrshnr_CfgRq.phys );
    putValue( HMI_PreCond_Ionzr_CfgRq, 		     		this.PreCond_Ionzr_CfgRq.phys );
    putValue( HMI_PreCond_Mode_CfgRq, 		     		this.PreCond_Mode_CfgRq.phys );
    putValue( HMI_PreCond_Seat_FL_CfgRq, 		     	this.PreCond_Seat_FL_CfgRq.phys );
    putValue( HMI_PreCond_Seat_FR_CfgRq, 		     	this.PreCond_Seat_FR_CfgRq.phys );
    putValue( HMI_PreCond_Seat_RL_CfgRq, 		     	this.PreCond_Seat_RL_CfgRq.phys );
    putValue( HMI_PreCond_Seat_RR_CfgRq, 		     	this.PreCond_Seat_RR_CfgRq.phys );
    putValue( HMI_HU_BatPreparing_Md_Rq, 		     	this.HU_BatPreparing_Md_Rq.phys );
	

// --- cyclicAndSpontanWithDelay 5 --- 1000ms cycle time ---
// Evaluate if received message is on event 
    bAliveCtr = getValue( HMI__MSGAliveCtr_PreCond_Rq_HU_AR );
    if( _PreCond_Rq_HU_AR_OnEventTrap_Active )
    {
        putValue( HMI__MSG_OnEvent_PreCond_Rq_HU_AR, 1 );
        cancelTimer( tPreCond_Rq_HU_AR_OnEventIND );
        setTimer( tPreCond_Rq_HU_AR_OnEventIND, 1000 );
    }
    else
    {
        if( bAliveCtr < 8 )
        {
            bAliveCtr = ( bAliveCtr + 1 ) & 0x07;
        }
        else
        {
            bAliveCtr = 0;
		}
        putValue( HMI__MSGAliveCtr_PreCond_Rq_HU_AR, bAliveCtr );
        _PreCond_Rq_HU_AR_OnEventTrap_Active = 1;
        setTimer( tPreCond_Rq_HU_AR_OnEventTrap, _PreCond_Rq_HU_AR_OnEventDetectTime );
    }
}

on timer tPreCond_Rq_HU_AR_OnEventIND
{
    putValue( HMI__MSG_OnEvent_PreCond_Rq_HU_AR, 0 );
}

on timer tPreCond_Rq_HU_AR_OnEventTrap
{
    _PreCond_Rq_HU_AR_OnEventTrap_Active = 0;
}

on message IC_StWheelSwitches_AR
{
    byte bAliveCtr;

    putValue( HMI_IC_Stat_V2, this.IC_Stat_V2.phys );
    putValue( HMI_StW_SwBack_HU_Psd, this.StW_SwBack_HU_Psd.phys );
    putValue( HMI_StW_SwDown_HUD_Psd, this.StW_SwDown_HUD_Psd.phys );
    putValue( HMI_StW_SwDown_MPM_Psd, this.StW_SwDown_MPM_Psd.phys );
    putValue( HMI_StW_SwEnd_HU_Psd, this.StW_SwEnd_HU_Psd.phys );
    putValue( HMI_StW_SwEnd_TELEAID_Psd, this.StW_SwEnd_TELEAID_Psd.phys );
    putValue( HMI_StW_SwFav_HU_Psd, this.StW_SwFav_HU_Psd.phys );
    putValue( HMI_StW_SwMinus_HU_Psd, this.StW_SwMinus_HU_Psd.phys );
    putValue( HMI_StW_SwMinus_MPM_Psd, this.StW_SwMinus_MPM_Psd.phys );
    putValue( HMI_StW_SwMinus_TELEAID_Psd, this.StW_SwMinus_TELEAID_Psd.phys );
    putValue( HMI_StW_SwMute_MPM_Psd, this.StW_SwMute_MPM_Psd.phys );
    putValue( HMI_StW_SwOFN_Ok_HU_Psd, this.StW_SwOFN_Ok_HU_Psd.phys );
    putValue( HMI_StW_SwOk_MPM_Psd, this.StW_SwOk_MPM_Psd.phys );
    putValue( HMI_StW_SwPlus_HU_Psd, this.StW_SwPlus_HU_Psd.phys );
    putValue( HMI_StW_SwPlus_MPM_Psd, this.StW_SwPlus_MPM_Psd.phys );
    putValue( HMI_StW_SwPlus_TELEAID_Psd, this.StW_SwPlus_TELEAID_Psd.phys );
    putValue( HMI_StW_SwSDS_Can_HU_Psd, this.StW_SwSDS_Can_HU_Psd.phys );
    putValue( HMI_StW_SwSDS_Mute_HU_Psd, this.StW_SwSDS_Mute_HU_Psd.phys );
    putValue( HMI_StW_SwSDS_Start_HU_Psd, this.StW_SwSDS_Start_HU_Psd.phys );
    putValue( HMI_StW_SwSend_HU_Psd, this.StW_SwSend_HU_Psd.phys );
    putValue( HMI_StW_SwUp_HUD_Psd, this.StW_SwUp_HUD_Psd.phys );
    putValue( HMI_StW_SwUp_MPM_Psd, this.StW_SwUp_MPM_Psd.phys );

// --- cyclicAndSpontanWithDelay 5 --- 100ms cycle time ---
// Evaluate if received message is on event 
    bAliveCtr = getValue( HMI__MSGAliveCtr_IC_StWheelSwitches_AR );
    if( _IC_StWheelSwitches_AR_OnEventTrap_Active )
    {
        putValue( HMI__MSG_OnEvent_IC_StWheelSwitches_AR, 1 );
        cancelTimer( tIC_StWheelSwitches_AR_OnEventIND );
        setTimer( tIC_StWheelSwitches_AR_OnEventIND, 1000 );
    }
    else
    {
        _IC_StWheelSwitches_AR_CycleReduction++;
        if( _IC_StWheelSwitches_AR_CycleReduction >= _cIC_StWheelSwitches_AR_CycleReductionValue )
        {
            _IC_StWheelSwitches_AR_CycleReduction = 0;
            if( bAliveCtr < 8 )
            {
                bAliveCtr = ( bAliveCtr + 1 ) & 0x07;
            }
            else
            {
                bAliveCtr = 0;
            }
        }
        putValue( HMI__MSGAliveCtr_IC_StWheelSwitches_AR, bAliveCtr );
        _IC_StWheelSwitches_AR_OnEventTrap_Active = 1;
        setTimer( tIC_StWheelSwitches_AR_OnEventTrap, _IC_StWheelSwitches_AR_OnEventDetectTime );
    }
}

on timer tIC_StWheelSwitches_AR_OnEventIND
{
    putValue( HMI__MSG_OnEvent_IC_StWheelSwitches_AR, 0 );
}

on timer tIC_StWheelSwitches_AR_OnEventTrap
{
    _IC_StWheelSwitches_AR_OnEventTrap_Active = 0;
}

on message IC_WIM_AR
{
    byte bAliveCtr;

    putValue( HMI_AcustWarn_Actv_IC, this.AcustWarn_Actv_IC.phys );
    putValue( HMI_IC_DiBa_Rq, this.IC_DiBa_Rq.phys );
    putValue( HMI_IC_Msg_Disp_Stat, this.IC_Msg_Disp_Stat.phys );
    putValue( HMI_IC_Msg_Disp_Stat2, this.IC_Msg_Disp_Stat2.phys );
    putValue( HMI_WarnPrio1_Mute_Rq, this.WarnPrio1_Mute_Rq.phys );

// --- cyclicAndSpontanWithDelay 5 --- 500ms cycle time ---
// Evaluate if received message is on event 
    bAliveCtr = getValue( HMI__MSGAliveCtr_IC_WIM_AR );
    if( _IC_WIM_AR_OnEventTrap_Active )
    {
        putValue( HMI__MSG_OnEvent_IC_WIM_AR, 1 );
        cancelTimer( tIC_WIM_AR_OnEventIND );
        setTimer( tIC_WIM_AR_OnEventIND, 1000 );
    }
    else
    {
        _IC_WIM_AR_CycleReduction++;
        if( _IC_WIM_AR_CycleReduction >= _cIC_WIM_AR_CycleReductionValue )
        {
            _IC_WIM_AR_CycleReduction = 0;
            if( bAliveCtr < 8 )
            {
                bAliveCtr = ( bAliveCtr + 1 ) & 0x07;
            }
            else
            {
                bAliveCtr = 0;
            }
        }
        putValue( HMI__MSGAliveCtr_IC_WIM_AR, bAliveCtr );
        _IC_WIM_AR_OnEventTrap_Active = 1;
        setTimer( tIC_WIM_AR_OnEventTrap, _IC_WIM_AR_OnEventDetectTime );
    }
}

on timer tIC_WIM_AR_OnEventIND
{
    putValue( HMI__MSG_OnEvent_IC_WIM_AR, 0 );
}

on timer tIC_WIM_AR_OnEventTrap
{
    _IC_WIM_AR_OnEventTrap_Active = 0;
}

on message IC_WIM2_AR
{
    byte bAliveCtr;

    putValue( HMI_IC_Indicator1_Disp_Stat, this.IC_Indicator1_Disp_Stat.phys );
    putValue( HMI_IC_Indicator2_Disp_Stat, this.IC_Indicator2_Disp_Stat.phys );
    putValue( HMI_IC_Indicator3_Disp_Stat, this.IC_Indicator3_Disp_Stat.phys );
    putValue( HMI_IC_Indicator4_Disp_Stat, this.IC_Indicator4_Disp_Stat.phys );
    putValue( HMI_IC_Indicator5_Disp_Stat, this.IC_Indicator5_Disp_Stat.phys );
    putValue( HMI_IC_Indicator6_Disp_Stat, this.IC_Indicator6_Disp_Stat.phys );
    putValue( HMI_IC_Indicator7_Disp_Stat, this.IC_Indicator7_Disp_Stat.phys );
    putValue( HMI_IC_Indicator8_Disp_Stat, this.IC_Indicator8_Disp_Stat.phys );
    putValue( HMI_IC_Indicator9_Disp_Stat, this.IC_Indicator9_Disp_Stat.phys );
    putValue( HMI_IC_Indicator10_Disp_Stat, this.IC_Indicator10_Disp_Stat.phys );
    putValue( HMI_IC_Indicator11_Disp_Stat, this.IC_Indicator11_Disp_Stat.phys );
    putValue( HMI_IC_Indicator12_Disp_Stat, this.IC_Indicator12_Disp_Stat.phys );
    putValue( HMI_IC_Indicator13_Disp_Stat, this.IC_Indicator13_Disp_Stat.phys );
    putValue( HMI_IC_Indicator14_Disp_Stat, this.IC_Indicator14_Disp_Stat.phys );
    putValue( HMI_IC_Indicator15_Disp_Stat, this.IC_Indicator15_Disp_Stat.phys );
    putValue( HMI_IC_Indicator16_Disp_Stat, this.IC_Indicator16_Disp_Stat.phys );
    putValue( HMI_IC_Indicator17_Disp_Stat, this.IC_Indicator17_Disp_Stat.phys );
    putValue( HMI_IC_Indicator18_Disp_Stat, this.IC_Indicator18_Disp_Stat.phys );
    putValue( HMI_IC_Indicator19_Disp_Stat, this.IC_Indicator19_Disp_Stat.phys );
    putValue( HMI_IC_Indicator20_Disp_Stat, this.IC_Indicator20_Disp_Stat.phys );
    putValue( HMI_IC_Indicator21_Disp_Stat, this.IC_Indicator21_Disp_Stat.phys );
    putValue( HMI_IC_Indicator22_Disp_Stat, this.IC_Indicator22_Disp_Stat.phys );
    putValue( HMI_IC_Indicator23_Disp_Stat, this.IC_Indicator23_Disp_Stat.phys );
    putValue( HMI_IC_Indicator24_Disp_Stat, this.IC_Indicator24_Disp_Stat.phys );
    putValue( HMI_IC_Indicator25_Disp_Stat, this.IC_Indicator25_Disp_Stat.phys );
    putValue( HMI_IC_Indicator26_Disp_Stat, this.IC_Indicator26_Disp_Stat.phys );
    putValue( HMI_IC_Indicator27_Disp_Stat, this.IC_Indicator27_Disp_Stat.phys );
    putValue( HMI_IC_Indicator28_Disp_Stat, this.IC_Indicator28_Disp_Stat.phys );
    putValue( HMI_IC_Indicator29_Disp_Stat, this.IC_Indicator29_Disp_Stat.phys );
	  putValue( HMI_IC_Indicator30_Disp_Stat, this.IC_Indicator30_Disp_Stat.phys );
	  putValue( HMI_IC_Indicator31_Disp_Stat, this.IC_Indicator31_Disp_Stat.phys );
    putValue( HMI_IC_Indicator32_Disp_Stat, this.IC_Indicator32_Disp_Stat.phys );

// --- cyclicAndSpontanWithDelay 5 --- 500ms cycle time ---
// Evaluate if received message is on event 
    bAliveCtr = getValue( HMI__MSGAliveCtr_IC_WIM2_AR );
    if( _IC_WIM2_AR_OnEventTrap_Active )
    {
        putValue( HMI__MSG_OnEvent_IC_WIM2_AR, 1 );
        cancelTimer( tIC_WIM2_AR_OnEventIND );
        setTimer( tIC_WIM2_AR_OnEventIND, 1000 );
    }
    else
    {
        _IC_WIM2_AR_CycleReduction++;
        if( _IC_WIM2_AR_CycleReduction >= _cIC_WIM2_AR_CycleReductionValue )
        {
            _IC_WIM2_AR_CycleReduction = 0;
            if( bAliveCtr < 8 )
            {
                bAliveCtr = ( bAliveCtr + 1 ) & 0x07;
            }
            else
            {
                bAliveCtr = 0;
            }
        }
        putValue( HMI__MSGAliveCtr_IC_WIM2_AR, bAliveCtr );
        _IC_WIM2_AR_OnEventTrap_Active = 1;
        setTimer( tIC_WIM2_AR_OnEventTrap, _IC_WIM2_AR_OnEventDetectTime );
    }
}

on timer tIC_WIM2_AR_OnEventIND
{
    putValue( HMI__MSG_OnEvent_IC_WIM2_AR, 0 );
}

on timer tIC_WIM2_AR_OnEventTrap
{
    _IC_WIM2_AR_OnEventTrap_Active = 0;
}

on message LDC_Disp_Stat_IC_AR
{
    byte bAliveCtr;

    putValue( HMI_BSM_DispIfc_ok, this.BSM_DispIfc_ok.phys );
    putValue( HMI_DTQ_DispIfc_ok, this.DTQ_DispIfc_ok.phys );
    putValue( HMI_FCW_Ifc_ok, this.FCW_Ifc_ok.phys );
    putValue( HMI_LDC_Ifc_ok_ESP, this.LDC_Ifc_ok_ESP.phys );
    putValue( HMI_LDC_Ifc_ok_RDU, this.LDC_Ifc_ok_RDU.phys );
    putValue( HMI_LDC_SpdUnit_Rq, this.LDC_SpdUnit_Rq.phys );
    putValue( HMI_LDC_SPEEDO_Cal, this.LDC_SPEEDO_Cal.phys );
    putValue( HMI_LDC_SPEEDO_SegRing_Avl, this.LDC_SPEEDO_SegRing_Avl.phys );
    putValue( HMI_LDP_Ifc_Ok, this.LDP_Ifc_Ok.phys );
    putValue( HMI_Rsrv1_LDC_Disp_Stat_IC, this.Rsrv1_LDC_Disp_Stat_IC.phys );
    putValue( HMI_Rsrv2_LDC_Disp_Stat_IC, this.Rsrv2_LDC_Disp_Stat_IC.phys );
    putValue( HMI_Rsrv3_LDC_Disp_Stat_IC, this.Rsrv3_LDC_Disp_Stat_IC.phys );
    putValue( HMI_Rsrv4_LDC_Disp_Stat_IC, this.Rsrv4_LDC_Disp_Stat_IC.phys );
    putValue( HMI_Rsrv5_LDC_Disp_Stat_IC, this.Rsrv5_LDC_Disp_Stat_IC.phys );
    putValue( HMI_FDC_ActvOffer_Conf_IC, this.FDC_ActvOffer_Conf_IC.phys );
    putValue( HMI_FDC_ASIL_Chk_IC, this.FDC_ASIL_Chk_IC.phys );
    putValue( HMI_FDC_Ifc_OK, this.FDC_Ifc_OK.phys );	
	putValue( HMI_FDC_ActvOffer_With_WthrConf_IC, this.FDC_ActvOffer_With_WthrConf_IC.phys );
	putValue( HMI_FDC_ActvOffer_Without_WthrConf_IC, this.FDC_ActvOffer_Without_WthrConf_IC.phys );

// --- cyclicAndSpontanWithDelay 5 --- 200ms cycle time ---
// Evaluate if received message is on event 
    bAliveCtr = getValue( HMI__MSGAliveCtr_LDC_Disp_Stat_IC_AR );
    if( _LDC_Disp_Stat_IC_AR_OnEventTrap_Active )
    {
        putValue( HMI__MSG_OnEvent_LDC_Disp_Stat_IC_AR, 1 );
        cancelTimer( tLDC_Disp_Stat_IC_AR_OnEventIND );
        setTimer( tLDC_Disp_Stat_IC_AR_OnEventIND, 1000 );
    }
    else
    {
        _LDC_Disp_Stat_IC_AR_CycleReduction++;
        if( _LDC_Disp_Stat_IC_AR_CycleReduction >= _cLDC_Disp_Stat_IC_AR_CycleReductionValue )
        {
            _LDC_Disp_Stat_IC_AR_CycleReduction = 0;
            if( bAliveCtr < 8 )
            {
                bAliveCtr = ( bAliveCtr + 1 ) & 0x07;
            }
            else
            {
                bAliveCtr = 0;
            }
        }
        putValue( HMI__MSGAliveCtr_LDC_Disp_Stat_IC_AR, bAliveCtr );
        _LDC_Disp_Stat_IC_AR_OnEventTrap_Active = 1;
        setTimer( tLDC_Disp_Stat_IC_AR_OnEventTrap, _LDC_Disp_Stat_IC_AR_OnEventDetectTime );
    }
}

on timer tLDC_Disp_Stat_IC_AR_OnEventIND
{
    putValue( HMI__MSG_OnEvent_LDC_Disp_Stat_IC_AR, 0 );
}

on timer tLDC_Disp_Stat_IC_AR_OnEventTrap
{
    _LDC_Disp_Stat_IC_AR_OnEventTrap_Active = 0;
}

on message Maintenance1_AR
{
    byte bAliveCtr;

    putValue( HMI_MtData_Ok,        this.MtData_Ok.phys );
    putValue( HMI_MtPckt_1_Due,     this.MtPckt_1_Due.phys );
    putValue( HMI_MtPckt_2_Due,     this.MtPckt_2_Due.phys );
    putValue( HMI_MtPckt_3_Due,     this.MtPckt_3_Due.phys );
    putValue( HMI_MtPckt_4_Due,     this.MtPckt_4_Due.phys );
    putValue( HMI_MtPckt_5_Due,     this.MtPckt_5_Due.phys );
    putValue( HMI_MtPckt_6_Due,     this.MtPckt_6_Due.phys );
    putValue( HMI_MtPckt_7_Due,     this.MtPckt_7_Due.phys );
    putValue( HMI_Prio_ResDistTm,   this.Prio_ResDistTm.phys );
    putValue( HMI_ResDist,          this.ResDist.phys );
    putValue( HMI_ResTm_V2,         this.ResTm_V2.phys );
    putValue( HMI_ServCode_Digit1,  this.ServCode_Digit1.phys );
    putValue( HMI_ServCode_Digit2,  this.ServCode_Digit2.phys );
    putValue( HMI_ServCont,         this.ServCont.phys );
    putValue( HMI_ServDispMd,       this.ServDispMd.phys );
    putValue( HMI_ServWarn,         this.ServWarn.phys );
    putValue( HMI_SpecServ_Disp_Rq, this.SpecServ_Disp_Rq.phys );
    putValue( HMI_Unit_ResDist,     this.Unit_ResDist.phys );

// --- cyclicAndSpontanWithDelay 5 --- 5000ms cycle time ---
// Evaluate if received message is on event 
    bAliveCtr = getValue( HMI__MSGAliveCtr_Maintenance1_AR );
    if( _Maintenance1_AR_OnEventTrap_Active )
    {
        putValue( HMI__MSG_OnEvent_Maintenance1_AR, 1 );
        cancelTimer( tMaintenance1_AR_OnEventIND );
        setTimer( tMaintenance1_AR_OnEventIND, 1000 );
    }
    else
    {
        if( bAliveCtr < 8 )
        {
            bAliveCtr = ( bAliveCtr + 1 ) & 0x07;
        }
        else
        {
            bAliveCtr = 0;
		}
        putValue( HMI__MSGAliveCtr_Maintenance1_AR, bAliveCtr );
        _Maintenance1_AR_OnEventTrap_Active = 1;
        setTimer( tMaintenance1_AR_OnEventTrap, _Maintenance1_AR_OnEventDetectTime );
    }
}

on timer tMaintenance1_AR_OnEventIND
{
    putValue( HMI__MSG_OnEvent_Maintenance1_AR, 0 );
}

on timer tMaintenance1_AR_OnEventTrap
{
    _Maintenance1_AR_OnEventTrap_Active = 0;
}

on message Maintenance2_AR
{
    byte bAliveCtr;

    putValue( HMI_ServCode_BitGrp_0, this.ServCode_BitGrp_0.phys );//neu SLP10.08
    putValue( HMI_ServCode_BitGrp_1, this.ServCode_BitGrp_1.phys );
    putValue( HMI_ServCode_BitGrp_2, this.ServCode_BitGrp_2.phys );
    putValue( HMI_ServCode_BitGrp_3, this.ServCode_BitGrp_3.phys );
    putValue( HMI_ServCode_BitGrp_4, this.ServCode_BitGrp_4.phys );
    putValue( HMI_ServCode_BitGrp_5, this.ServCode_BitGrp_5.phys );
    putValue( HMI_ServCode_BitGrp_6, this.ServCode_BitGrp_6.phys );
    putValue( HMI_ServCode_BitGrp_minus1, this.ServCode_BitGrp_minus1.phys );//neu SLP10.08
    putValue( HMI_ServCode_BitGrp_minus2, this.ServCode_BitGrp_minus2.phys );//neu SLP10.08
    putValue( HMI_ServCode_BitGrp_minus2, this.ServCode_BitGrp_minus3.phys );//neu SLP10.08
    putValue( HMI_ServCode_Country_V2, this.ServCode_Country_V2.phys );
    putValue( HMI_ServCode_CRC_Hi, this.ServCode_CRC_Hi.phys );
    putValue( HMI_ServCode_CRC_Lo, this.ServCode_CRC_Lo.phys );

// --- cyclicAndSpontanWithDelay 5 --- 2000ms cycle time ---
// Evaluate if received message is on event 
    bAliveCtr = getValue( HMI__MSGAliveCtr_Maintenance2_AR );
    if( _Maintenance2_AR_OnEventTrap_Active )
    {
        putValue( HMI__MSG_OnEvent_Maintenance2_AR, 1 );
        cancelTimer( tMaintenance2_AR_OnEventIND );
        setTimer( tMaintenance2_AR_OnEventIND, 1000 );
    }
    else
    {
        if( bAliveCtr < 8 )
        {
            bAliveCtr = ( bAliveCtr + 1 ) & 0x07;
        }
        else
        {
            bAliveCtr = 0;
		}
        putValue( HMI__MSGAliveCtr_Maintenance2_AR, bAliveCtr );
        _Maintenance2_AR_OnEventTrap_Active = 1;
        setTimer( tMaintenance2_AR_OnEventTrap, _Maintenance2_AR_OnEventDetectTime );
    }
}

on timer tMaintenance2_AR_OnEventIND
{
    putValue( HMI__MSG_OnEvent_Maintenance2_AR, 0 );
}

on timer tMaintenance2_AR_OnEventTrap
{
    _Maintenance2_AR_OnEventTrap_Active = 0;
}

on message Maintenance3_AR
{
    byte bAliveCtr;

    putValue( HMI_RemTm_ServCall, this.RemTm_ServCall.phys );

// --- cyclicAndSpontanWithDelay 5 --- 2000ms cycle time ---
// Evaluate if received message is on event 
    bAliveCtr = getValue( HMI__MSGAliveCtr_Maintenance3_AR );
    if( _Maintenance3_AR_OnEventTrap_Active )
    {
        putValue( HMI__MSG_OnEvent_Maintenance3_AR, 1 );
        cancelTimer( tMaintenance3_AR_OnEventIND );
        setTimer( tMaintenance3_AR_OnEventIND, 1000 );
    }
    else
    {
        if( bAliveCtr < 8 )
        {
            bAliveCtr = ( bAliveCtr + 1 ) & 0x07;
        }
        else
        {
            bAliveCtr = 0;
		}
        putValue( HMI__MSGAliveCtr_Maintenance3_AR, bAliveCtr );
        _Maintenance3_AR_OnEventTrap_Active = 1;
        setTimer( tMaintenance3_AR_OnEventTrap, _Maintenance3_AR_OnEventDetectTime );
    }
}

on timer tMaintenance3_AR_OnEventIND
{
    putValue( HMI__MSG_OnEvent_Maintenance3_AR, 0 );
}

on timer tMaintenance3_AR_OnEventTrap
{
    _Maintenance3_AR_OnEventTrap_Active = 0;
}

on message Meas_IC_1
{
    byte bAliveCtr;

    putValue( HMI_Meas_IC_1A, 						this.Meas_IC_1A.phys );
    putValue( HMI_Meas_IC_1B, 						this.Meas_IC_1B.phys );
    putValue( HMI_Meas_IC_1C, 						this.Meas_IC_1C.phys );
    putValue( HMI_Meas_IC_1D, 						this.Meas_IC_1D.phys );
    putValue( HMI_Meas_IC_1E, 						this.Meas_IC_1E.phys );
    putValue( HMI_Meas_IC_1F, 						this.Meas_IC_1F.phys );
    putValue( HMI_Meas_IC_1G, 						this.Meas_IC_1G.phys );
    putValue( HMI_Meas_IC_1H, 						this.Meas_IC_1H.phys );
    putValue( Env_HIL_ControlLampPreheatDiesel, this.HIL_ControlLampPreheatDiesel.phys );
    putValue( Env_HIL_ControlLampABS_Defect, this.HIL_ControlLampABS_Defect.phys );
    putValue( Env_HIL_FuelReserve, this.HIL_FuelReserve.phys );
    putValue( Env_HIL_ControlLampFlash_L, this.HIL_ControlLampFlash_L.phys );
    putValue( Env_HIL_ControlLampFlash_R, this.HIL_ControlLampFlash_R.phys );
    putValue( Env_HIL_ControlLampChkEngine_EOBD, this.HIL_ControlLampChkEngine_EOBD.phys );
    putValue( Env_HIL_ControlLampTirePressWarn, this.HIL_ControlLampTirePressWarn.phys );
    putValue( Env_HIL_ControlLampSeatbelts, this.HIL_ControlLampSeatbelts.phys );
    putValue( Env_HIL_ControlLampSRS, this.HIL_ControlLampSRS.phys );
    putValue( Env_HIL_ControlLampESP_ASR, this.HIL_ControlLampESP_ASR.phys );
    putValue( Env_HIL_ControlLampHighBeam, this.HIL_ControlLampHighBeam.phys );
    putValue( Env_HIL_ControlLampPositionLamp, this.HIL_ControlLampPositionLamp.phys );
    putValue( Env_HIL_ControlLampDTR_Red, this.HIL_ControlLampDTR_Red.phys );
    putValue( Env_HIL_ControlLampBrake, this.HIL_ControlLampBrake.phys );
    putValue( Env_HIL_ControlLampBrake_USA, this.HIL_ControlLampBrake_USA.phys );
    putValue( Env_HIL_OffroadStatusIcon, this.HIL_OffroadStatusIcon.phys );
    putValue( Env_HIL_ControlLampESP_Off, this.HIL_ControlLampESP_Off.phys );
    putValue( Env_HIL_ControlLampWaterTemp, this.HIL_ControlLampWaterTemp.phys );
    putValue( Env_HIL_ControlLampLowBeam, this.HIL_ControlLampLowBeam.phys );
    putValue( Env_HIL_ControlLampFogLamp, this.HIL_ControlLampFogLamp.phys );
    putValue( Env_HIL_ControlLampFogLampRear, this.HIL_ControlLampFogLampRear.phys );
    putValue( Env_HIL_ControlLampRBS, this.HIL_ControlLampRBS.phys );
    putValue( Env_HIL_ReadyStatIcon_Hyb, this.HIL_ReadyStatIcon_Hyb.phys );
    putValue( Env_HIL_ControlLampYellowBrakeSymbol, this.HIL_ControlLampYellowBrakeSymbol.phys );
 //   putValue( Env_HIL_ControlLampCheckEngineUSA, this.HIL_ControlLampCheckEngineUSA.phys );
    putValue( Env_HIL_ReadyPassivStatIcon_Hyb, this.HIL_ReadyPassivStatIcon_Hyb.phys );
    putValue( Env_HIL_ControlLampParkBrkActRed, this.HIL_ControlLampParkBrkActRed.phys );
    putValue( Env_HIL_ControlLampParkBrkActRedUSA, this.HIL_ControlLampParkBrkActRedUSA.phys );
    putValue( Env_HIL_ControlLampParkBrkDefYel, this.HIL_ControlLampParkBrkDefYel.phys );
    putValue( Env_HIL_ControlLampParkBrkDefYelUSA, this.HIL_ControlLampParkBrkDefYelUSA.phys );
    putValue( Env_HIL_SpeedometerMode, this.HIL_SpeedometerMode.phys );
    putValue( Env_HIL_AmbientTemp, this.HIL_AmbientTemp.phys );
    putValue( Env_HIL_ECO_PassivIcon, this.HIL_ECO_PassivIcon.phys );
    putValue( Env_HIL_StatusIcon_LowRange, this.HIL_StatusIcon_LowRange.phys );
    putValue( Env_HIL_SupplySystemIndLamp, this.HIL_SupplySystemIndLamp.phys );
    putValue( Env_HIL_DigitalClock, this.HIL_DigitalClock.phys );
    putValue( Env_HIL_Limiter, this.HIL_Limiter.phys );
    putValue( Env_HIL_Tempomat, this.HIL_Tempomat.phys );
    putValue( Env_HIL_DTR_Speaker, this.HIL_DTR_Speaker.phys );
    putValue( Env_HIL_CNG, this.HIL_CNG.phys );
    putValue( Env_HIL_RearWiperActive, this.HIL_RearWiperActive.phys );
    putValue( Env_HIL_UK_Speedometer, this.HIL_UK_Speedometer.phys );
    putValue( Env_HIL_DigiTachoInStatusArea, this.HIL_DigiTachoInStatusArea.phys );
    putValue( Env_HIL_H2_DFTSigDispStat, this.HIL_H2_DFTSigDispStat.phys );
    putValue( Env_HIL_Acoustic_Volume, this.HIL_Acoustic_Volume.phys );
    putValue( Env_HIL_SBC_H, this.HIL_SBC_H.phys );
    putValue( Env_HIL_ElectricRange, this.HIL_ElectricRange.phys );
    putValue( Env_HIL_EngineRun, this.HIL_EngineRun.phys );
    putValue( Env_HIL_GearSelectInd, this.HIL_GearSelectInd.phys );
  //  putValue( Env_HIL_DrivingProgramMeas1, this.HIL_DrivingProgramMeas1.phys );
    putValue( Env_HIL_AttentionAssistIcon, this.HIL_AttentionAssistIcon.phys );
    putValue( Env_HIL_AutoHighBeam, this.HIL_AutoHighBeam.phys );
    putValue( Env_HIL_LaneDeptWarnIconYellow, this.HIL_LaneDeptWarnIconYellow.phys );
    putValue( Env_HIL_CoolantTemp, this.HIL_CoolantTemp.phys );
    putValue( Env_HIL_LaneDeptWarnIconWhite, this.HIL_LaneDeptWarnIconWhite.phys );

// --- spontan 1 --- 
// Evaluate if received message is on event 
    bAliveCtr = getValue( HMI__MSGAliveCtr_Meas_IC_1 );
    if( _Meas_IC_1_OnEventTrap_Active )
    {
        putValue( HMI__MSG_OnEvent_Meas_IC_1, 1 );
        cancelTimer( tMeas_IC_1_OnEventIND );
        setTimer( tMeas_IC_1_OnEventIND, 1000 );
    }
    else
    {
        if( bAliveCtr < 8 )
        {
            bAliveCtr = ( bAliveCtr + 1 ) & 0x07;
        }
        else
        {
            bAliveCtr = 0;
		}
        putValue( HMI__MSGAliveCtr_Meas_IC_1, bAliveCtr );
        _Meas_IC_1_OnEventTrap_Active = 1;
        setTimer( tMeas_IC_1_OnEventTrap, _Meas_IC_1_OnEventDetectTime );
    }
}

on timer tMeas_IC_1_OnEventIND
{
    putValue( HMI__MSG_OnEvent_Meas_IC_1, 0 );
}

on timer tMeas_IC_1_OnEventTrap
{
    _Meas_IC_1_OnEventTrap_Active = 0;
}

on message Meas_IC_2
{
    byte bAliveCtr;

    putValue( HMI_Meas_IC_2A, 		   this.Meas_IC_2A.phys );
    putValue( HMI_Meas_IC_2B, 		   this.Meas_IC_2B.phys );
    putValue( HMI_Meas_IC_2C, 		   this.Meas_IC_2C.phys );
    putValue( HMI_Meas_IC_2D, 		   this.Meas_IC_2D.phys );
    putValue( HMI_Meas_IC_2E, 		   this.Meas_IC_2E.phys );
    putValue( HMI_Meas_IC_2F, 		   this.Meas_IC_2F.phys );
    putValue( HMI_Meas_IC_2G, 		   this.Meas_IC_2G.phys );
    putValue( HMI_Meas_IC_2H, 		   this.Meas_IC_2H.phys );
    putValue( Env_HIL_RelVolumeAcoust,		this.HIL_RelVolumeAcoust.phys );
    putValue( Env_HIL_EngineSpeed,		this.HIL_EngineSpeed.phys );
//    putValue( Env_HIL_System,			this.HIL_System.phys );
    putValue( Env_HIL_GulfstateWarnIconStat,	this.HIL_GulfstateWarnIconStat.phys );
    putValue( Env_HIL_DrivingProgram_C_E,	this.HIL_DrivingProgram_C_E.phys );
//    putValue( Env_HIL_DrivingProgramMeas2,	this.HIL_DrivingProgramMeas2.phys );
    putValue( Env_HIL_DisplayedUnit,		this.HIL_DisplayedUnit.phys );
    putValue( Env_HIL_CMS_StatusIconMeas2,	this.HIL_CMS_StatusIconMeas2.phys );
//  putValue( Env_HIL_DrivingPosition,		this.HIL_DrivingPosition.phys );
    putValue( Env_HIL_DisplayedLayoutVar,	this.HIL_DisplayedLayoutVar.phys );
    putValue( Env_HIL_SelectedSpeed,		this.HIL_SelectedSpeed.phys );
    putValue( Env_HIL_Cruise_Text_Symbol,	this.HIL_Cruise_Text_Symbol.phys );
    putValue( Env_HIL_StatusLine,		this.HIL_StatusLine.phys );

// --- spontan 1 --- 
// Evaluate if received message is on event 
    bAliveCtr = getValue( HMI__MSGAliveCtr_Meas_IC_2 );
    if( _Meas_IC_2_OnEventTrap_Active )
    {
        putValue( HMI__MSG_OnEvent_Meas_IC_2, 1 );
        cancelTimer( tMeas_IC_2_OnEventIND );
        setTimer( tMeas_IC_2_OnEventIND, 1000 );
    }
    else
    {
        if( bAliveCtr < 8 )
        {
            bAliveCtr = ( bAliveCtr + 1 ) & 0x07;
        }
        else
        {
            bAliveCtr = 0;
		}
        putValue( HMI__MSGAliveCtr_Meas_IC_2, bAliveCtr );
        _Meas_IC_2_OnEventTrap_Active = 1;
        setTimer( tMeas_IC_2_OnEventTrap, _Meas_IC_2_OnEventDetectTime );
    }
}

on timer tMeas_IC_2_OnEventIND
{
    putValue( HMI__MSG_OnEvent_Meas_IC_2, 0 );
}

on timer tMeas_IC_2_OnEventTrap
{
    _Meas_IC_2_OnEventTrap_Active = 0;
}

on message Meas_IC_3
{
    byte bAliveCtr;

    putValue( HMI_Meas_IC_3A, 		            this.Meas_IC_3A.phys );
    putValue( HMI_Meas_IC_3B, 		            this.Meas_IC_3B.phys );
    putValue( HMI_Meas_IC_3C, 		            this.Meas_IC_3C.phys );
    putValue( HMI_Meas_IC_3D, 		            this.Meas_IC_3D.phys );
    putValue( HMI_Meas_IC_3E, 		            this.Meas_IC_3E.phys );
    putValue( HMI_Meas_IC_3F, 		            this.Meas_IC_3F.phys );
    putValue( HMI_Meas_IC_3G, 		            this.Meas_IC_3G.phys );
    putValue( HMI_Meas_IC_3H, 		            this.Meas_IC_3H.phys );
    putValue( Env_HIL_SpeedLimitAssistInvert,	this.HIL_SpeedLimitAssistInvert.phys );
    putValue( Env_HIL_SpeedLimitAssist,		    this.HIL_SpeedLimitAssist.phys );
    putValue( Env_HIL_CNG_StatusIconMeas3,	  this.HIL_CNG_StatusIconMeas3.phys );
    putValue( Env_HIL_TurnIndSounder,		      this.HIL_TurnIndSounder.phys );
    putValue( Env_HIL_ShiftRecTargetGear,	    this.HIL_ShiftRecTargetGear.phys );
    putValue( Env_HIL_ShiftRecommArrows,	    this.HIL_ShiftRecommArrows.phys );
    putValue( Env_HIL_ParktronicLeft,		      this.HIL_ParktronicLeft.phys );
    putValue( Env_HIL_ParkingSpaceSearchAct,	this.HIL_ParkingSpaceSearchAct.phys );
    putValue( Env_HIL_ParkingSpaceRight,	    this.HIL_ParkingSpaceRight.phys );
    putValue( Env_HIL_ParkingSpaceLeft,		    this.HIL_ParkingSpaceLeft.phys );
    putValue( Env_HIL_ParkingSpaceFound,	    this.HIL_ParkingSpaceFound.phys );
    putValue( Env_HIL_ECO_Icon,			          this.HIL_ECO_Icon.phys );
    putValue( Env_HIL_Chime,			            this.HIL_Chime.phys );
    putValue( Env_HIL_Buzzer,			            this.HIL_Buzzer.phys );
    putValue( Env_HIL_BritishEnglish,		      this.HIL_BritishEnglish.phys );
    putValue( Env_HIL_BlindSpotMonitoring,	  this.HIL_BlindSpotMonitoring.phys );
    putValue( Env_HIL_ParktronicRight,		    this.HIL_ParktronicRight.phys );
    putValue( Env_HIL_DisplayColor,		        this.HIL_DisplayColor.phys );
    //putValue( Env_HIL_Language,			          this.HIL_Language.phys );
    putValue( Env_HIL_Submenu_Msg_Byte2,	    this.HIL_Submenu_Msg_Byte2 );
    putValue( Env_HIL_Submenu_Msg_Byte1,	    this.HIL_Submenu_Msg_Byte1 );
    putValue( Env_HIL_MainMenu,			          this.HIL_MainMenu );
//  write(" HIL_Meas_3 ID -> %02X %02X %02X ",this.HIL_MainMenu,  this.HIL_Submenu_Msg_Byte1, this.HIL_Submenu_Msg_Byte2 );

// --- spontan 1 --- 
// Evaluate if received message is on event 
    bAliveCtr = getValue( HMI__MSGAliveCtr_Meas_IC_3 );
    if( _Meas_IC_3_OnEventTrap_Active )
    {
        putValue( HMI__MSG_OnEvent_Meas_IC_3, 1 );
        cancelTimer( tMeas_IC_3_OnEventIND );
        setTimer( tMeas_IC_3_OnEventIND, 1000 );
    }
    else
    {
        if( bAliveCtr < 8 )
        {
            bAliveCtr = ( bAliveCtr + 1 ) & 0x07;
        }
        else
        {
            bAliveCtr = 0;
	}
        putValue( HMI__MSGAliveCtr_Meas_IC_3, bAliveCtr );
        _Meas_IC_3_OnEventTrap_Active = 1;
        setTimer( tMeas_IC_3_OnEventTrap, _Meas_IC_3_OnEventDetectTime );
    }
}

on timer tMeas_IC_3_OnEventIND
{
    putValue( HMI__MSG_OnEvent_Meas_IC_3, 0 );
}

on timer tMeas_IC_3_OnEventTrap
{
    _Meas_IC_3_OnEventTrap_Active = 0;
}

on message Meas_IC_4
{
    byte bAliveCtr;

    putValue( HMI_Meas_IC_4A, 		this.Meas_IC_4A.phys );
    putValue( HMI_Meas_IC_4B, 		this.Meas_IC_4B.phys );
    putValue( HMI_Meas_IC_4C, 		this.Meas_IC_4C.phys );
    putValue( HMI_Meas_IC_4D, 		this.Meas_IC_4D.phys );
    putValue( HMI_Meas_IC_4E, 		this.Meas_IC_4E.phys );
    putValue( HMI_Meas_IC_4F, 		this.Meas_IC_4F.phys );
    putValue( HMI_Meas_IC_4G, 		this.Meas_IC_4G.phys );
    putValue( HMI_Meas_IC_4H, 		this.Meas_IC_4H.phys );
    putValue( Env_HIL_LayoutNumber, 		this.Meas_IC_4H.phys );

    switch( this.HIL_LayoutNumber.phys )
    {
        case 0x01:
                    /* MESS_IC4 (LV 0x01) - Trip Computer Ab Start */
                    bAliveCtr = getValue( Env_HIL_RX_01_Alive );
                    if( bAliveCtr < 8 )
                    {
                        bAliveCtr = ( bAliveCtr + 1 ) & 0x07;
                    }
                    else
                    {
                        bAliveCtr = 0;
                    }
                    putValue( Env_HIL_RX_01_Alive, bAliveCtr );
                    putValue( Env_HIL_TimeSinceStart,            this.HIL_TimeSinceStart.phys );
                    putValue( Env_HIL_DistanceSinceStart,        this.HIL_DistanceSinceStart.phys );
                    putValue( Env_HIL_AvgSpeedSinceStart,        this.HIL_AvgSpeedSinceStart.phys );
                    putValue( Env_HIL_AvgConsSinceStart,        this.HIL_AvgConsSinceStart.phys );
                    break;
        case 0x02:
                    /* MESS_IC4 (LV 0x02) - Trip Computer Ab Reset */
                    bAliveCtr = getValue( Env_HIL_RX_02_Alive );
                    if( bAliveCtr < 8 )
                    {
                        bAliveCtr = ( bAliveCtr + 1 ) & 0x07;
                    }
                    else
                    {
                        bAliveCtr = 0;
                    }
                    putValue( Env_HIL_RX_02_Alive, bAliveCtr );
                    putValue( Env_HIL_TimeSinceReset,            this.HIL_TimeSinceReset.phys );
                    putValue( Env_HIL_DistanceSinceReset,        this.HIL_DistanceSinceReset.phys );
                    putValue( Env_HIL_AvgSpeedSinceReset,        this.HIL_AvgSpeedSinceReset.phys );
                    putValue( Env_HIL_AvgConsSinceReset,        this.HIL_AvgConsSinceReset.phys );
                    break;
        case 0x03:
                    /* MESS_IC4 (LV 0x03) - Speedometer and Fuellevel */
                    bAliveCtr = getValue( Env_HIL_RX_03_Alive );
                    if( bAliveCtr < 8 )
                    {
                        bAliveCtr = ( bAliveCtr + 1 ) & 0x07;
                    }
                    else
                    {
                        bAliveCtr = 0;
                    }
                    putValue( Env_HIL_RX_03_Alive, bAliveCtr );
                    putValue( Env_HIL_IconVehicleMeas4_3,        this.HIL_IconVehicleMeas4_3.phys );
                    putValue( Env_HIL_FuelLevelIntTargetVal,    this.HIL_FuelLevelIntTargetVal.phys );
                    putValue( Env_HIL_FuelLevelDisplayedVal,    this.HIL_FuelLevelDisplayedVal.phys );
                    putValue( Env_HIL_FuelLevelBargraph,        this.HIL_FuelLevelBargraph_CNG.phys );
                    putValue( Env_HIL_SpeedoPointervalue,        this.HIL_SpeedoPointervalue.phys );
                    putValue( Env_HIL_LayoutNumber,                this.HIL_LayoutNumber.phys );
                    putValue( Env_HIL_TripRecorder_Daily,        this.HIL_TripRecorder_Daily.phys );
                    break;
        case 0x05:
                    bAliveCtr = getValue( Env_HIL_RX_05_Alive );
                    if( bAliveCtr < 8 )
                    {
                        bAliveCtr = ( bAliveCtr + 1 ) & 0x07;
                    }
                    else
                    {
                        bAliveCtr = 0;
                    }
                    putValue( Env_HIL_RX_05_Alive, bAliveCtr );
                    /* MESS_IC4 (LV 0x05) - Hybrid */
                
                    break;
        case 0x07:
                    /* MESS_IC4 (LV 0x07) - Verbrauch & Reichweite / Taxi */
                
                    break;
        case 0x08:
                    /* MESS_IC4 (LV 0x08) - Outside Temperature and Adblue */
                    bAliveCtr = getValue( Env_HIL_RX_08_Alive );
                    if( bAliveCtr < 8 )
                    {
                        bAliveCtr = ( bAliveCtr + 1 ) & 0x07;
                    }
                    else
                    {
                        bAliveCtr = 0;
                    }
                    putValue( Env_HIL_RX_08_Alive, bAliveCtr );
                    putValue( Env_HIL_HeatCompCounter,            this.HIL_HeatCompCounter.phys );
                    putValue( Env_HIL_EngSt_Remain,                this.HIL_EngSt_Remain.phys );
                    putValue( Env_HIL_EngineTempCounter,        this.HIL_EngineTempCounter.phys );
                    putValue( Env_HIL_AdblueEU6_RemainDist,        this.HIL_AdblueEU6_RemainDist.phys );
                    break;
        case 0x09:
                    /* MESS_IC4 (LV 0x09) - Speed Limit Assist */
/*                    bAliveCtr = getValue( Env_HIL_RX_09_Alive );
                    if( bAliveCtr < 8 )
                    {
                        bAliveCtr = ( bAliveCtr + 1 ) & 0x07;
                    }
                    else
                    {
                        bAliveCtr = 0;
                    }
                    putValue( Env_HIL_RX_09_Alive, bAliveCtr );*/
                    break;
        case 0x0A:
                    /* MESS_IC4 (LV 0x0A) - Belt Status Rear */
                    bAliveCtr = getValue( Env_HIL_RX_0A_Alive );
                    if( bAliveCtr < 8 )
                    {
                        bAliveCtr = ( bAliveCtr + 1 ) & 0x07;
                    }
                    else
                    {
                        bAliveCtr = 0;
                    }
                    putValue( Env_HIL_RX_0A_Alive, bAliveCtr );
                    putValue( Env_HIL_VehicleLine,                this.HIL_VehicleLine.phys );
                    putValue( Env_HIL_SeatRows,                    this.HIL_SeatRows.phys );
                    putValue( Env_HIL_IconVehicleMeas4_10,        this.HIL_IconVehicleMeas4_10.phys );
                    putValue( Env_HIL_Icon3rdRowRight,            this.HIL_Icon3rdRowRight.phys );
                    putValue( Env_HIL_Icon3rdRowLeft,            this.HIL_Icon3rdRowLeft.phys );
                    putValue( Env_HIL_Icon2ndRowRight,            this.HIL_Icon2ndRowRight.phys );
                    putValue( Env_HIL_Icon2ndRowMiddle,            this.HIL_Icon2ndRowMiddle.phys );
                    putValue( Env_HIL_Icon2ndRowLeft,            this.HIL_Icon2ndRowLeft.phys );
                    break;
        case 0x0D:
                    /* MESS_IC4 (LV 0x0D) - DTR2 (Distronic 2) */
                    bAliveCtr = getValue( Env_HIL_RX_0D_Alive );
                    if( bAliveCtr < 8 )
                    {
                        bAliveCtr = ( bAliveCtr + 1 ) & 0x07;
                    }
                    else
                    {
                        bAliveCtr = 0;
                    }
                    putValue( Env_HIL_RX_0D_Alive, bAliveCtr );
                    break;
        case 0x0E:
                    /* MESS_IC4 (LV 0x0E) - Tire Pressure Monitoring */
                    bAliveCtr = getValue( Env_HIL_RX_0E_Alive );
                    if( bAliveCtr < 8 )
                    {
                        bAliveCtr = ( bAliveCtr + 1 ) & 0x07;
                    }
                    else
                    {
                        bAliveCtr = 0;
                    }
                    putValue( Env_HIL_RX_0E_Alive, bAliveCtr );
                    break;
        case 0x0F:
                    /* MESS_IC4 (LV 0x0F) - TSA */
                    bAliveCtr = getValue( Env_HIL_RX_0F_Alive );
                    if( bAliveCtr < 8 )
                    {
                        bAliveCtr = ( bAliveCtr + 1 ) & 0x07;
                    }
                    else
                    {
                        bAliveCtr = 0;
                    }
                    putValue( Env_HIL_RX_0F_Alive, bAliveCtr );
                    putValue( Env_HIL_TSA_WarnText,                this.HIL_TSA_WarnText.phys );
                    putValue( Env_HIL_TSA_SpeedUnit,            this.HIL_TSA_SpeedUnit.phys );
                    putValue( Env_HIL_TSA_IconSet,                this.HIL_TSA_IconSet.phys );
                    putValue( Env_HIL_TSA_DispPopupActiv,        this.HIL_TSA_DispPopupActiv.phys );
                    putValue( Env_HIL_TSA_DispPermanentActiv,    this.HIL_TSA_DispPermanentActiv.phys );
                    putValue( Env_HIL_TSA_AddInfoAlign,            this.HIL_TSA_AddInfoAlign.phys );
                    putValue( Env_HIL_TSA_AddInfo,                this.HIL_TSA_AddInfo.phys );
                    putValue( Env_HIL_SLA_Sign2,                this.HIL_SLA_Sign2.phys );
                    putValue( Env_HIL_SLA_Sign1,                this.HIL_SLA_Sign1.phys );
                    break;
        case 0x10:
                    /* MESS_IC4 (LV 0x10) - Acoustics and Coolant Temperature */
                    bAliveCtr = getValue( Env_HIL_RX_10_Alive );
                    if( bAliveCtr < 8 )
                    {
                        bAliveCtr = ( bAliveCtr + 1 ) & 0x07;
                    }
                    else
                    {
                        bAliveCtr = 0;
                    }
                    putValue( Env_HIL_RX_10_Alive, bAliveCtr );
                    putValue( Env_HIL_CoolantTempUnit,            this.HIL_CoolantTempUnit.phys );
                    putValue( Env_HIL_CoolantTempTellTale,        this.HIL_CoolantTempTellTale.phys );
                    putValue( Env_HIL_CoolantTempDisplayed,        this.HIL_CoolantTempDisplayed.phys );
                    putValue( Env_HIL_AcoustTurnSignalOn,        this.HIL_AcoustTurnSignalOn.phys );
                    putValue( Env_HIL_AcoustTurnSignalOff,        this.HIL_AcoustTurnSignalOff.phys );
                    putValue( Env_HIL_AcoustSeatBeltWarniLvl2,    this.HIL_AcoustSeatBeltWarniLvl2.phys );
                    putValue( Env_HIL_AcoustSeatBeltWarniLvl1,    this.HIL_AcoustSeatBeltWarniLvl1.phys );
                    putValue( Env_HIL_AcoustPrio2Warn,            this.HIL_AcoustPrio2Warn.phys );
                    putValue( Env_HIL_AcoustPrio1Warn,            this.HIL_AcoustPrio1Warn.phys );
                    putValue( Env_HIL_AcoustParktronicSound,    this.HIL_AcoustParktronicSound.phys );
                    putValue( Env_HIL_AcoustLatCollWarn,        this.HIL_AcoustLatCollWarn.phys );
                    putValue( Env_HIL_AcoustFrontCollWarn,        this.HIL_AcoustFrontCollWarn.phys );
                    putValue( Env_HIL_AcoustContWarn,            this.HIL_AcoustContWarn.phys );
                    putValue( Env_HIL_AcoustAttentionAssWarn,    this.HIL_AcoustAttentionAssWarn.phys );
                    putValue( Env_HIL_AcoustAcknowledgement,    this.HIL_AcoustAcknowledgement.phys );
                    break;
        case 0x11:
                    /* MESS_IC4 (LV 0x11) - Eco Score */
                    bAliveCtr = getValue( Env_HIL_RX_11_Alive );
                    if( bAliveCtr < 8 )
                    {
                        bAliveCtr = ( bAliveCtr + 1 ) & 0x07;
                    }
                    else
                    {
                        bAliveCtr = 0;
                    }
                    putValue( Env_HIL_RX_11_Alive, bAliveCtr );
                    putValue( Env_HIL_ECO_Score_Total_Disp_Rq,    this.HIL_ECO_Score_Total_Disp_Rq.phys );
                    putValue( Env_HIL_ECO_Score_FreeWhl_Disp_Rq,this.HIL_ECO_Score_FreeWhl_Disp_Rq.phys );
                    putValue( Env_HIL_ECO_Score_Const_Disp_Rq,    this.HIL_ECO_Score_Const_Disp_Rq.phys );
                    putValue( Env_HIL_ECO_Score_Accel_Disp_Rq,    this.HIL_ECO_Score_Accel_Disp_Rq.phys );
                    break;
		case 0x2A:
                    /* MESS_IC4 (LV 0x2A) - AdBlue */
                    bAliveCtr = getValue( Env_HIL_RX_2A_Alive );
                    if( bAliveCtr < 8 )
                    {
                        bAliveCtr = ( bAliveCtr + 1 ) & 0x07;
                    }
                    else
                    {
                        bAliveCtr = 0;
                    }
                    putValue( Env_HIL_RX_2A_Alive, bAliveCtr );
					
                    putValue( Env_HIL_AdBlue_Perm_Fluid_Lvl,      		this.HIL_AdBlue_Perm_Fluid_Lvl.phys );
                    putValue( Env_HIL_AdBlue_Perm_Icon_color,     		this.HIL_AdBlue_Perm_Icon_color.phys );
                    putValue( Env_HIL_AdBlue_Perm_Rsrv_Marker_pos,    	this.HIL_AdBlue_Perm_Rsrv_Marker_pos.phys );
					
                    break;			
   }

// --- spontan 1 --- 
// Evaluate if received message is on event 
    bAliveCtr = getValue( HMI__MSGAliveCtr_Meas_IC_4 );
    if( _Meas_IC_4_OnEventTrap_Active )
    {
        putValue( HMI__MSG_OnEvent_Meas_IC_4, 1 );
        cancelTimer( tMeas_IC_4_OnEventIND );
        setTimer( tMeas_IC_4_OnEventIND, 1000 );
    }
    else
    {
        if( bAliveCtr < 8 )
        {
            bAliveCtr = ( bAliveCtr + 1 ) & 0x07;
        }
        else
        {
            bAliveCtr = 0;
		}
        putValue( HMI__MSGAliveCtr_Meas_IC_4, bAliveCtr );
        _Meas_IC_4_OnEventTrap_Active = 1;
        setTimer( tMeas_IC_4_OnEventTrap, _Meas_IC_4_OnEventDetectTime );
    }
}

on timer tMeas_IC_4_OnEventIND
{
    putValue( HMI__MSG_OnEvent_Meas_IC_4, 0 );
}

on timer tMeas_IC_4_OnEventTrap
{
    _Meas_IC_4_OnEventTrap_Active = 0;
}

on message Meas_IC_5
{
    byte bAliveCtr;

    putValue( HMI_Meas_IC_5A, 	        this.Meas_IC_5A.phys );
    putValue( HMI_Meas_IC_5B, 	        this.Meas_IC_5B.phys );
    putValue( HMI_Meas_IC_5C, 	        this.Meas_IC_5C.phys );
    putValue( HMI_Meas_IC_5D, 	        this.Meas_IC_5D.phys );
    putValue( HMI_Meas_IC_5E, 	        this.Meas_IC_5E.phys );
    putValue( HMI_Meas_IC_5F, 	        this.Meas_IC_5F.phys );
    putValue( HMI_Meas_IC_5G, 	        this.Meas_IC_5G.phys );
    putValue( HMI_Meas_IC_5H, 	        this.Meas_IC_5H.phys );

// --- spontan 1 --- 
// Evaluate if received message is on event 
    bAliveCtr = getValue( HMI__MSGAliveCtr_Meas_IC_5 );
    if( _Meas_IC_5_OnEventTrap_Active )
    {
        putValue( HMI__MSG_OnEvent_Meas_IC_5, 1 );
        cancelTimer( tMeas_IC_5_OnEventIND );
        setTimer( tMeas_IC_5_OnEventIND, 1000 );
    }
    else
    {
        if( bAliveCtr < 8 )
        {
            bAliveCtr = ( bAliveCtr + 1 ) & 0x07;
        }
        else
        {
            bAliveCtr = 0;
		}
        putValue( HMI__MSGAliveCtr_Meas_IC_5, bAliveCtr );
        setTimer( tMeas_IC_5_OnEventTrap, _Meas_IC_5_OnEventDetectTime );
    }
}

on timer tMeas_IC_5_OnEventIND
{
    putValue( HMI__MSG_OnEvent_Meas_IC_5, 0 );
}

on timer tMeas_IC_5_OnEventTrap
{
    _Meas_IC_5_OnEventTrap_Active = 0;
}

on message NM_IC_AR
{
    byte bAliveCtr;

//	putValue( HMI_Awake_Diag_Actv_IC, this.Awake_Diag_Actv.phys );
//	putValue( HMI_Awake_IgnitionAccessory_On, this.Awake_IgnitionAccessory_On.phys );
	putValue( HMI_WakeupRsn_IC, this.WakeupRsn_IC.phys );

// --- spontan 1 --- 
// Evaluate if received message is on event 
    bAliveCtr = getValue( HMI__MSGAliveCtr_NM_IC_AR );
    if( _NM_IC_AR_OnEventTrap_Active )
    {
        putValue( HMI__MSG_OnEvent_NM_IC_AR, 1 );
        cancelTimer( tNM_IC_AR_OnEventIND );
        setTimer( tNM_IC_AR_OnEventIND, 1000 );
    }
    else
    {
        if( bAliveCtr < 8 )
        {
            bAliveCtr = ( bAliveCtr + 1 ) & 0x07;
        }
        else
        {
            bAliveCtr = 0;
		}
        putValue( HMI__MSGAliveCtr_NM_IC_AR, bAliveCtr );
        _NM_IC_AR_OnEventTrap_Active = 1;
        setTimer( tNM_IC_AR_OnEventTrap, _NM_IC_AR_OnEventDetectTime );
    }
}

on timer tNM_IC_AR_OnEventIND
{
    putValue( HMI__MSG_OnEvent_NM_IC_AR, 0 );
}

on timer tNM_IC_AR_OnEventTrap
{
    _NM_IC_AR_OnEventTrap_Active = 0;
}

on message NV_Rq_IC_AR
{
    byte bAliveCtr;

	putValue( HMI_NVP_Disp_Actv,    this.NVP_Disp_Actv.phys );
	putValue( HMI_NVP_DispLnk_Stat, this.NVP_DispLnk_Stat.phys );
	putValue( HMI_NVP_DispMd,       this.NVP_DispMd.phys );
	putValue( HMI_NVP_SPL_Md,       this.NVP_SPL_Md.phys );

// --- spontan 1 --- 
// Evaluate if received message is on event 
    bAliveCtr = getValue( HMI__MSGAliveCtr_NV_Rq_IC_AR );
    if( _NV_Rq_IC_AR_OnEventTrap_Active )
    {
        putValue( HMI__MSG_OnEvent_NV_Rq_IC_AR, 1 );
        cancelTimer( tNV_Rq_IC_AR_OnEventIND );
        setTimer( tNV_Rq_IC_AR_OnEventIND, 1000 );
    }
    else
    {
        if( bAliveCtr < 8 )
        {
            bAliveCtr = ( bAliveCtr + 1 ) & 0x07;
        }
        else
        {
            bAliveCtr = 0;
		}
        putValue( HMI__MSGAliveCtr_NV_Rq_IC_AR, bAliveCtr );
        _NV_Rq_IC_AR_OnEventTrap_Active = 1;
        setTimer( tNV_Rq_IC_AR_OnEventTrap, _NV_Rq_IC_AR_OnEventDetectTime );
    }
}

on timer tNV_Rq_IC_AR_OnEventIND
{
    putValue( HMI__MSG_OnEvent_NV_Rq_IC_AR, 0 );
}

on timer tNV_Rq_IC_AR_OnEventTrap
{
    _NV_Rq_IC_AR_OnEventTrap_Active = 0;
}

on message Park_Disp_Rs_AR
{
    byte bAliveCtr;
    byte crc;

    putValue( HMI_IC_Err_Stat,   ( this.IC_Err_Stat ) );
    putValue( HMI_IC_Func_Stat,   ( this.IC_Func_Stat ) );
    putValue( HMI_Park_IconDisp_Rs,   ( this.Park_IconDisp_Rs ) );
    putValue( HMI_Park_IconDisp_Stat_IC,   ( this.Park_IconDisp_Stat_IC ) );
    putValue( HMI_Park_Warn1_Disp_Rs,   ( this.Park_Warn1_Disp_Rs ) );
    putValue( HMI_Park_Warn1_Disp_Stat_IC,   ( this.Park_Warn1_Disp_Stat_IC ) );

// --- cyclicAndSpontanWithDelay 5 --- 200ms cycle time ---
// Evaluate if received message is on event 
    bAliveCtr = getValue( HMI__MSGAliveCtr_Park_Disp_Rs_AR );
    if( _Park_Disp_Rs_AR_OnEventTrap_Active )
    {
        putValue( HMI__MSG_OnEvent_Park_Disp_Rs_AR, 1 );
        cancelTimer( tPark_Disp_Rs_AR_OnEventIND );
        setTimer( tPark_Disp_Rs_AR_OnEventIND, 1000 );
    }
    else
    {
        _Park_Disp_Rs_AR_CycleReduction++;
        if( _Park_Disp_Rs_AR_CycleReduction >= _cPark_Disp_Rs_AR_CycleReductionValue )
        {
            _Park_Disp_Rs_AR_CycleReduction = 0;
            if( bAliveCtr < 8 )
            {
                bAliveCtr = ( bAliveCtr + 1 ) & 0x07;
            }
            else
            {
                bAliveCtr = 0;
            }
        }
        putValue( HMI__MSGAliveCtr_Park_Disp_Rs_AR, bAliveCtr );
        setTimer( tPark_Disp_Rs_AR_OnEventTrap, _Park_Disp_Rs_AR_OnEventDetectTime );
    }
}

on timer tPark_Disp_Rs_AR_OnEventIND
{
    putValue( HMI__MSG_OnEvent_Park_Disp_Rs_AR, 0 );
}

on timer tPark_Disp_Rs_AR_OnEventTrap
{
    _Park_Disp_Rs_AR_OnEventTrap_Active = 0;
}

/*/*@@msg:Pers_Stat_AR (0x4C6):*/
/*on message Pers_Stat_AR
{
    byte bAliveCtr;

    putValue( HMI_Pers_ActvSlotId_Stat, this.Pers_ActvSlotId_Stat.phys );
    putValue( HMI_Pers_AutoSeatPosn_Enbl, this.Pers_AutoSeatPosn_Enbl.phys );
    putValue( HMI_Pers_InstSlotIdList, this.Pers_InstSlotIdList.phys );
    putValue( HMI_Pers_UserProfActv_Stat, this.Pers_UserProfActv_Stat.phys );
    putValue( HMI_Pers_UserProfSel_Stat, this.Pers_UserProfSel_Stat.phys );

// --- cyclicAndSpontanWithDelay 5 --- 500ms cycle time ---
// Evaluate if received message is on event 
    bAliveCtr = getValue( HMI__MSGAliveCtr_Pers_Stat_AR );
    if( _Pers_Stat_AR_OnEventTrap_Active )
    {
        putValue( HMI__MSG_OnEvent_Pers_Stat_AR, 1 );
        cancelTimer( tPers_Stat_AR_OnEventIND );
        setTimer( tPers_Stat_AR_OnEventIND, 1000 );
    }
    else
    {
        _Pers_Stat_AR_CycleReduction++;
        if( _Pers_Stat_AR_CycleReduction >= _cPers_Stat_AR_CycleReductionValue )
        {
            _Pers_Stat_AR_CycleReduction = 0;
            if( bAliveCtr < 8 )
            {
                bAliveCtr = ( bAliveCtr + 1 ) & 0x07;
            }
            else
            {
                bAliveCtr = 0;
            }
        }
        putValue( HMI__MSGAliveCtr_Pers_Stat_AR, bAliveCtr );
        _Pers_Stat_AR_OnEventTrap_Active = 1;
        setTimer( tPers_Stat_AR_OnEventTrap, _Pers_Stat_AR_OnEventDetectTime );
    }
}
*/

/*on timer tPers_Stat_AR_OnEventIND
{
    putValue( HMI__MSG_OnEvent_Pers_Stat_AR, 0 );
}
*/

/*on timer tPers_Stat_AR_OnEventTrap
{
    _Pers_Stat_AR_OnEventTrap_Active = 0;
}
*/

on message ROE_IC
{
    byte bAliveCtr;

	putValue( HMI_ROE_DTC_IC, this.ROE_DTC_IC.phys );
	putValue( HMI_ROE_DTC_Stat_IC, this.ROE_DTC_Stat_IC.phys );
	putValue( HMI_ROE_Header_IC, this.ROE_Header_IC.phys );

// --- spontan 1 --- 
// Evaluate if received message is on event 
    bAliveCtr = getValue( HMI__MSGAliveCtr_ROE_IC );
    if( _ROE_IC_OnEventTrap_Active )
    {
        putValue( HMI__MSG_OnEvent_ROE_IC, 1 );
        cancelTimer( tROE_IC_OnEventIND );
        setTimer( tROE_IC_OnEventIND, 1000 );
    }
    else
    {
        if( bAliveCtr < 8 )
        {
            bAliveCtr = ( bAliveCtr + 1 ) & 0x07;
        }
        else
        {
            bAliveCtr = 0;
		}
        putValue( HMI__MSGAliveCtr_ROE_IC, bAliveCtr );
        _ROE_IC_OnEventTrap_Active = 1;
        setTimer( tROE_IC_OnEventTrap, _ROE_IC_OnEventDetectTime );
    }
}

on timer tROE_IC_OnEventIND
{
    putValue( HMI__MSG_OnEvent_ROE_IC, 0 );
}

on timer tROE_IC_OnEventTrap
{
    _ROE_IC_OnEventTrap_Active = 0;
}

on message IC_DriveAssistSys_AR
{
    byte bAliveCtr;
    byte crc;

    putValue( HMI_APM_RaceMd_Rq,                    this.APM_RaceMd_Rq.phys );
    putValue( HMI_DrowWarnDisp_Stat,                this.DrowWarnDisp_Stat.phys );
    putValue( HMI_PreHtIndLmp_Flt,                  this.PreHtIndLmp_Flt.phys );
    putValue( HMI_PTS_Disp_Stat_IC,                 this.PTS_Disp_Stat_IC.phys );
    putValue( HMI_RollTestMd_Rq,                    this.RollTestMd_Rq.phys );
    putValue( HMI_RoofLuggMd_Rq,                    this.RoofLuggMd_Rq.phys );
    putValue( HMI_SPCR_Conf_IC,                     this.SPCR_Conf_IC.phys );
    putValue( HMI_SPCR_Flt_IC,                      this.SPCR_Flt_IC.phys );

//*****************************************************************************************************
// --- cyclic 0 --- 100ms cycle time ---
// Evaluate if received message is on event 
    bAliveCtr = getValue( HMI__MSGAliveCtr_IC_DriveAssistSys_AR );
    if( _IC_DriveAssistSys_AR_OnEventTrap_Active )
    {
        putValue( HMI__MSG_OnEvent_IC_DriveAssistSys_AR, 1 );
        cancelTimer( tIC_DriveAssistSys_AR_OnEventIND );
        setTimer( tIC_DriveAssistSys_AR_OnEventIND, 1000 );
    }
    else
    {
        _IC_DriveAssistSys_AR_CycleReduction++;
        if( _IC_DriveAssistSys_AR_CycleReduction >= _cIC_DriveAssistSys_AR_CycleReductionValue )
        {
            _IC_DriveAssistSys_AR_CycleReduction = 0;
            if( bAliveCtr < 8 )
            {
                bAliveCtr = ( bAliveCtr + 1 ) & 0x07;
            }
            else
            {
                bAliveCtr = 0;
            }
        }
        putValue( HMI__MSGAliveCtr_IC_DriveAssistSys_AR, bAliveCtr );
        _IC_DriveAssistSys_AR_OnEventTrap_Active = 1;
        setTimer( tIC_DriveAssistSys_AR_OnEventTrap, _IC_DriveAssistSys_AR_OnEventDetectTime );
    }
}

on timer tIC_DriveAssistSys_AR_OnEventIND
{
    putValue( HMI__MSG_OnEvent_IC_DriveAssistSys_AR, 0 );
}

on timer tIC_DriveAssistSys_AR_OnEventTrap
{
    _IC_DriveAssistSys_AR_OnEventTrap_Active = 0;
}

on message RTC_Stat1_AR
{
    byte bAliveCtr;

    putValue( HMI_DayCnt, 		this.DayCnt.phys );
    putValue( HMI_EngShutOffTm,         this.EngShutOffTm.phys );
    putValue( HMI_HVAC_Vprzr_DryVnTmr_Stat, this.HVAC_Vprzr_DryVnTmr_Stat.phys );
    putValue( HMI_PT_ShutOffTm,         this.PT_ShutOffTm.phys );

// --- cyclicAndSpontanWithDelay 5 --- 1000ms cycle time ---
// Evaluate if received message is on event 
    bAliveCtr = getValue( HMI__MSGAliveCtr_RTC_Stat1_AR );
    if( _RTC_Stat1_AR_OnEventTrap_Active )
    {
        putValue( HMI__MSG_OnEvent_RTC_Stat1_AR, 1 );
        cancelTimer( tRTC_Stat1_AR_OnEventIND );
        setTimer( tRTC_Stat1_AR_OnEventIND, 1000 );
    }
    else
    {
        if( bAliveCtr < 8 )
        {
            bAliveCtr = ( bAliveCtr + 1 ) & 0x07;
        }
        else
        {
            bAliveCtr = 0;
		}
        putValue( HMI__MSGAliveCtr_RTC_Stat1_AR, bAliveCtr );
        _RTC_Stat1_AR_OnEventTrap_Active = 1;
        setTimer( tRTC_Stat1_AR_OnEventTrap, _RTC_Stat1_AR_OnEventDetectTime );
    }
}

on timer tRTC_Stat1_AR_OnEventIND
{
    putValue( HMI__MSG_OnEvent_RTC_Stat1_AR, 0 );
}

on timer tRTC_Stat1_AR_OnEventTrap
{
    _RTC_Stat1_AR_OnEventTrap_Active = 0;
}

on message RTC_Date_Time_AR
{
    byte bAliveCtr;

    putValue( HMI_DateTmDay, this.DateTmDay.phys );
    putValue( HMI_DateTmHour, this.DateTmHour.phys );
    putValue( HMI_DateTmMinute, this.DateTmMinute.phys );
    putValue( HMI_DateTmMonth, this.DateTmMonth.phys );
    putValue( HMI_DateTmSecond, this.DateTmSecond.phys );
    putValue( HMI_DateTmStat, this.DateTmStat.phys );
    putValue( HMI_DateTmWeekday, this.DateTmWeekday.phys );
    putValue( HMI_DateTmYear, this.DateTmYear.phys );
    putValue( HMI_ICH_Dur_Rq, this.ICH_Dur_Rq.phys );
    putValue( HMI_ICH_HtVn_Rq_IC, this.ICH_HtVn_Rq_IC.phys );

// --- cyclicAndSpontanWithDelay 5 --- 1000ms cycle time ---
// Evaluate if received message is on event 
    bAliveCtr = getValue( HMI__MSGAliveCtr_RTC_Date_Time_AR );
    if( _RTC_Date_Time_AR_OnEventTrap_Active )
    {
        putValue( HMI__MSG_OnEvent_RTC_Date_Time_AR, 1 );
        cancelTimer( tRTC_Date_Time_AR_OnEventIND );
        setTimer( tRTC_Date_Time_AR_OnEventIND, 1000 );
    }
    else
    {
        if( bAliveCtr < 8 )
        {
            bAliveCtr = ( bAliveCtr + 1 ) & 0x07;
        }
        else
        {
            bAliveCtr = 0;
		}
        putValue( HMI__MSGAliveCtr_RTC_Date_Time_AR, bAliveCtr );
        _RTC_Date_Time_AR_OnEventTrap_Active = 1;
        setTimer( tRTC_Date_Time_AR_OnEventTrap, _RTC_Date_Time_AR_OnEventDetectTime );
    }
}

on timer tRTC_Date_Time_AR_OnEventIND
{
    putValue( HMI__MSG_OnEvent_RTC_Date_Time_AR, 0 );
}

on timer tRTC_Date_Time_AR_OnEventTrap
{
    _RTC_Date_Time_AR_OnEventTrap_Active = 0;
}

on message TC_AddInfo1_AR
{
    byte bAliveCtr;

	putValue( HMI_TC_AvgSpd_Reset, 	this.TC_AvgSpd_Reset.phys );
	putValue( HMI_TC_AvgSpd_Start, 	this.TC_AvgSpd_Start.phys );
	putValue( HMI_TC_DrvTme_Reset, 	this.TC_DrvTme_Reset.phys );
	putValue( HMI_TC_DrvTme_Start, 	this.TC_DrvTme_Start.phys );
	
// --- cyclicX 0 --- 1000ms cycle time ---
// Evaluate if received message is on event 
    bAliveCtr = getValue( HMI__MSGAliveCtr_TC_AddInfo1_AR );
    if( _TC_AddInfo1_AR_OnEventTrap_Active )
    {
        putValue( HMI__MSG_OnEvent_TC_AddInfo1_AR, 1 );
        cancelTimer( tTC_AddInfo1_AR_OnEventIND );
        setTimer( tTC_AddInfo1_AR_OnEventIND, 1000 );
    }
    else
    {
        if( bAliveCtr < 8 )
        {
            bAliveCtr = ( bAliveCtr + 1 ) & 0x07;
        }
        else
        {
            bAliveCtr = 0;
		}
        putValue( HMI__MSGAliveCtr_TC_AddInfo1_AR, bAliveCtr );
        _TC_AddInfo1_AR_OnEventTrap_Active = 1;
        setTimer( tTC_AddInfo1_AR_OnEventTrap, _TC_AddInfo1_AR_OnEventDetectTime );
    }
}

on timer tTC_AddInfo1_AR_OnEventIND
{
    putValue( HMI__MSG_OnEvent_TC_AddInfo1_AR, 0 );
}

on timer tTC_AddInfo1_AR_OnEventTrap
{
    _TC_AddInfo1_AR_OnEventTrap_Active = 0;
}

on message TC_AddInfo2_AR
{
    byte bAliveCtr;

	putValue( HMI_TC_DrvTme_ZE_Reset, 	this.TC_DrvTme_ZE_Reset.phys );
	putValue( HMI_TC_DrvTme_ZE_Start, 	this.TC_DrvTme_ZE_Start.phys );
	
// --- cyclicX 0 --- 1000ms cycle time ---
// Evaluate if received message is on event 
    bAliveCtr = getValue( HMI__MSGAliveCtr_TC_AddInfo2_AR );
    if( _TC_AddInfo2_AR_OnEventTrap_Active )
    {
        putValue( HMI__MSG_OnEvent_TC_AddInfo2_AR, 1 );
        cancelTimer( tTC_AddInfo2_AR_OnEventIND );
        setTimer( tTC_AddInfo2_AR_OnEventIND, 1000 );
    }
    else
    {
        if( bAliveCtr < 8 )
        {
            bAliveCtr = ( bAliveCtr + 1 ) & 0x07;
        }
        else
        {
            bAliveCtr = 0;
	}
        putValue( HMI__MSGAliveCtr_TC_AddInfo2_AR, bAliveCtr );
        _TC_AddInfo2_AR_OnEventTrap_Active = 1;
        setTimer( tTC_AddInfo2_AR_OnEventTrap, _TC_AddInfo2_AR_OnEventDetectTime );
    }
}

on timer tTC_AddInfo2_AR_OnEventIND
{
    putValue( HMI__MSG_OnEvent_TC_AddInfo2_AR, 0 );
}

on timer tTC_AddInfo2_AR_OnEventTrap
{
    _TC_AddInfo2_AR_OnEventTrap_Active = 0;
}

on message TC_AddInfo3_AR
{
    byte bAliveCtr;

	putValue( HMI_TC_Dist_ZE_Reset, 	this.TC_Dist_ZE_Reset.phys );
	putValue( HMI_TC_Dist_ZE_Start, 	this.TC_Dist_ZE_Start.phys );
	
// --- cyclicX 0 --- 1000ms cycle time ---
// Evaluate if received message is on event 
    bAliveCtr = getValue( HMI__MSGAliveCtr_TC_AddInfo3_AR );
    if( _TC_AddInfo3_AR_OnEventTrap_Active )
    {
        putValue( HMI__MSG_OnEvent_TC_AddInfo3_AR, 1 );
        cancelTimer( tTC_AddInfo3_AR_OnEventIND );
        setTimer( tTC_AddInfo3_AR_OnEventIND, 1000 );
    }
    else
    {
        if( bAliveCtr < 8 )
        {
            bAliveCtr = ( bAliveCtr + 1 ) & 0x07;
        }
        else
        {
            bAliveCtr = 0;
		}
        putValue( HMI__MSGAliveCtr_TC_AddInfo3_AR, bAliveCtr );
        _TC_AddInfo3_AR_OnEventTrap_Active = 1;
        setTimer( tTC_AddInfo3_AR_OnEventTrap, _TC_AddInfo3_AR_OnEventDetectTime );
    }
}

on timer tTC_AddInfo3_AR_OnEventIND
{
    putValue( HMI__MSG_OnEvent_TC_AddInfo3_AR, 0 );
}

on timer tTC_AddInfo3_AR_OnEventTrap
{
    _TC_AddInfo3_AR_OnEventTrap_Active = 0;
}

on message TC_Dist_AR
{
    byte bAliveCtr;

//	putValue( HMI_CNG_FuelMdChg_Rq, 	this.CNG_FuelMdChg_Rq.phys );
	putValue( HMI_TC_Distance_Sel, 	this.TC_FuelType_TC_DIST.phys );
	if( this.TC_FuelType_TC_DIST == 0 ) // Gas
	{
		putValue( HMI_TC_GasFuelDist_Reset, this.TC_GasFuelDist_Reset.phys );
		putValue( HMI_TC_GasFuelDist_Start, this.TC_GasFuelDist_Start.phys );
		putValue( HMI_TC_GasFuelTankLvl, 	this.TC_GasFuelTankLvl.phys );
	}
	if( this.TC_FuelType_TC_DIST == 1 ) // Liquid
	{
		putValue( HMI_TC_LiquidFuelDist_Reset, this.TC_LiquidFuelDist_Reset.phys );
		putValue( HMI_TC_LiquidFuelDist_Start, this.TC_LiquidFuelDist_Start.phys );
		putValue( HMI_TC_LiquidFuelRefillEvent_Dtct, this.TC_LiquidFuelRefillEvent_Dtct.phys );
		putValue( HMI_TC_LiquidFuelTankLvl, this.TC_LiquidFuelTankLvl.phys );
	}
	if( this.TC_FuelType_TC_DIST == 2 ) // Electric
	{
		putValue( HMI_TC_ElecEnergyDist_Reset, this.TC_ElecEnergyDist_Reset.phys );
		putValue( HMI_TC_ElecEnergyDist_Start, this.TC_ElecEnergyDist_Start.phys );
	}

// --- spontan 1 --- 
// Evaluate if received message is on event 
    bAliveCtr = getValue( HMI__MSGAliveCtr_TC_Dist_AR );
    _TC_Dist_AR_CycleReduction = _TC_Dist_AR_CycleReduction + 1;
    if( _TC_Dist_AR_OnEventTrap_Active )
    {
        putValue( HMI__MSG_OnEvent_TC_Dist_AR, 1 );
        cancelTimer( tTC_Dist_AR_OnEventIND );
        setTimer( tTC_Dist_AR_OnEventIND, 1000 );
    }
    else
    {
        if( bAliveCtr < 8 )
        {
            if( _TC_Dist_AR_CycleReduction == _cTC_Dist_AR_CycleReductionValue )
            {
                bAliveCtr = ( bAliveCtr + 1 ) & 0x07;
                _TC_Dist_AR_CycleReduction = 0;
            }
        }
        else
        {
            bAliveCtr = 0;
		}
        putValue( HMI__MSGAliveCtr_TC_Dist_AR, bAliveCtr );
        _TC_Dist_AR_OnEventTrap_Active = 1;
        setTimer( tTC_Dist_AR_OnEventTrap, _TC_Dist_AR_OnEventDetectTime );
    }
}

on timer tTC_Dist_AR_OnEventIND
{
    putValue( HMI__MSG_OnEvent_TC_Dist_AR, 0 );
}

on timer tTC_Dist_AR_OnEventTrap
{
    _TC_Dist_AR_OnEventTrap_Active = 0;
}

/*on message TP_IC_MPM
{
    putValue( HMI_TP_IC_MPM_0, this.byte(0) );
    putValue( HMI_TP_IC_MPM_1, this.byte(1) );
    putValue( HMI_TP_IC_MPM_2, this.byte(2) );
    putValue( HMI_TP_IC_MPM_3, this.byte(3) );
    putValue( HMI_TP_IC_MPM_4, this.byte(4) );
    putValue( HMI_TP_IC_MPM_5, this.byte(5) );
    putValue( HMI_TP_IC_MPM_6, this.byte(6) );
    putValue( HMI_TP_IC_MPM_7, this.byte(7) );
}*/

/*on message TP_IC_TELEAID
{
	putValue( HMI_ICTPA_IC_TELEAIDTP_IC_TEL_0_, this.byte(0) );
	putValue( HMI_ICTPA_IC_TELEAIDTP_IC_TEL_1_, this.byte(1) );
	putValue( HMI_ICTPA_IC_TELEAIDTP_IC_TEL_2_, this.byte(2) );
	putValue( HMI_ICTPA_IC_TELEAIDTP_IC_TEL_3_, this.byte(3) );
	putValue( HMI_ICTPA_IC_TELEAIDTP_IC_TEL_4_, this.byte(4) );
	putValue( HMI_ICTPA_IC_TELEAIDTP_IC_TEL_5_, this.byte(5) );
	putValue( HMI_ICTPA_IC_TELEAIDTP_IC_TEL_6_, this.byte(6) );
	putValue( HMI_ICTPA_IC_TELEAIDTP_IC_TEL_7_, this.byte(7) );
}*/

on message TP_IC_TGW_Aud
{
    putValue( HMI_TP_IC_TGW_Aud_0, this.byte(0) );
    putValue( HMI_TP_IC_TGW_Aud_1, this.byte(1) );
    putValue( HMI_TP_IC_TGW_Aud_2, this.byte(2) );
    putValue( HMI_TP_IC_TGW_Aud_3, this.byte(3) );
    putValue( HMI_TP_IC_TGW_Aud_4, this.byte(4) );
    putValue( HMI_TP_IC_TGW_Aud_5, this.byte(5) );
    putValue( HMI_TP_IC_TGW_Aud_6, this.byte(6) );
    putValue( HMI_TP_IC_TGW_Aud_7, this.byte(7) );

}

/*on message TP_IC_TGW_Nav
{
    putValue( HMI_TP_IC_TGW_Nav_0, this.byte(0) );
    putValue( HMI_TP_IC_TGW_Nav_1, this.byte(1) );
    putValue( HMI_TP_IC_TGW_Nav_2, this.byte(2) );
    putValue( HMI_TP_IC_TGW_Nav_3, this.byte(3) );
    putValue( HMI_TP_IC_TGW_Nav_4, this.byte(4) );
    putValue( HMI_TP_IC_TGW_Nav_5, this.byte(5) );
    putValue( HMI_TP_IC_TGW_Nav_6, this.byte(6) );
    putValue( HMI_TP_IC_TGW_Nav_7, this.byte(7) );
}*/

/*on message TP_IC_TGW_Tel
{
    putValue( HMI_TP_IC_TGW_Tel_0, this.byte(0) );
    putValue( HMI_TP_IC_TGW_Tel_1, this.byte(1) );
    putValue( HMI_TP_IC_TGW_Tel_2, this.byte(2) );
    putValue( HMI_TP_IC_TGW_Tel_3, this.byte(3) );
    putValue( HMI_TP_IC_TGW_Tel_4, this.byte(4) );
    putValue( HMI_TP_IC_TGW_Tel_5, this.byte(5) );
    putValue( HMI_TP_IC_TGW_Tel_6, this.byte(6) );
    putValue( HMI_TP_IC_TGW_Tel_7, this.byte(7) );
}*/

/*on message TP_IC_WPT
{
    putValue( HMI_TP_IC_WPT_0, this.byte(0) );
    putValue( HMI_TP_IC_WPT_1, this.byte(1) );
    putValue( HMI_TP_IC_WPT_2, this.byte(2) );
    putValue( HMI_TP_IC_WPT_3, this.byte(3) );
    putValue( HMI_TP_IC_WPT_4, this.byte(4) );
    putValue( HMI_TP_IC_WPT_5, this.byte(5) );
    putValue( HMI_TP_IC_WPT_6, this.byte(6) );
    putValue( HMI_TP_IC_WPT_7, this.byte(7) );
}*/

on envVar Env_HU_Config_AutoSync_Trigger
{
    if( getValue( Env_HU_Config_AutoSync_Trigger ) )
    {
        putValue( HMI_IC_AddSpeedo_Rq, getValue( HMI_IC_AddSpeedo_Stat ) );
        putValue( HMI_IC_DesignVar_Rq, getValue( HMI_IC_DesignVar_Stat ) );
        putValue( HMI_IC_DistUnit_Rq,  getValue( HMI_IC_DistUnit_Stat ) );
        putValue( HMI_IC_TempDisp_Rq,  getValue( HMI_IC_TempDisp_Stat ) );
    }
}

on message TP_IC_TGW_Pers
{
    putValue( HMI_TP_IC_TGW_Pers_0, this.byte(0) );
    putValue( HMI_TP_IC_TGW_Pers_1, this.byte(1) );
    putValue( HMI_TP_IC_TGW_Pers_2, this.byte(2) );
    putValue( HMI_TP_IC_TGW_Pers_3, this.byte(3) );
    putValue( HMI_TP_IC_TGW_Pers_4, this.byte(4) );
    putValue( HMI_TP_IC_TGW_Pers_5, this.byte(5) );
    putValue( HMI_TP_IC_TGW_Pers_6, this.byte(6) );
    putValue( HMI_TP_IC_TGW_Pers_7, this.byte(7) );

}

on message ICH_Rq_IC_VAN_AR
{
    byte bAliveCtr;

    putValue( HMI_ICH_PreTm_Rq_IC, 	          this.ICH_PreTm_Rq_IC.phys );
    putValue( HMI_ICH_PreTm1_Hour_Rq_IC, 	    this.ICH_PreTm1_Hour_Rq_IC.phys );
    putValue( HMI_ICH_PreTm1_Minute_Rq_IC, 	  this.ICH_PreTm1_Minute_Rq_IC.phys );
    putValue( HMI_ICH_PreTm2_Hour_Rq_IC, 	    this.ICH_PreTm2_Hour_Rq_IC.phys );
    putValue( HMI_ICH_PreTm2_Minute_Rq_IC, 	  this.ICH_PreTm2_Minute_Rq_IC.phys );
    putValue( HMI_ICH_PreTm3_Hour_Rq_IC, 	    this.ICH_PreTm3_Hour_Rq_IC.phys );
    putValue( HMI_ICH_PreTm3_Minute_Rq_IC, 	  this.ICH_PreTm3_Minute_Rq_IC.phys );
  
    if (getValue(HMI_set_value_from_RX)==0x01)
    {
      putValue(HMI_ICH_PreTm_Stat, getValue(HMI_ICH_PreTm_Rq_IC));
      putValue(HMI_ICH_PreTm1_Hour_Stat, getValue(HMI_ICH_PreTm1_Hour_Rq_IC));
      putValue(HMI_ICH_PreTm1_Minute_Stat, getValue(HMI_ICH_PreTm1_Minute_Rq_IC));
      putValue(HMI_ICH_PreTm2_Hour_Stat, getValue(HMI_ICH_PreTm2_Hour_Rq_IC));
      putValue(HMI_ICH_PreTm2_Minute_Stat, getValue(HMI_ICH_PreTm2_Minute_Rq_IC));
      putValue(HMI_ICH_PreTm3_Hour_Stat, getValue(HMI_ICH_PreTm3_Hour_Rq_IC));
      putValue(HMI_ICH_PreTm3_Minute_Stat, getValue(HMI_ICH_PreTm3_Minute_Rq_IC));
    }
// --- cyclicAndSpontanWithDelay 5 --- 1000ms cycle time ---
// Evaluate if received message is on event 
    bAliveCtr = getValue( HMI__MSGAliveCtr_ICH_Rq_IC_VAN_AR );
    putValue( HMI__MSG_OnEvent_ICH_Rq_IC_VAN_AR, 1 );
    cancelTimer( tICH_Rq_IC_VAN_AR_OnEventIND );
    setTimer( tICH_Rq_IC_VAN_AR_OnEventIND, 1000 );
    if( bAliveCtr < 8 )
    {
        bAliveCtr = ( bAliveCtr + 1 ) & 0x07;
    }
    else
    {
        bAliveCtr = 0;
    }
    putValue( HMI__MSGAliveCtr_ICH_Rq_IC_VAN_AR, bAliveCtr );
}

on timer tICH_Rq_IC_VAN_AR_OnEventTrap
{
    _ICH_Rq_IC_VAN_AR_OnEventTrap_Active = 0;
}

on timer tICH_Rq_IC_VAN_AR_OnEventIND
{
    putValue( HMI__MSG_OnEvent_ICH_Rq_IC_VAN_AR, 0 );
}

on message IC_AddDisp_VAN_AR
{
    byte bAliveCtr;

    putValue( HMI_DPF_ManRgnrt_Rq, 	   this.DPF_ManRgnrt_Rq.phys );

// --- cyclicAndSpontanWithDelay 5 --- 1000ms cycle time ---
// Evaluate if received message is on event 
    bAliveCtr = getValue( HMI__MSGAliveCtr_IC_AddDisp_VAN_AR );
    putValue( HMI__MSG_OnEvent_IC_AddDisp_VAN_AR, 1 );
    cancelTimer( tIC_AddDisp_VAN_AR_OnEventIND );
    setTimer( tIC_AddDisp_VAN_AR_OnEventIND, 1000 );
    if( bAliveCtr < 8 )
    {
        bAliveCtr = ( bAliveCtr + 1 ) & 0x07;
    }
    else
    {
        bAliveCtr = 0;
    }
    putValue( HMI__MSGAliveCtr_IC_AddDisp_VAN_AR, bAliveCtr );
}

on timer tIC_AddDisp_VAN_AR_OnEventTrap
{
    _IC_AddDisp_VAN_AR_OnEventTrap_Active = 0;
}

on timer tIC_AddDisp_VAN_AR_OnEventIND
{
    putValue( HMI__MSG_OnEvent_IC_AddDisp_VAN_AR, 0 );
}

on message ActvComf_Rq_AR
{
    byte bAliveCtr;
  
    if(getValue(HMI_with_wo_HU) == VS30_without_HU)
    {
      putValue( HMI_CLkS_ActvComf_Rq, 	          this.CLkS_ActvComf_Rq.phys );
      putValue( HMI_DrowDtct_ActvComf_Prog_Stat, 	this.DrowDtct_ActvComf_Prog_Stat.phys );
      putValue( HMI_HVAC_FanLvlLimit_ActvComf_Rq, this.HVAC_FanLvlLimit_ActvComf_Rq.phys );
      putValue( HMI_HVAC_Ionzr_ActvComf_Rq, 	    this.HVAC_Ionzr_ActvComf_Rq.phys );
      putValue( HMI_HVAC_Pulsation_ActvComf_Rq, 	this.HVAC_Pulsation_ActvComf_Rq.phys );
      putValue( HMI_HVAC_RHU_ActvComf_Rq, 	      this.HVAC_RHU_ActvComf_Rq.phys );
      putValue( HMI_HVAC_SGEN_ActvComf_Rq, 	      this.HVAC_SGEN_ActvComf_Rq.phys );
      putValue( HMI_HVAC_TempDelta_ActvComf_Rq, 	this.HVAC_TempDelta_ActvComf_Rq.phys );
      putValue( HMI_HVAC_TempDir_ActvComf_Rq, 	  this.HVAC_TempDir_ActvComf_Rq.phys );
      putValue( HMI_ICH_HtVn_ActvComf_Rq, 	      this.ICH_HtVn_ActvComf_Rq.phys );
      putValue( HMI_IL_ActvComf_On_Rq, 	          this.IL_ActvComf_On_Rq.phys );
      putValue( HMI_IL_ActvComf_Prog_Rq, 	        this.IL_ActvComf_Prog_Rq.phys );
      putValue( HMI_MCMS_ActvComf_FL_Rq, 	        this.MCMS_ActvComf_FL_Rq.phys );
      putValue( HMI_MCMS_ActvComf_FR_Rq, 	        this.MCMS_ActvComf_FR_Rq.phys );
      putValue( HMI_MCMS_ActvComf_RL_Rq, 	        this.MCMS_ActvComf_RL_Rq.phys );
      putValue( HMI_MCMS_ActvComf_RR_Rq, 	        this.MCMS_ActvComf_RR_Rq.phys );
      putValue( HMI_MCMS_ActvComfProg_Rq, 	      this.MCMS_ActvComfProg_Rq.phys );
      putValue( HMI_PkBrk_ActvComf_Rq, 	          this.PkBrk_ActvComf_Rq.phys );
      putValue( HMI_SeatCond_ActvComf_Seat_FL_Rq, this.SeatCond_ActvComf_Seat_FL_Rq.phys );
      putValue( HMI_SeatCond_ActvComf_Seat_FR_Rq, this.SeatCond_ActvComf_Seat_FR_Rq.phys );
      putValue( HMI_SeatCond_ActvComf_Seat_RL_Rq, this.SeatCond_ActvComf_Seat_RL_Rq.phys );
      putValue( HMI_SeatCond_ActvComf_Seat_RR_Rq, this.SeatCond_ActvComf_Seat_RR_Rq.phys );
      putValue( HMI_SeatCond_ActvComfProg_Rq, 	  this.SeatCond_ActvComfProg_Rq.phys );
      putValue( HMI_StWhlHeat_ActvComf_Rq, 	      this.StWhlHeat_ActvComf_Rq.phys );
      putValue( HMI_SwIllLvl_ActvComf_Rq, 	      this.SwIllLvl_ActvComf_Rq.phys );

// --- cyclicAndSpontanWithDelay 5 --- 1000ms cycle time ---
// Evaluate if received message is on event 
      bAliveCtr = getValue( HMI__MSGAliveCtr_ActvComf_Rq_AR );
      putValue( HMI__MSG_OnEvent_ActvComf_Rq_AR, 1 );
      cancelTimer( tActvComf_Rq_AR_OnEventIND );
      setTimer( tActvComf_Rq_AR_OnEventIND, 1000 );
      if( bAliveCtr < 8 )
      {
        bAliveCtr = ( bAliveCtr + 1 ) & 0x07;
      }
      else
      {
        bAliveCtr = 0;
      }
      putValue( HMI__MSGAliveCtr_ActvComf_Rq_AR, bAliveCtr );
    }
}

on timer tActvComf_Rq_AR_OnEventTrap
{
      _ActvComf_Rq_AR_OnEventTrap_Active = 0;
}

on timer tActvComf_Rq_AR_OnEventIND
{
      putValue( HMI__MSG_OnEvent_ActvComf_Rq_AR, 0 );
}


on message Config_HU2_AR
{
    byte bAliveCtr;
  
//    if(getValue(HMI_with_wo_HU) == VS30_without_HU)
//    {
      putValue( HMI_ALDW_Md_Rq_HU, 	    this.ALDW_Md_Rq_HU.phys );
      putValue( HMI_ARB_AutoFct_Rq_HU, 	        this.ARB_AutoFct_Rq_HU.phys );
      putValue( HMI_ARB_AutoFct_Rq_HU, 	    this.ARB_AutoFct_Rq_HU.phys );
      putValue( HMI_BltLineIll_Rq, 	  this.BltLineIll_Rq.phys );
      putValue( HMI_BltSlckDec_Md_Rq_HU, 	  this.BltSlckDec_Md_Rq_HU.phys );
      putValue( HMI_DRLt_On_Rq_HU, 	  this.DRLt_On_Rq_HU.phys );
      putValue( HMI_EmbIll_Rq, 	  this.EmbIll_Rq.phys );
      putValue( HMI_FDC_Md_Rq_HU, 	  this.FDC_Md_Rq_HU.phys );
      putValue( HMI_Global_FactReset_Rq,this.Global_FactReset_Rq.phys );
      putValue( HMI_IL_AgDur_Rq, 	  this.IL_AgDur_Rq.phys );
      putValue( HMI_LDP_Sensitive_Md_Rq_HU, 	    this.LDP_Sensitive_Md_Rq_HU.phys );
      putValue( HMI_NightLineIll_Rq, 	    this.NightLineIll_Rq.phys );
      putValue( HMI_PN14_Hibern_Md_Rq_HU, 	this.PN14_Hibern_Md_Rq_HU.phys );
      putValue( HMI_PT4_PTCoor_Standby_Abort_Rq, 	this.PT4_PTCoor_Standby_Abort_Rq.phys );
      putValue( HMI_RoadsdCallSwLED_Rq_TGW, 	this.RoadsdCallSwLED_Rq_TGW.phys );
      putValue( HMI_RunBrdIll_Rq, 	this.RunBrdIll_Rq.phys );
      putValue( HMI_ServCallSwLED_Rq_TGW,this.ServCallSwLED_Rq_TGW.phys );
      putValue( HMI_SOS_CallSwLED_Rq_TGW, 	this.SOS_CallSwLED_Rq_TGW.phys );
      putValue( HMI_TaxiRoofLmpMd_Rq_HU, this.TaxiRoofLmpMd_Rq_HU.phys );


// --- cyclicAndSpontanWithDelay 5 --- 1000ms cycle time ---
// Evaluate if received message is on event 
      bAliveCtr = getValue( HMI__MSGAliveCtr_Config_HU2_AR );
      putValue( HMI__MSG_OnEvent_Config_HU2_AR, 1 );
      cancelTimer( tConfig_HU2_AR_OnEventIND );
      setTimer( tConfig_HU2_AR_OnEventIND, 1000 );
      if( bAliveCtr < 8 )
      {
        bAliveCtr = ( bAliveCtr + 1 ) & 0x07;
      }
      else
      {
        bAliveCtr = 0;
      }
      putValue( HMI__MSGAliveCtr_Config_HU2_AR, bAliveCtr );
//    }
}

on timer tConfig_HU2_AR_OnEventTrap
{
      _Config_HU2_AR_OnEventTrap_Active = 0;
}

on timer tConfig_HU2_AR_OnEventIND
{
      putValue( HMI__MSG_OnEvent_Config_HU2_AR, 0 );
}

on message Config_HU3_AR
{
    byte bAliveCtr;
  
    if(getValue(HMI_with_wo_HU) == VS30_without_HU)
    {
      putValue( HMI_AFS_Md_Rq_HU, 	    this.AFS_Md_Rq_HU.phys );
      putValue( HMI_ARC_Md_Rq, 	        this.ARC_Md_Rq.phys );
      putValue( HMI_HUD_Md_Rq_HU, 	    this.HUD_Md_Rq_HU.phys );
      putValue( HMI_IC_AddSpeedo_Rq, 	  this.IC_AddSpeedo_Rq.phys );
      putValue( HMI_IC_DesignVar_Rq, 	  this.IC_DesignVar_Rq.phys );
      putValue( HMI_IC_DistUnit_Rq, 	  this.IC_DistUnit_Rq.phys );
      putValue( HMI_IC_FactReset_Rq, 	  this.IC_FactReset_Rq.phys );
      putValue( HMI_IC_TempDisp_Rq, 	  this.IC_TempDisp_Rq.phys );
      putValue( HMI_ILS_TouristMd_Rq_HU,this.ILS_TouristMd_Rq_HU.phys );
      putValue( HMI_NV_FactReset_Rq, 	  this.NV_FactReset_Rq.phys );
      putValue( HMI_NVP_DispMd_Rq, 	    this.NVP_DispMd_Rq.phys );
      putValue( HMI_NVP_SPL_Md_Rq, 	    this.NVP_SPL_Md_Rq.phys );
      putValue( HMI_PIP_HUD_Add2_Actv, 	this.PIP_HUD_Add2_Actv.phys );
      putValue( HMI_PIP_HUD_Add3_Actv, 	this.PIP_HUD_Add3_Actv.phys );
      putValue( HMI_PIP_HUD_Add4_Actv, 	this.PIP_HUD_Add4_Actv.phys );
      putValue( HMI_PIP_HUD_AMG_RaceApp_Actv,this.PIP_HUD_AMG_RaceApp_Actv.phys );
      putValue( HMI_PIP_HUD_Apps_Actv, 	this.PIP_HUD_Apps_Actv.phys );
      putValue( HMI_PIP_HUD_Audio_Actv, this.PIP_HUD_Audio_Actv.phys );
      putValue( HMI_PIP_HUD_Navi_Actv, 	this.PIP_HUD_Navi_Actv.phys );
      putValue( HMI_PIP_HUD_Phone_Actv, this.PIP_HUD_Phone_Actv.phys );
      putValue( HMI_PIP_IC_Add2_Actv, 	this.PIP_IC_Add2_Actv.phys );
      putValue( HMI_PIP_IC_Add3_Actv, 	this.PIP_IC_Add3_Actv.phys );
      putValue( HMI_PIP_IC_Add4_Actv, 	this.PIP_IC_Add4_Actv.phys );
      putValue( HMI_PIP_IC_AMG_RaceApp_Actv,this.PIP_IC_AMG_RaceApp_Actv.phys );
      putValue( HMI_PIP_IC_Apps_Actv, 	this.PIP_IC_Apps_Actv.phys );
      putValue( HMI_PIP_IC_Audio_Actv, 	this.PIP_IC_Audio_Actv.phys );
      putValue( HMI_PIP_IC_Navi_Actv, 	this.PIP_IC_Navi_Actv.phys );
      putValue( HMI_PIP_IC_Phone_Actv, 	this.PIP_IC_Phone_Actv.phys );

// --- cyclicAndSpontanWithDelay 5 --- 1000ms cycle time ---
// Evaluate if received message is on event 
      bAliveCtr = getValue( HMI__MSGAliveCtr_Config_HU3_AR );
      putValue( HMI__MSG_OnEvent_Config_HU3_AR, 1 );
      cancelTimer( tConfig_HU3_AR_OnEventIND );
      setTimer( tConfig_HU3_AR_OnEventIND, 1000 );
      if( bAliveCtr < 8 )
      {
        bAliveCtr = ( bAliveCtr + 1 ) & 0x07;
      }
      else
      {
        bAliveCtr = 0;
      }
      putValue( HMI__MSGAliveCtr_Config_HU3_AR, bAliveCtr );
    }
}

on timer tConfig_HU3_AR_OnEventTrap
{
      _Config_HU3_AR_OnEventTrap_Active = 0;
}

on timer tConfig_HU3_AR_OnEventIND
{
      putValue( HMI__MSG_OnEvent_Config_HU3_AR, 0 );
}

on message Config_HU4_AR
{
    byte bAliveCtr;
  
    if(getValue(HMI_with_wo_HU) == VS30_without_HU)
    {
      putValue( HMI_CNG_FuelMdChg_Rq_V2,      this.CNG_FuelMdChg_Rq_V2.phys );
      putValue( HMI_HU_AC_Curr_Max_Rq,        this.HU_AC_Curr_Max_Rq.phys );
      putValue( HMI_HU_TouchAcousticsMd_Stat, this.HU_TouchAcousticsMd_Stat.phys );
      putValue( HMI_Park_AccelMd_Rq_HU,       this.Park_AccelMd_Rq_HU.phys );
      putValue( HMI_Park_AttenuatMd_Rq_HU,    this.Park_AttenuatMd_Rq_HU.phys );
      putValue( HMI_Park_BrkMd_Rq_HU,         this.Park_BrkMd_Rq_HU.phys );
      putValue( HMI_Park_CTA_Md_Rq_HU,        this.Park_CTA_Md_Rq_HU.phys );
      putValue( HMI_Park_FactReset_Rq_HU,     this.Park_FactReset_Rq_HU.phys );
      putValue( HMI_Park_ObjDtctMd_Rq_HU,     this.Park_ObjDtctMd_Rq_HU.phys );
      putValue( HMI_Park_ParkSpaceSelSw_Psd_HU,this.Park_ParkSpaceSelSw_Psd_HU.phys );
      putValue( HMI_Park_RevGrMd_Rq_HU,       this.Park_RevGrMd_Rq_HU.phys );
      putValue( HMI_Park_Sonar_Ft_Md_Rq_HU,   this.Park_Sonar_Ft_Md_Rq_HU.phys );
      putValue( HMI_Park_Sonar_R_Md_Rq_HU,    this.Park_Sonar_R_Md_Rq_HU.phys );
      putValue( HMI_Park_StMd_Rq_HU,          this.Park_StMd_Rq_HU.phys );
      putValue( HMI_Park_StyleMd_Rq_HU,       this.Park_StyleMd_Rq_HU.phys );
      putValue( HMI_Park_WarnFreq_Ft_Rq_HU,   this.Park_WarnFreq_Ft_Rq_HU.phys );
      putValue( HMI_Park_Sonar_Sd_Md_Rq_HU,    this.Park_Sonar_Sd_Md_Rq_HU.phys );
      putValue( HMI_Park_WarnVol_Ft_Rq_HU,    this.Park_WarnVol_Ft_Rq_HU.phys );
      putValue( HMI_Park_WarnVol_R_Rq_HU,     this.Park_WarnVol_R_Rq_HU.phys );
      putValue( HMI_PNHV_AC_Curr_Max_Lim_Rq_HU,this.PNHV_AC_Curr_Max_Lim_Rq_HU.phys );
      putValue( HMI_StWhl_OFN_SnstyMd_Rq,     this.StWhl_OFN_SnstyMd_Rq.phys );
      
// --- cyclicAndSpontanWithDelay 5 --- 1000ms cycle time ---
// Evaluate if received message is on event 
      bAliveCtr = getValue( HMI__MSGAliveCtr_Config_HU4_AR );
      putValue( HMI__MSG_OnEvent_Config_HU4_AR, 1 );
      cancelTimer( tConfig_HU4_AR_OnEventIND );
      setTimer( tConfig_HU4_AR_OnEventIND, 1000 );
      if( bAliveCtr < 8 )
      {
        bAliveCtr = ( bAliveCtr + 1 ) & 0x07;
      }
      else
      {
        bAliveCtr = 0;
      }
      putValue( HMI__MSGAliveCtr_Config_HU4_AR, bAliveCtr );
    }
}

on timer tConfig_HU4_AR_OnEventTrap
{
      _Config_HU4_AR_OnEventTrap_Active = 0;
}

on timer tConfig_HU4_AR_OnEventIND
{
      putValue( HMI__MSG_OnEvent_Config_HU4_AR, 0 );
}

on message Config_HU5_AR
{
    byte bAliveCtr;
    byte bCheckMaxSpd;
  
    if(getValue(HMI_with_wo_HU) == VS30_without_HU)
    {
      putValue( HMI_BSM_Md_Rq_HU,           this.BSM_Md_Rq_HU.phys );
      putValue( HMI_CMS_FactReset_Rq_HU,    this.CMS_FactReset_Rq_HU.phys );
      putValue( HMI_DrowDtct_Md_Rq_HU,      this.DrowDtct_Md_Rq_HU.phys );
      putValue( HMI_DTQ_Md_Rq_HU,           this.DTQ_Md_Rq_HU.phys );
      putValue( HMI_ESP_Md_Rq_HU,           this.ESP_Md_Rq_HU.phys );
      putValue( HMI_Language_Rq_V2,         this.Language_Rq_V2.phys );
      putValue( HMI_Language_Rq_V3,         this.Language_Rq_V3.phys );
      putValue( HMI_LDC_CMS_Md_Rq_HU,       this.LDC_CMS_Md_Rq_HU.phys );
      putValue( HMI_LDC_SLA_SpdLmtTkOvr_Md_Rq_HU,this.LDC_SLA_SpdLmtTkOvr_Md_Rq_HU.phys );
      putValue( HMI_LDC_SpdUnit_Rq_HU,      this.LDC_SpdUnit_Rq_HU.phys );
      putValue( HMI_LDC_WTSL_Spd_Max_Rq_HU, this.LDC_WTSL_Spd_Max_Rq_HU.phys );
      putValue( HMI_LDP_Md_Rq_HU,           this.LDP_Md_Rq_HU.phys );
      putValue( HMI_Park_Softkey_Rq,        this.Park_Softkey_Rq.phys );
      putValue( HMI_SND_GEN_Md_Rq,          this.SND_GEN_Md_Rq.phys );
      putValue( HMI_TC_EEBBC_Rq,            this.TC_EEBBC_Rq.phys );
      putValue( HMI_TSA_FactReset_Rq_HU,    this.TSA_FactReset_Rq_HU.phys );
      putValue( HMI_TSA_HU_DispMd_Rq_HU,    this.TSA_HU_DispMd_Rq_HU.phys );
      putValue( HMI_TSA_IC_DispMd_Rq_HU,    this.TSA_IC_DispMd_Rq_HU.phys );
      putValue( HMI_TSA_SpdWarnMd_Rq_HU,    this.TSA_SpdWarnMd_Rq_HU.phys );
      putValue( HMI_TSA_SpdWarnOffset_Rq_HU,this.TSA_SpdWarnOffset_Rq_HU.phys );
      putValue( HMI_TSA_WarnMd_Rq_HU,       this.TSA_WarnMd_Rq_HU.phys );
      
      if (getValue(HMI_set_value_from_RX_speed)==0x01)
      {
        bCheckMaxSpd = getValue(HMI_LDC_WTSL_Spd_Max_Disp_Rq_HU);
        switch(bCheckMaxSpd)
        {
          case 0x01:
          {
            putValue(HMI_LDC_WTSL_Spd_Max_Stat, getValue(HMI_LDC_WTSL_Spd_Max_Rq_HU));
            break;
          }
          case 0x02:
          {
            if (getValue(HMI_LDC_WTSL_Spd_Max_Rq_HU) == 253)
            {
              putValue(HMI_LDC_WTSL_Spd_Max_Stat, 0);
            }
            break;
          }
          default:
            break;            
        }
      }
      

// --- cyclicAndSpontanWithDelay 5 --- 1000ms cycle time ---
// Evaluate if received message is on event 
      bAliveCtr = getValue( HMI__MSGAliveCtr_Config_HU5_AR );
      putValue( HMI__MSG_OnEvent_Config_HU5_AR, 1 );
      cancelTimer( tConfig_HU5_AR_OnEventIND );
      setTimer( tConfig_HU5_AR_OnEventIND, 1000 );
      if( bAliveCtr < 8 )
      {
        bAliveCtr = ( bAliveCtr + 1 ) & 0x07;
      }
      else
      {
        bAliveCtr = 0;
      }
      putValue( HMI__MSGAliveCtr_Config_HU5_AR, bAliveCtr );
    }
}

on timer tConfig_HU5_AR_OnEventTrap
{
      _Config_HU5_AR_OnEventTrap_Active = 0;
}

on timer tConfig_HU5_AR_OnEventIND
{
      putValue( HMI__MSG_OnEvent_Config_HU5_AR, 0 );
}

on message Config_HU6_AR
{
    byte bAliveCtr;
  
    if(getValue(HMI_with_wo_HU) == VS30_without_HU)
    {
      putValue( HMI_TSA_SpdWarnOffset_Disp_Rq_HU, 	  this.TSA_SpdWarnOffset_Disp_Rq_HU.phys );
	    putValue( HMI_TSA_SpdWarnOffset_Gen_Rq_HU, 	    this.TSA_SpdWarnOffset_Gen_Rq_HU.phys );
	    putValue( HMI_TSA_SpdWarnOffset_Unit_Rq_HU, 	  this.TSA_SpdWarnOffset_Unit_Rq_HU.phys );
      putValue( HMI_TSA_SpdWarnOffset1_Rq_HU, 	 	    this.TSA_SpdWarnOffset1_Rq_HU.phys );
	    putValue( HMI_TSA_SpdWarnOffset2_Rq_HU, 	 	    this.TSA_SpdWarnOffset2_Rq_HU.phys );
	    putValue( HMI_TSA_SpdWarnOffsetBase_Rq_HU, 	    this.TSA_SpdWarnOffsetBase_Rq_HU.phys );
	    putValue( HMI_TSA_SpdWarnThrs_Rq_HU, 	 		      this.TSA_SpdWarnThrs_Rq_HU.phys );
      putValue( HMI_DSR_Softkey_Psd,                  this.DSR_Softkey_Psd.phys );
      putValue( HMI_DTQ_LaneChg_Md_Rq_HU,             this.DTQ_LaneChg_Md_Rq_HU.phys );
      putValue( HMI_DTR_Curve_Md_Rq_HU,               this.DTR_Curve_Md_Rq_HU.phys );
      putValue( HMI_DTR_FactReset_Rq_HU,              this.DTR_FactReset_Rq_HU.phys );
      putValue( HMI_RDOS_Md_Rq_HU,              this.RDOS_Md_Rq_HU.phys );
      putValue( HMI_IndWhlAdj_Rq_HU,                  this.IndWhlAdj_Rq_HU.phys );
      putValue( HMI_LDC_CMS_PreWarn_Md_Rq_HU,         this.LDC_CMS_PreWarn_Md_Rq_HU.phys );
      putValue( HMI_RDOS_Md_Rq_HU,                    this.RDOS_Md_Rq_HU.phys );
      putValue( HMI_SSA_Md_Rq_HU,                     this.SSA_Md_Rq_HU.phys );
      putValue( HMI_VehLvl_Offset_FL_Rq_HU,           this.VehLvl_Offset_FL_Rq_HU.phys );
      putValue( HMI_VehLvl_Offset_FR_Rq_HU,           this.VehLvl_Offset_FR_Rq_HU.phys );
      putValue( HMI_VehLvl_Offset_RL_Rq_HU,           this.VehLvl_Offset_RL_Rq_HU.phys );
      putValue( HMI_VehLvl_Offset_RR_Rq_HU,           this.VehLvl_Offset_RR_Rq_HU.phys );
	  
// --- cyclicAndSpontanWithDelay 5 --- 1000ms cycle time ---
// Evaluate if received message is on event 
      bAliveCtr = getValue( HMI__MSGAliveCtr_Config_HU6_AR );
      putValue( HMI__MSG_OnEvent_Config_HU6_AR, 1 );
      cancelTimer( tConfig_HU6_AR_OnEventIND );
      setTimer( tConfig_HU6_AR_OnEventIND, 1000 );
      if( bAliveCtr < 8 )
      {
        bAliveCtr = ( bAliveCtr + 1 ) & 0x07;
      }
      else
      {
        bAliveCtr = 0;
      }
      putValue( HMI__MSGAliveCtr_Config_HU6_AR, bAliveCtr );
    }
}

on timer tConfig_HU6_AR_OnEventTrap
{
      _Config_HU6_AR_OnEventTrap_Active = 0;
}

on timer tConfig_HU6_AR_OnEventIND
{
      putValue( HMI__MSG_OnEvent_Config_HU6_AR, 0 );
}

on message Config_HU_Disp_Rq_AR
{
    byte bAliveCtr;
  
    if(getValue(HMI_with_wo_HU) == VS30_without_HU)
    {
		putValue( HMI_AFS_Md_Cfg_Disp_Rq_HU, 	   	this.AFS_Md_Cfg_Disp_Rq_HU.phys );
		putValue( HMI_BSM_Md_Disp_Rq_HU, 	   		  this.BSM_Md_Disp_Rq_HU.phys );
		putValue( HMI_CNG_FuelMdChg_Disp_Rq_HU, 	this.CNG_FuelMdChg_Disp_Rq_HU.phys );
		putValue( HMI_DrowDtct_Md_Disp_Rq_HU, 	  this.DrowDtct_Md_Disp_Rq_HU.phys );
		putValue( HMI_DSR_Softkey_Disp_Rq_HU, 	  this.DSR_Softkey_Disp_Rq_HU.phys );
		putValue( HMI_DTQ_LaneChg_Md_Disp_Rq_HU, 	this.DTQ_LaneChg_Md_Disp_Rq_HU.phys );
		putValue( HMI_DTQ_Md_Disp_Rq_HU, 	   		  this.DTQ_Md_Disp_Rq_HU.phys );
		putValue( HMI_DTR_Curve_Disp_Rq_HU, 	   	this.DTR_Curve_Disp_Rq_HU.phys );
		putValue( HMI_ILS_TouristMd_Disp_Rq_HU, 	this.ILS_TouristMd_Disp_Rq_HU.phys );
		putValue( HMI_ILS_TouristMd_Disp_Rq_HU_V2,this.ILS_TouristMd_Disp_Rq_HU_V2.phys );
		putValue( HMI_LCMS_Md_Disp_Rq_HU, 	   		this.LCMS_Md_Disp_Rq_HU.phys );
		putValue( HMI_LDC_CMS_Md_Disp_Rq_HU, 	   	this.LDC_CMS_Md_Disp_Rq_HU.phys );
		putValue( HMI_LDC_WTSL_Spd_Max_Disp_Rq_HU,this.LDC_WTSL_Spd_Max_Disp_Rq_HU.phys );
		putValue( HMI_LDP_Md_Disp_Rq_HU, 	   		  this.LDP_Md_Disp_Rq_HU.phys );
		putValue( HMI_NVP_SPL_Md_Disp_Rq_HU, 	   	this.NVP_SPL_Md_Disp_Rq_HU.phys );
		putValue( HMI_Park_BrkMd_Disp_Rq_HU, 	   	this.Park_BrkMd_Disp_Rq_HU.phys );
		putValue( HMI_Park_Softkey_Disp_Rq_HU, 	  this.Park_Softkey_Disp_Rq_HU.phys );
		putValue( HMI_VehDrvProg_M_Disp_Rq_HU, 	  this.VehDrvProg_M_Disp_Rq_HU.phys );
    putValue( HMI_FDC_Md_Disp_Rq_HU, 	        this.FDC_Md_Disp_Rq_HU.phys );
    putValue( HMI_SwIllLvl_Rq_HU_AMG, 	      this.SwIllLvl_Rq_HU_AMG.phys );
    

// --- cyclicAndSpontanWithDelay 5 --- 1000ms cycle time ---
// Evaluate if received message is on event 
      bAliveCtr = getValue( HMI__MSGAliveCtr_Config_HU_Disp_Rq_AR );
      putValue( HMI__MSG_OnEvent_Config_HU_Disp_Rq_AR, 1 );
      cancelTimer( tConfig_HU_Disp_Rq_AR_OnEventIND );
      setTimer( tConfig_HU_Disp_Rq_AR_OnEventIND, 1000 );
      if( bAliveCtr < 8 )
      {
        bAliveCtr = ( bAliveCtr + 1 ) & 0x07;
      }
      else
      {
        bAliveCtr = 0;
      }
      putValue( HMI__MSGAliveCtr_Config_HU_Disp_Rq_AR, bAliveCtr );
    }
}

on timer tConfig_HU_Disp_Rq_AR_OnEventTrap
{
      _Config_HU_Disp_Rq_AR_OnEventTrap_Active = 0;
}

on timer tConfig_HU_Disp_Rq_AR_OnEventIND
{
      putValue( HMI__MSG_OnEvent_Config_HU_Disp_Rq_AR, 0 );
}

on message HU_DateTm_Rq_AR
{
    byte bAliveCtr;
    byte bCurrentState;
    byte bPreviousState = 7;
  
    if(getValue(HMI_with_wo_HU) == VS30_without_HU)
    {
        putValue( HMI_DateTmClkFormat,    this.DateTmClkFormat.phys );
        putValue( HMI_DateTmDateFormat,   this.DateTmDateFormat.phys );
        putValue( HMI_DateTmDay_Rq,       this.DateTmDay_Rq.phys );
        putValue( HMI_DateTmHour_Rq,      this.DateTmHour_Rq.phys );
        putValue( HMI_DateTmMinute_Rq,    this.DateTmMinute_Rq.phys );
        putValue( HMI_DateTmMonth_Rq,     this.DateTmMonth_Rq.phys );
        putValue( HMI_DateTmMonthStyle,   this.DateTmMonthStyle.phys );
        putValue( HMI_DateTmSecond_Rq,    this.DateTmSecond_Rq.phys );
        putValue( HMI_DateTmStat_Rq,      this.DateTmStat_Rq.phys );
        putValue( HMI_DateTmSyncRsn_V2,   this.DateTmSyncRsn_V2.phys );
        putValue( HMI_DateTmWeekday_Rq,   this.DateTmWeekday_Rq.phys );
        putValue( HMI_DateTmYear_Rq,      this.DateTmYear_Rq.phys );
        
      bCurrentState = getValue(HMI_DateTmStat_Rq);
      
      if (getValue(HMI_set_value_from_RX_time)==0x01)
      {
        switch(bCurrentState)
        {
          case 2:/*Plausible*/
          {
            if(bPreviousState == 3)
            {
                putValue( HMI_DateTmStat,      getValue(HMI_DateTmStat_Rq ));
            }
            bPreviousState = bCurrentState;
            break;
          }
          case 3:/*New*/
          {
            if(bPreviousState != 3)
            {
              putValue( HMI_DateTmDay,       getValue(HMI_DateTmDay_Rq ));
              putValue( HMI_DateTmHour,      getValue(HMI_DateTmHour_Rq ));
              putValue( HMI_DateTmMinute,    getValue(HMI_DateTmMinute_Rq ));
              putValue( HMI_DateTmMonth,     getValue(HMI_DateTmMonth_Rq ));
              putValue( HMI_DateTmSecond,    getValue(HMI_DateTmSecond_Rq ));
              putValue( HMI_DateTmStat,      getValue(HMI_DateTmStat_Rq ));
              putValue( HMI_DateTmWeekday,   getValue(HMI_DateTmWeekday_Rq ));
              putValue( HMI_DateTmYear,      getValue(HMI_DateTmYear_Rq ));
            }
            bPreviousState = bCurrentState;
            break;
          }
          default: bPreviousState = bCurrentState;
          break;
        }
      }
      
// --- cyclicAndSpontanWithDelay 5 --- 1000ms cycle time ---
// Evaluate if received message is on event 
      bAliveCtr = getValue( HMI__MSGAliveCtr_HU_DateTm_Rq_AR );
      putValue( HMI__MSG_OnEvent_HU_DateTm_Rq_AR, 1 );
      cancelTimer( tHU_DateTm_Rq_AR_OnEventIND );
      setTimer( tHU_DateTm_Rq_AR_OnEventIND, 1000 );
      if( bAliveCtr < 8 )
      {
        bAliveCtr = ( bAliveCtr + 1 ) & 0x07;
      }
      else
      {
        bAliveCtr = 0;
      }
      putValue( HMI__MSGAliveCtr_HU_DateTm_Rq_AR, bAliveCtr );
    }
}

on timer tHU_DateTm_Rq_AR_OnEventTrap
{
      _HU_DateTm_Rq_AR_OnEventTrap_Active = 0;
}

on timer tHU_DateTm_Rq_AR_OnEventIND
{
      putValue( HMI__MSG_OnEvent_HU_DateTm_Rq_AR, 0 );
}

on message TGW_COM_Call_Disp_Rq_AR
{
    byte bAliveCtr;

    putValue( HMI_MBCall_Call_Rq,    this.MBCall_Call_Rq.phys );
    putValue( HMI_MBCall_End_Call_Rq, 		     this.MBCall_End_Call_Rq.phys );
    putValue( HMI_MBCall_Popup_Cnfrm, 		     this.MBCall_Popup_Cnfrm.phys );
    putValue( HMI_MBCall_ReturnCall_Stat, 		this.MBCall_ReturnCall_Stat.phys );
    putValue( HMI_MBCall_TrckMd_Rq,   this.MBCall_TrckMd_Rq.phys );
    putValue( HMI_OfflineMd_Rq,    this.OfflineMd_Rq.phys );
    putValue( HMI_UserDataReset_Stat, 		this.UserDataReset_Stat.phys );

// --- cyclicAndSpontanWithDelay 5 --- 1000ms cycle time ---
// Evaluate if received message is on event 
    bAliveCtr = getValue( HMI__MSGAliveCtr_TGW_COM_Call_Disp_Rq_AR );
    if( _TGW_COM_Call_Disp_Rq_AR_OnEventTrap_Active )
    {
        putValue( HMI__MSG_OnEvent_TGW_COM_Call_Disp_Rq_AR, 1 );
        cancelTimer( tTGW_COM_Call_Disp_Rq_AR_OnEventIND );
        setTimer( tTGW_COM_Call_Disp_Rq_AR_OnEventIND, 1000 );
    }
    else
    {
        if( bAliveCtr < 8 )
        {
            bAliveCtr = ( bAliveCtr + 1 ) & 0x07;
        }
        else
        {
            bAliveCtr = 0;
		}
        putValue( HMI__MSGAliveCtr_TGW_COM_Call_Disp_Rq_AR, bAliveCtr );
        _TGW_COM_Call_Disp_Rq_AR_OnEventTrap_Active = 1;
        setTimer( tTGW_COM_Call_Disp_Rq_AR_OnEventTrap, _TGW_COM_Call_Disp_Rq_AR_OnEventDetectTime );
    }
}

on timer tTGW_COM_Call_Disp_Rq_AR_OnEventIND
{
    putValue( HMI__MSG_OnEvent_TGW_COM_Call_Disp_Rq_AR, 0 );
}

on timer tTGW_COM_Call_Disp_Rq_AR_OnEventTrap
{
    _TGW_COM_Call_Disp_Rq_AR_OnEventTrap_Active = 0;
}