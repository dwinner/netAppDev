/*@!Encoding:1252*/
includes
{
  #include "../../_DLL/latest_BAP_DLL.cin"
}

variables
{

	//@BAPSIMGEN_VAR_SECTION_BEGIN

	/***************************************************/
	/*            BapSimGen FSG template               */
	/***************************************************/

	/************** Ausgabe Konsole (Traces) ***********/
	dword gBAP_Trace;
	dword gError_Trace;

	/************** Node Verwaltung ***************/
	//Power on/off
	byte gSG_PowerOnOff=0x01;     // wird mit Power_off/on gesetzt
	byte gBAP_Init=0;             // schon mal initialisiert?

	const Power_off = 0x00;	
	const Power_on	= 0x01;

	mstimer TaskTimer;				//real communication timer

	/************** Request **************/
	const Requestbuffer_lines = 100;
	const BAP_buffer_size = 4096;

	/************ Speichern von Requests im "Ringbuffer" ***********/
	int   gBAP_Requestbuffer_status	[Requestbuffer_lines];		             // 0: kein Eintrag, 1: pending
	dword gBAP_Request_header		[Requestbuffer_lines] [6];				 // beinhaltet auch skalare Daten
	dword gBAP_Request_data         [Requestbuffer_lines] [BAP_buffer_size]; // Ringbuffer fuer BAP-Request


	/************** Indication **************/
	// enthaelt die derzeitige Indication
	dword gBAP_Indication_header[6];	
	byte  gBAP_Indication_data[BAP_buffer_size];		

	/************** Konstanten ****************/

	//BAP Data Type 
	const Bap_void				=0;
	const Bap_uint8				=1;
	const Bap_uint16			=2;
	const Bap_uint32			=3;
	const Bap_byteSequence		=4;
    const Bap_fixedByteSequence =4;
    const Bap_error				=5;
    const Bap_acknowledge		=6;

	char Datatype_Text[7][20] =
	{
		"void", "uint8", "uint16", "uint32", "byteSequence", "error", "acknowledge"
	};
	
	//BAP request types
	const DataSetGet_REQ	= 0x00;
	const DataSet_REQ		= 0x01;
	const DataGet_REQ		= 0x02;
	const Data_REQ			= 0x03;
	const Changed_REQ		= 0x04;
	const Start_REQ			= 0x05;
	const StartResult_REQ	= 0x06;
	const AbortResult_REQ	= 0x07;
	const Processing_REQ	= 0x08;
	const Result_REQ		= 0x09;
	const DataAck_REQ       = 0x0A;
	const Ack_REQ           = 0x0B;
	const Invalid_REQ    	= 0x1F; // Kennzeichnung fuer einen ungueltigen Request
	const Error_REQ         = 0x20;

	char Requesttype_Text[33][30] =
	{
		"DataSetGet_REQ", "DataSet_REQ", "DataGet_REQ", "Data_REQ",			/* 00 .. 03 */
		"Changed_REQ", "Start_REQ", "StartResult_REQ", "AbortResult_REQ",   /* 04 .. 07 */
		"Processing_REQ", "Result_REQ", "DataAck_REQ", "Ack_REQ", 		/* 08 .. 0b */
		"Invalid_REQ", "Invalid_REQ", "Invalid_REQ", "Invalid_REQ",  		/* 0c .. 0f */
		"Invalid_REQ", "Invalid_REQ", "Invalid_REQ", "Invalid_REQ",  		/* 10 .. 13 */
		"Invalid_REQ", "Invalid_REQ", "Invalid_REQ", "Invalid_REQ",  		/* 14 .. 17 */
		"Invalid_REQ", "Invalid_REQ", "Invalid_REQ", "Invalid_REQ", 		/* 18 .. 1b */
		"Invalid_REQ", "Invalid_REQ", "Invalid_REQ", "Invalid_REQ",  		/* 1c .. 1f */
		"Error_REQ"	  														/* 20 */
	};
	
	//BAP indication types
	const Data_IND				= 0x00;
	const Reset_IND				= 0x01;
	const DataAck_IND			= 0x02;
	const Result_IND			= 0x03;
	const Processing_IND	    = 0x04;
	const Changed_IND			= 0x05;
	const DataSetGet_IND	    = 0x06;
	const DataSet_IND			= 0x07;
	const DataGet_IND			= 0x08;
	const Ack_IND				= 0x09;
	const Processing_CNF_IND	= 0x0A;
	const Start_IND				= 0x0B;
	const StartResult_IND		= 0x0C;
	const AbortResult_IND		= 0x0D;
	const Invalid_IND			= 0x1F; // Kennzeichnung fuer eine ungueltige Indication
	const Error_IND             = 0x20;

	char Indicationtype_Text[33][30] =
	{
		"Data_IND", "Reset_IND", "DataAck_IND", "Result_IND",				/* 00 .. 03 */
		"Processing_IND", "Changed_IND", "DataSetGet_IND", "DataSet_IND",	/* 04 .. 07 */
		"DataGet_IND", "Ack_IND", "Processing_CNF_IND", "Start_REQ",		/* 08 .. 0b */
		"StartResult_REQ", "AbortResult_REQ", "Invalid_REQ", "Invalid_REQ", /* 0c .. 0f */
		"Invalid_REQ", "Invalid_REQ", "Invalid_REQ", "Invalid_REQ",			/* 10 .. 13 */
		"Invalid_REQ", "Invalid_REQ", "Invalid_REQ", "Invalid_REQ",			/* 14 .. 17 */
		"Invalid_REQ", "Invalid_REQ", "Invalid_REQ", "Invalid_REQ",			/* 18 .. 1b */
		"Invalid_REQ", "Invalid_REQ", "Invalid_REQ", "Invalid_REQ",			/* 1c .. 1f */
		"Error_REQ"	  														/* 20 */
	};	
	
	char Acknowledgetype_Text[24][30] =
	{
		"Property_SetGet_ACK", "Array_SetGet_ACK", "Property_Set_ACK", "Array_Set_ACK",				/* 00 .. 03 */
		"Method_Start_ACK", "Method_StartResult_ACK", "Method_AbortResult_ACK", "Property_Get_ACK",	/* 04 .. 07 */
		"Array_Get_ACK", "Cache_GetAll_ACK", "Property_Ack_ACK", "Property_Status_ACK",	   			/* 08 .. 0b */
		"Property_StatusAck_ACK", "Property_Error_ACK", "Array_Status_ACK", "Array_Changed_ACK",	/* 0c .. 0f */
		"Array_Error_ACK", "Method_Processing_ACK", "Method_Result_ACK", "Method_Error_ACK",  		/* 10 .. 13 */
		"Unknown_ACK", "Unknown_ACK", "Unknown_ACK", "Unknown_ACK"									/* 14 .. 17 */
	};

	/**************************** Global Function-ID's ******************************/

	byte already_pressed = 0;

	const FctID_GetAll									= 0x01;
	const FctID_BAP_Config								= 0x02;
	const FctID_FunctionList							= 0x03;
	const FctID_HeartBeat								= 0x04;
    
    char SGtype[4]="FSG";


	//// Begin: konfigurationsabhýngige Variablen, die als BAPCONFIG_VARS in Template definiert sind
	
	char  dbc_path[255]             = "BAP\\FSG52_MFL_Config_34\\bapdb\\BAP_only_MLBevo_v1.24F.dbc";
	char  xml_path[255]             = "BAP\\FSG52_MFL_Config_34\\bapxml\\BAP_SW16_MFL_MLBevo_P31DF34_FSG_V1.40.xml";
	dword NODE_INDEX                =  0;
	char  NODE_NAME[100]            = "MFL_Config";
	const LSGID                     = 52;
	char  panel_name[100]           = "FSG52_0";
	char  bapconfig_panel_name[100]    = "panel3";
	char  common_panel_name[100]    = "panel2";
	const TaskTime                  = 10;
	 const C_FSG_52_0_0_1_ID = 1;
	 char gCheckbox1[100] = "checkbox_C_FSG_52_0_0_1";
	 char gErrField1[100] = "errfield_C_FSG_52_0_0_1";
	 byte gC_FSG_52_0_0_1_ErrCode = 1;
	 const P_FSG_52_0_0_2_ID = 2;
	 byte P_FSG_52_0_0_2Reset_BTN_already_pressed = 0;
	 char gCheckbox2[100] = "checkbox_P_FSG_52_0_0_2";
	 char gErrField2[100] = "errfield_P_FSG_52_0_0_2";
	 byte gP_FSG_52_0_0_2_ErrCode = 1;
	 const P_FSG_52_0_0_3_ID = 3;
	 byte P_FSG_52_0_0_3Status_BTN_already_pressed = 0;
	 char gCheckbox3[100] = "checkbox_P_FSG_52_0_0_3";
	 char gErrField3[100] = "errfield_P_FSG_52_0_0_3";
	 byte gP_FSG_52_0_0_3_ErrCode = 1;
	 const P_FSG_52_0_0_4_ID = 4;
	 byte P_FSG_52_0_0_4Status_BTN_already_pressed = 0;
	 char gCheckbox4[100] = "checkbox_P_FSG_52_0_0_4";
	 char gErrField4[100] = "errfield_P_FSG_52_0_0_4";
	 byte gP_FSG_52_0_0_4_ErrCode = 1;
	 const P_FSG_52_0_0_14_ID = 14;
	 byte P_FSG_52_0_0_14Status_BTN_already_pressed = 0;
	 char gCheckbox14[100] = "checkbox_P_FSG_52_0_0_14";
	 char gErrField14[100] = "errfield_P_FSG_52_0_0_14";
	 byte gP_FSG_52_0_0_14_ErrCode = 1;
	 char gPanel14[100] = "panel_P_FSG_52_0_0_14";
	 const P_FSG_52_0_0_15_ID = 15;
	 byte P_FSG_52_0_0_15Status_BTN_already_pressed = 0;
	 char gCheckbox15[100] = "checkbox_P_FSG_52_0_0_15";
	 char gErrField15[100] = "errfield_P_FSG_52_0_0_15";
	 byte gP_FSG_52_0_0_15_ErrCode = 1;
	 char gPanel15[100] = "panel_P_FSG_52_0_0_15";
	 const P_FSG_52_0_0_16_ID = 16;
	 byte P_FSG_52_0_0_16Status_BTN_already_pressed = 0;
	 char gCheckbox16[100] = "checkbox_P_FSG_52_0_0_16";
	 char gErrField16[100] = "errfield_P_FSG_52_0_0_16";
	 byte gP_FSG_52_0_0_16_ErrCode = 1;
	 char gPanel16[100] = "panel_P_FSG_52_0_0_16";
	 const P_FSG_52_0_0_17_ID = 17;
	 byte P_FSG_52_0_0_17Status_BTN_already_pressed = 0;
	 byte P_FSG_52_0_0_17StatusAck_BTN_already_pressed = 0;
	 char gCheckbox17[100] = "checkbox_P_FSG_52_0_0_17";
	 char gErrField17[100] = "errfield_P_FSG_52_0_0_17";
	 byte gP_FSG_52_0_0_17_ErrCode = 1;
	 char gPanel17[100] = "panel_P_FSG_52_0_0_17";
	 const P_FSG_52_0_0_18_ID = 18;
	 byte P_FSG_52_0_0_18Status_BTN_already_pressed = 0;
	 char gCheckbox18[100] = "checkbox_P_FSG_52_0_0_18";
	 char gErrField18[100] = "errfield_P_FSG_52_0_0_18";
	 byte gP_FSG_52_0_0_18_ErrCode = 1;
	 char gPanel18[100] = "panel_P_FSG_52_0_0_18";
	 const P_FSG_52_0_0_19_ID = 19;
	 byte P_FSG_52_0_0_19Status_BTN_already_pressed = 0;
	 char gCheckbox19[100] = "checkbox_P_FSG_52_0_0_19";
	 char gErrField19[100] = "errfield_P_FSG_52_0_0_19";
	 byte gP_FSG_52_0_0_19_ErrCode = 1;
	 char gPanel19[100] = "panel_P_FSG_52_0_0_19";
	 const M_FSG_52_0_0_20_ID = 20;
	 byte M_FSG_52_0_0_20Result_BTN_already_pressed = 0;
	 char gCheckbox20[100] = "checkbox_M_FSG_52_0_0_20";
	 char gErrField20[100] = "errfield_M_FSG_52_0_0_20";
	 byte gM_FSG_52_0_0_20_ErrCode = 1;
	 char gPanel20[100] = "panel_M_FSG_52_0_0_20";


	//// End konfigurationsabhýngige Variablen 
	
	/// Begin: Definition der BUS-Schnittstellen
	
	// FLEXRAY NOT ENABLED!
	
	// ETHERNET NOT ENABLED! 
	
	//// End Bus Schnittstellen

}

on preStart
{
    char Version[200];
    char Path[255];

    /***** Erzeugen der Ausgabeconsolen *****/  
    gBAP_Trace=writecreate("BAP-Trace");        //write-window for BAP-cummunication
    writeclear(gBAP_Trace);                     //clear BAP-window in write-window
    
    gError_Trace=writecreate("Error");          //error-window for BAP-cummunication
    writeclear(gError_Trace);                   //clear error-window in write-window
    
    writeclear(1);                              //clear CAPL-window in write-window
    
    /**** Versionsstring von DLL holen und auf Bildschirm ausgeben ***/ 
    BAP150_GetVersions(Version, 200);
    writelineEx(gBAP_Trace, 0, "Versionx:%s", Version);
                                            
    NODE_INDEX = BAP150_CreateNode();
    writelineEx(gBAP_Trace, 0, "FSG %d Nodeindex:%d", LSGID, Version);
    
    /**** Laden der CANoe Datenbank *****/
    getAbsFilePath(dbc_path, Path, 255);
    writelineEx(gBAP_Trace, 0, "Load BAP_DBC-File: %s", Path);
    if(BAP150_LoadDBC(NODE_INDEX, 1, Path)  != 0) {        writelineEx(gError_Trace, 0, "Fehler beim Laden: %s !", Path);
    }

    /**** Laden des BAP XML Files ****/
    getAbsFilePath(xml_path, Path, 255);
    writelineEx(gBAP_Trace, 0, "Load BAP-XML-File: %s", Path);
    if (BAP150_LoadConfig(NODE_INDEX, Path) != 0) {
        writelineEx(gError_Trace, 0, "Fehler beim Laden: %s !", Path);
    }

    if (BAP150_AddCanMap(NODE_INDEX, 1, 1) != 0) {
        writelineEx(gError_Trace, 0, "Fehler beim Mappen!");
    }   
    
    // FLEXRAY NOT ENABLED!
}

DisableFctCtrl ()
{
  	EnableControl(panel_name, common_panel_name, 0);
	EnableControl(panel_name,gErrField1,0);
	EnableControl(panel_name,gErrField2,0);
	EnableControl(panel_name,gErrField3,0);
	EnableControl(panel_name,gErrField4,0);
	EnableControl(panel_name,gErrField14,0);
	EnableControl(panel_name,gPanel14,0);
	EnableControl(panel_name,"panel_P_FSG_52_0_0_14",0);
	EnableControl(panel_name,gErrField15,0);
	EnableControl(panel_name,gPanel15,0);
	EnableControl(panel_name,"panel_P_FSG_52_0_0_15",0);
	EnableControl(panel_name,gErrField16,0);
	EnableControl(panel_name,gPanel16,0);
	EnableControl(panel_name,"panel_P_FSG_52_0_0_16",0);
	EnableControl(panel_name,gErrField17,0);
	EnableControl(panel_name,gPanel17,0);
	EnableControl(panel_name,"panel_P_FSG_52_0_0_17",0);
	EnableControl(panel_name,gErrField18,0);
	EnableControl(panel_name,gPanel18,0);
	EnableControl(panel_name,"panel_P_FSG_52_0_0_18",0);
	EnableControl(panel_name,gErrField19,0);
	EnableControl(panel_name,gPanel19,0);
	EnableControl(panel_name,"panel_P_FSG_52_0_0_19",0);
	EnableControl(panel_name,gErrField20,0);
	EnableControl(panel_name,gPanel20,0);
	EnableControl(panel_name,"panel_M_FSG_52_0_0_20_Result",0);
	EnableControl(panel_name,"panel_M_FSG_52_0_0_20_Processing",0);
	EnableControl(panel_name,"panel_M_FSG_52_0_0_20_Start",0);

}

EnableFctCtrl ()
{
  	EnableControl(panel_name, common_panel_name, 1);
	if(getValue(P_FSG_52_0_0_14_FctLstItemEn)){
		 EnableControl(panel_name,gPanel14,1);
		 EnableControl(panel_name,gErrField14,1);
	}
	if(getValue(P_FSG_52_0_0_15_FctLstItemEn)){
		 EnableControl(panel_name,gPanel15,1);
		 EnableControl(panel_name,gErrField15,1);
	}
	if(getValue(P_FSG_52_0_0_16_FctLstItemEn)){
		 EnableControl(panel_name,gPanel16,1);
		 EnableControl(panel_name,gErrField16,1);
	}
	if(getValue(P_FSG_52_0_0_17_FctLstItemEn)){
		 EnableControl(panel_name,gPanel17,1);
		 EnableControl(panel_name,gErrField17,1);
	}
	if(getValue(P_FSG_52_0_0_18_FctLstItemEn)){
		 EnableControl(panel_name,gPanel18,1);
		 EnableControl(panel_name,gErrField18,1);
	}
	if(getValue(P_FSG_52_0_0_19_FctLstItemEn)){
		 EnableControl(panel_name,gPanel19,1);
		 EnableControl(panel_name,gErrField19,1);
	}
	if(getValue(M_FSG_52_0_0_20_FctLstItemEn)){
		 EnableControl(panel_name,gPanel20,1);
		 EnableControl(panel_name,gErrField20,1);
	}

}

DisableConfigCtrl ()
{
  	EnableControl(panel_name, bapconfig_panel_name, 0);
	EnableControl(panel_name, "panel3_edit", 0);
//	EnableControl(panel_name,gCheckbox1,0);
//	if(!getValue(C_FSG_52_0_0_1_FctLstItemEn)){
//		 SetControlBackColor(panel_name,gCheckbox1,MakeRGB(200,200,200));
//	}
//	EnableControl(panel_name,gCheckbox2,0);
//	if(!getValue(P_FSG_52_0_0_2_FctLstItemEn)){
//		 SetControlBackColor(panel_name,gCheckbox2,MakeRGB(200,200,200));
//	}
//	EnableControl(panel_name,gCheckbox3,0);
//	if(!getValue(P_FSG_52_0_0_3_FctLstItemEn)){
//		 SetControlBackColor(panel_name,gCheckbox3,MakeRGB(200,200,200));
//	}
	EnableControl(panel_name, "panel_P_FSG_52_0_0_4", 0);
//	EnableControl(panel_name,gCheckbox4,0);
//	if(!getValue(P_FSG_52_0_0_4_FctLstItemEn)){
//		 SetControlBackColor(panel_name,gCheckbox4,MakeRGB(200,200,200));
//	}
//	EnableControl(panel_name,gCheckbox14,0);
//	if(!getValue(P_FSG_52_0_0_14_FctLstItemEn)){
//		 SetControlBackColor(panel_name,gCheckbox14,MakeRGB(200,200,200));
//	}
//	EnableControl(panel_name,gCheckbox15,0);
//	if(!getValue(P_FSG_52_0_0_15_FctLstItemEn)){
//		 SetControlBackColor(panel_name,gCheckbox15,MakeRGB(200,200,200));
//	}
//	EnableControl(panel_name,gCheckbox16,0);
//	if(!getValue(P_FSG_52_0_0_16_FctLstItemEn)){
//		 SetControlBackColor(panel_name,gCheckbox16,MakeRGB(200,200,200));
//	}
//	EnableControl(panel_name,gCheckbox17,0);
//	if(!getValue(P_FSG_52_0_0_17_FctLstItemEn)){
//		 SetControlBackColor(panel_name,gCheckbox17,MakeRGB(200,200,200));
//	}
//	EnableControl(panel_name,gCheckbox18,0);
//	if(!getValue(P_FSG_52_0_0_18_FctLstItemEn)){
//		 SetControlBackColor(panel_name,gCheckbox18,MakeRGB(200,200,200));
//	}
//	EnableControl(panel_name,gCheckbox19,0);
//	if(!getValue(P_FSG_52_0_0_19_FctLstItemEn)){
//		 SetControlBackColor(panel_name,gCheckbox19,MakeRGB(200,200,200));
//	}
//	EnableControl(panel_name,gCheckbox20,0);
//	if(!getValue(M_FSG_52_0_0_20_FctLstItemEn)){
//		 SetControlBackColor(panel_name,gCheckbox20,MakeRGB(200,200,200));
//	}

}

EnableConfigCtrl ()
{
  	EnableControl(panel_name, bapconfig_panel_name, 1);
	EnableControl(panel_name, "panel3_edit", 1);
	if(getValue(C_FSG_52_0_0_1_FctLstItemEn))
	{
		setControlForeColor(panel_name, gCheckbox1, MakeRGB(0,240,0));
	}
	else
	{
		setControlForeColor(panel_name, gCheckbox1, MakeRGB(250,0,0));
	}
	if(getValue(P_FSG_52_0_0_2_FctLstItemEn))
	{
		setControlForeColor(panel_name, gCheckbox2, MakeRGB(0,240,0));
	}
	else
	{
		setControlForeColor(panel_name, gCheckbox2, MakeRGB(250,0,0));
	}
	if(getValue(P_FSG_52_0_0_3_FctLstItemEn))
	{
		setControlForeColor(panel_name, gCheckbox3, MakeRGB(0,240,0));
	}
	else
	{
		setControlForeColor(panel_name, gCheckbox3, MakeRGB(250,0,0));
	}
	EnableControl(panel_name, "panel_P_FSG_52_0_0_4", 1);
	if(getValue(P_FSG_52_0_0_4_FctLstItemEn))
	{
		setControlForeColor(panel_name, gCheckbox4, MakeRGB(0,240,0));
	}
	else
	{
		setControlForeColor(panel_name, gCheckbox4, MakeRGB(250,0,0));
	}
	if(getValue(P_FSG_52_0_0_14_FctLstItemEn))
	{
		EnableControl(panel_name, "panel_P_FSG_52_0_0_14",1);
		EnableControl(panel_name,"errfield_P_FSG_52_0_0_14",1);
		setControlForeColor(panel_name, gCheckbox14, MakeRGB(0,240,0));
	}
	else
	{
		EnableControl(panel_name, "panel_P_FSG_52_0_0_14",0);
		EnableControl(panel_name,"errfield_P_FSG_52_0_0_14",0);
		setControlForeColor(panel_name, gCheckbox14, MakeRGB(250,0,0));
	}
	if(getValue(P_FSG_52_0_0_15_FctLstItemEn))
	{
		EnableControl(panel_name, "panel_P_FSG_52_0_0_15",1);
		EnableControl(panel_name,"errfield_P_FSG_52_0_0_15",1);
		setControlForeColor(panel_name, gCheckbox15, MakeRGB(0,240,0));
	}
	else
	{
		EnableControl(panel_name, "panel_P_FSG_52_0_0_15",0);
		EnableControl(panel_name,"errfield_P_FSG_52_0_0_15",0);
		setControlForeColor(panel_name, gCheckbox15, MakeRGB(250,0,0));
	}
	if(getValue(P_FSG_52_0_0_16_FctLstItemEn))
	{
		EnableControl(panel_name, "panel_P_FSG_52_0_0_16",1);
		EnableControl(panel_name,"errfield_P_FSG_52_0_0_16",1);
		setControlForeColor(panel_name, gCheckbox16, MakeRGB(0,240,0));
	}
	else
	{
		EnableControl(panel_name, "panel_P_FSG_52_0_0_16",0);
		EnableControl(panel_name,"errfield_P_FSG_52_0_0_16",0);
		setControlForeColor(panel_name, gCheckbox16, MakeRGB(250,0,0));
	}
	if(getValue(P_FSG_52_0_0_17_FctLstItemEn))
	{
		EnableControl(panel_name, "panel_P_FSG_52_0_0_17",1);
		EnableControl(panel_name,"errfield_P_FSG_52_0_0_17",1);
		setControlForeColor(panel_name, gCheckbox17, MakeRGB(0,240,0));
	}
	else
	{
		EnableControl(panel_name, "panel_P_FSG_52_0_0_17",0);
		EnableControl(panel_name,"errfield_P_FSG_52_0_0_17",0);
		setControlForeColor(panel_name, gCheckbox17, MakeRGB(250,0,0));
	}
	if(getValue(P_FSG_52_0_0_18_FctLstItemEn))
	{
		EnableControl(panel_name, "panel_P_FSG_52_0_0_18",1);
		EnableControl(panel_name,"errfield_P_FSG_52_0_0_18",1);
		setControlForeColor(panel_name, gCheckbox18, MakeRGB(0,240,0));
	}
	else
	{
		EnableControl(panel_name, "panel_P_FSG_52_0_0_18",0);
		EnableControl(panel_name,"errfield_P_FSG_52_0_0_18",0);
		setControlForeColor(panel_name, gCheckbox18, MakeRGB(250,0,0));
	}
	if(getValue(P_FSG_52_0_0_19_FctLstItemEn))
	{
		EnableControl(panel_name, "panel_P_FSG_52_0_0_19",1);
		EnableControl(panel_name,"errfield_P_FSG_52_0_0_19",1);
		setControlForeColor(panel_name, gCheckbox19, MakeRGB(0,240,0));
	}
	else
	{
		EnableControl(panel_name, "panel_P_FSG_52_0_0_19",0);
		EnableControl(panel_name,"errfield_P_FSG_52_0_0_19",0);
		setControlForeColor(panel_name, gCheckbox19, MakeRGB(250,0,0));
	}
	if(getValue(M_FSG_52_0_0_20_FctLstItemEn))
	{
		EnableControl(panel_name, "panel_M_FSG_52_0_0_20",1);
		EnableControl(panel_name,"errfield_M_FSG_52_0_0_20",1);
		EnableControl(panel_name,"panel_M_FSG_52_0_0_20_Processing",1);
		EnableControl(panel_name,"panel_M_FSG_52_0_0_20_Start",1);
		setControlForeColor(panel_name, gCheckbox20, MakeRGB(0,240,0));
	}
	else
	{
		EnableControl(panel_name, "panel_M_FSG_52_0_0_20",0);
		EnableControl(panel_name,"errfield_M_FSG_52_0_0_20",0);
		EnableControl(panel_name,"panel_M_FSG_52_0_0_20_Processing",0);
		EnableControl(panel_name,"panel_M_FSG_52_0_0_20_Start",0);
		setControlForeColor(panel_name, gCheckbox20, MakeRGB(250,0,0));
	}

}

resetErrfieldColor()
{
  	setControlBackColor(panel_name, "errfield_C_FSG_52_0_0_1", MakeRGB(255,255,255));
	setControlBackColor(panel_name, "errfield_P_FSG_52_0_0_2", MakeRGB(255,255,255));
	setControlBackColor(panel_name, "errfield_P_FSG_52_0_0_3", MakeRGB(255,255,255));
	setControlBackColor(panel_name, "errfield_P_FSG_52_0_0_4", MakeRGB(255,255,255));
	setControlBackColor(panel_name, "errfield_P_FSG_52_0_0_14", MakeRGB(255,255,255));
	setControlBackColor(panel_name, "errfield_P_FSG_52_0_0_15", MakeRGB(255,255,255));
	setControlBackColor(panel_name, "errfield_P_FSG_52_0_0_16", MakeRGB(255,255,255));
	setControlBackColor(panel_name, "errfield_P_FSG_52_0_0_17", MakeRGB(255,255,255));
	setControlBackColor(panel_name, "errfield_P_FSG_52_0_0_18", MakeRGB(255,255,255));
	setControlBackColor(panel_name, "errfield_P_FSG_52_0_0_19", MakeRGB(255,255,255));
	setControlBackColor(panel_name, "errfield_M_FSG_52_0_0_20", MakeRGB(255,255,255));

}

CANoe_Shutdown ()
{
	// Timer: cancel real CAN-communication timer
	canceltimer(TaskTimer);
	// Ruecksetzen der Hintergrundfarbe der Error-Felder
	resetErrfieldColor();
	// Deaktivierung aller Panel Elemente 
	EnableConfigCtrl();
}

on timer TaskTimer
{
	/*** Aufruf des BAP Task in DLL fuer NODE_INDEX ***/
	BAP150_Task(NODE_INDEX);	

	/*** Pollen ueber die anstehenden Indications (Lesen aus DLL, Auslesen eines Puffers der DLL) ***/
	BAP_DLL_Indication();	
	
	/*** Pollen ueber die anstehenden Requests (Schreiben in DLL, dort werden evt. Sendeauftraege gesetzt) ***/
	BAP_DLL_Request();
	
	/*** Abarbeiten der ausstehenden Sendeauftraege innerhalb der BAP DLL und Versenden ueber CANoe ***/
	if (getValue(KCAN__NMH_ICAS1_Gateway_CommActive))
	{
		BAP_CAN_TX_Request();
	}

	/*** Der Empfang von CAN Daten geschieht ueber on message CAN message Mechanismen ***/
	// keine Funktion hier

	/*** Retriggern des Timers mit 10 ms ***/
	setTimer(TaskTimer, TaskTime); // @TODO bei anderer Taskzeit muss hier modifiziert werden
}

BAP_DLL_Indication()	//function to get received BAP-data from DLL (at BAL-interface)
{
	int i, length, datalength, temp;
	byte Indication_data[BAP_buffer_size];		// indication data from DLL
	dword Indication_header[6];					// indication header from DLL
	byte BAP_data_type;

	// init local variables
	length=0;
	datalength=0;
	temp=0;
	BAP_data_type=0;

	for(i = 0; i < 6; i++)
		Indication_header[i]=0;

	for(i = 0; i < BAP_buffer_size; i++)
		Indication_data[i]=0;

	// BAP-Stack needs this information for successful BAP150_GetIndication 
	Indication_header[4]=BAP_buffer_size;

	while (BAP150_GetInd(NODE_INDEX, Indication_header, Indication_data) == 0)
	{		
		//read header and write in global variable
		for (i = 0; i < 6; i++) {
			gBAP_Indication_header[i]=Indication_header[i];	
		}

		// nur Bytesequneces haben Datenanteil
		if (gBAP_Indication_header[3] == Bap_byteSequence)
		{
			for (i = 0; i < BAP_buffer_size; i++) {
				gBAP_Indication_data[i]=Indication_data[i];	
			}
		}	
		// Verarbeiten der Indication
		Process_Current_Indication();

		// Vorbereiten fuer naechsten Durchlauf 
		Indication_header[4]=BAP_buffer_size;
	} 
}

setBitInFctList(word fctid, byte fctList[])
{
    byte byteNo ;
    byte bitno ;
    byte fctValue ;

    byteNo = fctid / 8;
    bitno = fctid % 8;
    fctValue = 0x80 >> bitno;
    fctList[byteNo] |= fctValue;
}

float round (float value, float step)
{
	return _floor(value / step + 0.5) * step;
}

ChangeConfig(long paramIndex,long config[])
{

        byte temp ;
        temp = BAP150_ChangeConfig(NODE_INDEX, paramIndex, config);
        if(temp == 0)
        {}//writelineEx(gBAP_Trace, 0, "BAP150_ChangeConfig for %s succesful (LSG %d, NODE_INDEX %d)", NODE_NAME, LSGID, NODE_INDEX);
        else
            writelineEx(gError_Trace, 0, "BAP150_ChangeConfig error 0x%X for %s (LSG %d, NODE_INDEX %d)", temp, NODE_NAME, LSGID, NODE_INDEX);        
}

PrintIndicationError(char reason[])
{
	writelineEx(gError_Trace, 0, "%s - %s lsgId:%d fctid:%d indType:%d dataType:%s",
		reason, SGtype, gBAP_Indication_header[0], gBAP_Indication_header[1], Indicationtype_Text[gBAP_Indication_header[2]], Datatype_Text[gBAP_Indication_header[3]]);
}

initBapConfig()
{
        long config[3];
    config[0] = LSGID;
    config[1] = 0;
    config[2] = getValue(BAPCFG_FSG_52_0_0_ProtocolMajor);
    ChangeConfig(0x0012,config);
    config[2] = getValue(BAPCFG_FSG_52_0_0_ProtocolMinor);
    ChangeConfig(0x0013,config);
    config[2] = getValue(BAPCFG_FSG_52_0_0_LsgClassMajor);
    ChangeConfig(0x0010,config);
    config[2] = getValue(BAPCFG_FSG_52_0_0_LsgClassMinor);
    ChangeConfig(0x0011,config);
    config[2] = getValue(BAPCFG_FSG_52_0_0_DFMajor);
    ChangeConfig(0x0014,config);
    config[2] = getValue(BAPCFG_FSG_52_0_0_DFMinor);
    ChangeConfig(0x0015,config);
    
}

initFctList()
{
    byte fctList[8]={0,0,0,0,0,0,0,0};
    int i;
    dword request[6];
    byte errorCode;

    fctList[0]=0;
    fctList[1]=0;
    fctList[2]=0;
    fctList[3]=0;
    fctList[4]=0;
    fctList[5]=0;
    fctList[6]=0;
    fctList[7]=0;

    /*if(getValue(P_FSG_44_0_13_FunctionListId))
    {
        setBitInFctList(P_FSG_44_0_13_ID, fctList);
    }*/
           if(getValue(P_FSG_52_0_0_19_FctLstItemEn))
       {
           setBitInFctList(P_FSG_52_0_0_19_ID, fctList);
       }
       if(getValue(M_FSG_52_0_0_20_FctLstItemEn))
       {
           setBitInFctList(M_FSG_52_0_0_20_ID, fctList);
       }
       if(getValue(P_FSG_52_0_0_18_FctLstItemEn))
       {
           setBitInFctList(P_FSG_52_0_0_18_ID, fctList);
       }
       if(getValue(P_FSG_52_0_0_17_FctLstItemEn))
       {
           setBitInFctList(P_FSG_52_0_0_17_ID, fctList);
       }
       if(getValue(P_FSG_52_0_0_16_FctLstItemEn))
       {
           setBitInFctList(P_FSG_52_0_0_16_ID, fctList);
       }
       if(getValue(P_FSG_52_0_0_15_FctLstItemEn))
       {
           setBitInFctList(P_FSG_52_0_0_15_ID, fctList);
       }
       if(getValue(P_FSG_52_0_0_14_FctLstItemEn))
       {
           setBitInFctList(P_FSG_52_0_0_14_ID, fctList);
       }
       if(getValue(P_FSG_52_0_0_4_FctLstItemEn))
       {
           setBitInFctList(P_FSG_52_0_0_4_ID, fctList);
       }
       if(getValue(P_FSG_52_0_0_3_FctLstItemEn))
       {
           setBitInFctList(P_FSG_52_0_0_3_ID, fctList);
       }
       if(getValue(P_FSG_52_0_0_2_FctLstItemEn))
       {
           setBitInFctList(P_FSG_52_0_0_2_ID, fctList);
       }
       if(getValue(C_FSG_52_0_0_1_FctLstItemEn))
       {
           setBitInFctList(C_FSG_52_0_0_1_ID, fctList);
       }


    for(i=0;i<8;i++){
        writelineEx(gBAP_Trace, 0, "fctList[%d]: 0x%02x ",i,fctList[i]);
    }

    request [0]=LSGID;
    request [1]=3;
    request [3]= Bap_byteSequence;
    request [4]= 8;

    errorCode=BAP150_InitSendBuf(NODE_INDEX,request,fctList);
    if(errorCode)
        writelineEx(gError_Trace, 0, "BAP150_InitSendBuf(Functionlist) returns 0x%02x ",errorCode);
}

initHeartbeat()
{
       long data[2];
   data[0]=LSGID;
   if( getValue(P_FSG_52_0_0_4_FctLstItemEn) )
      data[1]=getValue(P_FSG_52_0_0_4);
   else
      data[1]=0;
   ChangeConfig(0x00,data);
   InitSendBuf_int8(P_FSG_52_0_0_4_ID, data[1]);

}

BapOnOff(byte _on)
{
    int length, temp;

    /***** Einschalten ******/
    if(_on==1){
        // soll der BAP Stack wieder initlialisiert werden?                                 
        if(gBAP_Init==0){
            gBAP_Init=1;
            temp=BAP150_Init(NODE_INDEX, LSGID);
            if(temp==0)
                writelineEx(gBAP_Trace, 0, "BAP_Init for %s succesful (LSG %d, NODE_INDEX %d)", NODE_NAME, LSGID, NODE_INDEX);
            else
                writelineEx(gError_Trace, 0, "BAP_Init error 0x%X for %s (LSG %d, NODE_INDEX %d)", temp, NODE_NAME, LSGID, NODE_INDEX);         
        }

        // Initialisierung aller Variablen
        Initialize_Variables();                     

        // Aktivierung aller Panelelemente
		EnableFctCtrl();
        //EnableControl(panel_name, bapconfig_panel_name, 0); // @TODO
		//DisableConfigCtrl();


        //BAP-Shutdown
        temp = BAP150_Shutdown(NODE_INDEX, LSGID);
        if(temp==0)
            writelineEx(gBAP_Trace, 0, "BAP_Shutdown for %s succesful (LSG %d, NODE_INDEX %d)", NODE_NAME, LSGID, NODE_INDEX);
        else
            writelineEx(gError_Trace, 0, "BAP_Shutdown error 0x%X for %s (LSG %d, NODE_INDEX %d)", temp, NODE_NAME, LSGID, NODE_INDEX); 

        initBapConfig();
        initFctList();
        initHeartbeat();

        temp = BAP150_Start(NODE_INDEX, LSGID);             
        if(temp == 0)
            writelineEx(gBAP_Trace, 0, "BAP_Start for %s succesful (LSG %d, NODE_INDEX %d)", NODE_NAME, LSGID, NODE_INDEX);
        else
            writelineEx(gError_Trace, 0, "BAP_Start error 0x%X for %s (LSG %d, NODE_INDEX %d)", temp, NODE_NAME, LSGID, NODE_INDEX);        
    
        // setze den Timer fuer den zyklischen Aufruf des CANoe-"Tasks"
        setTimer(TaskTimer, 10);                
    
        //  BAPFsg_ProcessDebug(NODE_INDEX,DEBUG_CAN_CHANNEL, DEBUG_ID, LSGID, DEBUG_SWITCH_ON);    
    }
    else{ /***** Ausschalten ****/
        
        BAP150_Shutdown(NODE_INDEX,LSGID);
        
        CANoe_Shutdown();
        
        // ETHERNET NOT ENABLED! (CALL_FCT_CLOSE_UPD_SOCKET_TOKEN)
    }
    P_FSG_52_0_0_4_FctEn();
}

Initialize_Variables()	//initialize/reset all global variables
{
	int temp, i;
	byte  InitSend_data[BAP_buffer_size];	// InitSend data for DLL
	dword InitSend_header[6];	// InitSend header for DLL

	/**** Request Buffer Geschichten initialisieren ****/
	for (i = 0; i < Requestbuffer_lines; i++)
	{
		gBAP_Requestbuffer_status[i] = 0;
	}	
	for (i = 0; i < BAP_buffer_size; i++)
	{
		InitSend_data[i] = 0;
	}	

	// @TODO nur FSG relevant
	/**** Es ist notwendig mittels InitSendbuffer alle Properties im FSG zu initialisieren ****/
           InitSend_header[0] = LSGID;       
       InitSend_header[1] = 14; 
       InitSend_header[3] = Bap_uint8;
       InitSend_header[4] = 1;
       InitSend_header[5] = getValue(P_FSG_52_0_0_14);
	 putValue(P_FSG_52_0_0_14, InitSend_header[5]);
       temp = Bap150_InitSendBuf(NODE_INDEX, InitSend_header, InitSend_data);
       if(temp != 0)
           writelineEx(gError_Trace, 0, "BAP150_InitSendBuf error 0x%X for %s (LSG %d, FCTID %d)", temp, NODE_NAME, LSGID, InitSend_header[1]);
       InitSend_header[0] = LSGID;       
       InitSend_header[1] = 15; 
       InitSend_header[3] = Bap_uint8;
       InitSend_header[4] = 1;
       InitSend_header[5] = getValue(P_FSG_52_0_0_15);
	 putValue(P_FSG_52_0_0_15, InitSend_header[5]);
       temp = Bap150_InitSendBuf(NODE_INDEX, InitSend_header, InitSend_data);
       if(temp != 0)
           writelineEx(gError_Trace, 0, "BAP150_InitSendBuf error 0x%X for %s (LSG %d, FCTID %d)", temp, NODE_NAME, LSGID, InitSend_header[1]);
       InitSend_header[0] = LSGID;       
       InitSend_header[1] = 16; 
       InitSend_header[3] = Bap_uint16;
       InitSend_header[4] = 2;
       InitSend_header[5] = getValue(P_FSG_52_0_0_16);
	 putValue(P_FSG_52_0_0_16, InitSend_header[5]);
       temp = Bap150_InitSendBuf(NODE_INDEX, InitSend_header, InitSend_data);
       if(temp != 0)
           writelineEx(gError_Trace, 0, "BAP150_InitSendBuf error 0x%X for %s (LSG %d, FCTID %d)", temp, NODE_NAME, LSGID, InitSend_header[1]);
       InitSend_header[0] = LSGID;       
       InitSend_header[1] = 17; 
       InitSend_header[3] = Bap_fixedByteSequence;
       InitSend_header[4] = 5;
       InitSend_header[5] = 0;
       getValue(P_FSG_52_0_0_17,InitSend_data);
       putValue(P_FSG_52_0_0_17,InitSend_data, 5);
       temp = Bap150_InitSendBuf(NODE_INDEX, InitSend_header, InitSend_data);
       for (i=0; i<(getValueSize(P_FSG_52_0_0_17)); i++) 
       {
           InitSend_data[i] = 0;
       }
       if(temp != 0)
           writelineEx(gError_Trace, 0, "BAP150_InitSendBuf error 0x%X for %s (LSG %d, FCTID %d)", temp, NODE_NAME, LSGID, InitSend_header[1]);
       InitSend_header[0] = LSGID;       
       InitSend_header[1] = 18; 
       InitSend_header[3] = Bap_fixedByteSequence;
       InitSend_header[4] = 3;
       InitSend_header[5] = 0;
       getValue(P_FSG_52_0_0_18,InitSend_data);
       putValue(P_FSG_52_0_0_18,InitSend_data, 3);
       temp = Bap150_InitSendBuf(NODE_INDEX, InitSend_header, InitSend_data);
       for (i=0; i<(getValueSize(P_FSG_52_0_0_18)); i++) 
       {
           InitSend_data[i] = 0;
       }
       if(temp != 0)
           writelineEx(gError_Trace, 0, "BAP150_InitSendBuf error 0x%X for %s (LSG %d, FCTID %d)", temp, NODE_NAME, LSGID, InitSend_header[1]);
       InitSend_header[0] = LSGID;       
       InitSend_header[1] = 19; 
       InitSend_header[3] = Bap_byteSequence;
       InitSend_header[4] = 15; // 826;
       InitSend_header[5] = 0;
       getValue(P_FSG_52_0_0_19,InitSend_data);
       putValue(P_FSG_52_0_0_19,InitSend_data, 826);
       temp = Bap150_InitSendBuf(NODE_INDEX, InitSend_header, InitSend_data);
       for (i=0; i<(getValueSize(P_FSG_52_0_0_19)); i++) 
       {
           InitSend_data[i] = 0;
       }
       if(temp != 0)
           writelineEx(gError_Trace, 0, "BAP150_InitSendBuf error 0x%X for %s (LSG %d, FCTID %d)", temp, NODE_NAME, LSGID, InitSend_header[1]);

}

on start
{
  callAllOnEnvVar();
  
	// noch nicht eingeschaltet
	gSG_PowerOnOff=0;
	// noch nicht initialisiert
	gBAP_Init=0;
	// open the panel, nur fuer CANoe-Version >= 5.1 erlaubt
	//openPanel(panel_name);
	// deaktiviere alle aktiven Panel Elemente, ausser AN/AUSS
    CANoe_Shutdown();
    
// ETHERNET AND FLEXRAY NOT ENABLED!
        
}

BAP_CAN_TX_Request()	//Function to send BAP-data over CAN
{
   int i;
   byte TX_Data[8];				// CAN-data
   byte TX_Data_FR[10];    		// FlexRay-Data
   dword TX_Header[3];			// CAN-header
   message 0x100 TX_Message;	// dummy-message, Adresse wird noch modifiziert
   
   byte send_result;
   
   // ONLY CAN IS ENABLED! 
   		TX_Header[2] = 8; // max-Length of TX_Data

		// Pollen ueber die Queue, die von der DLL zur Verfuegung gestellt wird
		// Diese Daten muessen ueber den CAN Bus gesendet werden
	   	while (BAP150_CAN_GetTxDat(NODE_INDEX,TX_Header,TX_Data) == 0) {	
			TX_Message.CAN = TX_Header[0]; 		//CAN channel
			TX_Message.ID =TX_Header[1]; 			//Can ID
			TX_Message.DLC = TX_Header[2]; 		// received length
			
			for (i=0; i<TX_Message.DLC; i++) {	//CAN data-bytes
		  		TX_Message.byte(i) = TX_Data[i];
		  	}
		  	
		  	output(TX_Message);					//send CAN message
		  	
		  	//Versions Output
		  	if(TX_Data[0] == 0x40 && TX_Data[1] == 0x00 && TX_Header[2] == 4)
		  	{
		    	writelineEx(gBAP_Trace, 0,"Major Version: %i, Minor Version: %i", TX_Data[2], TX_Data[3]);
		  	}       
		  	TX_Header[2] = 8; // max-Length of TX_Data
	   	} 
   // ONLY CAN IS ENABLED!
   // FLEXRAY NOT ENABLED! (TX_FR_TOKEN)
   // ETHERNET NOT ENABLED! (TX_IP_TOKEN)
}

ringbuffer_write (byte lsgID, byte fctID, byte request, byte dataType, word length, dword singleData, byte data[])
{
	int bufferline, i;

	bufferline = getNextWriteIndex();	//get next free position in ring-buffer

	if (bufferline == -1) 
	{
		writelineEx(gError_Trace, 0, "Crititcal Error: No free buffer found!");
		return;
	}
		
	gBAP_Request_header[bufferline][0] = lsgID;	// LSG
	gBAP_Request_header[bufferline][1] = fctID;	// FCT
	gBAP_Request_header[bufferline][3] = dataType; // dataType
    //writelineEx(gBAP_Trace, 0, "Write request in buffer FSG NODEINDEX:%d lsgid:%d fctid:%d requesttype:%d datatype:%d length:%d", 
    //        NODE_INDEX,lsgID,fctID,request,dataType,length);


	switch (dataType)
	{
		case Bap_void:
			gBAP_Request_header[bufferline][2] = request;	// request
			gBAP_Request_header[bufferline][4] = 0;	// length
				// Void
			// @TODO?		
			break;
		case Bap_uint8:
			gBAP_Request_header[bufferline][2] = request;		// request
			gBAP_Request_header[bufferline][5] = singleData;	// Daten		
			break;
		case Bap_uint16:
			gBAP_Request_header[bufferline][2] = request;		// request
			gBAP_Request_header[bufferline][5] = singleData;	// Daten
			break;			
		case Bap_uint32:
			gBAP_Request_header[bufferline][2] = request;		// request
			gBAP_Request_header[bufferline][5] = singleData;	// Daten		
			break;	
		case Bap_byteSequence:
			gBAP_Request_header[bufferline][2] = request;	// request
			gBAP_Request_header[bufferline][4] = length;	// length
			// Daten der ByteSequence kopieren
			for(i = 0; i < BAP_buffer_size; i++)									
				gBAP_Request_data[bufferline][i] = data[i];
		case Bap_error:
			gBAP_Request_header[bufferline][5] = singleData;	// Errorcode						
			break;
		default:
			break;
	}

			

}

Request_void (byte lsgID, byte fctID, byte request)
{
	int i;
	byte dataArray [BAP_buffer_size];

	// Initialisieren eines Arrays
	for(i=0;i<BAP_buffer_size;i++) dataArray [i]=0;

	ringbuffer_write (lsgID, fctID, request, Bap_void, 0, 0, dataArray);	
}

Request_int8 (byte lsgID, byte fctID, byte request, dword data)
{
	int i;
	byte dataArray [BAP_buffer_size];

	// Initialisieren eines Arrays
	for(i=0;i<BAP_buffer_size;i++) dataArray [i]=0;

	ringbuffer_write (lsgID, fctID, request, Bap_uint8, 0, data, dataArray);

}

Request_int16 (byte lsgID, byte fctID, byte request, dword data)
{
	int i;
	byte dataArray [BAP_buffer_size];

	// Initialisieren eines Arrays
	for(i=0;i<BAP_buffer_size;i++) dataArray [i]=0;

	ringbuffer_write (lsgID, fctID, request, Bap_uint16, 0, data, dataArray);

}

Request_int32 (byte lsgID, byte fctID, byte request, dword data)
{
	int i;
	byte dataArray [BAP_buffer_size];

	// Initialisieren eines Arrays
	for(i=0;i<BAP_buffer_size;i++) dataArray [i]=0;

	ringbuffer_write (lsgID, fctID, request, Bap_uint32, 0, data, dataArray);
}

Request_byteSequence (byte lsgID, byte fctID, byte request, byte data[], word length)
{
	int i;
	byte dataArray [BAP_buffer_size];

	// Initialisieren eines Arrays
	for(i=0;i<BAP_buffer_size;i++) dataArray [i]=0;

	// Fuellen des Arrays
	for(i=0;i<length;i++) dataArray [i]=data[i];

	ringbuffer_write (lsgID, fctID, request, Bap_byteSequence, length, 0, dataArray);
}

Request_error (byte lsgID, byte fctID, byte errorCode)
{
	int i;
	byte dataArray [BAP_buffer_size];

	// Initialisieren eines Arrays
	for(i=0;i<BAP_buffer_size;i++) dataArray [i]=0;

	ringbuffer_write (lsgID, fctID, Error_REQ, Bap_error, 0, errorCode, dataArray);
}

InitSendBuf_int8 (byte fctID, dword data)
{
    dword request[6];
    int errorCode;
    byte  InitSend_data[1];

    request [0]= LSGID;
    request [1]= fctID;
    request [3]= Bap_uint8;
    request [5]= data;

    errorCode=
    BAP150_InitSendBuf(NODE_INDEX,request,InitSend_data);
    
    if(errorCode)
        writelineEx(gError_Trace, 0, "InitSendBuf_int8 error 0x%X for %s (LSG %d, FCTID %d)", errorCode, NODE_NAME, LSGID, fctID);
    
}

InitSendBuf_int16 (byte fctID, dword data)
{
    dword request[6];
    byte errorCode;
    byte  InitSend_data[1];

    request [0]= LSGID;
    request [1]= fctID;
    request [3]= Bap_uint16;
    request [5]= data;

    errorCode=BAP150_InitSendBuf(NODE_INDEX,request,InitSend_data);
    
    if(errorCode)
        writelineEx(gError_Trace, 0, "InitSendBuf_int16 error 0x%X for %s (LSG %d, FCTID %d)", errorCode, NODE_NAME, LSGID, fctID);
}

InitSendBuf_int32 (byte fctID, dword data)
{
    dword request[6];
    byte errorCode;
    byte  InitSend_data[1];

    request [0]= LSGID;
    request [1]= fctID;
    request [3]= Bap_uint32;
    request [5]= data;

    errorCode=BAP150_InitSendBuf(NODE_INDEX,request,InitSend_data);
    
    if(errorCode)
        writelineEx(gError_Trace, 0, "InitSendBuf_int32 error 0x%X for %s (LSG %d, FCTID %d)", errorCode, NODE_NAME, LSGID, fctID);
}

InitSendBuf_byteSequence (byte fctID, byte data[], word length)
{
    dword request[6];
    byte errorCode;

    request [0]= LSGID;
    request [1]= fctID;
    request [3]= Bap_uint32;
    request [4]= length;

    errorCode=BAP150_InitSendBuf(NODE_INDEX,request,data);
    
    if(errorCode)
        writelineEx(gError_Trace, 0, "InitSendBuf_byteSequence error 0x%X for %s (LSG %d, FCTID %d)", errorCode, NODE_NAME, LSGID, fctID);
}

DisplayRequestErrorCode(dword fctID, dword errCode)
{
       switch(fctID)
   {
       case C_FSG_52_0_0_1_ID:
           gC_FSG_52_0_0_1_ErrCode = 0;
           putValue(C_FSG_52_0_0_1_ErrCode,  errCode);
           setControlBackColor(panel_name,"errfield_C_FSG_52_0_0_1", MakeRGB(255,79,79));
       break;
       case P_FSG_52_0_0_2_ID:
           gP_FSG_52_0_0_2_ErrCode = 0;
           putValue(P_FSG_52_0_0_2_ErrCode,  errCode);
           setControlBackColor(panel_name,"errfield_P_FSG_52_0_0_2", MakeRGB(255,79,79));
       break;
       case P_FSG_52_0_0_3_ID:
           gP_FSG_52_0_0_3_ErrCode = 0;
           putValue(P_FSG_52_0_0_3_ErrCode,  errCode);
           setControlBackColor(panel_name,"errfield_P_FSG_52_0_0_3", MakeRGB(255,79,79));
       break;
       case P_FSG_52_0_0_4_ID:
           gP_FSG_52_0_0_4_ErrCode = 0;
           putValue(P_FSG_52_0_0_4_ErrCode,  errCode);
           setControlBackColor(panel_name,"errfield_P_FSG_52_0_0_4", MakeRGB(255,79,79));
       break;
       case P_FSG_52_0_0_14_ID:
           gP_FSG_52_0_0_14_ErrCode = 0;
           putValue(P_FSG_52_0_0_14_ErrCode,  errCode);
           setControlBackColor(panel_name,"errfield_P_FSG_52_0_0_14", MakeRGB(255,79,79));
       break;
       case P_FSG_52_0_0_15_ID:
           gP_FSG_52_0_0_15_ErrCode = 0;
           putValue(P_FSG_52_0_0_15_ErrCode,  errCode);
           setControlBackColor(panel_name,"errfield_P_FSG_52_0_0_15", MakeRGB(255,79,79));
       break;
       case P_FSG_52_0_0_16_ID:
           gP_FSG_52_0_0_16_ErrCode = 0;
           putValue(P_FSG_52_0_0_16_ErrCode,  errCode);
           setControlBackColor(panel_name,"errfield_P_FSG_52_0_0_16", MakeRGB(255,79,79));
       break;
       case P_FSG_52_0_0_17_ID:
           gP_FSG_52_0_0_17_ErrCode = 0;
           putValue(P_FSG_52_0_0_17_ErrCode,  errCode);
           setControlBackColor(panel_name,"errfield_P_FSG_52_0_0_17", MakeRGB(255,79,79));
       break;
       case P_FSG_52_0_0_18_ID:
           gP_FSG_52_0_0_18_ErrCode = 0;
           putValue(P_FSG_52_0_0_18_ErrCode,  errCode);
           setControlBackColor(panel_name,"errfield_P_FSG_52_0_0_18", MakeRGB(255,79,79));
       break;
       case P_FSG_52_0_0_19_ID:
           gP_FSG_52_0_0_19_ErrCode = 0;
           putValue(P_FSG_52_0_0_19_ErrCode,  errCode);
           setControlBackColor(panel_name,"errfield_P_FSG_52_0_0_19", MakeRGB(255,79,79));
       break;
       case M_FSG_52_0_0_20_ID:
           gM_FSG_52_0_0_20_ErrCode = 0;
           putValue(M_FSG_52_0_0_20_ErrCode,  errCode);
           setControlBackColor(panel_name,"errfield_M_FSG_52_0_0_20", MakeRGB(255,79,79));
           putValue(M_FSG_52_0_0_20_State,  "ReqErr");
       break;
       default:
           writelineEx(gError_Trace, 0, "%s%d/%d Unknown Functionid in  displayErrorCode", SGtype, LSGID,fctID);
   }

}

BAP_DLL_Request ()
{
    int i;
    int l=0;
    byte temp;
    byte Request_data[4096];    //Request data for DLL
    dword Request_header[6];    //Request header for DLL
    byte dataValid;
    int nextElementToRead;
    
    // defaultmaessig ist senden OK
    dataValid = 1;

    // loeschen der Daten "Container"
    for(i=0;i<6;i++)
        Request_header[i]=0;
    for(i=0;i<BAP_buffer_size;i++)
        Request_data[i]=0;

    
    // Verarbeiten aller noch offenen Requests  
    while ((nextElementToRead = getNextReadIndex()) != -1) 
    {
        // Fuer alle Datentypen gleich
        Request_header[0]=gBAP_Request_header [nextElementToRead][0];       //LSG-ID
        Request_header[1]=gBAP_Request_header [nextElementToRead][1];       //Function-ID
        Request_header[2]=gBAP_Request_header [nextElementToRead][2];       //request type
        Request_header[3]=gBAP_Request_header [nextElementToRead][3];       //BAP data type

        switch(gBAP_Request_header[nextElementToRead][3]){
            case Bap_uint32:
                l=2;
            case Bap_uint16:
                l++;
            case Bap_uint8:
            case Bap_error: // Request (2) wird dabei ignoriert
                l++;
            case Bap_void:  // Datenfeld (5) wird dabei ignoriert
                Request_header[4]=l;                                                //  not used
                Request_header[5]=gBAP_Request_header [nextElementToRead][5];       // Daten
            break;
            case Bap_byteSequence:                                  
                Request_header[4]=gBAP_Request_header [nextElementToRead][4];       // length
                Request_header[5]=0;                                                // not used

                // data-array for BAP-DLL funcion 'BAP_Request'
                for(i=0;i<BAP_buffer_size;i++)
                    Request_data[i]=gBAP_Request_data [nextElementToRead][i];
                break;          
            default:
                writelineEx(gError_Trace, 0, "BAP_DLL_Request: invalid BAP-Data-Type: %d", gBAP_Request_header[nextElementToRead][3]);
                dataValid = 0;
            break;          
        }
        
        if(dataValid){
            // wie heisst der Request?
            writelineEx(gBAP_Trace, 0, "%s%d/%d BAP_Request %s datatype:%s length:%d", SGtype, Request_header[0],Request_header[1],Requesttype_Text[Request_header[2]],Datatype_Text[Request_header[3]],Request_header[4]);
            temp = BAP150_Request(NODE_INDEX, Request_header, Request_data);    //send data to BAP-DLL  
            // BAP-Request failed
            if(temp != 0){
                // Fehlercode: Request failed
                writelineEx(gError_Trace, 0, "%s%d/%d Error during BAP_Request errorcode: 0x%X", SGtype, Request_header[0],Request_header[1],temp);
                DisplayRequestErrorCode(Request_header[1],temp);
            } 
        }

    }
} 

int getNextReadIndex ()
{
	int i, ret;
	// der Puffer wird nach dem naechsten zu lesenden Eintrag durchsucht
	// Existiert keiner wird -1 zurueckgegeben
	ret = -1;

	for (i = 0; i < Requestbuffer_lines; i++)
	{
		if (gBAP_Requestbuffer_status[i] == 1)
		{
			// zum verschicken
			ret = i;
			// und wieder freigeben
			gBAP_Requestbuffer_status[i] = 0;
			break;
		}
	}

	return (ret);
}

int getNextWriteIndex ()
{
	int i, ret;
	// der Puffer wird nach dem naechsten freien Eintrag durchsucht
	// Existiert keiner wird -1 zurueckgegeben
	ret = -1;

	for (i = 0; i < Requestbuffer_lines; i++)
	{
		if (gBAP_Requestbuffer_status[i] == 0)
		{
			// zum schreiben
			ret = i;
			// belegen
			gBAP_Requestbuffer_status[i] = 1;
			break;
		}
	}

	return (ret);
}

//gBAP_Indication_header[0])  // LSGID
//gBAP_Indication_header[1]) // FCTID
//gBAP_Indication_header[2]) // IndType
//gBAP_Indication_header[3]) // Datentyp

M_FSG_52_0_0_20_ProcessingRequest ()
{
   Request_Int8(LSGID, M_FSG_52_0_0_20_ID, Processing_REQ, getValue(M_FSG_52_0_0_20_Processing));
}


Process_Current_Indication ()
{
   int rxsize;
   int txsize;
   byte temp[BAP_buffer_size];
   char buffer[BAP_buffer_size];
   if(strncmp(Datatype_Text[gBAP_Indication_header[3]], "acknowledge", 4)!=0) 
       writelineEx(gBAP_Trace, 0, "NodeIndex: %d: CurrentIndication %s lsgid:%d fctid:%d indType:%s dataType=%s length=%d",
               NODE_INDEX, SGtype, gBAP_Indication_header[0], gBAP_Indication_header[1], Indicationtype_Text[gBAP_Indication_header[2]], Datatype_Text[gBAP_Indication_header[3]], gBAP_Indication_header[4]);
   else 
       writelineEx(gBAP_Trace, 0, "Internal acknowledge %s-%d fctid:%d indType:%s dataType=%s length=%d",
               SGtype, gBAP_Indication_header[0], gBAP_Indication_header[1], Acknowledgetype_Text[gBAP_Indication_header[5]], Datatype_Text[gBAP_Indication_header[3]], gBAP_Indication_header[4]);
   switch(gBAP_Indication_header[0])  // LSGID
   {
   case LSGID:
       switch(gBAP_Indication_header[1]) // FCTID
       {
    case P_FSG_52_0_0_14_ID: 
        switch(gBAP_Indication_header[3]) // Datentyp 
        {
            case Bap_error:
                gP_FSG_52_0_0_14_ErrCode = 0;
                setControlBackColor(panel_name, "errfield_P_FSG_52_0_0_14", MakeRGB(255,79,79));  
                gP_FSG_52_0_0_14_ErrCode = 1;
                break;
            case Bap_acknowledge:
                break;
            default:
                PrintIndicationError("Illegal DataType");
                break;
        }
    break;
    case P_FSG_52_0_0_15_ID: 
        switch(gBAP_Indication_header[3]) // Datentyp 
        {
            case Bap_error:
                gP_FSG_52_0_0_15_ErrCode = 0;
                setControlBackColor(panel_name, "errfield_P_FSG_52_0_0_15", MakeRGB(255,79,79));  
                gP_FSG_52_0_0_15_ErrCode = 1;
                break;
            case Bap_acknowledge:
                break;
            default:
                PrintIndicationError("Illegal DataType");
                break;
        }
    break;
    case P_FSG_52_0_0_16_ID: 
        switch(gBAP_Indication_header[3]) // Datentyp 
        {
            case Bap_uint16:
                    switch(gBAP_Indication_header[2]) // IndType
                    {
                        case DataSet_IND: // Indicationtyp pruefen
                            if (getValue(P_FSG_52_0_0_16_ErrEn)) { 
                               Request_error(LSGID,P_FSG_52_0_0_16_ID,getValue(P_FSG_52_0_0_16_ErrCode)); 
                               break;
                            }
                            // Daten setzen
                            putValue(P_FSG_52_0_0_16, gBAP_Indication_header[5]);
                            setControlBackColor(panel_name, "errfield_P_FSG_52_0_0_16", MakeRGB(255,255,255));  
                            break;                              
                        case DataSetGet_IND: // Indicationtyp pruefen
                            if (getValue(P_FSG_52_0_0_16_ErrEn)) { 
                               Request_error(LSGID,P_FSG_52_0_0_16_ID,getValue(P_FSG_52_0_0_16_ErrCode)); 
                               break;
                            }
                            // Daten setzen
                            putValue(P_FSG_52_0_0_16, gBAP_Indication_header[5]);
                            setControlBackColor(panel_name, "errfield_P_FSG_52_0_0_16", MakeRGB(255,255,255));  
                            // und antworten
                            Request_Int16(LSGID, P_FSG_52_0_0_16_ID, Data_REQ, getValue(P_FSG_52_0_0_16));
                            break;
                        default:
                            PrintIndicationError("Illegal IndType");
                            break;
                    }
                    break;
            case Bap_error:
                gP_FSG_52_0_0_16_ErrCode = 0;
                putValue(P_FSG_52_0_0_16_ErrCode,  gBAP_Indication_header[5]);
                setControlBackColor(panel_name, "errfield_P_FSG_52_0_0_16", MakeRGB(255,79,79));  
                gP_FSG_52_0_0_16_ErrCode = 1;
                break;
            case Bap_acknowledge:
                break;
            default:
                    PrintIndicationError("Illegal DataType");
                    break;
        }
    break;
    case P_FSG_52_0_0_17_ID: 
        switch(gBAP_Indication_header[3]) // Datentyp 
        {
            case Bap_byteSequence:
                switch (gBAP_Indication_header[2]) // IndType
                {
                    case DataSet_IND: // Indicationtyp pruefen
                       if (getValue(P_FSG_52_0_0_17_ErrEn)) { 
                           Request_error(LSGID,P_FSG_52_0_0_17_ID,getValue(P_FSG_52_0_0_17_ErrCode)); 
                           break;
                        }
                        // Daten setzen
                        putValue(P_FSG_52_0_0_17, gBAP_Indication_data, gBAP_Indication_header[4]);
                        setControlBackColor(panel_name, "errfield_P_FSG_52_0_0_17", MakeRGB(255,255,255));  
                        break;
                    case DataSetGet_IND: // Indicationtyp pruefen
                       if (getValue(P_FSG_52_0_0_17_ErrEn)) { 
                           Request_error(LSGID,P_FSG_52_0_0_17_ID,getValue(P_FSG_52_0_0_17_ErrCode)); 
                           break;
                        }
                        // Daten setzen
                        putValue(P_FSG_52_0_0_17, gBAP_Indication_data, gBAP_Indication_header[4]);
                        setControlBackColor(panel_name, "errfield_P_FSG_52_0_0_17", MakeRGB(255,255,255));  
                        // und antworten
                        getValue(P_FSG_52_0_0_17, temp);
                        Request_byteSequence(LSGID, P_FSG_52_0_0_17_ID, Data_REQ, temp, gBAP_Indication_header[4]);
                        break;
				     case Ack_IND: // Indication pruefen
						 //write("ASG hat Ack geschickt (BYTESEQUENCE)");
                        putValue(P_FSG_52_0_0_17_Ack, gBAP_Indication_data, gBAP_Indication_header[4]);
                        setControlBackColor(panel_name, "errfield_P_FSG_52_0_0_17", MakeRGB(255,255,255));  
                        break;
                    default:
                            PrintIndicationError("Illegal IndType");
                        break;
                }
                break;
            case Bap_error:
                gP_FSG_52_0_0_17_ErrCode = 0;
                putValue(P_FSG_52_0_0_17_ErrCode,  gBAP_Indication_header[5]);
                setControlBackColor(panel_name, "errfield_P_FSG_52_0_0_17", MakeRGB(255,79,79));  
                gP_FSG_52_0_0_17_ErrCode = 1;
                break;
            case Bap_acknowledge:
                break;
            default:
                PrintIndicationError("Illegal DataType");
                break;
        }
    break;
    case P_FSG_52_0_0_18_ID: 
        switch(gBAP_Indication_header[3]) // Datentyp 
        {
            case Bap_error:
                gP_FSG_52_0_0_18_ErrCode = 0;
                setControlBackColor(panel_name, "errfield_P_FSG_52_0_0_18", MakeRGB(255,79,79));  
                gP_FSG_52_0_0_18_ErrCode = 1;
                break;
            case Bap_acknowledge:
                break;
            default:
                PrintIndicationError("Illegal DataType");
                break;
        }
    break;
    case P_FSG_52_0_0_19_ID: 
        switch(gBAP_Indication_header[3]) // Datentyp 
        {
            case Bap_error:
                gP_FSG_52_0_0_19_ErrCode = 0;
                setControlBackColor(panel_name, "errfield_P_FSG_52_0_0_19", MakeRGB(255,79,79));  
                gP_FSG_52_0_0_19_ErrCode = 1;
                break;
            case Bap_acknowledge:
                break;
            default:
                PrintIndicationError("Illegal DataType");
                break;
        }
    break;
    case M_FSG_52_0_0_20_ID: 
            switch(gBAP_Indication_header[3]) // Datentyp
            {
                case Bap_byteSequence:
                    switch (gBAP_Indication_header[2]) // IndType
                    {
                        case StartResult_IND: 
                            if (getValue(M_FSG_52_0_0_20_ErrEn)) { 
                               Request_error(LSGID,M_FSG_52_0_0_20_ID,getValue(M_FSG_52_0_0_20_ErrCode)); 
                               break;
                            }
                           // running
                            putValue(M_FSG_52_0_0_20_State, "Running");
                            // Daten setzen
                            putValue(M_FSG_52_0_0_20_Start, gBAP_Indication_data, gBAP_Indication_header[4]);
                            setControlBackColor(panel_name, "errfield_M_FSG_52_0_0_20", MakeRGB(255,255,255));  
                            break;
                        case Start_IND:
                            if (getValue(M_FSG_52_0_0_20_ErrEn)) { 
                               Request_error(LSGID,M_FSG_52_0_0_20_ID,getValue(M_FSG_52_0_0_20_ErrCode)); 
                               break;
                            }
                            putValue(M_FSG_52_0_0_20_State, "Started");
                            // Daten setzen
                            putValue(M_FSG_52_0_0_20_Start, gBAP_Indication_data, gBAP_Indication_header[4]);
                            setControlBackColor(panel_name, "errfield_M_FSG_52_0_0_20", MakeRGB(255,255,255));  
                            break;
                        default:
                            PrintIndicationError("Illegal IndType");
                            break;
                    }
                    break;
              case Bap_void:
                    switch (gBAP_Indication_header[2]) // IndType
                    {
                        case AbortResult_IND:
                            putValue(M_FSG_52_0_0_20_State, "Aborted");
                            //if (getValue(M_FSG_52_0_0_20_ErrEn)) 
                            { 
                               // Fehler als Quittierung schicken
                               Request_Error(LSGID, M_FSG_52_0_0_20_ID, getValue(M_FSG_52_0_0_20_ErrCode));
                            }
                            break;
                        case Processing_CNF_IND:    
                            if (getValue(M_FSG_52_0_0_20_ErrEn)) { 
                               // Fehler als Quittierung schicken
                               Request_Error(LSGID, M_FSG_52_0_0_20_ID, getValue(M_FSG_52_0_0_20_ErrCode));
                               break;
                            }
                            // Processing schicken
                            //getValue(M_FSG_52_0_0_20_Processing, temp);
                            //Request_byteSequence(LSGID, M_FSG_52_0_0_20_ID, Processing_REQ, temp, getValueSize(M_FSG_52_0_0_20_Processing));
                            M_FSG_52_0_0_20_ProcessingRequest();
                            setControlBackColor(panel_name, "errfield_M_FSG_52_0_0_20", MakeRGB(255,255,255));  
                            break;
                        default:
                            PrintIndicationError("Illegal IndType");
                            break;
                    }
                    break;
            case Bap_error:
                gM_FSG_52_0_0_20_ErrCode = 0;
                putValue(M_FSG_52_0_0_20_ErrCode,  gBAP_Indication_header[5]);
                setControlBackColor(panel_name, "errfield_M_FSG_52_0_0_20", MakeRGB(255,79,79));  
                gM_FSG_52_0_0_20_ErrCode = 1;
                break;
            case Bap_acknowledge:
                break;
            default:
                    PrintIndicationError("Illegal DataType");
                    break;
            }
    break;
       default:
           writelineEx(gError_Trace, 0, "NodeIndex: %d: Illegal Fct: lsgid:%d fctid:%d indType:%d",
           NODE_INDEX, gBAP_Indication_header[0], gBAP_Indication_header[1], gBAP_Indication_header[2]);
           break;
       }
       break;
   default:
       writelineEx(gError_Trace, 0, "NodeIndex: %d: Illegal LSGID: lsgid:%d fctid:%d indType:%s", NODE_INDEX, gBAP_Indication_header[0], gBAP_Indication_header[1], Indicationtype_Text[gBAP_Indication_header[2]]);
       break;
   }
}


on message BAP_MFL_ASG_01
{
   int i, temp;
   byte RX_Data[8];            // received CAN-DATA
   dword RX_Header[3];         // received CAN-Header
   if(gSG_PowerOnOff==Power_on){
       RX_Header[0]=this.CAN;
       RX_Header[1]=this.ID;
       RX_Header[2]=this.DLC; // received length
       for (i=0; i<this.DLC; i++) {
           RX_Data[i]=this.byte(i);
       }
	   
	   //MR61529 - start
        //temp=BAP150_CAN_SetRxDat(NODE_INDEX,RX_Header,RX_Data);	
         switch ((RX_Data[1] & 0x0F))
        {
        //getAll
        case 1: //error
                if (getValue(C_FSG_52_0_0_0_1_ErrEn)==0x01)
                Request_error(LSGID,FctID_GetAll,getValue(C_FSG_52_0_0_0_1_ErrCode)); 
                
                else if (getValue(C_FSG_52_0_0_0_1_FctEn) == 0x01)
                temp=BAP150_CAN_SetRxDat(NODE_INDEX,RX_Header,RX_Data);//send recieved CAN-data with CAN-header to BAP-DLL
                break;

        case 2: //error
                if (getValue(P_FSG_52_0_0_0_2_ErrEn)==0x01)
                Request_error(LSGID,FctID_BAP_Config,getValue(P_FSG_52_0_0_0_2_ErrCode)); 

                else if (getValue(P_FSG_52_0_0_0_2_FctEn) == 0x01)
                temp=BAP150_CAN_SetRxDat(NODE_INDEX,RX_Header,RX_Data);//send recieved CAN-data with CAN-header to BAP-DLL
                break;

        case 3: //error
                if (getValue(P_FSG_52_0_0_0_3_ErrEn)==0x01)
                Request_error(LSGID,FctID_FunctionList,getValue(P_FSG_52_0_0_0_3_ErrCode)); 
                
                else if (getValue(P_FSG_52_0_0_0_3_FctEn) == 0x01)
       		temp=BAP150_CAN_SetRxDat(NODE_INDEX, RX_Header, RX_Data);
       		break;
             
        
        default: temp=BAP150_CAN_SetRxDat(NODE_INDEX,RX_Header,RX_Data);	//send recieved CAN-data with CAN-header to BAP-DLL
                break;
        }
	   
       //temp=BAP150_CAN_SetRxDat(NODE_INDEX, RX_Header, RX_Data);
   }
}

on message CAN1.BAP_MFL_FSG_01
{
   if(this.byte(0) == 0x3D && this.byte(1) == 0x14) // PU_Action
    {
      Request_Int8(LSGID, M_FSG_52_0_0_20_ID, Result_REQ, getValue(M_FSG_52_0_0_20_Result));
    }
}



intertelegram_err(long fctId)
{
    long data[4];
    data[0]=LSGID;
    data[1]=fctId;
    data[2]=1;
    data[3]=940;
    ChangeConfig(0x0020,data);
}

sequence_err(long fctId, long size)
{
    long data[5];
    long lastSeg;

    lastSeg = size-5;

    data[0]=LSGID;
    data[1]=fctId;
    data[2]=lastSeg/7+1;
    data[3]=1;
    data[4]=(lastSeg/7+4) & 15;
    ChangeConfig(0x0021,data);
}

intertelegram_err_off(long fctId)
{
    long data[4];
    data[0]=LSGID;
    data[1]=fctId;
    data[2]=5000;
    data[3]=0;
    ChangeConfig(0x0020,data);
}

sequence_err_off(long fctId)
{
    long data[5];

    data[0]=LSGID;
    data[1]=fctId;
    data[2]=5000;
    data[3]=0;
    data[4]=0;
    ChangeConfig(0x0021,data);
}

// START OF BUS CONFIG PANEL CAPL

// ETHERNET AND FLEXRAY NOT ENABLED! (ENABLE_BUS_SELECTOR_PANEL_TOKEN)

// ETHERNET AND FLEXRAY NOT ENABLED! (ENABLE_CAN_FRAME_TOKEN)

// ETHERNET AND FLEXRAY NOT ENABLED! (ENABLE_FR_FRAME_TOKEN)

// ETHERNET AND FLEXRAY NOT ENABLED! (ENABLE_ETHERNET_FRAME_TOKEN)

// ETHERNET AND FLEXRAY NOT ENABLED! (ENABLE_IP_FORMAT_TOKEN)

// ETHERNET AND FLEXRAY NOT ENABLED! (ON_ENVVAR_BUSTYPE_TOKEN)

// ETHERNET NOT ENABLED! (ON_ENVVAR_ETHERNET_APPLY_BTN_TOKEN)

// ETHERNET NOT ENABLED! (ON_ENVVAR_ETHERNET_RESET_BTN_TOKEN)

// ETHERNET NOT ENABLED! (ON_ENVVAR_IP_INTERFACE_LIST_TOKEN)

// ETHERNET NOT ENABLED! (ON_ENVVAR_IP_FORMAT_TOKEN)

// ETHERNET NOT ENABLED! (ON_UDP_RECEIVE_FROM_TOKEN)

// ETHERNET NOT ENABLED!

on envVar ON_OFF_FSG52_0
{
   BapOnOff(getvalue(this));
   gSG_PowerOnOff=getvalue(ON_OFF_FSG52_0);
}
on envVar BAPCFG_FSG_52_0_0_DFMajor
{
    long temp[3];
    byte ret,i ;
    for (i = 0; i < 4; i++)
    {
        temp[0] = LSGID;
        temp[1] = i;
        temp[2] = getValue(this);
        ret = BAP150_ChangeConfig(NODE_INDEX, 9, temp);
        if (ret != 0)
        {
            writeLineEx(gBAP_Trace, 0, "NodeIndex: %d: Error %d occured during setting of Minor DF Version.",NODE_INDEX, ret);
        }
    }
}
on envVar BAPCFG_FSG_52_0_0_DFMinor
{
    long temp[3];
    byte ret,i ;
    for (i = 0; i < 4; i++)
    {
        temp[0] = LSGID;
        temp[1] = i;
        temp[2] = getValue(this);
        ret = BAP150_ChangeConfig(NODE_INDEX, 10, temp);
        if (ret != 0)
        {
            writeLineEx(gBAP_Trace, 0, "NodeIndex: %d: Error %d occured during setting of Minor DF Version.",NODE_INDEX, ret);
        }
    }
}
on envVar BAPCFG_FSG_52_0_0_LsgClassMajor
{
    long temp[3];
    byte ret,i ;
    for (i = 0; i < 4; i++)
    {
        temp[0] = LSGID;
        temp[1] = i;
        temp[2] = getValue(this);
        ret = BAP150_ChangeConfig(NODE_INDEX, 5, temp);
        if (ret != 0)
        {
            writeLineEx(gBAP_Trace, 0, "NodeIndex: %d: Error %d occured during setting of Minor DF Version.",NODE_INDEX, ret);
        }
    }
}
on envVar BAPCFG_FSG_52_0_0_LsgClassMinor
{
    long temp[3];
    byte ret,i ;
    for (i = 0; i < 4; i++)
    {
        temp[0] = LSGID;
        temp[1] = i;
        temp[2] = getValue(this);
        ret = BAP150_ChangeConfig(NODE_INDEX, 6, temp);
        if (ret != 0)
        {
            writeLineEx(gBAP_Trace, 0, "NodeIndex: %d: Error %d occured during setting of Minor DF Version.",NODE_INDEX, ret);
        }
    }
}
on envVar BAPCFG_FSG_52_0_0_ProtocolMajor
{
    long temp[3];
    byte ret,i ;
    for (i = 0; i < 4; i++)
    {
        temp[0] = LSGID;
        temp[1] = i;
        temp[2] = getValue(this);
        ret = BAP150_ChangeConfig(NODE_INDEX, 7, temp);
        if (ret != 0)
        {
            writeLineEx(gBAP_Trace, 0, "NodeIndex: %d: Error %d occured during setting of Minor DF Version.",NODE_INDEX, ret);
        }
    }
}
on envVar BAPCFG_FSG_52_0_0_ProtocolMinor
{
    long temp[3];
    byte ret,i ;
    for (i = 0; i < 4; i++)
    {
        temp[0] = LSGID;
        temp[1] = i;
        temp[2] = getValue(this);
        ret = BAP150_ChangeConfig(NODE_INDEX, 8, temp);
        if (ret != 0)
        {
            writeLineEx(gBAP_Trace, 0, "NodeIndex: %d: Error %d occured during setting of Minor DF Version.",NODE_INDEX, ret);
        }
    }
}
// Setzen der Schriftfarbe bei Zustandswechsel der FCTID C_FSG_52_0_0_1_ID
on envVar C_FSG_52_0_0_1_FctLstItemEn
{
       if(getValue(this)) 
       {
           setControlForeColor(panel_name, "checkbox_C_FSG_52_0_0_1", MakeRGB(0,240,0));
       }
       else
       {
           setControlForeColor(panel_name, "checkbox_C_FSG_52_0_0_1", MakeRGB(250,0,0));
       }
}
// Setzen der Schriftfarbe bei Zustandswechsel der FCTID P_FSG_52_0_0_2_ID
on envVar P_FSG_52_0_0_2_FctLstItemEn
{
       if(getValue(this)) 
       {
           setControlForeColor(panel_name, "checkbox_P_FSG_52_0_0_2", MakeRGB(0,240,0));
       }
       else
       {
           setControlForeColor(panel_name, "checkbox_P_FSG_52_0_0_2", MakeRGB(250,0,0));
       }
}
// Ruecksetzen des Fehlerstatus durch manuelle Fehlereingabe
on envVar P_FSG_52_0_0_2_ErrCode
{
       if(gP_FSG_52_0_0_2_ErrCode) 
       {
           setControlBackColor(panel_name,"errfield_P_FSG_52_0_0_2", MakeRGB(255,255,255));
       }
       gP_FSG_52_0_0_2_ErrCode = 1;
}
// Setzen der Schriftfarbe bei Zustandswechsel der FCTID P_FSG_52_0_0_3_ID
on envVar P_FSG_52_0_0_3_FctLstItemEn
{
       if(getValue(this)) 
       {
           setControlForeColor(panel_name, "checkbox_P_FSG_52_0_0_3", MakeRGB(0,240,0));
       }
       else
       {
           setControlForeColor(panel_name, "checkbox_P_FSG_52_0_0_3", MakeRGB(250,0,0));
       }
}
// Ruecksetzen des Fehlerstatus durch manuelle Fehlereingabe
on envVar P_FSG_52_0_0_3_ErrCode
{
       if(gP_FSG_52_0_0_3_ErrCode) 
       {
           setControlBackColor(panel_name,"errfield_P_FSG_52_0_0_3", MakeRGB(255,255,255));
       }
       gP_FSG_52_0_0_3_ErrCode = 1;
}
// De-Aktivierung der Eingabefelder der HB-FCT P_FSG_52_0_0_4
on envVar P_FSG_52_0_0_4_FctLstItemEn
{
       if(getValue(this)) 
       {
//           EnableControl(panel_name,"panel_FSG_52_0_0_4",1);
//           EnableControl(panel_name,"${ERRFIELD}",1);
           EnableControl(panel_name,"panel_P_FSG_52_0_0_4_HBEn",1);
           setControlForeColor(panel_name, "checkbox_P_FSG_52_0_0_4", MakeRGB(0,240,0));
       }
       else
       {
//           EnableControl(panel_name,"panel_FSG_52_0_0_4",0);
//           EnableControl(panel_name,"${ERRFIELD}",0);
           EnableControl(panel_name,"panel_P_FSG_52_0_0_4_HBEn",0);
           setControlForeColor(panel_name, "checkbox_P_FSG_52_0_0_4", MakeRGB(250,0,0));
       }
}
on envVar P_FSG_52_0_0_4_FctEn
{
  P_FSG_52_0_0_4_FctEn();
}
P_FSG_52_0_0_4_FctEn()
{
	long data[2];
	if(getValue(P_FSG_52_0_0_4_FctEn)>0)
	{
		data[0] = 52;
		data[1] = getValue(P_FSG_52_0_0_4);
		write("enable HB");
	}
	else
	{
		data[0] = 52;
		data[1] = 0;
		write("disable HB");
	}
	Bap150_ChangeConfig(NODE_INDEX, 0x00, data);
}
// Ruecksetzen des Fehlerstatus durch manuelle Fehlereingabe
on envVar P_FSG_52_0_0_4_ErrCode
{
       if(gP_FSG_52_0_0_4_ErrCode) 
       {
           setControlBackColor(panel_name,"errfield_P_FSG_52_0_0_4", MakeRGB(255,255,255));
       }
       gP_FSG_52_0_0_4_ErrCode = 1;
}
// Ruecksetzen des Fehlerstatus durch manuelle Fehlereingabe
on envVar P_FSG_52_0_0_14_ErrCode
{
       if(gP_FSG_52_0_0_14_ErrCode) 
       {
           setControlBackColor(panel_name,"errfield_P_FSG_52_0_0_14", MakeRGB(255,255,255));
       }
       gP_FSG_52_0_0_14_ErrCode = 1;
}
on envVar P_FSG_52_0_0_14Status_BTN
{
    if (P_FSG_52_0_0_14Status_BTN_already_pressed == 0)
    {
       putValue(P_FSG_52_0_0_14_ErrCode,0);
       SetControlBackColor(panel_name,"errField_P_FSG_52_0_0_14",MakeRGB(255,255,255));
       P_FSG_52_0_0_14Status_BTN_already_pressed = 1;
    }
    else
    {
       Request_Int8(LSGID, P_FSG_52_0_0_14_ID, Data_REQ, getValue(P_FSG_52_0_0_14));
      P_FSG_52_0_0_14Status_BTN_already_pressed = 0;
    }
}
on envVar P_FSG_52_0_0_14_FctEn
{
    long data[3];
    data[0]=LSGID;
    data[1]=P_FSG_52_0_0_14_ID;
    data[2]=getValue(P_FSG_52_0_0_14_FctEn);
    ChangeConfig(0x0031,data);
}
// De-Aktivierung der Eingabefelder der FCTID P_FSG_52_0_0_14
on envVar P_FSG_52_0_0_14_FctLstItemEn
{
       if(getValue(this)) 
       {
           EnableControl(panel_name,"panel_FSG_52_0_0_14",1);
           EnableControl(panel_name,"errfield_P_FSG_52_0_0_14",1);
           EnableControl(panel_name,"panel_P_FSG_52_0_0_14",1);
           setControlForeColor(panel_name, "checkbox_P_FSG_52_0_0_14", MakeRGB(0,240,0));
       }
       else
       {
           EnableControl(panel_name,"panel_FSG_52_0_0_14",0);
           EnableControl(panel_name,"errfield_P_FSG_52_0_0_14",0);
           EnableControl(panel_name,"panel_P_FSG_52_0_0_14",0);
           setControlForeColor(panel_name, "checkbox_P_FSG_52_0_0_14", MakeRGB(250,0,0));
       }
}
on envVar P_FSG_52_0_0_14 // bus value of FSG_Setup (14).
{
	// opcodes: Error-Status
	byte param1; // InstalledKeys
	// DATATYPE_UINTXX
	param1 = getValue(P_FSG_52_0_0_14);
	putValue(P_FSG_52_0_0_14_1, param1);
}

on envVar P_FSG_52_0_0_14_1_0
{
	byte bitval;
	//thisval steht hier fuer den bitfield-wert, 
	//aus Generierungsgruenden hier keine einheitliche Bezeichnung moeglich.
	byte thisval; // InstalledKeys
	bitval= getValue(this);
	thisval = getValue(P_FSG_52_0_0_14_1);
	thisval = thisval&~(1<<0)|(bitval<<0);
	putValue(P_FSG_52_0_0_14_1,thisval);
}

on envVar P_FSG_52_0_0_14_1_1
{
	byte bitval;
	//thisval steht hier fuer den bitfield-wert, 
	//aus Generierungsgruenden hier keine einheitliche Bezeichnung moeglich.
	byte thisval; // InstalledKeys
	bitval= getValue(this);
	thisval = getValue(P_FSG_52_0_0_14_1);
	thisval = thisval&~(1<<1)|(bitval<<1);
	putValue(P_FSG_52_0_0_14_1,thisval);
}

on envVar P_FSG_52_0_0_14_1_2
{
	byte bitval;
	//thisval steht hier fuer den bitfield-wert, 
	//aus Generierungsgruenden hier keine einheitliche Bezeichnung moeglich.
	byte thisval; // InstalledKeys
	bitval= getValue(this);
	thisval = getValue(P_FSG_52_0_0_14_1);
	thisval = thisval&~(1<<2)|(bitval<<2);
	putValue(P_FSG_52_0_0_14_1,thisval);
}

on envVar P_FSG_52_0_0_14_1_3
{
	byte bitval;
	//thisval steht hier fuer den bitfield-wert, 
	//aus Generierungsgruenden hier keine einheitliche Bezeichnung moeglich.
	byte thisval; // InstalledKeys
	bitval= getValue(this);
	thisval = getValue(P_FSG_52_0_0_14_1);
	thisval = thisval&~(1<<3)|(bitval<<3);
	putValue(P_FSG_52_0_0_14_1,thisval);
}

on envVar P_FSG_52_0_0_14_1_4
{
	byte bitval;
	//thisval steht hier fuer den bitfield-wert, 
	//aus Generierungsgruenden hier keine einheitliche Bezeichnung moeglich.
	byte thisval; // InstalledKeys
	bitval= getValue(this);
	thisval = getValue(P_FSG_52_0_0_14_1);
	thisval = thisval&~(1<<4)|(bitval<<4);
	putValue(P_FSG_52_0_0_14_1,thisval);
}

on envVar P_FSG_52_0_0_14_1 // FSG_Setup.InstalledKeys
{
	byte superval;

	//Update Childvalue (BitField)
	byte mask=0x01;
	int i = 0;
	byte thisval; // InstalledKeys
	thisval = getValue(this);
	if(thisval&(mask<<0))
		putValue(P_FSG_52_0_0_14_1_0, 1);
	else
		putValue(P_FSG_52_0_0_14_1_0, 0);
	if(thisval&(mask<<1))
		putValue(P_FSG_52_0_0_14_1_1, 1);
	else
		putValue(P_FSG_52_0_0_14_1_1, 0);
	if(thisval&(mask<<2))
		putValue(P_FSG_52_0_0_14_1_2, 1);
	else
		putValue(P_FSG_52_0_0_14_1_2, 0);
	if(thisval&(mask<<3))
		putValue(P_FSG_52_0_0_14_1_3, 1);
	else
		putValue(P_FSG_52_0_0_14_1_3, 0);
	if(thisval&(mask<<4))
		putValue(P_FSG_52_0_0_14_1_4, 1);
	else
		putValue(P_FSG_52_0_0_14_1_4, 0);

    // Update superval
	superval = getValue(P_FSG_52_0_0_14);
	superval = thisval;
	putValue(P_FSG_52_0_0_14,superval);
}

// Ruecksetzen des Fehlerstatus durch manuelle Fehlereingabe
on envVar P_FSG_52_0_0_15_ErrCode
{
       if(gP_FSG_52_0_0_15_ErrCode) 
       {
           setControlBackColor(panel_name,"errfield_P_FSG_52_0_0_15", MakeRGB(255,255,255));
       }
       gP_FSG_52_0_0_15_ErrCode = 1;
}
on envVar P_FSG_52_0_0_15Status_BTN
{
    if (P_FSG_52_0_0_15Status_BTN_already_pressed == 0)
    {
       putValue(P_FSG_52_0_0_15_ErrCode,0);
       SetControlBackColor(panel_name,"errField_P_FSG_52_0_0_15",MakeRGB(255,255,255));
       P_FSG_52_0_0_15Status_BTN_already_pressed = 1;
    }
    else
    {
       Request_Int8(LSGID, P_FSG_52_0_0_15_ID, Data_REQ, getValue(P_FSG_52_0_0_15));
      P_FSG_52_0_0_15Status_BTN_already_pressed = 0;
    }
}
on envVar P_FSG_52_0_0_15_FctEn
{
    long data[3];
    data[0]=LSGID;
    data[1]=P_FSG_52_0_0_15_ID;
    data[2]=getValue(P_FSG_52_0_0_15_FctEn);
    ChangeConfig(0x0031,data);
}
// De-Aktivierung der Eingabefelder der FCTID P_FSG_52_0_0_15
on envVar P_FSG_52_0_0_15_FctLstItemEn
{
       if(getValue(this)) 
       {
           EnableControl(panel_name,"panel_FSG_52_0_0_15",1);
           EnableControl(panel_name,"errfield_P_FSG_52_0_0_15",1);
           EnableControl(panel_name,"panel_P_FSG_52_0_0_15",1);
           setControlForeColor(panel_name, "checkbox_P_FSG_52_0_0_15", MakeRGB(0,240,0));
       }
       else
       {
           EnableControl(panel_name,"panel_FSG_52_0_0_15",0);
           EnableControl(panel_name,"errfield_P_FSG_52_0_0_15",0);
           EnableControl(panel_name,"panel_P_FSG_52_0_0_15",0);
           setControlForeColor(panel_name, "checkbox_P_FSG_52_0_0_15", MakeRGB(250,0,0));
       }
}
on envVar P_FSG_52_0_0_15 // bus value of FSG_OperationState (15).
{
	// opcodes: Error-Status
	byte param1; // OP_State
	// DATATYPE_UINTXX
	param1 = getValue(P_FSG_52_0_0_15);
	putValue(P_FSG_52_0_0_15_1, param1);
}

on envVar P_FSG_52_0_0_15_1 // FSG_OperationState.OP_State
{
	byte superval;

	//Update Childvalue (Enum)
	byte thisval; // OP_State
	thisval = getValue(this);

    // Update superval
	superval = getValue(P_FSG_52_0_0_15);
	superval = thisval;
	putValue(P_FSG_52_0_0_15,superval);
}

// Ruecksetzen des Fehlerstatus durch manuelle Fehlereingabe
on envVar P_FSG_52_0_0_16_ErrCode
{
       if(gP_FSG_52_0_0_16_ErrCode) 
       {
           setControlBackColor(panel_name,"errfield_P_FSG_52_0_0_16", MakeRGB(255,255,255));
       }
       gP_FSG_52_0_0_16_ErrCode = 1;
}
on envVar P_FSG_52_0_0_16Status_BTN
{
    if (P_FSG_52_0_0_16Status_BTN_already_pressed == 0)
    {
       putValue(P_FSG_52_0_0_16_ErrCode,0);
       SetControlBackColor(panel_name,"errField_P_FSG_52_0_0_16",MakeRGB(255,255,255));
       P_FSG_52_0_0_16Status_BTN_already_pressed = 1;
    }
    else
    {
       Request_Int16(LSGID, P_FSG_52_0_0_16_ID, Data_REQ, getValue(P_FSG_52_0_0_16));
      P_FSG_52_0_0_16Status_BTN_already_pressed = 0;
    }
}
on envVar P_FSG_52_0_0_16_FctEn
{
    long data[3];
    data[0]=LSGID;
    data[1]=P_FSG_52_0_0_16_ID;
    data[2]=getValue(P_FSG_52_0_0_16_FctEn);
    ChangeConfig(0x0031,data);
}
// De-Aktivierung der Eingabefelder der FCTID P_FSG_52_0_0_16
on envVar P_FSG_52_0_0_16_FctLstItemEn
{
       if(getValue(this)) 
       {
           EnableControl(panel_name,"panel_FSG_52_0_0_16",1);
           EnableControl(panel_name,"errfield_P_FSG_52_0_0_16",1);
           EnableControl(panel_name,"panel_P_FSG_52_0_0_16",1);
           setControlForeColor(panel_name, "checkbox_P_FSG_52_0_0_16", MakeRGB(0,240,0));
       }
       else
       {
           EnableControl(panel_name,"panel_FSG_52_0_0_16",0);
           EnableControl(panel_name,"errfield_P_FSG_52_0_0_16",0);
           EnableControl(panel_name,"panel_P_FSG_52_0_0_16",0);
           setControlForeColor(panel_name, "checkbox_P_FSG_52_0_0_16", MakeRGB(250,0,0));
       }
}
on envVar P_FSG_52_0_0_16 // bus value of InstrumentClusterFunctions (16).
{
	// opcodes: Error-Status
	word param1; // ConfigurationOptions
	// DATATYPE_UINTXX
	param1 = getValue(P_FSG_52_0_0_16);
	putValue(P_FSG_52_0_0_16_1, param1);
}

on envVar P_FSG_52_0_0_16_1_0
{
	byte bitval;
	//thisval steht hier fuer den bitfield-wert, 
	//aus Generierungsgruenden hier keine einheitliche Bezeichnung moeglich.
	word thisval; // ConfigurationOptions
	bitval= getValue(this);
	thisval = getValue(P_FSG_52_0_0_16_1);
	thisval = thisval&~(1<<0)|(bitval<<0);
	putValue(P_FSG_52_0_0_16_1,thisval);
}

on envVar P_FSG_52_0_0_16_1_1
{
	byte bitval;
	//thisval steht hier fuer den bitfield-wert, 
	//aus Generierungsgruenden hier keine einheitliche Bezeichnung moeglich.
	word thisval; // ConfigurationOptions
	bitval= getValue(this);
	thisval = getValue(P_FSG_52_0_0_16_1);
	thisval = thisval&~(1<<1)|(bitval<<1);
	putValue(P_FSG_52_0_0_16_1,thisval);
}

on envVar P_FSG_52_0_0_16_1_2
{
	byte bitval;
	//thisval steht hier fuer den bitfield-wert, 
	//aus Generierungsgruenden hier keine einheitliche Bezeichnung moeglich.
	word thisval; // ConfigurationOptions
	bitval= getValue(this);
	thisval = getValue(P_FSG_52_0_0_16_1);
	thisval = thisval&~(1<<2)|(bitval<<2);
	putValue(P_FSG_52_0_0_16_1,thisval);
}

on envVar P_FSG_52_0_0_16_1_3
{
	byte bitval;
	//thisval steht hier fuer den bitfield-wert, 
	//aus Generierungsgruenden hier keine einheitliche Bezeichnung moeglich.
	word thisval; // ConfigurationOptions
	bitval= getValue(this);
	thisval = getValue(P_FSG_52_0_0_16_1);
	thisval = thisval&~(1<<3)|(bitval<<3);
	putValue(P_FSG_52_0_0_16_1,thisval);
}

on envVar P_FSG_52_0_0_16_1_4
{
	byte bitval;
	//thisval steht hier fuer den bitfield-wert, 
	//aus Generierungsgruenden hier keine einheitliche Bezeichnung moeglich.
	word thisval; // ConfigurationOptions
	bitval= getValue(this);
	thisval = getValue(P_FSG_52_0_0_16_1);
	thisval = thisval&~(1<<4)|(bitval<<4);
	putValue(P_FSG_52_0_0_16_1,thisval);
}

on envVar P_FSG_52_0_0_16_1_5
{
	byte bitval;
	//thisval steht hier fuer den bitfield-wert, 
	//aus Generierungsgruenden hier keine einheitliche Bezeichnung moeglich.
	word thisval; // ConfigurationOptions
	bitval= getValue(this);
	thisval = getValue(P_FSG_52_0_0_16_1);
	thisval = thisval&~(1<<5)|(bitval<<5);
	putValue(P_FSG_52_0_0_16_1,thisval);
}

on envVar P_FSG_52_0_0_16_1 // InstrumentClusterFunctions.ConfigurationOptions
{
	word superval;

	//Update Childvalue (BitField)
	byte mask=0x01;
	int i = 0;
	word thisval; // ConfigurationOptions
	thisval = getValue(this);
	if(thisval&(mask<<0))
		putValue(P_FSG_52_0_0_16_1_0, 1);
	else
		putValue(P_FSG_52_0_0_16_1_0, 0);
	if(thisval&(mask<<1))
		putValue(P_FSG_52_0_0_16_1_1, 1);
	else
		putValue(P_FSG_52_0_0_16_1_1, 0);
	if(thisval&(mask<<2))
		putValue(P_FSG_52_0_0_16_1_2, 1);
	else
		putValue(P_FSG_52_0_0_16_1_2, 0);
	if(thisval&(mask<<3))
		putValue(P_FSG_52_0_0_16_1_3, 1);
	else
		putValue(P_FSG_52_0_0_16_1_3, 0);
	if(thisval&(mask<<4))
		putValue(P_FSG_52_0_0_16_1_4, 1);
	else
		putValue(P_FSG_52_0_0_16_1_4, 0);
	if(thisval&(mask<<5))
		putValue(P_FSG_52_0_0_16_1_5, 1);
	else
		putValue(P_FSG_52_0_0_16_1_5, 0);

    // Update superval
	superval = getValue(P_FSG_52_0_0_16);
	superval = thisval;
	putValue(P_FSG_52_0_0_16,superval);
}

// Ruecksetzen des Fehlerstatus durch manuelle Fehlereingabe
on envVar P_FSG_52_0_0_17_ErrCode
{
       if(gP_FSG_52_0_0_17_ErrCode) 
       {
           setControlBackColor(panel_name,"errfield_P_FSG_52_0_0_17", MakeRGB(255,255,255));
       }
       gP_FSG_52_0_0_17_ErrCode = 1;
}
on envVar P_FSG_52_0_0_17Status_BTN
{
	byte BAPTemp[5];
   if (P_FSG_52_0_0_17Status_BTN_already_pressed == 0)
   {
      putValue(P_FSG_52_0_0_17_ErrCode,0);
      SetControlBackColor(panel_name,"errField_P_FSG_52_0_0_17",MakeRGB(255,255,255));
      P_FSG_52_0_0_17Status_BTN_already_pressed = 1;
   }
   else
   {
      getValue(P_FSG_52_0_0_17, BAPTemp);
      Request_ByteSequence(LSGID, P_FSG_52_0_0_17_ID, Data_REQ, BAPTemp, getValueSize(P_FSG_52_0_0_17));
      P_FSG_52_0_0_17Status_BTN_already_pressed = 0;
   }
}
on envVar P_FSG_52_0_0_17StatusAck_BTN
{
	byte BAPTemp[5];
   if (P_FSG_52_0_0_17StatusAck_BTN_already_pressed == 0)
   {
      putValue(P_FSG_52_0_0_17_ErrCode,0);
      SetControlBackColor(panel_name,"errField_P_FSG_52_0_0_17",MakeRGB(255,255,255));
      P_FSG_52_0_0_17StatusAck_BTN_already_pressed = 1;
   }
   else
   {
      getValue(P_FSG_52_0_0_17, BAPTemp);
      Request_ByteSequence(LSGID, P_FSG_52_0_0_17_ID, DataAck_REQ, BAPTemp, getValueSize(P_FSG_52_0_0_17));
      P_FSG_52_0_0_17StatusAck_BTN_already_pressed = 0;
   }
}
on envVar P_FSG_52_0_0_17_FctEn
{
    long data[3];
    data[0]=LSGID;
    data[1]=P_FSG_52_0_0_17_ID;
    data[2]=getValue(P_FSG_52_0_0_17_FctEn);
    ChangeConfig(0x0031,data);
}
// De-Aktivierung der Eingabefelder der FCTID P_FSG_52_0_0_17
on envVar P_FSG_52_0_0_17_FctLstItemEn
{
       if(getValue(this)) 
       {
           EnableControl(panel_name,"panel_FSG_52_0_0_17",1);
           EnableControl(panel_name,"errfield_P_FSG_52_0_0_17",1);
           EnableControl(panel_name,"panel_P_FSG_52_0_0_17",1);
           setControlForeColor(panel_name, "checkbox_P_FSG_52_0_0_17", MakeRGB(0,240,0));
       }
       else
       {
           EnableControl(panel_name,"panel_FSG_52_0_0_17",0);
           EnableControl(panel_name,"errfield_P_FSG_52_0_0_17",0);
           EnableControl(panel_name,"panel_P_FSG_52_0_0_17",0);
           setControlForeColor(panel_name, "checkbox_P_FSG_52_0_0_17", MakeRGB(250,0,0));
       }
}
on envVar P_FSG_52_0_0_17 // bus value of KeyConfiguration (17).
{
	// opcodes: Error-Status-StatusAck
	byte param1; // ConfigKey1
	byte param2; // ConfigKey2
	byte param3; // ConfigKey3
	byte param4; // ConfigKey4
	byte param5; // ConfigKey5
	// DATATYPE_BYTESEQUENCE / DATATYPE_FIXEDBYTESEQUENCE
	int i;
	byte superval[5];
	int currentPos;
	currentPos = 0;
	for( i = 0; i < 5; i++ ) {
		superval[i] = 0;
	}
	getValue(P_FSG_52_0_0_17, superval);
	///////// Start param1 - UINT8 /////////
	param1 = superval[currentPos++];
	putValue(P_FSG_52_0_0_17_1, param1);
	///////// Start param2 - UINT8 /////////
	param2 = superval[currentPos++];
	putValue(P_FSG_52_0_0_17_2, param2);
	///////// Start param3 - UINT8 /////////
	param3 = superval[currentPos++];
	putValue(P_FSG_52_0_0_17_3, param3);
	///////// Start param4 - UINT8 /////////
	param4 = superval[currentPos++];
	putValue(P_FSG_52_0_0_17_4, param4);
	///////// Start param5 - UINT8 /////////
	param5 = superval[currentPos++];
	putValue(P_FSG_52_0_0_17_5, param5);
}

on envVar P_FSG_52_0_0_17_1 // KeyConfiguration.ConfigKey1
{
	byte superval[5];

	//Update Childvalue (Enum)
	byte thisval; // ConfigKey1
	thisval = getValue(this);

    // Update superval
	getValue(P_FSG_52_0_0_17, superval);
	superval[0]=thisval;
	putValue(P_FSG_52_0_0_17,superval);
}

on envVar P_FSG_52_0_0_17_2 // KeyConfiguration.ConfigKey2
{
	byte superval[5];

	//Update Childvalue (Enum)
	byte thisval; // ConfigKey2
	thisval = getValue(this);

    // Update superval
	getValue(P_FSG_52_0_0_17, superval);
	superval[1]=thisval;
	putValue(P_FSG_52_0_0_17,superval);
}

on envVar P_FSG_52_0_0_17_3 // KeyConfiguration.ConfigKey3
{
	byte superval[5];

	//Update Childvalue (Enum)
	byte thisval; // ConfigKey3
	thisval = getValue(this);

    // Update superval
	getValue(P_FSG_52_0_0_17, superval);
	superval[2]=thisval;
	putValue(P_FSG_52_0_0_17,superval);
}

on envVar P_FSG_52_0_0_17_4 // KeyConfiguration.ConfigKey4
{
	byte superval[5];

	//Update Childvalue (Enum)
	byte thisval; // ConfigKey4
	thisval = getValue(this);

    // Update superval
	getValue(P_FSG_52_0_0_17, superval);
	superval[3]=thisval;
	putValue(P_FSG_52_0_0_17,superval);
}

on envVar P_FSG_52_0_0_17_5 // KeyConfiguration.ConfigKey5
{
	byte superval[5];

	//Update Childvalue (Enum)
	byte thisval; // ConfigKey5
	thisval = getValue(this);

    // Update superval
	getValue(P_FSG_52_0_0_17, superval);
	superval[4]=thisval;
	putValue(P_FSG_52_0_0_17,superval);
}

on envVar P_FSG_52_0_0_17_Ack // bus value of KeyConfiguration (17).
{
	// opcodes: Error-Status-StatusAck
	byte param1; // ConfigKey1
	byte param2; // ConfigKey2
	byte param3; // ConfigKey3
	byte param4; // ConfigKey4
	byte param5; // ConfigKey5
	// DATATYPE_BYTESEQUENCE / DATATYPE_FIXEDBYTESEQUENCE
	int i;
	byte superval[5];
	int currentPos;
	currentPos = 0;
	for( i = 0; i < 5; i++ ) {
		superval[i] = 0;
	}
	getValue(P_FSG_52_0_0_17_Ack, superval);
	///////// Start param1 - UINT8 /////////
	param1 = superval[currentPos++];
	putValue(P_FSG_52_0_0_17_Ack_1, param1);
	///////// Start param2 - UINT8 /////////
	param2 = superval[currentPos++];
	putValue(P_FSG_52_0_0_17_Ack_2, param2);
	///////// Start param3 - UINT8 /////////
	param3 = superval[currentPos++];
	putValue(P_FSG_52_0_0_17_Ack_3, param3);
	///////// Start param4 - UINT8 /////////
	param4 = superval[currentPos++];
	putValue(P_FSG_52_0_0_17_Ack_4, param4);
	///////// Start param5 - UINT8 /////////
	param5 = superval[currentPos++];
	putValue(P_FSG_52_0_0_17_Ack_5, param5);
}

on envVar P_FSG_52_0_0_17_Ack_1 // KeyConfiguration.ConfigKey1
{
	byte superval[5];

	//Update Childvalue (Enum)
	byte thisval; // ConfigKey1
	thisval = getValue(this);

    // Update superval
	getValue(P_FSG_52_0_0_17_Ack, superval);
	superval[0]=thisval;
	putValue(P_FSG_52_0_0_17_Ack,superval);
}

on envVar P_FSG_52_0_0_17_Ack_2 // KeyConfiguration.ConfigKey2
{
	byte superval[5];

	//Update Childvalue (Enum)
	byte thisval; // ConfigKey2
	thisval = getValue(this);

    // Update superval
	getValue(P_FSG_52_0_0_17_Ack, superval);
	superval[1]=thisval;
	putValue(P_FSG_52_0_0_17_Ack,superval);
}

on envVar P_FSG_52_0_0_17_Ack_3 // KeyConfiguration.ConfigKey3
{
	byte superval[5];

	//Update Childvalue (Enum)
	byte thisval; // ConfigKey3
	thisval = getValue(this);

    // Update superval
	getValue(P_FSG_52_0_0_17_Ack, superval);
	superval[2]=thisval;
	putValue(P_FSG_52_0_0_17_Ack,superval);
}

on envVar P_FSG_52_0_0_17_Ack_4 // KeyConfiguration.ConfigKey4
{
	byte superval[5];

	//Update Childvalue (Enum)
	byte thisval; // ConfigKey4
	thisval = getValue(this);

    // Update superval
	getValue(P_FSG_52_0_0_17_Ack, superval);
	superval[3]=thisval;
	putValue(P_FSG_52_0_0_17_Ack,superval);
}

on envVar P_FSG_52_0_0_17_Ack_5 // KeyConfiguration.ConfigKey5
{
	byte superval[5];

	//Update Childvalue (Enum)
	byte thisval; // ConfigKey5
	thisval = getValue(this);

    // Update superval
	getValue(P_FSG_52_0_0_17_Ack, superval);
	superval[4]=thisval;
	putValue(P_FSG_52_0_0_17_Ack,superval);
}

// Ruecksetzen des Fehlerstatus durch manuelle Fehlereingabe
on envVar P_FSG_52_0_0_18_ErrCode
{
       if(gP_FSG_52_0_0_18_ErrCode) 
       {
           setControlBackColor(panel_name,"errfield_P_FSG_52_0_0_18", MakeRGB(255,255,255));
       }
       gP_FSG_52_0_0_18_ErrCode = 1;
}
on envVar P_FSG_52_0_0_18Status_BTN
{
	byte BAPTemp[3];
   if (P_FSG_52_0_0_18Status_BTN_already_pressed == 0)
   {
      putValue(P_FSG_52_0_0_18_ErrCode,0);
      SetControlBackColor(panel_name,"errField_P_FSG_52_0_0_18",MakeRGB(255,255,255));
      P_FSG_52_0_0_18Status_BTN_already_pressed = 1;
   }
   else
   {
      getValue(P_FSG_52_0_0_18, BAPTemp);
      Request_ByteSequence(LSGID, P_FSG_52_0_0_18_ID, Data_REQ, BAPTemp, getValueSize(P_FSG_52_0_0_18));
      P_FSG_52_0_0_18Status_BTN_already_pressed = 0;
   }
}
on envVar P_FSG_52_0_0_18_FctEn
{
    long data[3];
    data[0]=LSGID;
    data[1]=P_FSG_52_0_0_18_ID;
    data[2]=getValue(P_FSG_52_0_0_18_FctEn);
    ChangeConfig(0x0031,data);
}
// De-Aktivierung der Eingabefelder der FCTID P_FSG_52_0_0_18
on envVar P_FSG_52_0_0_18_FctLstItemEn
{
       if(getValue(this)) 
       {
           EnableControl(panel_name,"panel_FSG_52_0_0_18",1);
           EnableControl(panel_name,"errfield_P_FSG_52_0_0_18",1);
           EnableControl(panel_name,"panel_P_FSG_52_0_0_18",1);
           setControlForeColor(panel_name, "checkbox_P_FSG_52_0_0_18", MakeRGB(0,240,0));
       }
       else
       {
           EnableControl(panel_name,"panel_FSG_52_0_0_18",0);
           EnableControl(panel_name,"errfield_P_FSG_52_0_0_18",0);
           EnableControl(panel_name,"panel_P_FSG_52_0_0_18",0);
           setControlForeColor(panel_name, "checkbox_P_FSG_52_0_0_18", MakeRGB(250,0,0));
       }
}
on envVar P_FSG_52_0_0_18 // bus value of KeyAction (18).
{
	// opcodes: Error-Status
	byte param1; // FSGActionKey1
	byte param2; // FSGActionKey2
	byte param3; // FSGKeyNoFunc
	// DATATYPE_BYTESEQUENCE / DATATYPE_FIXEDBYTESEQUENCE
	int i;
	byte superval[3];
	int currentPos;
	currentPos = 0;
	for( i = 0; i < 3; i++ ) {
		superval[i] = 0;
	}
	getValue(P_FSG_52_0_0_18, superval);
	///////// Start param1 - UINT8 /////////
	param1 = superval[currentPos++];
	putValue(P_FSG_52_0_0_18_1, param1);
	///////// Start param2 - UINT8 /////////
	param2 = superval[currentPos++];
	putValue(P_FSG_52_0_0_18_2, param2);
	///////// Start param3 - UINT8 /////////
	param3 = superval[currentPos++];
	putValue(P_FSG_52_0_0_18_3, param3);
}

on envVar P_FSG_52_0_0_18_1 // KeyAction.FSGActionKey1
{
	byte superval[3];

	//Update Childvalue (Enum)
	byte thisval; // FSGActionKey1
	thisval = getValue(this);

    // Update superval
	getValue(P_FSG_52_0_0_18, superval);
	superval[0]=thisval;
	putValue(P_FSG_52_0_0_18,superval);
}

on envVar P_FSG_52_0_0_18_2 // KeyAction.FSGActionKey2
{
	byte superval[3];

	//Update Childvalue (Enum)
	byte thisval; // FSGActionKey2
	thisval = getValue(this);

    // Update superval
	getValue(P_FSG_52_0_0_18, superval);
	superval[1]=thisval;
	putValue(P_FSG_52_0_0_18,superval);
}

on envVar P_FSG_52_0_0_18_3 // KeyAction.FSGKeyNoFunc
{
	byte superval[3];

	//Update Childvalue (Enum)
	byte thisval; // FSGKeyNoFunc
	thisval = getValue(this);

    // Update superval
	getValue(P_FSG_52_0_0_18, superval);
	superval[2]=thisval;
	putValue(P_FSG_52_0_0_18,superval);
}

// Ruecksetzen des Fehlerstatus durch manuelle Fehlereingabe
on envVar P_FSG_52_0_0_19_ErrCode
{
       if(gP_FSG_52_0_0_19_ErrCode) 
       {
           setControlBackColor(panel_name,"errfield_P_FSG_52_0_0_19", MakeRGB(255,255,255));
       }
       gP_FSG_52_0_0_19_ErrCode = 1;
}
on envVar P_FSG_52_0_0_19Status_BTN
{
	byte BAPTemp[826];
    if (P_FSG_52_0_0_19Status_BTN_already_pressed == 0)
    {
        putValue(P_FSG_52_0_0_19_ErrCode,0);
        SetControlBackColor(panel_name,"errField_P_FSG_52_0_0_19",MakeRGB(255,255,255));
        P_FSG_52_0_0_19Status_BTN_already_pressed = 1;
    }
    else
    {
		P_FSG_52_0_0_19_BuildFct();
        getValue(P_FSG_52_0_0_19, BAPTemp);
        Request_ByteSequence(LSGID, P_FSG_52_0_0_19_ID, Data_REQ, BAPTemp, getValueSize(P_FSG_52_0_0_19));
        if(getValue(P_FSG_52_0_0_19_IntTlgEn)) //getValue(IT))
        {
           intertelegram_err(P_FSG_52_0_0_19_ID);
        }
        if(getValue(P_FSG_52_0_0_19_SegmEn))   //getvalue(SG)
        {
           sequence_err(P_FSG_52_0_0_19_ID,elCount(BAPTemp));
        }
       P_FSG_52_0_0_19Status_BTN_already_pressed = 0;
    }
}
on envVar P_FSG_52_0_0_19_FctEn
{
    long data[3];
    data[0]=LSGID;
    data[1]=P_FSG_52_0_0_19_ID;
    data[2]=getValue(P_FSG_52_0_0_19_FctEn);
    ChangeConfig(0x0031,data);
}
// De-Aktivierung der Eingabefelder der FCTID P_FSG_52_0_0_19
on envVar P_FSG_52_0_0_19_FctLstItemEn
{
       if(getValue(this)) 
       {
           EnableControl(panel_name,"panel_FSG_52_0_0_19",1);
           EnableControl(panel_name,"errfield_P_FSG_52_0_0_19",1);
           EnableControl(panel_name,"panel_P_FSG_52_0_0_19",1);
           setControlForeColor(panel_name, "checkbox_P_FSG_52_0_0_19", MakeRGB(0,240,0));
       }
       else
       {
           EnableControl(panel_name,"panel_FSG_52_0_0_19",0);
           EnableControl(panel_name,"errfield_P_FSG_52_0_0_19",0);
           EnableControl(panel_name,"panel_P_FSG_52_0_0_19",0);
           setControlForeColor(panel_name, "checkbox_P_FSG_52_0_0_19", MakeRGB(250,0,0));
       }
}
// Man darf gleichzeitig nur Checkbox fuer SegmError oder IntertelegramError aktiviert werden
on envVar P_FSG_52_0_0_19_IntTlgEn
{
       if(getValue(this)) 
       {
           putValue(P_FSG_52_0_0_19_SegmEn,0);
           intertelegram_err(P_FSG_52_0_0_19_ID);
       }
       else
       {
           intertelegram_err_off(P_FSG_52_0_0_19_ID);
       }
}
// Man darf gleichzeitig nur Checkbox fuer SegmError oder IntertelegramError aktiviert werden
on envVar P_FSG_52_0_0_19_SegmEn
{
       if(getValue(this)) 
       {
           putValue(P_FSG_52_0_0_19_IntTlgEn,0);
           sequence_err(P_FSG_52_0_0_19_ID,getValueSize(P_FSG_52_0_0_19_SegmEn));
       }
       else
       {
              sequence_err_off(P_FSG_52_0_0_19_ID);
       }
}
on envVar P_FSG_52_0_0_19 // bus value of PU_Content (19).
{
	// opcodes: Error-Status
	byte param1; // TAID
	byte param2; // Priority
	byte param3; // LogicalContext
	byte param4; // CursorPosition
	byte param5[94]; //Record: Option_1
	byte param6[94]; //Record: Option_2
	byte param7[94]; //Record: Option_3
	byte param8[94]; //Record: Option_4
	byte param9[452]; // Text
	word len9;
	byte cnt9;
	byte param10; // Icon
	byte param11; // maximumDisplayTime
	// DATATYPE_BYTESEQUENCE / DATATYPE_FIXEDBYTESEQUENCE
	int i;
	byte superval[826];
	int currentPos;
	currentPos = 0;
	for( i = 0; i < 826; i++ ) {
		superval[i] = 0;
	}
	getValue(P_FSG_52_0_0_19, superval);
	///////// Start param1 - UINT8 /////////
	param1 = superval[currentPos++];
	putValue(P_FSG_52_0_0_19_1, round((param1 * 1.0) - (0) + (0), 1.0));
	///////// Start param2 - UINT8 /////////
	param2 = superval[currentPos++];
	putValue(P_FSG_52_0_0_19_2, param2);
	///////// Start param3 - UINT8 /////////
	param3 = superval[currentPos++];
	putValue(P_FSG_52_0_0_19_3, param3);
	///////// Start param4 - UINT8 /////////
	param4 = superval[currentPos++];
	putValue(P_FSG_52_0_0_19_4, param4);
	///////// Start param5 - Record /////////
	for( i = 0; i <=getvaluesize(P_FSG_52_0_0_19_5)-1; i++ )
	{
		param5[i] = superval[currentPos++];
	}
	putValue(P_FSG_52_0_0_19_5, param5, getvaluesize(P_FSG_52_0_0_19_5));
	///////// Start param6 - Record /////////
	for( i = 0; i <=getvaluesize(P_FSG_52_0_0_19_6)-1; i++ )
	{
		param6[i] = superval[currentPos++];
	}
	putValue(P_FSG_52_0_0_19_6, param6, getvaluesize(P_FSG_52_0_0_19_6));
	///////// Start param7 - Record /////////
	for( i = 0; i <=getvaluesize(P_FSG_52_0_0_19_7)-1; i++ )
	{
		param7[i] = superval[currentPos++];
	}
	putValue(P_FSG_52_0_0_19_7, param7, getvaluesize(P_FSG_52_0_0_19_7));
	///////// Start param8 - Record /////////
	for( i = 0; i <=getvaluesize(P_FSG_52_0_0_19_8)-1; i++ )
	{
		param8[i] = superval[currentPos++];
	}
	putValue(P_FSG_52_0_0_19_8, param8, getvaluesize(P_FSG_52_0_0_19_8));
	///////// Start param9 - STRING /////////
	getValue(P_FSG_52_0_0_19_9, param9);
	if((superval[currentPos] & 0x80) > 0)
	{
		if(450>127) /* Max Fct-Katalog Laenge: 450*/
		{
			len9 = ( (superval[currentPos]&0x7F) <<8) + superval[currentPos+1];
			currentPos = currentPos + 2;
			cnt9 = 1;
		}
		else
		{
			len9 = 450;
			writelineEx(gBAP_Trace, 0, "Anzahl der Laengeninformation-Bytes in P_FSG_52_0_0_19 ueberschreitet die erlaubte 1 Byte vom Fct-Kalatog.");
		}
	}
	else
	{
		len9 = superval[currentPos]&0x7F;
		currentPos = currentPos + 1;
		cnt9 = 0;
	}
	
	if(len9 > 450)
	{
		writelineEx(gBAP_Trace, 0, "Laenge:%d bei der Byte Position:%d ueberschreitet die Maximale erlaubte Laenge von Fct-Kalatog", len9, currentPos);
		len9 = 450;
	
		if(len9 < 128) cnt9 = 0;
		else cnt9 = 1;
	}
	
	for(i = 0; i < len9; i++)
	{
		param9[i] = superval[currentPos++];
	}
	
	putValue(P_FSG_52_0_0_19_9_len, len9);
	putValue(P_FSG_52_0_0_19_9_cnt, cnt9);
	
	if(len9 > getValueSize(P_FSG_52_0_0_19_9))
		putValue(P_FSG_52_0_0_19_9, param9, len9);
	else
		putValue(P_FSG_52_0_0_19_9, param9, getValueSize(P_FSG_52_0_0_19_9));

	///////// Start param10 - UINT8 /////////
	param10 = superval[currentPos++];
	putValue(P_FSG_52_0_0_19_10, param10);
	///////// Start param11 - UINT8 /////////
	param11 = superval[currentPos++];
	putValue(P_FSG_52_0_0_19_11, round((param11 * 1.0), 1.0));
}

// Updates the bus value field and other dependencies.
P_FSG_52_0_0_19_BuildFct()
{
	byte param1; // TAID
	byte param2; // Priority
	byte param3; // LogicalContext
	byte param4; // CursorPosition
	byte param5[94]; //Record: Option_1
	byte param6[94]; //Record: Option_2
	byte param7[94]; //Record: Option_3
	byte param8[94]; //Record: Option_4
	byte param9[453]; // Text
	word len9;
	byte cnt9;
	byte param10; // Icon
	byte param11; // maximumDisplayTime

	int i;
	byte superval[827];
	int currentPos;
	currentPos = 0;
// gen_BuildFunc_SetSuperVals 
	@P_FSG_52_0_0_19_1_range = round(@P_FSG_52_0_0_19_1 + (0), 1.0); // slider value + min = real value
	param1 = round( (@P_FSG_52_0_0_19_1 + (0) - (0)) / (1.0), 1.0); // (slider value + min - offset) / step = busvalue
	superval[currentPos++]=param1;
// gen_BuildFunc_SetSuperVals 
	param2 = getValue(P_FSG_52_0_0_19_2);
	superval[currentPos++]=param2;
// gen_BuildFunc_SetSuperVals 
	param3 = getValue(P_FSG_52_0_0_19_3);
	superval[currentPos++]=param3;
// gen_BuildFunc_SetSuperVals 
	param4 = getValue(P_FSG_52_0_0_19_4);
	superval[currentPos++]=param4;
// gen_BuildFunc_SetSuperVals 
	//Record:Option_1
	getValue(P_FSG_52_0_0_19_5, param5);
	for( i = 0; i <= getvaluesize(P_FSG_52_0_0_19_5)-1; i++)
	{
	 superval[currentPos++] = param5[i];
	}
// gen_BuildFunc_SetSuperVals 
	//Record:Option_2
	getValue(P_FSG_52_0_0_19_6, param6);
	for( i = 0; i <= getvaluesize(P_FSG_52_0_0_19_6)-1; i++)
	{
	 superval[currentPos++] = param6[i];
	}
// gen_BuildFunc_SetSuperVals 
	//Record:Option_3
	getValue(P_FSG_52_0_0_19_7, param7);
	for( i = 0; i <= getvaluesize(P_FSG_52_0_0_19_7)-1; i++)
	{
	 superval[currentPos++] = param7[i];
	}
// gen_BuildFunc_SetSuperVals 
	//Record:Option_4
	getValue(P_FSG_52_0_0_19_8, param8);
	for( i = 0; i <= getvaluesize(P_FSG_52_0_0_19_8)-1; i++)
	{
	 superval[currentPos++] = param8[i];
	}
// gen_BuildFunc_SetSuperVals 
	getValue(P_FSG_52_0_0_19_9, param9);
	len9 = getValue(P_FSG_52_0_0_19_9_len);
	cnt9= getValue(P_FSG_52_0_0_19_9_cnt);
	
	/* check box aktiviert*/
	if (cnt9 == 1)
	{
		/* 0 bis 450 (MaxString - 1B oder 2B) */
		if(len9 >= 0 && len9 <= 450)
		{
			//writelineEx(gBAP_Trace, 0, "[Debug-1] Len9: %d", len9);
			superval[currentPos] = (len9&0x7f00) | 0x80;
			superval[currentPos+1] = len9 & 0x00ff;
		}
		else
		{
			writelineEx(gBAP_Trace, 0, "Eingegebene Laenge: %d von P_FSG_52_0_0_19_9 ist ungueltig. Die max. erlaubte Laenge ist %d.", len9, 450);
			return;
		}
	}
	else if(cnt9 == 0) /*check box deaktiviert*/
	{
		if(len9 >= 0 && len9 <= 127)
		{
			//writelineEx(gBAP_Trace, 0, "[Debug-1] Len9: %d", len9);
			superval[currentPos]= len9 & 0x00ff;
			putValue(P_FSG_52_0_0_19_9_len, len9);
		}
		else if(len9 > 127 && len9 <= 450)
		{
			superval[currentPos] = (len9&0x7f00) | 0x80;
			superval[currentPos+1] = len9 & 0x00ff;
			putValue(P_FSG_52_0_0_19_9_len, len9);
			putValue(P_FSG_52_0_0_19_9_cnt, 1);
		}
		else
		{
			writelineEx(gBAP_Trace, 0, "Eingegebene Laenge: %d von P_FSG_52_0_0_19_9 ist ungueltig. Die max. erlaubte Laenge ist %d.", len9, 450);
			return;
		}
	}
	currentPos += cnt9+1;
	for(i = 0; i < len9; i++)
	{
		superval[currentPos++]= param9[i];
	}

// gen_BuildFunc_SetSuperVals 
	param10 = getValue(P_FSG_52_0_0_19_10);
	superval[currentPos++]=param10;
// gen_BuildFunc_SetSuperVals 
	@P_FSG_52_0_0_19_11_range = round(@P_FSG_52_0_0_19_11, 1.0); // slider value + min = real value
  param11 = @P_FSG_52_0_0_19_11_range;
	//param11 = 0; // underlying parameter has constant value 255.
	superval[currentPos++]=param11;
	putValue(P_FSG_52_0_0_19, superval, currentPos);
}


// Ueberwachung der Darstellungsvariable der Range.
on envVar P_FSG_52_0_0_19_1_range // PU_Content.TAID 
{
	@P_FSG_52_0_0_19_1 = @P_FSG_52_0_0_19_1_range - (0); // slider = range - min
}

on envVar P_FSG_52_0_0_19_1 // PU_Content.TAID
{
	P_FSG_52_0_0_19_BuildFct();
}

on envVar P_FSG_52_0_0_19_2 // PU_Content.Priority
{
	P_FSG_52_0_0_19_BuildFct();
}

on envVar P_FSG_52_0_0_19_3 // PU_Content.LogicalContext
{
	P_FSG_52_0_0_19_BuildFct();
}

on envVar P_FSG_52_0_0_19_4 // PU_Content.CursorPosition
{
	P_FSG_52_0_0_19_BuildFct();
}

//Record: Option_1, Element: OptionType
on envVar P_FSG_52_0_0_19_5_OptionType // Option_1.OptionType
{
	byte superval[92];

	//Update Childvalue (Enum)
	byte thisval; // OptionType
	thisval = getValue(this);

    // Update superval
	getValue(P_FSG_52_0_0_19_5, superval);
	superval[0]=thisval;
 
	putValue(P_FSG_52_0_0_19_5,superval,getvaluesize(P_FSG_52_0_0_19_5));
}

//Record: Option_1, Element: OptionString
on envVar P_FSG_52_0_0_19_5_OptionString // Option_1.OptionString
{
	byte superval[93];

	//Update Childvalue (String)
	word i;
	byte thisval[92];
	getValue(this, thisval);

    // Update superval
	getValue(P_FSG_52_0_0_19_5, superval);
  
  @P_FSG_52_0_0_19_5_OptionString_len = getvaluesize(P_FSG_52_0_0_19_5_OptionString);
  
  superval[0] = @P_FSG_52_0_0_19_5_OptionType;
  superval[1] = @P_FSG_52_0_0_19_5_OptionString_len;

	for( i = 0; i < 91; i++ )
	{
		superval[i+2] = thisval[i];
	}

	putValue(P_FSG_52_0_0_19_5,superval,@P_FSG_52_0_0_19_5_OptionString_len+2);
}

on envVar P_FSG_52_0_0_19_5 // PU_Content.Option_1
{
	byte recordVal[93]; //Record: Option_1
	int currentPos;
	int i;
//UpdateChildValue for Record.
	byte param1; // OptionType
	byte param2[92]; // OptionString
  byte param2_len; // OptionString

	currentPos = 0;
	getValue(P_FSG_52_0_0_19_5, recordVal);
	// DATATYPE_BYTESEQUENCE / DATATYPE_FIXEDBYTESEQUENCE
	///////// Start param1 - UINT8 /////////
	param1 = recordVal[currentPos++];
	putValue(P_FSG_52_0_0_19_5_OptionType, param1);
	///////// Start param2 - STRING (fixedBytesequnece)/////////
  param2_len = recordVal[currentPos++];
	putValue(P_FSG_52_0_0_19_5_OptionString_len, param2_len);
  
	for( i = 0; i < 91; i++ )
	{
		param2[i] = recordVal[currentPos++];
	}
  putValue(P_FSG_52_0_0_19_5_OptionString, param2, getvaluesize(P_FSG_52_0_0_19_5_OptionString));
	P_FSG_52_0_0_19_BuildFct();
}

//Record: Option_2, Element: OptionType
on envVar P_FSG_52_0_0_19_6_OptionType // Option_2.OptionType
{
	byte superval[92];

	//Update Childvalue (Enum)
	byte thisval; // OptionType
	thisval = getValue(this);

    // Update superval
	getValue(P_FSG_52_0_0_19_6, superval);
	superval[0]=thisval;
  
	putValue(P_FSG_52_0_0_19_6,superval,getvaluesize(P_FSG_52_0_0_19_6));
}

//Record: Option_2, Element: OptionString
on envVar P_FSG_52_0_0_19_6_OptionString // Option_2.OptionString
{
	byte superval[93];

	//Update Childvalue (String)
	word i;
	byte thisval[91];
	getValue(this, thisval);

    // Update superval
	getValue(P_FSG_52_0_0_19_6, superval);
  
  @P_FSG_52_0_0_19_6_OptionString_len = getvaluesize(P_FSG_52_0_0_19_6_OptionString);
  
  superval[0] = @P_FSG_52_0_0_19_6_OptionType;
  superval[1] = @P_FSG_52_0_0_19_6_OptionString_len;
  
	for( i = 0; i < 91; i++ )
	{
		superval[i+2] = thisval[i];
	}
  
	putValue(P_FSG_52_0_0_19_6,superval,@P_FSG_52_0_0_19_6_OptionString_len+2);
}

on envVar P_FSG_52_0_0_19_6 // PU_Content.Option_2
{
	byte recordVal[93]; //Record: Option_2
	int currentPos;
	int i;
//UpdateChildValue for Record.
	byte param1; // OptionType
	byte param2[92]; // OptionString
  byte param2_len; // OptionString

	currentPos = 0;
	getValue(P_FSG_52_0_0_19_6, recordVal);
	// DATATYPE_BYTESEQUENCE / DATATYPE_FIXEDBYTESEQUENCE
	///////// Start param1 - UINT8 /////////
	param1 = recordVal[currentPos++];
	putValue(P_FSG_52_0_0_19_6_OptionType, param1);
	///////// Start param2 - STRING (fixedBytesequnece)/////////
  param2_len = recordVal[currentPos++];
	putValue(P_FSG_52_0_0_19_6_OptionString_len, param2_len);
  
	for( i = 0; i < 91; i++ )
	{
		param2[i] = recordVal[currentPos++];
	}
	putValue(P_FSG_52_0_0_19_6_OptionString, param2, getvaluesize(P_FSG_52_0_0_19_6_OptionString));
	P_FSG_52_0_0_19_BuildFct();
}

//Record: Option_3, Element: OptionType
on envVar P_FSG_52_0_0_19_7_OptionType // Option_3.OptionType
{
	byte superval[92];

	//Update Childvalue (Enum)
	byte thisval; // OptionType
	thisval = getValue(this);

    // Update superval
	getValue(P_FSG_52_0_0_19_7, superval);
	superval[0]=thisval;
  
	putValue(P_FSG_52_0_0_19_7,superval,getvaluesize(P_FSG_52_0_0_19_7));
}

//Record: Option_3, Element: OptionString
on envVar P_FSG_52_0_0_19_7_OptionString // Option_3.OptionString
{
	byte superval[93];

	//Update Childvalue (String)
	word i;
	byte thisval[91];
	getValue(this, thisval);

    // Update superval
	getValue(P_FSG_52_0_0_19_7, superval);
  
  @P_FSG_52_0_0_19_7_OptionString_len = getvaluesize(P_FSG_52_0_0_19_7_OptionString);
  
  superval[0] = @P_FSG_52_0_0_19_7_OptionType;
  superval[1] = @P_FSG_52_0_0_19_7_OptionString_len;
  
	for( i = 0; i < 91; i++ )
	{
		superval[i+2] = thisval[i];
	}
  
	putValue(P_FSG_52_0_0_19_7,superval,@P_FSG_52_0_0_19_7_OptionString_len+2);
}

on envVar P_FSG_52_0_0_19_7 // PU_Content.Option_3
{
	byte recordVal[93]; //Record: Option_3
	int currentPos;
	int i;
//UpdateChildValue for Record.
	byte param1; // OptionType
	byte param2[92]; // OptionString
  byte param2_len; // OptionString

	currentPos = 0;
	getValue(P_FSG_52_0_0_19_7, recordVal);
	// DATATYPE_BYTESEQUENCE / DATATYPE_FIXEDBYTESEQUENCE
	///////// Start param1 - UINT8 /////////
	param1 = recordVal[currentPos++];
	putValue(P_FSG_52_0_0_19_7_OptionType, param1);
	///////// Start param2 - STRING (fixedBytesequnece)/////////
  param2_len = recordVal[currentPos++];
	putValue(P_FSG_52_0_0_19_7_OptionString_len, param2_len);
  
	for( i = 0; i < 91; i++ )
	{
		param2[i] = recordVal[currentPos++];
	}
	putValue(P_FSG_52_0_0_19_7_OptionString, param2, getvaluesize(P_FSG_52_0_0_19_7_OptionString));
	P_FSG_52_0_0_19_BuildFct();
}

//Record: Option_4, Element: OptionType
on envVar P_FSG_52_0_0_19_8_OptionType // Option_4.OptionType
{
	byte superval[92];

	//Update Childvalue (Enum)
	byte thisval; // OptionType
	thisval = getValue(this);

    // Update superval
	getValue(P_FSG_52_0_0_19_8, superval);
	superval[0]=thisval;
  
	putValue(P_FSG_52_0_0_19_8,superval,getvaluesize(P_FSG_52_0_0_19_8));
}

//Record: Option_4, Element: OptionString
on envVar P_FSG_52_0_0_19_8_OptionString // Option_4.OptionString
{
	byte superval[93];

	//Update Childvalue (String)
	word i;
	byte thisval[91];
	getValue(this, thisval);

    // Update superval
	getValue(P_FSG_52_0_0_19_8, superval);
  
  @P_FSG_52_0_0_19_8_OptionString_len = getvaluesize(P_FSG_52_0_0_19_8_OptionString);
  
  superval[0] = @P_FSG_52_0_0_19_8_OptionType;
  superval[1] = @P_FSG_52_0_0_19_8_OptionString_len;
  
	for( i = 0; i < 91; i++ )
	{
		superval[i+2] = thisval[i];
	}
  
	putValue(P_FSG_52_0_0_19_8,superval,@P_FSG_52_0_0_19_8_OptionString_len+2);
}

on envVar P_FSG_52_0_0_19_8 // PU_Content.Option_4
{
	byte recordVal[93]; //Record: Option_4
	int currentPos;
	int i;
//UpdateChildValue for Record.
	byte param1; // OptionType
	byte param2[92]; // OptionString
  byte param2_len; // OptionString

	currentPos = 0;
	getValue(P_FSG_52_0_0_19_8, recordVal);
	// DATATYPE_BYTESEQUENCE / DATATYPE_FIXEDBYTESEQUENCE
	///////// Start param1 - UINT8 /////////
	param1 = recordVal[currentPos++];
	putValue(P_FSG_52_0_0_19_8_OptionType, param1);
	///////// Start param2 - STRING (fixedBytesequnece)/////////
  param2_len = recordVal[currentPos++];
	putValue(P_FSG_52_0_0_19_8_OptionString_len, param2_len);
  
	for( i = 0; i < 91; i++ )
	{
		param2[i] = recordVal[currentPos++];
	}
	putValue(P_FSG_52_0_0_19_8_OptionString, param2, getvaluesize(P_FSG_52_0_0_19_8_OptionString));
	P_FSG_52_0_0_19_BuildFct();
}

// Ueberwachung der CheckBox fuer String
on envVar  P_FSG_52_0_0_19_9_cnt
{
	word len;
	byte cnt;
	len = getValue(P_FSG_52_0_0_19_9_len);
	cnt = getValue(P_FSG_52_0_0_19_9_cnt);

	/* wird nur gerufen, wenn check box deaktiviert mit Length>127*/ 
	if( cnt == 0) 
	{
		if(len > 127 )
		{
			putValue(P_FSG_52_0_0_19_9_len, 127);
		}
	}

	P_FSG_52_0_0_19_BuildFct();
}



// Ueberwachung der Eingabefeld fuer String Data
on envVar P_FSG_52_0_0_19_9_len
{
	word len;
	len = getValue(this);
	/* Validierung der Eingabe*/
	if(len > 450)
	{
		writelineEx(gBAP_Trace, 0, "Eingegebene Laenge: %d von P_FSG_52_0_0_19_9 ist ungueltig. Die max. erlaubte Laenge ist %d. ", len, 450);
		putValue(this, 450);
	}
	P_FSG_52_0_0_19_BuildFct();
}


on envVar P_FSG_52_0_0_19_9 // PU_Content.Text
{
	putValue(P_FSG_52_0_0_19_9_len, getValueSize(this));
	P_FSG_52_0_0_19_BuildFct();
}

on envVar P_FSG_52_0_0_19_10 // PU_Content.Icon
{
	P_FSG_52_0_0_19_BuildFct();
}

// Ueberwachung der Darstellungsvariable der Range.
on envVar P_FSG_52_0_0_19_11_range // PU_Content.maximumDisplayTime
{
	@P_FSG_52_0_0_19_11 = @P_FSG_52_0_0_19_11_range; //- (255);  slider = range - min
}

on envVar P_FSG_52_0_0_19_11 // PU_Content.maximumDisplayTime
{
  @P_FSG_52_0_0_19_11_range = @P_FSG_52_0_0_19_11;
  
	P_FSG_52_0_0_19_BuildFct();
}

// Ruecksetzen des Fehlerstatus durch manuelle Fehlereingabe
on envVar M_FSG_52_0_0_20_ErrCode
{
       if(gM_FSG_52_0_0_20_ErrCode) 
       {
           setControlBackColor(panel_name,"errfield_M_FSG_52_0_0_20", MakeRGB(255,255,255));
       }
       gM_FSG_52_0_0_20_ErrCode = 1;
}
on envVar M_FSG_52_0_0_20Result_BTN
{
  if (M_FSG_52_0_0_20Result_BTN_already_pressed == 0)
  {
     putValue(M_FSG_52_0_0_20_ErrCode,0);
     SetControlBackColor(panel_name,"errField_M_FSG_52_0_0_20",MakeRGB(255,255,255));
     M_FSG_52_0_0_20Result_BTN_already_pressed = 1;
  }
  else
  {
     putValue(M_FSG_52_0_0_20_State, "Result");
     Request_Int8(LSGID, M_FSG_52_0_0_20_ID, Result_REQ, getValue(M_FSG_52_0_0_20_Result));
     M_FSG_52_0_0_20Result_BTN_already_pressed = 0;
  }
}
on envVar M_FSG_52_0_0_20_FctEn
{
    long data[3];
    data[0]=LSGID;
    data[1]=M_FSG_52_0_0_20_ID;
    data[2]=getValue(M_FSG_52_0_0_20_FctEn);
    ChangeConfig(0x0031,data);
}
// De-Aktivierung der Eingabefelder der FCTID M_FSG_52_0_0_20
on envVar M_FSG_52_0_0_20_FctLstItemEn
{
       if(getValue(this)) 
       {
           EnableControl(panel_name,"panel_FSG_52_0_0_20",1);
           EnableControl(panel_name,"errfield_M_FSG_52_0_0_20",1);
           EnableControl(panel_name,"panel_M_FSG_52_0_0_20",1);
           EnableControl(panel_name,"panel_M_FSG_52_0_0_20_Processing",1);
           EnableControl(panel_name,"panel_M_FSG_52_0_0_20_Start",1);
           setControlForeColor(panel_name, "checkbox_M_FSG_52_0_0_20", MakeRGB(0,240,0));
       }
       else
       {
           EnableControl(panel_name,"panel_FSG_52_0_0_20",0);
           EnableControl(panel_name,"errfield_M_FSG_52_0_0_20",0);
           EnableControl(panel_name,"panel_M_FSG_52_0_0_20",0);
           EnableControl(panel_name,"panel_M_FSG_52_0_0_20_Processing",0);
           EnableControl(panel_name,"panel_M_FSG_52_0_0_20_Start",0);
           setControlForeColor(panel_name, "checkbox_M_FSG_52_0_0_20", MakeRGB(250,0,0));
       }
}
on envVar M_FSG_52_0_0_20_Result // bus value of PU_Action (20).
{
	// opcodes: Error-Processing-Result
	byte param1; // PU_ActionResult
	// DATATYPE_UINTXX
	param1 = getValue(M_FSG_52_0_0_20_Result);
	putValue(M_FSG_52_0_0_20_Result_1, param1);
}

on envVar M_FSG_52_0_0_20_Result_1 // PU_Action.PU_ActionResult
{
	byte superval;

	//Update Childvalue (Enum)
	byte thisval; // PU_ActionResult
	thisval = getValue(this);

    // Update superval
	superval = getValue(M_FSG_52_0_0_20_Result);
	superval = thisval;
	putValue(M_FSG_52_0_0_20_Result,superval);
}

on envVar M_FSG_52_0_0_20_Processing // bus value of PU_Action (20).
{
	// opcodes: Error-Processing-Result
	byte param1; // Reserve
	// DATATYPE_UINTXX
	param1 = getValue(M_FSG_52_0_0_20_Processing);
	putValue(M_FSG_52_0_0_20_Processing_1, round((param1 * 1.0) - (0) + (0), 1.0));
}

// Ueberwachung der Darstellungsvariable der Range.
on envVar M_FSG_52_0_0_20_Processing_1_range // PU_Action.Reserve 
{
	@M_FSG_52_0_0_20_Processing_1 = @M_FSG_52_0_0_20_Processing_1_range - (0); // slider = range - min
}

on envVar M_FSG_52_0_0_20_Processing_1 // PU_Action.Reserve
{
	byte superval;

	//Update Childvalue (Number)
	byte thisval; // Reserve
	float slider_value;

	slider_value = 0; // Konstanter Parameter.
	@M_FSG_52_0_0_20_Processing_1_range = slider_value + (0); // real value := slider value + range min.
	thisval = (byte)round((slider_value + (0) - (0)) / (1.0), 1); // bus value := (slider value + min - offset) / step.

    // Update superval
	superval = getValue(M_FSG_52_0_0_20_Processing);
	superval = thisval;
	putValue(M_FSG_52_0_0_20_Processing,superval);
}

on envVar M_FSG_52_0_0_20_Start // bus value of PU_Action (20).
{
	// opcodes: AbortResult-StartResult
	byte param1; // TAID
	byte param2; // Option
	// DATATYPE_BYTESEQUENCE / DATATYPE_FIXEDBYTESEQUENCE
	int i;
	byte superval[2];
	int currentPos;
	currentPos = 0;
	for( i = 0; i < 2; i++ ) {
		superval[i] = 0;
	}
	getValue(M_FSG_52_0_0_20_Start, superval);
	///////// Start param1 - UINT8 /////////
	param1 = superval[currentPos++];
	putValue(M_FSG_52_0_0_20_Start_1, round((param1 * 1.0) - (0) + (0), 1.0));
	///////// Start param2 - UINT8 /////////
	param2 = superval[currentPos++];
	putValue(M_FSG_52_0_0_20_Start_2, param2);
}

// Ueberwachung der Darstellungsvariable der Range.
on envVar M_FSG_52_0_0_20_Start_1_range // PU_Action.TAID 
{
	@M_FSG_52_0_0_20_Start_1 = @M_FSG_52_0_0_20_Start_1_range - (0); // slider = range - min
}

on envVar M_FSG_52_0_0_20_Start_1 // PU_Action.TAID
{
	byte superval[2];

	//Update Childvalue (Number)
	byte thisval; // TAID
	float slider_value;

	slider_value = round(@M_FSG_52_0_0_20_Start_1, 1.0);
	@M_FSG_52_0_0_20_Start_1_range = slider_value + (0); // real value := slider value + range min.
	thisval = (byte)round((slider_value + (0) - (0)) / (1.0), 1); // bus value := (slider value + min - offset) / step.

    // Update superval
	getValue(M_FSG_52_0_0_20_Start, superval);
	superval[0]=thisval;
	putValue(M_FSG_52_0_0_20_Start,superval);
}

on envVar M_FSG_52_0_0_20_Start_2 // PU_Action.Option
{
	byte superval[2];

	//Update Childvalue (Enum)
	byte thisval; // Option
	thisval = getValue(this);

    // Update superval
	getValue(M_FSG_52_0_0_20_Start, superval);
	superval[1]=thisval;
	putValue(M_FSG_52_0_0_20_Start,superval);
}



/**
*
* Template-Funktion zum automatischen befuellen der Array-Daten, die in einer Arrayfunktion genutzt werden.
* Die Funktion wird durch den von BAPSimGen generierten Code aufgerufen.
*
* Parameter:
* - structArray: Muss mindestens nMax * Arraygroesse Bytes Platz haben, wird vom BAPSimGen automatisch generiert
* - structElementsSizeArray: Enthaelt die Groesseangabe jedes Array-Elements. Die Arraygroesse entspricht der Elementanzahl im Array.
*       Byte & Nibble = 1; Word = 2; usw. Bei Strings wird die maximale Stringlaenge angegeben.
* - structElementsTypeArray: Gibt den Datentyp eines Array-Elements zurueck. Die Arraygroesse entspricht der Elmentanzahl im Array.
*                               0x0 = Zahlenwert, also ein Slider, Enum, Bitfield,...
*                               0xE = String (darauf folgt immer eine 2, mit der Angabe der benutzen Bytes im String)
*                               0xF = Laenge der Nutzdaten des Strings, nur return Wert
* - fctID: Kann zur Fallunterscheidung der Funktions-IDs verwendet werden.
* - nMax: Array-Index
*
* Die Funktion kann im Switch-Case beliebig erweitert werden. Der Switch-Case wertet den Parameter fctID aus.
*           
*                    
**/
initStruct(byte structArray[], dword structElementsSizeArray[], byte structElementsTypeArray[], dword structElementsMaxSizeArray[], word fctID, word nMax )
{
    byte rand8;
    word rand16;
    word randSize;
    word index;           //indexNr die an die String Parameter angehaengt wird.
    dword destArraySize;   //groesse von structArray
    dword destStructSize;  //groesse eines "Structs" also destArraySize / Anzahl Elemente (nMax))
    dword rand32;    
    dword i;
    dword pos;    //aktuelle Position im structArray
    dword elpos;  //aktuelle Position in den structElementsXXXArray's
    
    destArraySize = elCount(structArray);
    destStructSize = destArraySize / nMax;    

    Switch(fctID){

        //Idee ist, die Arrays je nach Funcion-ID speziell initalisieren zu koennen.
        //hierbei koennten die Daten z.B. aus einer Datei eingelesen werden,
        //oder auch ueber spezielle init Funktionen mit festen Werten initialisiert werden.
        //Der Default-Fall befuellt das Array mit Random-Werten und Strings mit einem vordefinierten Wort (hier test,)

        default :
        {
            pos = 0; 
            for(i = 1; i <= nMax; i++)
            {
                //walk through the array
                
                elpos = 0;
                while(pos < (destStructSize * i) )
                {   
                    //check Element type
                    if( structElementsTypeArray[elpos] == 0x0)          
                    { //Params like int, word, etc.
                        //check element length
                        Switch(structElementsSizeArray[elpos])
                        {
                            case(1) : //byte / nibble
                                rand8 = random(structElementsMaxSizeArray[elpos]);
                                structArray[pos] = rand8;
                                pos++;
                                break;

                            case(2) : //word / int
                                rand16 = random(structElementsMaxSizeArray[elpos]);
                                int2byte(structArray, pos, rand16);
                                pos += 2;
                                break;

                            case (4) : //dword / long
                                rand32 = random(structElementsMaxSizeArray[elpos]);
                                long2byte(structArray, pos, rand32);
                                pos += 4;
                                break;                        
                         }
                    }
                    else if(structElementsTypeArray[elpos] == 0xE)          
                    { //String Params like byte[]
                        randSize = random(structElementsSizeArray[elpos]);
                        if(randSize < 2) randSize = 2; 
                        index = i-1;
                        setRandomString(structArray ,pos ,structElementsSizeArray[elpos], randSize, index);
                        pos += structElementsSizeArray[elpos];
                    }
                    else if(structElementsTypeArray[elpos] == 0xF)          
                    {
                        int2byte(structArray, pos, randSize);
                        pos += 2;
                        //write("Pos: %d Strlth: %d Type: %d ",pos-1,randSize,structElementsTypeArray[elpos]);
                    
                    }
                    elpos++;
                }
            }   
        break;
        }            
    }
}

long2Byte(byte in[], dword pos, dword value)
{
    if( (elCount(in)-pos) < 4)
        write("Array out ouf bounds - too small!");
    in[pos] = value;
    in[++pos] = (value >> 8);
    in[++pos] = (value >> 16);
    in[++pos] = (value >> 24);
}

int2byte (byte in[],dword pos,word value)
{
    if( (elCount(in)-pos) < 2 )
        write("Array out of bounds - too small!");
    in[pos] = value;
    in[++pos] = (value >> 8);        
}

setRandomString (byte in[], dword pos, word strSize, word randSize, word count)
{
    word endPos, endString, j;
    byte testString[4]={'t','e','s','t'};
    
    endPos = pos + strSize;
    endString = pos + randSize;
    j=0;
    
    int2ascii(in, pos, count);
    pos += 2;
    
    for(pos; pos < endPos ;pos ++)
    {
        if(j > 3 )
            j = 0;
        if(pos < endString)
            in[pos] = testString[j++];
        else
            in[pos] = 0x0;
    }
}

int2ascii (byte in[], dword pos, word value)
{
    //Konvertiert nur die erste und zweite Dezimalstelle, also Zahlen zw. 0 und 99.
    
    //auf 2 Stellen kuerzen
    value = value%100;
    //10er schreiben
    in[pos] = (value/10) + 48;    //  0x30 hex = 48 dez = ascii null
    //1er schreiben
    in[pos+1] = (value%10) + 48;  //  0x30 hex = 48 dez = ascii null
}

//MR61529 
on envVar P_FSG_52_0_0_0_2_FctEn
{
    long data[3];
    data[0]=LSGID;
    data[1]=FctID_BAP_Config;
    data[2]=getValue(this);
    ChangeConfig(0x0031,data);
}

//MR61529 
on envVar C_FSG_52_0_0_0_1_SegmEn
{
       if(getValue(this)) 
       {
           putValue(C_FSG_52_0_0_0_1_IntTlgEn,0);
           sequence_err(FctID_GetAll,154);
       }
       else
       {
              sequence_err_off(FctID_GetAll);
       }
}

//MR61529 
on envVar C_FSG_52_0_0_0_1_IntTlgEn
{
       if(getValue(this)) 
       {
           putValue(C_FSG_52_0_0_0_1_SegmEn,0);
           intertelegram_err(FctID_GetAll);
       }
       else
       {
           intertelegram_err_off(FctID_GetAll);
       }
}

//MR61529 
on envVar C_FSG_52_0_0_0_1_ErrEn
{
if (getValue(this))
putValue(C_FSG_52_0_0_0_1_FctEn,0);
}

//MR61529 
on envVar C_FSG_52_0_0_0_1_FctEn
{
    long data[3];
    data[0]=LSGID;
    data[1]=FctID_GetAll;
    data[2]=getValue(this);
    ChangeConfig(0x0031,data);
}

//MR61529 
on envVar P_FSG_52_0_0_0_3_SegmEn
{
       if(getValue(this)) 
       {
           putValue(P_FSG_52_0_0_0_3_IntTlgEn,0);
           sequence_err(FctID_FunctionList,8);
       }
       else
       {
              sequence_err_off(FctID_FunctionList);
       }
}

//MR61529 
on envVar P_FSG_52_0_0_0_3_IntTlgEn
{
       if(getValue(this)) 
       {
           putValue(P_FSG_52_0_0_0_3_SegmEn,0);
           intertelegram_err(FctID_FunctionList);
       }
       else
       {
           intertelegram_err_off(FctID_FunctionList);
       }
}

//MR61529 
on envVar P_FSG_52_0_0_0_3_ErrEn
{
if (getValue(this))
putValue(P_FSG_52_0_0_0_3_FctEn,0);
}

//MR61529 
on envVar P_FSG_52_0_0_0_3_FctEn
{
    long data[3];
    data[0]=LSGID;
    data[1]=FctID_FunctionList;
    data[2]=getValue(this);
    ChangeConfig(0x0031,data);
}

//MR61529 	
//resending BAPconfig when this button is pressed
on envVar P_FSG_52_0_0_0_2Reset_BTN
{
   message 0x100 _mBAPconfig;	

    if (getValue(this))
    {
        //for BAPconfig Set/Reset button
         _mBAPconfig.CAN=1; 
		 _mBAPconfig.ID=0x97333410; 
		 _mBAPconfig.DLC=8; 
                	
         _mBAPconfig.byte(0) = 0x0D;
         _mBAPconfig.byte(1) = 0x02;
         _mBAPconfig.byte(2) = getValue(BAPCFG_FSG_52_0_0_ProtocolMajor);
         _mBAPconfig.byte(3) = getValue(BAPCFG_FSG_52_0_0_ProtocolMinor);
         _mBAPconfig.byte(4) = getValue(BAPCFG_FSG_52_0_0_LsgClassMajor);
         _mBAPconfig.byte(5) = getValue(BAPCFG_FSG_52_0_0_LsgClassMinor);
         _mBAPconfig.byte(6) = getValue(BAPCFG_FSG_52_0_0_DFMajor);
         _mBAPconfig.byte(7) = getValue(BAPCFG_FSG_52_0_0_DFMinor);
      
        output(_mBAPconfig);	
   }
}

