/*@!Encoding:1252*/
includes
{
}

variables
{
    byte Telefon_BAP_List_Short_case = 0;
    const Telefon_List_MAX = 4;
    mstimer Telefon_BAP_Short_Timer;

    byte Telefon_BAP_List_Long_case = 0;
    mstimer Telefon_BAP_Long_Timer;

    mstimer Telefon_BAP_Update_Timer;
    byte Telefon_start_update = 0;

    byte Phonebook_List_Long_case = 0;
    byte Phonebook_List_Short_case = 0;

    mstimer Phonebook_Short_Timer;
    mstimer Phonebook_Long_Timer;
    mstimer Phonebook_Update_Timer;

    byte Phonebook_start_update = 0;

    const PhoneModuleOn	= 0x07;
    
    byte Phonebook_Long_index = 0, Phonebook_Long_rand = 0;
    byte Phonebook_Long_func[10];
    byte Phonebook_Short_index = 0, Phonebook_Short_rand = 0;
    byte Phonebook_Short_func[10];

    byte Telefon_Long_index = 0, Telefon_Long_rand = 0;
    byte Telefon_Long_func[10];
    byte Telefon_Short_index = 0, Telefon_Short_rand = 0;
    byte Telefon_Short_func[10];
}

on timer Telefon_BAP_Short_Timer
{
    //email from Jens: 04FEB2012
    if (Telefon_Short_index < Telefon_List_MAX)
    {
        //write("Telefon_Short_index = %d", Telefon_Short_index);
        Telefon_BAP_List_Short_case = Telefon_Short_index;
        Telefon_BAP_Display_Short();
        Telefon_Short_index ++;
        
    } 
    else
    {
        putValue( env_Phone_CombNum_list_short, 0 );
        Telefon_Short_index = 0;
        cancelTimer( Telefon_BAP_Short_Timer ); 
                
        Telefon_start_update = 1;
        setTimer(Telefon_BAP_Update_Timer, 100 );
        //write("Telefon_BAP_List_Short_case  end");
    }           
}

on timer Telefon_BAP_Update_Timer
{
    if (Telefon_start_update == 1)
    {                        
        Telefon_start_update = 0;
        setTimer(Telefon_BAP_Update_Timer, 2000 );
    } 
    else
    {        
        putValue(env_FSG_FSG_OperationState_OK, 0x0 );
        putValue(env_FSG_FSG_Setup_OK, 0x0 );
        putValue(env_FSG_LockState_OK, 0x0 );
        putValue(env_FSG_CN_reload, 0x0 ); 
        //IssueList #80
        putValue(env_FSG_Phonebook_reload,0x0 ); 
         //IssueList #191
        putValue(env_FSG_CN_FRU,0x0 );  
                
        Telefon_start_update = 0;
        cancelTimer(Telefon_BAP_Update_Timer);
    } 
}   

on timer Telefon_BAP_Long_Timer
{
    //email from Jens: 04FEB2012
    if (Telefon_Long_index < Telefon_List_MAX)
    {
        //write("Telefon_Long_index = %d", Telefon_Long_index);
        Telefon_BAP_List_Long_case = Telefon_Long_index;
        Telefon_BAP_Display_Long ();
        Telefon_Long_index ++;
         
    } 
    else
    {
        putValue(env_Phone_CombNum_list_long, 0 );
        Telefon_Long_index = 0;
        cancelTimer(Telefon_BAP_Long_Timer); 
                
        Telefon_start_update = 1;
        setTimer (Telefon_BAP_Update_Timer, 100 );
        // write("Telefon_BAP_List_Long_case  end");

    }          
}

on timer Phonebook_Long_Timer
{
    //email from Jens: 04FEB2012
    if (Phonebook_Long_index < Telefon_List_MAX)
    {
        //write("Phonebook_Long_index= %d", Phonebook_Long_index);  
        Phonebook_List_Long_case = Phonebook_Long_index;
        Phonebook_Display_Long ();
        Phonebook_Long_index ++;
    } 
    else
    {
        putValue(env_Phone_Phonebook_list_long, 0 );
        Phonebook_Long_index = 0;
        //IssueList #191
        putValue(env_FSG_Phonebook_reload, 0x0 );  
        putValue(env_FSG_Phonebook_FRU,0x0 );   

        cancelTimer(Phonebook_Long_Timer); 
                
        Phonebook_start_update = 1;
        setTimer (Phonebook_Update_Timer, 100 );
        //write("Phonebook_Long_index  END");
	//IssueList #80
        Telefon_start_update = 1;
        setTimer (Telefon_BAP_Update_Timer, 100 );
    }        
}

on timer Phonebook_Short_Timer
{
    //email from Jens: 04FEB2012
    if (Phonebook_Short_index < Telefon_List_MAX)
    {
        //write("Phonebook_Short_index= %d", Phonebook_Short_index);  
        Phonebook_List_Short_case = Phonebook_Short_index;
        Phonebook_Display_Short ();
        Phonebook_Short_index ++;
    } 
    else
    {
        putValue(env_Phone_Phonebook_list_short, 0 );
        Phonebook_Short_index = 0;
        //IssueList #191
         putValue(env_FSG_Phonebook_FRU,0x0 ); 

        cancelTimer(Phonebook_Short_Timer); 
                
        Phonebook_start_update = 1;
        setTimer (Phonebook_Update_Timer, 100 );
        //IssueList #80
        Telefon_start_update = 1;

        setTimer (Telefon_BAP_Update_Timer, 100 );

        //write("Phonebook_Short_index  END");
    }           
}

on timer Phonebook_Update_Timer
{
    //email from Jens: 04FEB2012
    if (Phonebook_start_update == 1)
    {                
        Phonebook_start_update = 0;
        setTimer(Phonebook_Update_Timer, 2000 );
    }
    else
    {
        putValue(env_FSG_FSG_OperationState_OK, 0x0 );
        putValue(env_FSG_FSG_Setup_OK, 0x0 );
        putValue(env_FSG_LockState_OK, 0x0 );  
        putValue(env_FSG_PbState_OK, 0 );
        Phonebook_start_update = 0;
        cancelTimer(Phonebook_Update_Timer);
    }
}

on envVar env_Phone_CombNum_list_long
{
    if (getValue(this))
    {
        setTimer(Telefon_BAP_Long_Timer, 0 );
    }
}

on envVar env_Phone_CombNum_list_short
{
    if (getValue(this))
    {
        setTimer(Telefon_BAP_Short_Timer, 0 );
    }
}

on envVar env_Phone_Phonebook_list_short
{
    if (getValue(this))
    {
        setTimer(Phonebook_Short_Timer, 0 );
    }
}

on envVar env_Phone_Phonebook_list_long
{
    if (getValue(this))
    {
        setTimer(Phonebook_Long_Timer, 0 );
    }
}

void Telefon_BAP_Display_Long (void)
{
    switch(Telefon_BAP_List_Long_case)
    {        
        case 0:
            putValue(env_FSG_OP_State, 0x0 );      
            putValue(env_FSG_Tel_State, PhoneModuleOn);            
            putValue(env_FSG_FSG_OperationState_OK, 0x1);                
            setTimer(Telefon_BAP_Long_Timer, 1000 );
            break;
        case 1:            
            putValue(env_FSG_SIMCardReader, 0x1);
            putValue(env_FSG_CableConnection, 0x1);
            //IssueList #117                      
            //putValue(env_FSG_MobileConnectionType, 0x1);
            putValue(env_FSG_FSG_Setup_OK, 0x1);                        
            setTimer(Telefon_BAP_Long_Timer, 1000 );
            break;
        case 2:
            putValue(env_FSG_LockState, 0x1); 
            putValue(env_FSG_LockState, 0x0 ); 
            putValue(env_FSG_LockState_OK, 0x1);                              
            setTimer(Telefon_BAP_Long_Timer, 1000 );
            break;
        case 3:
            putValue(env_FSG_CN_DataSource, 0x1);
            putValue(env_FSG_CN_CSVPath, "BAP\\Arrays\\bap_phone_CombinedNumbers_List_long.csv");            
            putValue(env_FSG_CN_reload, 0x1);  
            //IssueList #191
            putValue(env_FSG_CN_FRU,0x1);           
            setTimer(Telefon_BAP_Long_Timer, 1000 );
            break;
        default:
            break;
    }
}

Telefon_BAP_Display_Short( void )
{
    switch(Telefon_BAP_List_Short_case)
    {        
        case 0:
            putValue(env_FSG_OP_State, 0x0 );  
            putValue(env_FSG_Tel_State, PhoneModuleOn);                      
            putValue(env_FSG_FSG_OperationState_OK, 0x1);                                     
            setTimer(Telefon_BAP_Short_Timer, 1000 );
            break;
        case 1:            
            putValue(env_FSG_SIMCardReader, 0x1);
            putValue(env_FSG_CableConnection, 0x1); 
            //IssueList #117                       
            //putValue(env_FSG_MobileConnectionType, 0x1); 
            putValue(env_FSG_FSG_Setup_OK, 0x1);                                               
            setTimer(Telefon_BAP_Short_Timer, 1000 );
            break;
        case 2:
            putValue(env_FSG_LockState, 0x1);     
            putValue(env_FSG_LockState, 0x0 );     
            putValue(env_FSG_LockState_OK, 0x1);                                                 
            setTimer(Telefon_BAP_Short_Timer, 1000 );
            break;
        case 3:
            putValue(env_FSG_CN_DataSource, 0x1);
            putValue(env_FSG_CN_CSVPath, "BAP\\Arrays\\bap_phone_CombinedNumbers_List_short.csv");            
            putValue(env_FSG_CN_reload, 0x1);
            //IssueList #191
            putValue(env_FSG_CN_FRU,0x1);           
            setTimer(Telefon_BAP_Short_Timer, 1000 );
            break;
        default:
            break;
    }
}

void Phonebook_Display_Long (void)
{
    switch(Phonebook_List_Long_case)
    {        
        case 0:
            putValue(env_FSG_OP_State, 0x0 );                      
            putValue(env_FSG_Tel_State, PhoneModuleOn);            
            putValue(env_FSG_FSG_OperationState_OK, 0x1);
            setTimer(Phonebook_Long_Timer, 1000 );
            break;
        case 1:            
            putValue(env_FSG_SIMCardReader, 0x1);
            putValue(env_FSG_CableConnection, 0x1);
            //IssueList #117                        
            //putValue(env_FSG_MobileConnectionType, 0x1);                        
            putValue(env_FSG_FSG_Setup_OK, 0x1);
            setTimer(Phonebook_Long_Timer, 1000 );
            break;
        case 2:
            putValue(env_FSG_LockState, 0x1);    
            putValue(env_FSG_LockState, 0x0 );    
            putValue(env_FSG_LockState_OK, 0x1);                      
            setTimer(Phonebook_Long_Timer, 1000 );
            break;
        case 3:                      
            putValue(env_FSG_PbState_DownloadState,2);
            putValue(env_FSG_PbState_EntriesUHV, 40 );
            putValue(env_FSG_PbState_OK, 1);
            
             //IssueList #191
            putValue(env_FSG_Phonebook_DataSource, 0x1);
            putValue(env_FSG_Phonebook_CSVPath, "BAP\\Arrays\\bap_phone_Phonebook_List_long.csv");            
            putValue(env_FSG_Phonebook_reload, 0x1);  
            putValue(env_FSG_Phonebook_FRU,0x1);          
            setTimer(Phonebook_Long_Timer, 1000 );
            break;
        default:
            break;
    }
}

void Phonebook_Display_Short (void)
{
    switch(Phonebook_List_Short_case)
    {        
        case 0:
            putValue(env_FSG_OP_State, 0x0 );
            putValue(env_FSG_Tel_State, PhoneModuleOn);                        
            putValue(env_FSG_FSG_OperationState_OK, 0x1);                      
            setTimer(Phonebook_Short_Timer, 1000 );
            break;
        case 1:            
            putValue(env_FSG_SIMCardReader, 0x1);
            putValue(env_FSG_CableConnection, 0x1);
            //IssueList #117                        
            //putValue(env_FSG_MobileConnectionType, 0x1); 
            putValue(env_FSG_FSG_Setup_OK, 0x1);                       
            setTimer(Phonebook_Short_Timer, 1000 );
            break;
        case 2:
            putValue(env_FSG_LockState, 0x1); 
            putValue(env_FSG_LockState, 0x0 ); 
            putValue(env_FSG_LockState_OK, 0x1);                                             
            setTimer(Phonebook_Short_Timer, 1000 );           
            break;
        case 3:                      
            putValue(env_FSG_PbState_DownloadState,2);
            putValue(env_FSG_PbState_EntriesUHV, 10 );
            putValue(env_FSG_PbState_OK, 1);
            //IssueList #80 - load all short list
            putValue(env_FSG_Phonebook_DataSource,1);
            putValue(env_FSG_Phonebook_CSVPath, "BAP\\Arrays\\bap_phone_Phonebook_List_short.csv");            
            putValue(env_FSG_Phonebook_reload, 0x1);
            //IssueList #191
            putValue(env_FSG_Phonebook_FRU,0x1);                
            setTimer(Phonebook_Short_Timer, 1000 );
            break;
        default:
            break;
    }
}

