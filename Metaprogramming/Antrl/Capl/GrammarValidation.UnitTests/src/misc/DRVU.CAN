/*@!Encoding:1252*/
/*
Copyright ( C ) Continental AG 2012



Based on Version  1.0, 12.05.10   from M.Dangelmeyr      IBD im Auftrag von EP/ESE   Daimler AG

Date of creation :  14.04.2011

Created by :                 Hans Jürgen Hipp


Version info

1.0	   10.2013	Inital versioning introduced
1.1	04.11.2013	HMI_2013_42a database
1.2     13.03.2014	HMI_2014_05a database
#VERSION#
#VERSION_END#
*/


variables
{
    const TRUE  =   0xAA;
    const FALSE =   0x00;
    const cManual = 0x00;
    const cAuto =   0xAA;

    msTimer t_DBKomTimer_20ms;      // Timer zum zyklischen Aufruf der DBKom-Task
    int c_tDBKomTimer_20ms = 20;    // msec
    msTimer t_DBKomTimer_5ms;       // Timer zum zyklischen Aufruf der DBKom-Task
    int c_tDBKomTimer_5ms = 5;      // msec


    // BA_DEF_ BO_  "GenMsgSendType" ENUM
    //  0 : cyclicX
    //  1 : spontanX
    //  2 : cyclicIfActiveX
    //  3 : spontanWithDelay
    //  4 : cyclicAndSpontanX
    //  5 : cyclicAndSpontanWithDelay
    //  6 : spontanWithRepitition
    //  7 : cyclicIfActiveAndSpontanWD
    //  8 : cyclicIfActiveFast
    //  9 : cyclicWithRepeatOnDemand
    //  10 : none

// #VAR_DEF#
//	message	 DPC_SwStat_DRVU_AMG_AR ID: 468 --- Sendeart 0 cyclicX ---
	message	 DPC_SwStat_DRVU_AMG_AR _mDPC_SwStat_DRVU_AMG_AR;
	int		_DPC_SwStat_DRVU_AMG_AR_Timebase;
	int		_DPC_SwStat_DRVU_AMG_AR_CycleCount;
	int		_DPC_SwStat_DRVU_AMG_AR_StartDelay;
	int     _DPC_SwStat_DRVU_AMG_AR_DelayCnt;
	int		_DPC_SwStat_DRVU_AMG_AR_Cnt;
	int     _DPC_SwStat_DRVU_AMG_AR_MinDelay;
	int		_DPC_SwStat_DRVU_AMG_AR_SpontanFlag;
	
	byte     _DPC_SwStat_DRVU_AMG_AR_E2E_Armed;
    byte     _DPC_SwStat_DRVU_AMG_AR_CRC_ErrorCnt;
    byte     _DPC_SwStat_DRVU_AMG_AR_SQC_TriggPos;
    int      _DPC_SwStat_DRVU_AMG_AR_SQC_WrongSeqJump;
    byte     _DPC_SwStat_DRVU_AMG_AR_SQC_RepeatedCnt;
    byte     _DPC_SwStat_DRVU_AMG_AR_MSG_DropCnt;
    byte     _DPC_SwStat_DRVU_AMG_AR_CRC_Offset[16] = { 77, 95, 113, 131, 149, 167, 185, 203, 221, 239, 6, 24, 42, 60, 78, 96 };
    msTimer _tDPC_SwStat_DRVU_AMG_AR;

//  Botschaft DRVU_AWD_Disp_Rq_AR ID: 645 --- Sendeart 0 cyclicX --- 
    message   DRVU_AWD_Disp_Rq_AR _mDRVU_AWD_Disp_Rq_AR;
    int      _DRVU_AWD_Disp_Rq_AR_Timebase;
    int      _DRVU_AWD_Disp_Rq_AR_CycleCount;
    int      _DRVU_AWD_Disp_Rq_AR_StartDelay;
    int      _DRVU_AWD_Disp_Rq_AR_Cnt;
    int      _DRVU_AWD_Disp_Rq_AR_SpontanFlag;
    msTimer _tDRVU_AWD_Disp_Rq_AR;
	
//  Botschaft DRVU_Aero_Stat_AR ID: 306 --- Sendeart 5 cyclicAndSpontanWithDelay --- 
    message   DRVU_Aero_Stat_AR _mDRVU_Aero_Stat_AR;
    int      _DRVU_Aero_Stat_AR_Timebase;
    int      _DRVU_Aero_Stat_AR_CycleCount;
    int      _DRVU_Aero_Stat_AR_StartDelay;
    int      _DRVU_Aero_Stat_AR_MinDelay;
    int      _DRVU_Aero_Stat_AR_Cnt;
    int      _DRVU_Aero_Stat_AR_SpontanFlag;
    int      _DRVU_Aero_Stat_AR_DelayCnt;
    msTimer _tDRVU_Aero_Stat_AR;	
	
//  Botschaft DRVU_DrvDyn_Disp_Rq_AR ID: 1073 --- Sendeart 5 cyclicAndSpontanWithDelay ---  
    message   DRVU_DrvDyn_Disp_Rq_AR _mDRVU_DrvDyn_Disp_Rq_AR;
    int      _DRVU_DrvDyn_Disp_Rq_AR_Timebase;
    int      _DRVU_DrvDyn_Disp_Rq_AR_CycleCount;
    int      _DRVU_DrvDyn_Disp_Rq_AR_StartDelay;
    int      _DRVU_DrvDyn_Disp_Rq_AR_MinDelay;
    int      _DRVU_DrvDyn_Disp_Rq_AR_DelayCnt;
    int      _DRVU_DrvDyn_Disp_Rq_AR_Cnt;
    int      _DRVU_DrvDyn_Disp_Rq_AR_SpontanFlag;
    msTimer _tDRVU_DrvDyn_Disp_Rq_AR;
	

//  Botschaft DRVU_Stat_AR ID: 876 --- Sendeart 5 cyclicAndSpontanWithDelay --- 
    message   DRVU_Stat_AR _mDRVU_Stat_AR;
    int      _DRVU_Stat_AR_Timebase;
    int      _DRVU_Stat_AR_CycleCount;
    int      _DRVU_Stat_AR_StartDelay;
    int      _DRVU_Stat_AR_MinDelay;
    int      _DRVU_Stat_AR_Cnt;
    int      _DRVU_Stat_AR_SpontanFlag;
    int      _DRVU_Stat_AR_DelayCnt;
    msTimer _tDRVU_Stat_AR;

    //  message   ROE_DRVU ID: 2565819648 --- Sendeart 9 cyclicWithRepeatOnDemand --- 
    message   ROE_DRVU _mROE_DRVU;
    int      _ROE_DRVU_Timebase;
    int      _ROE_DRVU_CycleCount;
    int      _ROE_DRVU_StartDelay;
    int      _ROE_DRVU_Cnt;
    int      _ROE_DRVU_MsgRepetitions;

    // Botschaft ROE_EDIFF ID: 2565818624 --- Sendeart 9 cyclicWithRepeatOnDemand --- 
    message ROE_EDIFF _mROE_EDIFF;
    int _ROE_EDIFF_Timebase;
    int _ROE_EDIFF_CycleCount = 3276;
    int _ROE_EDIFF_StartDelay;
    int _ROE_EDIFF_Cnt;
    int _ROE_EDIFF_MsgRepetitions;

    // Botschaft ROE_EMC ID: 2565818880 --- Sendeart 9 cyclicWithRepeatOnDemand --- 
    message ROE_EMC _mROE_EMC;
    int _ROE_EMC_Timebase;
    int _ROE_EMC_CycleCount = 3276;
    int _ROE_EMC_StartDelay;
    int _ROE_EMC_Cnt;
    int _ROE_EMC_MsgRepetitions;

    // Botschaft ROE_TXMC ID: 2565819136 --- Sendeart 9 cyclicWithRepeatOnDemand --- 
    message ROE_TXMC _mROE_TXMC;
    int _ROE_TXMC_Timebase;
    int _ROE_TXMC_CycleCount;
    int _ROE_TXMC_StartDelay;
    int _ROE_TXMC_Cnt;
    int _ROE_TXMC_MsgRepetitions;

// #VAR_DEF_END#

    Timer t_DoorNMCancelTimer;
    Timer t_KeyInLockNMCancelTimer;
    Timer t_StWhlButtonNMCancelTimer;
    Timer t_WakeWarningNMCancelTimer;
    Timer t_CarClosureNMCancelTimer;
    Timer t_EPKBWarningNMCancelTimer;
    Timer t_IlluNMCancelTimer;
    Timer t_GearIndNMCancelTimer;
    const byte c_NMCancelTimer_05sec = 5;
    const byte c_NMCancelTimer_30sec = 30;

    char buffer[1024], stringbuffer[512];
    int bActiveHelper;    // Hilfsvariable für "Aktive Signale"

//--------------------------------------- AUTOSAR NM ------------------------------------------------

    const byte cAUTO =   0;
    const byte cMANUAL = 1;

    msTimer t_NM_Transmit;
    long  NM_Transmit_Cycle;
    msTimer t_NM_Wait_Bus_Sleep_Time;
    const c_NM_Wait_Bus_Sleep_Time = 1500;
//    msTimer t_NM_Remote_Sleep_Ind_Time;
    const c_NM_Remote_Sleep_Ind_Time = 5000;
    msTimer t_NM_Repeat_Message_Time;
    const c_NM_Repeat_Message_Time = 6000;
    msTimer t_NM_Timeout_Time;
    const c_NM_Timeout_Time = 5000;

    byte NM_Mode = 0;
    const byte cNM_Mode_Init = 0;
    const byte cNM_Mode_Sleep = 1;
    const byte cNM_Mode_Prepare_Bus_Sleep = 2;
    const byte cNM_Mode_Ready_Sleep = 3;
    const byte cNM_Mode_Normal_Operation_State = 4;
    const byte cNM_Mode_RepeatMsg = 5;

    byte boCanNM_Rx_Indication = 0;
    byte boCanNM_Tx_Confirmation = 0;
    byte boCanNM_WaitBusSleep_Timer_Expired = 0;
    byte boCanNM_RepeatMessage_Timer_Expired = 0;
    byte boCanNM_NM_Timeout_Timer_Expired = 0;
    byte boCanNM_RepeatMessage_Requested = 0;

    const word cFLDoorNMRequest =       0x0001;
    const word cFRDoorNMRequest =       0x0002;
    const word cRLDoorNMRequest =       0x0004;
    const word cRRDoorNMRequest =       0x0008;
    const word cAllDoorNMRequest =      0x000F;
    const word cIgnitionNMRequest =     0x0010;
    const word cStWhlButtonNMRequest =  0x0020;
    const word cWakeWarningNMRequest =  0x0040;
    const word cEPKBWarningNMRequest =  0x0080;
    const word cIlluNMRequest =         0x0100;
    const word cCarClosureNMRequest =   0x0200;
    const word cGearIndNMRequest =      0x0400;

    const word cManualNMRequest =       0x8000;
    const word cAllNMRequest =          0xFFFF;

    const CanNmNodeId_Base =       1280; //  =  07h
    const CanNmNodeId_APM =          76; //  =  4Ch
    const CanNmNodeId_DRVU =         77; //  =  4Dh
    const CanNmNodeId_EIS =           7; //  =  07h
    const CanNmNodeId_HGW =          27; //  =  07h
    const CanNmNodeId_TGW =          56; //  =  38h
    const CanNmNodeId_RBTM_FR =      64; //  =  40h
    const CanNmNodeId_IC =           65; //  =  41h
    const CanNmNodeId_HUD =          66; //  =  42h
    const CanNmNodeId_NV =           67; //  =  43h
    const CanNmNodeId_RVC_SVS =      68; //  =  44h
    const CanNmNodeId_ORC =          69; //  =  45h
    const CanNmNodeId_RBTM_FL =      71; //  =  47h
    const CanNmNodeId_TPM =          82; //  =  52h

    const CanNmNodeDetectionEnabled          = 0; //false
    const CanNmNodeIdEnabled                 = 1; //true
    const CanNmUserDataEnabled               = 1; //true;
    const CanNmUserDataLentgh                = 7;
    const CanNmRepeatMsgIndEnabled           = 1; //true;
    const CanNmDevErrorDetect                = 0; //false
//    const CanNmUserDataEnabled             = 1; //true
    const CanNmRemoteSleepIndEnabled         = 0; //false
    const CanNmMsgReducedtime                = 80; //ms
    const CanNmPduRxIndicationEnabled        = 0; //false
    const CanNmStateChangeIndEnabled         = 0; //false
    const CanNmImmediateTxconfEnabled        = 0;// false
    const CanNmMsgTimeoutTime                = 5000; //ms
    const CanNmPduNidPosition                = 0; //CANNM_PDU_BYTE_0;
    const CanNmPduCbvPosition                = 0xFF; //ANNM_PDU_OFF;
    const CanNmPduLength                     = 8;
    const cCanNmPassiveModeEnabled           = 0; //false
    const CanNmBusSynchronizationEnabled     = 0; //false
    const CanNmBusLoadReductionEnabled       = 1; //true
//    const CanNmRemoteSleepIndEnabled       = 0; //false
//    const CanNmNodeDetectionEnabled        = 0; //false
    const CanNmComControlEnabled             = 1; //true    

    const NmAsrCanMsgStandardCycle =          2000;
    const NmAsrCanMsgCycleOffset_APM =          40;
    const NmAsrCanMsgReducedTime_APM =        1760;
    const NmAsrCanMsgCycleOffset_DRVU =         50;
    const NmAsrCanMsgReducedTime_DRVU =       1770;
    const NmAsrCanMsgCycleOffset_EIS =          70;
    const NmAsrCanMsgReducedTime_EIS =        1070;
    const NmAsrCanMsgCycleOffset_HGW =          30;
    const NmAsrCanMsgReducedTime_HGW =        1270;
    const NmAsrCanMsgCycleOffset_HUD =          20;
    const NmAsrCanMsgReducedTime_HUD =        1660;
    const NmAsrCanMsgCycleOffset_IC =           10;
    const NmAsrCanMsgReducedTime_IC =         1650;
    const NmAsrCanMsgCycleOffset_NV =           30;
    const NmAsrCanMsgReducedTime_NV =         1670;
    const NmAsrCanMsgCycleOffset_ORC =          50;
    const NmAsrCanMsgReducedTime_ORC =        1690;
    const NmAsrCanMsgCycleOffset_RBTM_FL =       0;
    const NmAsrCanMsgReducedTime_RBTM_FL =    1640;
    const NmAsrCanMsgCycleOffset_RBTM_FR =      70;
    const NmAsrCanMsgReducedTime_RBTM_FR =    1710;
    const NmAsrCanMsgCycleOffset_RVC =          40;
    const NmAsrCanMsgReducedTime_RVC =        1680;
    const NmAsrCanMsgCycleOffset_SVS =          40;
    const NmAsrCanMsgReducedTime_SVS =        1680;
    const NmAsrCanMsgCycleOffset_TGW =           0;
    const NmAsrCanMsgReducedTime_TGW =        1560;
    const NmAsrCanMsgCycleOffset_TPM =          20;
    const NmAsrCanMsgReducedTime_TPM =        1820;

    char gECU[12] = "HMI_DRVU";

    byte CanNmNodeId            = CanNmNodeId_DRVU;
    word NmNodeIdentifier       = CanNmNodeId_Base + CanNmNodeId_DRVU;
    word NmAsrCanMsgCycleOffset = NmAsrCanMsgCycleOffset_DRVU;
    word NmAsrCanMsgReducedTime = NmAsrCanMsgReducedTime_DRVU;
    word NmAsrCanMsgCycleTime   = 2000;
    byte NM_Repeat_Message_State_Active = 0;
    byte NM_AutomaticModeActive = 0;

    // Botschaft NM_xxx_AR --- Sendeart cyclicX --- 
    //message NM_DRVU_AR _mNM_xxx_AR;
    byte _mNM_xxx_Transmit_Allowed = 1;

//--------------------------------------- AUTOSAR NM ------------------------------------------------

    byte  crctable[256] = {
        0x00, 0x1D, 0x3A, 0x27, 0x74, 0x69, 0x4E, 0x53, 0xE8, 0xF5, 0xD2, 0xCF, 0x9C, 0x81, 0xA6, 0xBB,
        0xCD, 0xD0, 0xF7, 0xEA, 0xB9, 0xA4, 0x83, 0x9E, 0x25, 0x38, 0x1F, 0x02, 0x51, 0x4C, 0x6B, 0x76,
        0x87, 0x9A, 0xBD, 0xA0, 0xF3, 0xEE, 0xC9, 0xD4, 0x6F, 0x72, 0x55, 0x48, 0x1B, 0x06, 0x21, 0x3C,
        0x4A, 0x57, 0x70, 0x6D, 0x3E, 0x23, 0x04, 0x19, 0xA2, 0xBF, 0x98, 0x85, 0xD6, 0xCB, 0xEC, 0xF1,
        0x13, 0x0E, 0x29, 0x34, 0x67, 0x7A, 0x5D, 0x40, 0xFB, 0xE6, 0xC1, 0xDC, 0x8F, 0x92, 0xB5, 0xA8,
        0xDE, 0xC3, 0xE4, 0xF9, 0xAA, 0xB7, 0x90, 0x8D, 0x36, 0x2B, 0x0C, 0x11, 0x42, 0x5F, 0x78, 0x65,
        0x94, 0x89, 0xAE, 0xB3, 0xE0, 0xFD, 0xDA, 0xC7, 0x7C, 0x61, 0x46, 0x5B, 0x08, 0x15, 0x32, 0x2F,
        0x59, 0x44, 0x63, 0x7E, 0x2D, 0x30, 0x17, 0x0A, 0xB1, 0xAC, 0x8B, 0x96, 0xC5, 0xD8, 0xFF, 0xE2,
        0x26, 0x3B, 0x1C, 0x01, 0x52, 0x4F, 0x68, 0x75, 0xCE, 0xD3, 0xF4, 0xE9, 0xBA, 0xA7, 0x80, 0x9D,
        0xEB, 0xF6, 0xD1, 0xCC, 0x9F, 0x82, 0xA5, 0xB8, 0x03, 0x1E, 0x39, 0x24, 0x77, 0x6A, 0x4D, 0x50,
        0xA1, 0xBC, 0x9B, 0x86, 0xD5, 0xC8, 0xEF, 0xF2, 0x49, 0x54, 0x73, 0x6E, 0x3D, 0x20, 0x07, 0x1A,
        0x6C, 0x71, 0x56, 0x4B, 0x18, 0x05, 0x22, 0x3F, 0x84, 0x99, 0xBE, 0xA3, 0xF0, 0xED, 0xCA, 0xD7,
        0x35, 0x28, 0x0F, 0x12, 0x41, 0x5C, 0x7B, 0x66, 0xDD, 0xC0, 0xE7, 0xFA, 0xA9, 0xB4, 0x93, 0x8E,
        0xF8, 0xE5, 0xC2, 0xDF, 0x8C, 0x91, 0xB6, 0xAB, 0x10, 0x0D, 0x2A, 0x37, 0x64, 0x79, 0x5E, 0x43,
        0xB2, 0xAF, 0x88, 0x95, 0xC6, 0xDB, 0xFC, 0xE1, 0x5A, 0x47, 0x60, 0x7D, 0x2E, 0x33, 0x14, 0x09,
        0x7F, 0x62, 0x45, 0x58, 0x0B, 0x16, 0x31, 0x2C, 0x97, 0x8A, 0xAD, 0xB0, 0xE3, 0xFE, 0xD9, 0xC4
    };

    byte  crctable_profile02[256] = {
        0x00, 0x2F, 0x5E, 0x71, 0xBC, 0x93, 0xE2, 0xCD, 0x57, 0x78, 0x09, 0x26, 0xEB, 0xC4, 0xB5, 0x9A,
        0xAE, 0x81, 0xF0, 0xDF, 0x12, 0x3D, 0x4C, 0x63, 0xF9, 0xD6, 0xA7, 0x88, 0x45, 0x6A, 0x1B, 0x34,
        0x73, 0x5C, 0x2D, 0x02, 0xCF, 0xE0, 0x91, 0xBE, 0x24, 0x0B, 0x7A, 0x55, 0x98, 0xB7, 0xC6, 0xE9,
        0xDD, 0xF2, 0x83, 0xAC, 0x61, 0x4E, 0x3F, 0x10, 0x8A, 0xA5, 0xD4, 0xFB, 0x36, 0x19, 0x68, 0x47,
        0xE6, 0xC9, 0xB8, 0x97, 0x5A, 0x75, 0x04, 0x2B, 0xB1, 0x9E, 0xEF, 0xC0, 0x0D, 0x22, 0x53, 0x7C,
        0x48, 0x67, 0x16, 0x39, 0xF4, 0xDB, 0xAA, 0x85, 0x1F, 0x30, 0x41, 0x6E, 0xA3, 0x8C, 0xFD, 0xD2,
        0x95, 0xBA, 0xCB, 0xE4, 0x29, 0x06, 0x77, 0x58, 0xC2, 0xED, 0x9C, 0xB3, 0x7E, 0x51, 0x20, 0x0F,
        0x3B, 0x14, 0x65, 0x4A, 0x87, 0xA8, 0xD9, 0xF6, 0x6C, 0x43, 0x32, 0x1D, 0xD0, 0xFF, 0x8E, 0xA1,
        0xE3, 0xCC, 0xBD, 0x92, 0x5F, 0x70, 0x01, 0x2E, 0xB4, 0x9B, 0xEA, 0xC5, 0x08, 0x27, 0x56, 0x79,
        0x4D, 0x62, 0x13, 0x3C, 0xF1, 0xDE, 0xAF, 0x80, 0x1A, 0x35, 0x44, 0x6B, 0xA6, 0x89, 0xF8, 0xD7,
        0x90, 0xBF, 0xCE, 0xE1, 0x2C, 0x03, 0x72, 0x5D, 0xC7, 0xE8, 0x99, 0xB6, 0x7B, 0x54, 0x25, 0x0A,
        0x3E, 0x11, 0x60, 0x4F, 0x82, 0xAD, 0xDC, 0xF3, 0x69, 0x46, 0x37, 0x18, 0xD5, 0xFA, 0x8B, 0xA4,
        0x05, 0x2A, 0x5B, 0x74, 0xB9, 0x96, 0xE7, 0xC8, 0x52, 0x7D, 0x0C, 0x23, 0xEE, 0xC1, 0xB0, 0x9F,
        0xAB, 0x84, 0xF5, 0xDA, 0x17, 0x38, 0x49, 0x66, 0xFC, 0xD3, 0xA2, 0x8D, 0x40, 0x6F, 0x1E, 0x31,
        0x76, 0x59, 0x28, 0x07, 0xCA, 0xE5, 0x94, 0xBB, 0x21, 0x0E, 0x7F, 0x50, 0x9D, 0xB2, 0xC3, 0xEC,
        0xD8, 0xF7, 0x86, 0xA9, 0x64, 0x4B, 0x3A, 0x15, 0x8F, 0xA0, 0xD1, 0xFE, 0x33, 0x1C, 0x6D, 0x42
    };
}

on start
{
    putValue( HMI__NM_DRVU_NM_Request, 0 );  // reset all requests
    _NM_Switch_NM_Mode();
    
    // DBKom-Task starten
    
    __DRVU_Init_Msg();
    __DRVU_Startup_Delay();

    putValue( HMI__NM_DRVU_AutomaticModeActive, 0 );
    putValue( HMI__NM_DRVU_AutomaticModeActive, 1 );
}

__DRVU_Init_Msg()
{
// #START_INIT#
    DPC_SwStat_DRVU_AMG_AR_init();
    DRVU_AWD_Disp_Rq_AR_init();
    DRVU_Aero_Stat_AR_init();
    DRVU_DrvDyn_Disp_Rq_AR_init();
    DRVU_Stat_AR_init();
    ROE_DRVU_init();
    ROE_EDIFF_init();
    ROE_EMC_init();
    ROE_TXMC_init();
// #START_INIT_END#
//    ECU_APPL_DRVU_1_init();
//    ECU_APPL_DRVU_2_init();
//    Meas_DRVU_1_init();
//    NM_xxx_AR_init();
}

on envVar HMI__STOP_All_MESSAGES_DEFAULT_STARTDELAY
{
    if( getValue( this ) )
    {
        __DRVU_Init_Msg();
        __DRVU_Startup_Delay();
    }
}

on envVar HMI__STOP_All_MESSAGES_SET_STARTDELAY
{
    if( getValue( this ) )
    {
        __DRVU_Startup_Delay();
    }
}

__DRVU_Startup_Delay()
{
//    write(" Delay setzen :__DRVU_Startup_Delay");

// #START_DELAY#
    _DPC_SwStat_DRVU_AMG_AR_Cnt 	=   	getValue( HMI__STMSGSD_DPC_SwStat_DRVU_AMG_AR   		) / _DPC_SwStat_DRVU_AMG_AR_Timebase;
    _DRVU_AWD_Disp_Rq_AR_Cnt 	=   	getValue( HMI__STMSGSD_DRVU_AWD_Disp_Rq_AR   		) / _DRVU_AWD_Disp_Rq_AR_Timebase;
    _DRVU_Aero_Stat_AR_Cnt =   			getValue( HMI__STMSGSD_DRVU_Aero_Stat_AR   			) / _DRVU_Aero_Stat_AR_Timebase;
    _DRVU_DrvDyn_Disp_Rq_AR_Cnt =   	getValue( HMI__STMSGSD_DRVU_DrvDyn_Disp_Rq_AR   	) / _DRVU_DrvDyn_Disp_Rq_AR_Timebase;
    _DRVU_Stat_AR_Cnt =          		getValue( HMI__STMSGSD_DRVU_Stat_AR   				) / _DRVU_Stat_AR_Timebase;
    _ROE_DRVU_Cnt =              		getValue( HMI__STMSGSD_ROE_DRVU       				) / _ROE_DRVU_Timebase;
	
// #START_DELAY_END#
}

on Timer t_DBKomTimer_5ms
{
// *** DBKom-Sendefunktion ***
    // timer aufziehen für nächsten Zyklus
    if( getValue( HMI__NM_DRVU_CommActive ) |
        getValue( HMI__NM_DRVU_RequestBusCom )   )
    {
        setTimer( t_DBKomTimer_5ms, c_tDBKomTimer_5ms );
    }
// #CYC_TIMER_5_MS#
//    CLkS_Rq_AR_check_output();                   // Botschaft CLkS_Rq_AR                   --- Sendeart 8 cyclicIfActiveFast --- 
// #CYC_TIMER_5_MS_END#
}

on Timer t_DBKomTimer_20ms
{
// *** DBKom-Sendefunktion ***
    // timer aufziehen für nächsten Zyklus
    if( getValue( HMI__NM_DRVU_CommActive ) |
        getValue( HMI__NM_DRVU_RequestBusCom )   )
    {
        setTimer( t_DBKomTimer_20ms, c_tDBKomTimer_20ms );
    }
// #CYC_TIMER_20_MS#
    DPC_SwStat_DRVU_AMG_AR_check_output();
    DRVU_AWD_Disp_Rq_AR_check_output();
    DRVU_Stat_AR_check_output();
    DRVU_Aero_Stat_AR_check_output();
    DRVU_DrvDyn_Disp_Rq_AR_check_output();
    ROE_DRVU_check_output();
    ROE_EDIFF_check_output();
    ROE_EMC_check_output();
    ROE_TXMC_check_output();
// #CYC_TIMER_20_MS_END#
//    ECU_APPL_DRVU_1_check_output();
//    ECU_APPL_DRVU_2_check_output();
//    Meas_DRVU_1_check_output();
//    NM_xxx_AR_check_output();
}

on EnvVar HMI__SAVE_PANEL_CONFIG_DRVU
{
    dword hFile;

    if( getValue(this) )
    {
        write("Saving HMI Panel Variables ...");

        hFile = openFileWrite( "CONFIG\\HMI_PRESETS.ASC", 0 );
        filePutString( "base hex timestamps absolute\n", 31, hFile );

// #MSG_SAVEENVVAR#
        DPC_SwStat_DRVU_AMG_AR_saveEnvVars( hFile );
        DRVU_AWD_Disp_Rq_AR_saveEnvVars( hFile );
        DRVU_Stat_AR_saveEnvVars( hFile );
        DRVU_Aero_Stat_AR_saveEnvVars( hFile );
        DRVU_DrvDyn_Disp_Rq_AR_saveEnvVars( hFile );
        ROE_DRVU_saveEnvVars( hFile );
        ROE_EDIFF_saveEnvVars( hFile );
        ROE_EMC_saveEnvVars( hFile );
        ROE_TXMC_saveEnvVars( hFile );

// #MSG_SAVEENVVAR_END#
//        ECU_APPL_DRVU_1_saveEnvVars( hFile );
//        ECU_APPL_DRVU_2_saveEnvVars( hFile );
//        Meas_DRVU_1_saveEnvVars( hFile );
        NM_xxx_AR_saveEnvVars( hFile );

        fileClose(hFile );
    }
}

on EnvVar HMI__STOP_DRVU_MESSAGES_OFF
{
    if( getValue(this) )
    {
// #MSG_OFF#
        putValue( HMI__STMSG_DPC_SwStat_DRVU_AMG_AR, 1 );
        putValue( HMI__STMSG_DRVU_AWD_Disp_Rq_AR, 1 );
        putValue( HMI__STMSG_DRVU_Stat_AR, 1 );
        putValue( HMI__STMSG_DRVU_Aero_Stat_AR, 1 );
        putValue( HMI__STMSG_DRVU_DrvDyn_Disp_Rq_AR, 1 );
        putValue( HMI__STMSG_ROE_DRVU, 1 );
        putValue( HMI__STMSG_ROE_EDIFF, 1 );
        putValue( HMI__STMSG_ROE_EMC, 1 );
        putValue( HMI__STMSG_ROE_TXMC, 1 );
// #MSG_OFF_END#

//        putValue( HMI__STMSG_ECU_APPL_DRVU_1, 1 );
//        putValue( HMI__STMSG_ECU_APPL_DRVU_2, 1 );
//        putValue( HMI__STMSG_Meas_DRVU_1, 1 );
        //putValue( HMI__STMSG_NM_DRVU_AR, 1 );
    }
}

on envVar HMI__STOP_DRVU_MESSAGES_ON
{
    if( getValue(this) )
    {
// #MSG_ON#
        putValue( HMI__STMSG_DPC_SwStat_DRVU_AMG_AR, 0 );
        putValue( HMI__STMSG_DRVU_AWD_Disp_Rq_AR, 0 );
        putValue( HMI__STMSG_DRVU_Stat_AR, 0 );
        putValue( HMI__STMSG_DRVU_Aero_Stat_AR, 0 );
        putValue( HMI__STMSG_DRVU_DrvDyn_Disp_Rq_AR, 0 );
        putValue( HMI__STMSG_ROE_DRVU, 0 );
        putValue( HMI__STMSG_ROE_EDIFF, 0 );
        putValue( HMI__STMSG_ROE_EMC, 0 );
        putValue( HMI__STMSG_ROE_TXMC, 0 );
// #MSG_ON_END#

//        putValue( HMI__STMSG_ECU_APPL_DRVU_1, 0 );
//        putValue( HMI__STMSG_ECU_APPL_DRVU_2, 0 );
//        putValue( HMI__STMSG_Meas_DRVU_1, 0 );
        //putValue( HMI__STMSG_NM_DRVU_AR, 0 );
    }
}

on busOff
{
    resetCan();
    write("CAN has been resetted due to BUSOFF    ( coded version )");
}

on message 0x500-0x57F
{
    byte Identifier;

    Identifier = this.byte( 1 );

    if( this.byte( 1 ) == CanNmNodeId )    // check, wether the received NM-Frame is an own one
    {
        boCanNM_Tx_Confirmation = TRUE;    // so it is a TX-confirmation
    }
    else
    {
        boCanNM_Rx_Indication = TRUE;     // else it is a NM-Frame from another ECU
    }
    _NM_Switch_NM_Mode();     // inform the state-mashine
}

on timer t_DoorNMCancelTimer
{
    if( getValue( HMI__NM_EIS_AutomaticModeActive ) == 1 )
    {
        _ReleaseCommRequest( 15 );  // all doors reset their requests
    }
}

on timer t_KeyInLockNMCancelTimer
{
    if( getValue( HMI__NM_EIS_AutomaticModeActive ) == 1 )
    {
        _ReleaseCommRequest( cIgnitionNMRequest );
    }
}

on timer t_StWhlButtonNMCancelTimer
{
    if( getValue( HMI__NM_EIS_AutomaticModeActive ) == 1 )
    {
        _ReleaseCommRequest( cStWhlButtonNMRequest );  // all keys reset their requests
    }
}

on timer t_WakeWarningNMCancelTimer
{
    if( getValue( HMI__NM_EIS_AutomaticModeActive ) == 1 )
    {
        _ReleaseCommRequest( cWakeWarningNMRequest );  // all keys reset their requests
    }
}

on timer t_EPKBWarningNMCancelTimer
{
    if( getValue( HMI__NM_EIS_AutomaticModeActive ) == 1 )
    {
        _ReleaseCommRequest( cEPKBWarningNMRequest );  // all keys reset their requests
    }
}

on timer t_IlluNMCancelTimer
{
    if( getValue( HMI__NM_EIS_AutomaticModeActive ) == 1 )
    {
        _ReleaseCommRequest( cIlluNMRequest );  // all keys reset their requests
    }
}

on timer t_CarClosureNMCancelTimer
{
    if( getValue( HMI__NM_EIS_AutomaticModeActive ) == 1 )
    {
        _ReleaseCommRequest( cCarClosureNMRequest );  // all keys reset their requests
    }
}

on timer t_GearIndNMCancelTimer
{
    if( getValue( HMI__NM_EIS_AutomaticModeActive ) == 1 )
    {
        _ReleaseCommRequest( cGearIndNMRequest );  // all keys reset their requests
    }
}

on timer t_NM_Repeat_Message_Time
{
    boCanNM_RepeatMessage_Timer_Expired = TRUE;
    _NM_Switch_NM_Mode();     // inform the state-mashine
}

on timer t_NM_Timeout_Time
{
    boCanNM_NM_Timeout_Timer_Expired = TRUE;
    _NM_Switch_NM_Mode();     // inform the state-mashine
}

/*
on timer t_NM_Transmit
{
    setTimer( t_NM_Transmit, NM_Transmit_Cycle );
	
	_mNM_xxx_AR.byte( 1 ) = CanNmNodeId;
    if( _mNM_xxx_Transmit_Allowed )
        output( _mNM_xxx_AR );
	
}
*/

on timer t_NM_Wait_Bus_Sleep_Time
{
    boCanNM_WaitBusSleep_Timer_Expired = TRUE;
    _NM_Switch_NM_Mode();     // inform the state-mashine
}

/*
NM_xxx_AR_init()
{

    _mNM_xxx_AR.Awake_Diag_Actv.phys = getValue( HMI_Awake_Diag_Actv_DRVU );
    _mNM_xxx_AR.Awake_Ignition_On.phys = getValue( HMI_Awake_Ignition_On_DRVU );
    _mNM_xxx_AR.WakeupRsn_DRVU.phys = getValue( HMI_WakeupRsn_DRVU );
    _mNM_xxx_AR.Awake_EF_Actv.phys = getValue( HMI_Awake_EF_Actv_DRVU );
	
	
    _mNM_xxx_AR.Awake_IgnitionAccessory_On.phys = getValue( HMI_Awake_IgnitionAccessory_On_DRVU );

}
*/

NM_xxx_AR_saveEnvVars( dword hFile )
{
    //filePutString("\n// Knoten NM_DRVU_AR\n", 33, hFile );
    //snprintf(buffer, elcount(buffer), "0.0000 HMI__STMSG_NM_DRVU_AR := %X\n", getValue( HMI__STMSG_NM_DRVU_AR ));		filePutString (buffer, elcount(buffer), hFile);
    //snprintf(buffer, elcount(buffer), "0.0000 HMI__STMSGT_NM_DRVU_AR := %X\n", getValue( HMI__STMSGT_NM_DRVU_AR ));		filePutString (buffer, elcount(buffer), hFile);
    snprintf(buffer, elcount(buffer), "0.0000 HMI_HMI_Awake_Diag_Actv_DRVU := %X\n", getValue( HMI_Awake_Diag_Actv_DRVU ) );		filePutString (buffer, elcount(buffer), hFile);
    snprintf(buffer, elcount(buffer), "0.0000 HMI_HMI_Awake_Ignition_On_DRVU := %X\n", getValue( HMI_Awake_Ignition_On_DRVU ) );		filePutString (buffer, elcount(buffer), hFile);
    snprintf(buffer, elcount(buffer), "0.0000 HMI_WakeupRsn_DRVU := %X\n", getValue( HMI_WakeupRsn_DRVU ) );		filePutString (buffer, elcount(buffer), hFile);
    snprintf(buffer, elcount(buffer), "0.0000 HMI_Awake_EF_Actv_DRVU := %X\n", getValue( HMI_Awake_EF_Actv_DRVU ) );		filePutString (buffer, elcount(buffer), hFile);
}

/*
on envVar HMI__STMSG_NM_DRVU_AR
{
    if( getValue( this ) == 0 )
        _mNM_xxx_Transmit_Allowed = 1;
    else
        _mNM_xxx_Transmit_Allowed = 0;    
}
*/

/*
on EnvVar HMI_Awake_Diag_Actv_DRVU
{
    _mNM_xxx_AR.Awake_Diag_Actv = getValue(this);
}

on EnvVar HMI_Awake_Ignition_On_DRVU
{
    _mNM_xxx_AR.Awake_Ignition_On = getValue(this);
}

on EnvVar HMI_WakeupRsn_DRVU
{
    _mNM_xxx_AR.WakeupRsn_DRVU.phys = getValue(this);
}

on EnvVar HMI_Awake_EF_Actv_DRVU
{
    _mNM_xxx_AR.Awake_EF_Actv.phys = getValue(this);
}
*/

_NM_Switch_NM_Mode()
{
    byte bOld_NM_Mode;
    word NM_Request_State;

    bOld_NM_Mode = NM_Mode;
    NM_Request_State = getValue( HMI__NM_DRVU_NM_Request );
    switch( NM_Mode )
    {
        case cNM_Mode_Init:                   _NM_Init();
                                              NM_Mode = cNM_Mode_Sleep;
                                              break;
        case cNM_Mode_Sleep:                  if( boCanNM_Rx_Indication == TRUE )
                                              {
                                                  // _NM_NetworkStartIndication();   nothing to do
                                                  // _NM_PassiveStartUp();    is content of _NM_NetworkMode();
                                                  setTimer( t_NM_Transmit, NmAsrCanMsgCycleOffset );    // send NM-Frame delayed
                                                  boCanNM_Rx_Indication = FALSE;
                                                  cancelTimer( t_NM_Timeout_Time );
                                                  setTimer( t_NM_Timeout_Time, c_NM_Timeout_Time );
                                                  setTimer( t_NM_Repeat_Message_Time, c_NM_Repeat_Message_Time );
                                                  NM_Transmit_Cycle = NmAsrCanMsgStandardCycle;
                                                  _NM_NetworkMode();
                                                  NM_Mode = cNM_Mode_RepeatMsg;
                                              }
                                              if( NM_Request_State )
                                              {
                                                  setTimer( t_NM_Transmit, 1 );    //send NM-Franme immediately
                                                  NM_Transmit_Cycle = NmAsrCanMsgStandardCycle;
                                                  cancelTimer( t_NM_Timeout_Time );
                                                  setTimer( t_NM_Timeout_Time, c_NM_Timeout_Time );
                                                  setTimer( t_NM_Repeat_Message_Time, c_NM_Repeat_Message_Time );
                                                  NM_Transmit_Cycle = NmAsrCanMsgStandardCycle;
                                                  _NM_NetworkMode();
                                                  NM_Mode = cNM_Mode_RepeatMsg;
                                              }
                                              break;
        case cNM_Mode_Prepare_Bus_Sleep:      if( boCanNM_WaitBusSleep_Timer_Expired == TRUE )
                                              {
                                                  _NM_BusSleepModeInd();   // set message startup delay
                                                  NM_Mode = cNM_Mode_Sleep;
                                                  boCanNM_WaitBusSleep_Timer_Expired = FALSE;
                                              }
                                              if( boCanNM_NM_Timeout_Timer_Expired == TRUE )
                                                  boCanNM_NM_Timeout_Timer_Expired = FALSE;
                                              if( ( boCanNM_Rx_Indication == TRUE ) ||  NM_Request_State )
                                              {
                                                  boCanNM_Rx_Indication = FALSE;
                                                  if( NM_Request_State )
                                                  {
                                                      setTimer( t_NM_Transmit, 1 );    //send NM-Franme immediately
                                                  }
                                                  cancelTimer( t_NM_Timeout_Time );
                                                  setTimer( t_NM_Timeout_Time, c_NM_Timeout_Time );
                                                  setTimer( t_NM_Repeat_Message_Time, c_NM_Repeat_Message_Time );
                                                  _NM_NetworkMode();
                                                  NM_Transmit_Cycle = NmAsrCanMsgStandardCycle;
                                                  NM_Mode = cNM_Mode_RepeatMsg;
                                              }
                                              break;
        case cNM_Mode_Ready_Sleep:            if( boCanNM_Rx_Indication == TRUE )
                                              {
                                                  cancelTimer( t_NM_Timeout_Time );
                                                  setTimer( t_NM_Timeout_Time, c_NM_Timeout_Time );
                                                  boCanNM_Rx_Indication = FALSE;
                                              }
                                              if( boCanNM_Tx_Confirmation == TRUE )
                                              {
                                                  cancelTimer( t_NM_Timeout_Time );
                                                  setTimer( t_NM_Timeout_Time, c_NM_Timeout_Time );
                                                  boCanNM_Tx_Confirmation = FALSE;
                                              }
                                              if( NM_Request_State )
                                              {
                                                  setTimer( t_NM_Transmit, 1 );    //send NM-Franme immediately
                                                  cancelTimer( t_NM_Timeout_Time );
                                                  setTimer( t_NM_Timeout_Time, c_NM_Timeout_Time );
                                                  NM_Transmit_Cycle = NmAsrCanMsgReducedTime;
                                                  NM_Mode = cNM_Mode_Normal_Operation_State;
                                              }
                                              if( boCanNM_RepeatMessage_Requested == TRUE )
                                              {
                                                  setTimer( t_NM_Transmit, NmAsrCanMsgCycleOffset );    // send NM-Frame delayed
                                                  cancelTimer( t_NM_Timeout_Time );
                                                  setTimer( t_NM_Timeout_Time, c_NM_Timeout_Time );
                                                  setTimer( t_NM_Repeat_Message_Time, c_NM_Repeat_Message_Time );
                                                  NM_Transmit_Cycle = NmAsrCanMsgStandardCycle;
                                                  boCanNM_RepeatMessage_Requested = FALSE;
                                                  NM_Mode = cNM_Mode_RepeatMsg;
                                              }
                                              if( boCanNM_NM_Timeout_Timer_Expired == TRUE )
                                              {
                                                  setTimer( t_NM_Wait_Bus_Sleep_Time, c_NM_Wait_Bus_Sleep_Time );
                                                  _NM_PrepareBusSleepModeInd();    // here t_DBKonTimer is stopped
                                                  NM_Mode = cNM_Mode_Prepare_Bus_Sleep;
                                                  boCanNM_NM_Timeout_Timer_Expired = FALSE;
                                              }
                                              break;
        case cNM_Mode_Normal_Operation_State: if( boCanNM_NM_Timeout_Timer_Expired == TRUE )
                                              {
                                                  setTimer( t_NM_Timeout_Time, c_NM_Timeout_Time );
                                                  // _NM_TimeoutExeption();    // no action to be done
                                                  boCanNM_NM_Timeout_Timer_Expired = FALSE;
                                              }
                                              if( boCanNM_Rx_Indication == TRUE )
                                              {
                                                  cancelTimer( t_NM_Timeout_Time );
                                                  setTimer( t_NM_Timeout_Time, c_NM_Timeout_Time );
                                                  cancelTimer( t_NM_Transmit );
                                                  setTimer( t_NM_Transmit, NmAsrCanMsgReducedTime );
                                                  boCanNM_Rx_Indication = FALSE;
                                              }
                                              if( boCanNM_Tx_Confirmation == TRUE )
                                              {
                                                  cancelTimer( t_NM_Timeout_Time );
                                                  setTimer( t_NM_Timeout_Time, c_NM_Timeout_Time );
                                                  cancelTimer( t_NM_Transmit );
                                                  setTimer( t_NM_Transmit, NmAsrCanMsgStandardCycle );
                                                  boCanNM_Tx_Confirmation = FALSE;
                                              }
                                              if( NM_Request_State == 0 )    //no network requested
                                              {
                                                  cancelTimer( t_NM_Transmit );    // stop NM-Franme immediately
                                                  NM_Mode = cNM_Mode_Ready_Sleep;
                                              }
                                              if( boCanNM_RepeatMessage_Requested == TRUE )
                                              {
                                                  setTimer( t_NM_Transmit, NmAsrCanMsgCycleOffset );    // send NM-Frame delayed
                                                  cancelTimer( t_NM_Timeout_Time );
                                                  setTimer( t_NM_Timeout_Time, c_NM_Timeout_Time );
                                                  setTimer( t_NM_Repeat_Message_Time, c_NM_Repeat_Message_Time );
                                                  boCanNM_RepeatMessage_Requested = FALSE;
                                                  NM_Transmit_Cycle = NmAsrCanMsgStandardCycle;
                                                  NM_Mode = cNM_Mode_RepeatMsg;
                                              }
                                              break;
        case cNM_Mode_RepeatMsg:              if( boCanNM_NM_Timeout_Timer_Expired == TRUE )
                                              {
                                                  setTimer( t_NM_Timeout_Time, c_NM_Timeout_Time );
                                                  boCanNM_NM_Timeout_Timer_Expired = FALSE;
                                              }
                                              if( boCanNM_Rx_Indication == TRUE )
                                              {
                                                  cancelTimer( t_NM_Timeout_Time );
                                                  setTimer( t_NM_Timeout_Time, c_NM_Timeout_Time );
                                                  boCanNM_Rx_Indication = FALSE;
                                              }
                                              if( boCanNM_Tx_Confirmation == TRUE )
                                              {
                                                  cancelTimer( t_NM_Timeout_Time );
                                                  setTimer( t_NM_Timeout_Time, c_NM_Timeout_Time );
                                                  boCanNM_Tx_Confirmation = FALSE;
                                              }
                                              if( boCanNM_RepeatMessage_Timer_Expired == TRUE )
                                              {
                                                  boCanNM_RepeatMessage_Timer_Expired = FALSE;
                                                  if( NM_Request_State )
                                                  {
                                                      NM_Mode = cNM_Mode_Normal_Operation_State;
                                                      NM_Transmit_Cycle = NmAsrCanMsgReducedTime;
                                                  }
                                                  else
                                                  {
                                                      cancelTimer( t_NM_Transmit );    // stop NM-Franme immediately
                                                      NM_Mode = cNM_Mode_Ready_Sleep;
                                                  }
                                              }
                                              break;
    }
    if( bOld_NM_Mode != NM_Mode )
    {
        _Nm_StateChangeNotification( bOld_NM_Mode, NM_Mode );    // does the Trace
        putValue( HMI__NM_DRVU_ActualState, NM_Mode );
    }
}

_NM_Init()
{
    NM_Transmit_Cycle = NmAsrCanMsgStandardCycle;
}

_NM_NetworkMode()
{
    setTimer( t_DBKomTimer_5ms, 1 ); //  ms     start CAN-communication immediately
    setTimer( t_DBKomTimer_20ms, 2 ); //  ms     start CAN-communication immediately
    putValue( HMI__NM_DRVU_CommActive, 1 );
}

_Nm_BusSleepModeInd()
{
//    _Trace( "_Nm_BusSleepModeInd", "Sleep Mode active");
    __DRVU_Startup_Delay();
}

void _Nm_PrepareBusSleepModeInd()
{
//    _Trace( "Nm_PrepareBusSleepModeInd", "Prepare Sleep Mode active");
    putValue( HMI__NM_DRVU_CommActive, 0 );
    cancelTimer( t_DBKomTimer_20ms );
    cancelTimer( t_DBKomTimer_5ms );
}

_Nm_StateChangeNotification( byte previousState, byte currentState )
{
/*
    char line[50];

    snprintf( line, elcount(line ), "Transition from %d to %d", previousState, currentState );
    _Trace( "Nm_StateChangeNotification", "", line );
*/
}

_ReleaseCommRequest( word RequestID )
{
    word temp; // actual NM request status

    temp = getValue( HMI__NM_DRVU_NM_Request );
    temp &= ~RequestID; // reset NM request 
    putValue( HMI__NM_DRVU_NM_Request, temp );
    _NM_Switch_NM_Mode();
}

_SetCommRequest( word RequestID )
{
    word temp; // actual NM request status

    temp = getValue( HMI__NM_DRVU_NM_Request );
    temp |= RequestID; // set NM request 
    putValue( HMI__NM_DRVU_NM_Request, temp );
    _NM_Switch_NM_Mode();
}

void _TraceCall( char functionName[], long callResult )
{
    char line[100];

    if( callResult == 1 )
        snprintf( line, elcount(line ), "calling %s", functionName );
    else
        snprintf( line, elcount(line ), "call to %s failed - wrong state?", functionName );
    _Trace( "", "", line );
}

void _Trace( char functionName[], char info[])
{
    _Trace( functionName, info, "");
}

void _Trace( char functionName[], char info[], char verbose[], long argument )
{
    char line[100];

    snprintf( line, elcount(line ), verbose, argument );
    _Trace( functionName, info, line );
}

void _Trace( char functionName[], char info[], char verbose[])
{
  char sep[2] = "/";
  sep[0] = functionName[0] ? '/' : 0;
  if( verbose[0])
  {
    write( "[%.3f]%s%s%s: %s", timeNow()/100000.0, gECU
           , sep
           , functionName
           , verbose
           );
  } else
  {
    write( "[%.3f]%s%s%s: %s", timeNow()/100000.0, gECU
           , sep
           , functionName
           , info
           );
  }
}

___Template_Header()
{
// #FUNCTIONS#
// #FUNCTIONS_END#
// #TIMERS#
// #TIMERS_END#
// #ENVVARS#
// #ENVVARS_END#
}

DPC_SwStat_DRVU_AMG_AR_check_output()
{
    if( !getValue( HMI__STMSG_DPC_SwStat_DRVU_AMG_AR ) )
    {
    //  message   DPC_SwStat_DRVU_AMG_AR ID: 468 --- Sendeart 0 cyclicX --- 
        _DPC_SwStat_DRVU_AMG_AR_Cnt--;
        if( _DPC_SwStat_DRVU_AMG_AR_Cnt < 1 )
        {
            // Nachricht wg. abgelaufenem Zyklus ausgeben
            DPC_SwStat_DRVU_AMG_AR_output();
            // Zyklus-Z?hler zur?cksetzen
            _DPC_SwStat_DRVU_AMG_AR_Cnt = _DPC_SwStat_DRVU_AMG_AR_CycleCount;
        }
    }
}

DPC_SwStat_DRVU_AMG_AR_init()
{   /* Botschaft DPC_SwStat_DRVU_AMG_AR ID: 468 --- Sendeart 0 cyclicX --- 
BA_ "ApplMessage" BO_ 468 0;
BA_ "NmAsrMessage" BO_ 468 0;
BA_ "GenMsgMinAcceptLength" BO_ 468 8;
BA_ "GenMsgILSupport" BO_ 468 1;
BA_ "DiagState" BO_ 468 0;
BA_ "DiagRequest" BO_ 468 0;
BA_ "DiagResponse" BO_ 468 0;
BA_ "GenMsgStartValue" BO_ 468 "0";
BA_ "GenMsgStartDelayTime" BO_ 468 0;
BA_ "GenMsgCycleTime" BO_ 468 1000;
BA_ "GenMsgSendType" BO_ 468 0;
    */
    _DPC_SwStat_DRVU_AMG_AR_Timebase =         c_tDBKomTimer_5ms;
    _DPC_SwStat_DRVU_AMG_AR_CycleCount =     1000 / _DPC_SwStat_DRVU_AMG_AR_Timebase;
    _DPC_SwStat_DRVU_AMG_AR_StartDelay =      0 / _DPC_SwStat_DRVU_AMG_AR_Timebase;
    _DPC_SwStat_DRVU_AMG_AR_Cnt = _DPC_SwStat_DRVU_AMG_AR_StartDelay;

    putValue( HMI__STMSGSD_DPC_SwStat_DRVU_AMG_AR, _DPC_SwStat_DRVU_AMG_AR_StartDelay * _DPC_SwStat_DRVU_AMG_AR_Timebase );

    _mDPC_SwStat_DRVU_AMG_AR.Aero_SwStat_DRVU.phys = getValue( HMI_Aero_SwStat_DRVU );
    _mDPC_SwStat_DRVU_AMG_AR.AGA_SwStat_DRVU.phys = getValue( HMI_AGA_SwStat_DRVU );
    _mDPC_SwStat_DRVU_AMG_AR.Chrg_Sw_Stat_DRVU_AMG.phys = getValue( HMI_Chrg_Sw_Stat_DRVU_AMG );
    _mDPC_SwStat_DRVU_AMG_AR.CRC_DPC_Swstat_DRVU.phys = getValue( HMI_CRC_DPC_Swstat_DRVU );
    _mDPC_SwStat_DRVU_AMG_AR.DPC_Md_Aero_Rs_HU.phys = getValue( HMI_DPC_Md_Aero_Rs_HU );
    _mDPC_SwStat_DRVU_AMG_AR.ESP_SwStat_DRVU.phys = getValue( HMI_ESP_SwStat_DRVU );
    _mDPC_SwStat_DRVU_AMG_AR.M_SwStat_DRVU.phys = getValue( HMI_M_SwStat_DRVU );
    _mDPC_SwStat_DRVU_AMG_AR.Park_Front_Sw_Stat_DRVU_AMG.phys = getValue( HMI_Park_Front_Sw_Stat_DRVU_AMG );
    _mDPC_SwStat_DRVU_AMG_AR.Rsrv1_DPC_Swstat_DRVU.phys = getValue( HMI_Rsrv1_DPC_Swstat_DRVU );
    _mDPC_SwStat_DRVU_AMG_AR.Seat_D_Sw_Stat_DRVU_AMG.phys = getValue( HMI_Seat_D_Sw_Stat_DRVU_AMG );
    _mDPC_SwStat_DRVU_AMG_AR.Seat_P_Sw_Stat_DRVU_AMG.phys = getValue( HMI_Seat_P_Sw_Stat_DRVU_AMG );
    _mDPC_SwStat_DRVU_AMG_AR.Slick_Sw_Stat_DRVU_AMG.phys = getValue( HMI_Slick_Sw_Stat_DRVU_AMG );
    _mDPC_SwStat_DRVU_AMG_AR.SQC_DPC_Swstat_DRVU.phys = getValue( HMI_SQC_DPC_Swstat_DRVU );
    _mDPC_SwStat_DRVU_AMG_AR.Susp_SwStat_DRVU.phys = getValue( HMI_Susp_SwStat_DRVU );
    _mDPC_SwStat_DRVU_AMG_AR.SuspLvl_SwStat_DRVU.phys = getValue( HMI_SuspLvl_SwStat_DRVU );
}
	
	
DPC_SwStat_DRVU_AMG_AR_output()
{
    byte crc;
    byte SQC_help;

    SQC_help = getValue( HMI_SQC_DPC_Swstat_DRVU ); //get copy of actual EnvVar
    if( !getValue( HMI_SQC_DPC_Swstat_DRVU_Auto ) ) // automatic SQC-calculation active ?
    {
        if( SQC_help == _DPC_SwStat_DRVU_AMG_AR_SQC_TriggPos ) // start injection of error when trigger reached
        {
            _DPC_SwStat_DRVU_AMG_AR_E2E_Armed = 1;   // run
            putValue( HMI_E2E_DPC_SwStat_DRVU_AMG_State, 1 );
        }
        // calculate new sequence counter
        
        if( ( _DPC_SwStat_DRVU_AMG_AR_SQC_WrongSeqJump != 0 ) &&
            ( _DPC_SwStat_DRVU_AMG_AR_E2E_Armed == 1        )    )
        {
            SQC_help = SQC_help + 16 + _DPC_SwStat_DRVU_AMG_AR_SQC_WrongSeqJump;
            if( SQC_help > 15 )
                SQC_help = SQC_help - 16;
            if( SQC_help > 15 )
                SQC_help = SQC_help - 16;
            _DPC_SwStat_DRVU_AMG_AR_SQC_WrongSeqJump = 0;
        }
        
        if( ( _DPC_SwStat_DRVU_AMG_AR_SQC_RepeatedCnt ) &&
            ( _DPC_SwStat_DRVU_AMG_AR_E2E_Armed == 1  )    )
        {
            _DPC_SwStat_DRVU_AMG_AR_SQC_RepeatedCnt--;
        }
        else
        {
            if( SQC_help >= 15 ) SQC_help = 0;
            else SQC_help++;
        }
            
        putValue( HMI_SQC_DPC_Swstat_DRVU, SQC_help );
    }
    _mDPC_SwStat_DRVU_AMG_AR.SQC_DPC_Swstat_DRVU = SQC_help;

    if( getValue( HMI_CRC_DPC_Swstat_DRVU_Profile_02 ) )
    {
        if( !getValue( HMI_CRC_DPC_Swstat_DRVU_Auto ) )
        {   // CRC according Profile_02 ( W213 )
            // berechne crc
            crc = 0xFF;
//          crc = crctable_profile02[ crc ^ _mDPC_SwStat_DRVU_AMG_AR.byte( 0 ) ];  CRC
            crc = crctable_profile02[ crc ^ _mDPC_SwStat_DRVU_AMG_AR.byte( 1 ) ];
            crc = crctable_profile02[ crc ^ _mDPC_SwStat_DRVU_AMG_AR.byte( 2 ) ];
            crc = crctable_profile02[ crc ^ _mDPC_SwStat_DRVU_AMG_AR.byte( 3 ) ];
            crc = crctable_profile02[ crc ^ _mDPC_SwStat_DRVU_AMG_AR.byte( 4 ) ];
            crc = crctable_profile02[ crc ^ _mDPC_SwStat_DRVU_AMG_AR.byte( 5 ) ];
            crc = crctable_profile02[ crc ^ _mDPC_SwStat_DRVU_AMG_AR.byte( 6 ) ];
            crc = crctable_profile02[ crc ^ _mDPC_SwStat_DRVU_AMG_AR.byte( 7 ) ];
            crc = crctable_profile02[ crc ^ _DPC_SwStat_DRVU_AMG_AR_CRC_Offset[ _mDPC_SwStat_DRVU_AMG_AR.SQC_DPC_Swstat_DRVU ] ]; // load offset
            crc = (crc ^ 0xFF);
            
            if( ( _DPC_SwStat_DRVU_AMG_AR_CRC_ErrorCnt   && ( _DPC_SwStat_DRVU_AMG_AR_E2E_Armed == 1   ) ) ||
                ( getValue( HMI_CRC_DPC_Swstat_DRVU_Invalid )                                         )    )
            {
                crc++;
                if( _DPC_SwStat_DRVU_AMG_AR_CRC_ErrorCnt > 0 )
                    _DPC_SwStat_DRVU_AMG_AR_CRC_ErrorCnt--; 
            }
            _mDPC_SwStat_DRVU_AMG_AR.CRC_DPC_Swstat_DRVU = crc;
            putValue( HMI_CRC_DPC_Swstat_DRVU, crc );
        }
        else
            _mDPC_SwStat_DRVU_AMG_AR.CRC_DPC_Swstat_DRVU = getValue( HMI_CRC_DPC_Swstat_DRVU );
    }
    else
    {
        if( !getValue( HMI_CRC_DPC_Swstat_DRVU_Auto ) )
        {   // CRC according to SAE1850 ( W222 )
            // berechne crc
            crc = 0xFF;
//            crc = crctable[ crc ^ _mDPC_SwStat_DRVU_AMG_AR.byte( 0 ) ];  CRC
            crc = crctable[ crc ^ _mDPC_SwStat_DRVU_AMG_AR.byte( 1 ) ];
            crc = crctable[ crc ^ _mDPC_SwStat_DRVU_AMG_AR.byte( 2 ) ];
            crc = crctable[ crc ^ _mDPC_SwStat_DRVU_AMG_AR.byte( 3 ) ];
            crc = crctable[ crc ^ _mDPC_SwStat_DRVU_AMG_AR.byte( 4 ) ];
            crc = crctable[ crc ^ _mDPC_SwStat_DRVU_AMG_AR.byte( 5 ) ];
            crc = crctable[ crc ^ _mDPC_SwStat_DRVU_AMG_AR.byte( 6 ) ];
            crc = crctable[ crc ^ _mDPC_SwStat_DRVU_AMG_AR.byte( 7 ) ];
            crc = (crc ^ 0xFF);
            if( ( _DPC_SwStat_DRVU_AMG_AR_CRC_ErrorCnt   && ( _DPC_SwStat_DRVU_AMG_AR_E2E_Armed == 1   ) ) ||
                ( getValue( HMI_CRC_DPC_Swstat_DRVU_Invalid )                                         )    )
            {
                crc++;
                if( _DPC_SwStat_DRVU_AMG_AR_CRC_ErrorCnt > 0 )
                    _DPC_SwStat_DRVU_AMG_AR_CRC_ErrorCnt--; 
            }
            _mDPC_SwStat_DRVU_AMG_AR.CRC_DPC_Swstat_DRVU = crc;
            putValue( HMI_CRC_DPC_SwStat_DRVU, crc );
        }
        else
            _mDPC_SwStat_DRVU_AMG_AR.CRC_DPC_Swstat_DRVU = getValue( HMI_CRC_DPC_Swstat_DRVU );
    }
    if( ( _DPC_SwStat_DRVU_AMG_AR_MSG_DropCnt > 0 ) &&
        ( _DPC_SwStat_DRVU_AMG_AR_E2E_Armed == 1  )    )
    {
        _DPC_SwStat_DRVU_AMG_AR_MSG_DropCnt--;  // do not send message
    }
    else
        output( _mDPC_SwStat_DRVU_AMG_AR );
        
    if( _DPC_SwStat_DRVU_AMG_AR_E2E_Armed == 1 )
    {
        if ( ( _DPC_SwStat_DRVU_AMG_AR_MSG_DropCnt == 0      ) &&
             ( _DPC_SwStat_DRVU_AMG_AR_CRC_ErrorCnt == 0     ) &&
             ( _DPC_SwStat_DRVU_AMG_AR_SQC_RepeatedCnt == 0  ) &&
             ( _DPC_SwStat_DRVU_AMG_AR_SQC_WrongSeqJump == 0 )    )
        {
            _DPC_SwStat_DRVU_AMG_AR_E2E_Armed = 0; // no further influence, injetion completed
            putValue( HMI_E2E_DPC_SwStat_DRVU_AMG_State, 0 );
        }
    }
}	

DPC_SwStat_DRVU_AMG_AR_saveEnvVars( dword hFile )
{
    filePutString("\n// Knoten DRVU: DPC_SwStat_DRVU_AMG_AR\n", 29, hFile );
    snprintf( buffer, elcount( buffer ), "0.0000 HMI__STMSG_DPC_SwStat_DRVU_AMG_AR := %X\n", getValue( HMI__STMSG_DPC_SwStat_DRVU_AMG_AR ) );        filePutString ( buffer, elcount( buffer ), hFile );
    snprintf( buffer, elcount( buffer ), "0.0000 HMI__STMSGT_DPC_SwStat_DRVU_AMG_AR := %X\n", getValue( HMI__STMSGT_DPC_SwStat_DRVU_AMG_AR ));        filePutString ( buffer, elcount( buffer ), hFile );
    snprintf( buffer, elcount( buffer ), "0.0000 HMI_CRC_DPC_Swstat_DRVU := %X\n", getValue( HMI_CRC_DPC_Swstat_DRVU ) );        
	filePutString ( buffer, elcount( buffer ), hFile );
    snprintf( buffer, elcount( buffer ), "0.0000 HMI_CRC_DPC_Swstat_DRVU_Auto := %X\n", getValue( HMI_CRC_DPC_Swstat_DRVU_Auto ) );        filePutString ( buffer, elcount( buffer ), hFile );
    snprintf( buffer, elcount( buffer ), "0.0000 HMI_Aero_SwStat_DRVU := %X\n", getValue( HMI_Aero_SwStat_DRVU ) );        
	filePutString ( buffer, elcount( buffer ), hFile );
    snprintf( buffer, elcount( buffer ), "0.0000 HMI_AGA_SwStat_DRVU := %X\n", getValue( HMI_AGA_SwStat_DRVU ) );        
	filePutString ( buffer, elcount( buffer ), hFile );
    snprintf( buffer, elcount( buffer ), "0.0000 HMI_Chrg_Sw_Stat_DRVU_AMG := %X\n", getValue( HMI_Chrg_Sw_Stat_DRVU_AMG ) );        
	filePutString ( buffer, elcount( buffer ), hFile );
    snprintf( buffer, elcount( buffer ), "0.0000 HMI_DPC_Md_Aero_Rs_HU := %X\n", getValue( HMI_DPC_Md_Aero_Rs_HU ) );        
	filePutString ( buffer, elcount( buffer ), hFile );
    snprintf( buffer, elcount( buffer ), "0.0000 HMI_ESP_SwStat_DRVU := %X\n", getValue( HMI_ESP_SwStat_DRVU ) );        
	filePutString ( buffer, elcount( buffer ), hFile );
    snprintf( buffer, elcount( buffer ), "0.0000 HMI_M_SwStat_DRVU := %X\n", getValue( HMI_M_SwStat_DRVU ) );        
	filePutString ( buffer, elcount( buffer ), hFile );
    snprintf( buffer, elcount( buffer ), "0.0000 HMI_Park_Front_Sw_Stat_DRVU_AMG := %X\n", getValue( HMI_Park_Front_Sw_Stat_DRVU_AMG ) );        filePutString ( buffer, elcount( buffer ), hFile );
    snprintf( buffer, elcount( buffer ), "0.0000 HMI_Rsrv1_DPC_Swstat_DRVU := %X\n", getValue( HMI_Rsrv1_DPC_Swstat_DRVU ) );        
	filePutString ( buffer, elcount( buffer ), hFile );
    snprintf( buffer, elcount( buffer ), "0.0000 HMI_Seat_D_Sw_Stat_DRVU_AMG := %X\n", getValue( HMI_Seat_D_Sw_Stat_DRVU_AMG ) );        filePutString ( buffer, elcount( buffer ), hFile );
    snprintf( buffer, elcount( buffer ), "0.0000 HMI_Seat_P_Sw_Stat_DRVU_AMG := %X\n", getValue( HMI_Seat_P_Sw_Stat_DRVU_AMG ) );        filePutString ( buffer, elcount( buffer ), hFile );
    snprintf( buffer, elcount( buffer ), "0.0000 HMI_Slick_Sw_Stat_DRVU_AMG := %X\n", getValue( HMI_Slick_Sw_Stat_DRVU_AMG ) );        
	filePutString ( buffer, elcount( buffer ), hFile );
    snprintf( buffer, elcount( buffer ), "0.0000 HMI_Susp_SwStat_DRVU := %X\n", getValue( HMI_Susp_SwStat_DRVU ) );        
	filePutString ( buffer, elcount( buffer ), hFile );
    snprintf( buffer, elcount( buffer ), "0.0000 HMI_SuspLvl_SwStat_DRVU := %X\n", getValue( HMI_SuspLvl_SwStat_DRVU ) );        
	filePutString ( buffer, elcount( buffer ), hFile );
    snprintf( buffer, elcount( buffer ), "0.0000 HMI_SQC_DPC_Swstat_DRVU := %X\n", getValue( HMI_SQC_DPC_Swstat_DRVU ) );        
	filePutString ( buffer, elcount( buffer ), hFile );
    snprintf( buffer, elcount( buffer ), "0.0000 HMI_SQC_DPC_Swstat_DRVU_Auto := %X\n", getValue( HMI_SQC_DPC_Swstat_DRVU_Auto ) );        filePutString ( buffer, elcount( buffer ), hFile );
}

on timer _tDPC_SwStat_DRVU_AMG_AR
{
    putValue( HMI__STMSG_DPC_SwStat_DRVU_AMG_AR, 0 );
}


on EnvVar HMI__STMSG_DPC_SwStat_DRVU_AMG_AR
{
    long tDelay;
    if( getValue( this ) == 2 )
    {
        tDelay = getValue( HMI__STMSGT_DPC_SwStat_DRVU_AMG_AR );
        if( tDelay > 0)    
            setTimer( _tDPC_SwStat_DRVU_AMG_AR, tDelay );
        else
            putValue( HMI__STMSG_DPC_SwStat_DRVU_AMG_AR, 0 );
    }
}

on envVar HMI__STMSG_PO_DPC_SwStat_DRVU_AMG_AR
{
    if( getValue( this ) )
        openPanel("DPC_SwStat_DRVU_AMG_AR");
}

on envVar HMI_E2E_DPC_SwStat_DRVU_AMG_Inject
{
    if( getValue( this ) )
    {
        _DPC_SwStat_DRVU_AMG_AR_CRC_ErrorCnt = getValue( HMI_CRC_DPC_Swstat_DRVU_ErrorCount );
        _DPC_SwStat_DRVU_AMG_AR_SQC_TriggPos = getValue( HMI_SQC_DPC_Swstat_DRVU_TriggerPosition );
        _DPC_SwStat_DRVU_AMG_AR_SQC_WrongSeqJump = getValue( HMI_SQC_DPC_DPC_SwStat_DRVU_AMG_WrongSeq );
        _DPC_SwStat_DRVU_AMG_AR_SQC_RepeatedCnt = getValue( HMI_SQC_DPC_DPC_SwStat_DRVU_AMG_Repeated );
        _DPC_SwStat_DRVU_AMG_AR_MSG_DropCnt = getValue( HMI_SQC_DPC_DPC_SwStat_DRVU_AMG_DropCnt );
        putValue( HMI_E2E_DPC_SwStat_DRVU_AMG_State, 2 );
        _DPC_SwStat_DRVU_AMG_AR_E2E_Armed = 2;  //armed
    }
}

on EnvVar HMI_Aero_SwStat_DRVU
{
    _mDPC_SwStat_DRVU_AMG_AR.Aero_SwStat_DRVU.phys = getValue(this);
    _DPC_SwStat_DRVU_AMG_AR_SpontanFlag = 1;
}

on EnvVar HMI_AGA_SwStat_DRVU
{
    _mDPC_SwStat_DRVU_AMG_AR.AGA_SwStat_DRVU.phys = getValue(this);
    _DPC_SwStat_DRVU_AMG_AR_SpontanFlag = 1;
}

on EnvVar HMI_Chrg_Sw_Stat_DRVU_AMG
{
    _mDPC_SwStat_DRVU_AMG_AR.Chrg_Sw_Stat_DRVU_AMG.phys = getValue(this);
    _DPC_SwStat_DRVU_AMG_AR_SpontanFlag = 1;
}

on EnvVar HMI_CRC_DPC_Swstat_DRVU
{
    _mDPC_SwStat_DRVU_AMG_AR.CRC_DPC_Swstat_DRVU.phys = getValue(this);
    _DPC_SwStat_DRVU_AMG_AR_SpontanFlag = 1;
}

on EnvVar HMI_DPC_Md_Aero_Rs_HU
{
    _mDPC_SwStat_DRVU_AMG_AR.DPC_Md_Aero_Rs_HU.phys = getValue(this);
    _DPC_SwStat_DRVU_AMG_AR_SpontanFlag = 1;
}

on EnvVar HMI_ESP_SwStat_DRVU
{
    _mDPC_SwStat_DRVU_AMG_AR.ESP_SwStat_DRVU.phys = getValue(this);
    _DPC_SwStat_DRVU_AMG_AR_SpontanFlag = 1;
}

on EnvVar HMI_M_SwStat_DRVU
{
    _mDPC_SwStat_DRVU_AMG_AR.M_SwStat_DRVU.phys = getValue(this);
    _DPC_SwStat_DRVU_AMG_AR_SpontanFlag = 1;
}

on EnvVar HMI_Park_Front_Sw_Stat_DRVU_AMG
{
    _mDPC_SwStat_DRVU_AMG_AR.Park_Front_Sw_Stat_DRVU_AMG.phys = getValue(this);
    _DPC_SwStat_DRVU_AMG_AR_SpontanFlag = 1;
}

on EnvVar HMI_Rsrv1_DPC_Swstat_DRVU
{
    _mDPC_SwStat_DRVU_AMG_AR.Rsrv1_DPC_Swstat_DRVU.phys = getValue(this);
    _DPC_SwStat_DRVU_AMG_AR_SpontanFlag = 1;
}

on EnvVar HMI_Seat_D_Sw_Stat_DRVU_AMG
{
    _mDPC_SwStat_DRVU_AMG_AR.Seat_D_Sw_Stat_DRVU_AMG.phys = getValue(this);
    _DPC_SwStat_DRVU_AMG_AR_SpontanFlag = 1;
}

on EnvVar HMI_Seat_P_Sw_Stat_DRVU_AMG
{
    _mDPC_SwStat_DRVU_AMG_AR.Seat_P_Sw_Stat_DRVU_AMG.phys = getValue(this);
    _DPC_SwStat_DRVU_AMG_AR_SpontanFlag = 1;
}

on EnvVar HMI_Slick_Sw_Stat_DRVU_AMG
{
    _mDPC_SwStat_DRVU_AMG_AR.Slick_Sw_Stat_DRVU_AMG.phys = getValue(this);
    _DPC_SwStat_DRVU_AMG_AR_SpontanFlag = 1;
}

on EnvVar HMI_SQC_DPC_Swstat_DRVU
{
    _mDPC_SwStat_DRVU_AMG_AR.SQC_DPC_Swstat_DRVU.phys = getValue(this);
    _DPC_SwStat_DRVU_AMG_AR_SpontanFlag = 1;
}

on EnvVar HMI_Susp_SwStat_DRVU
{
    _mDPC_SwStat_DRVU_AMG_AR.Susp_SwStat_DRVU.phys = getValue(this);
    _DPC_SwStat_DRVU_AMG_AR_SpontanFlag = 1;
}

on EnvVar HMI_SuspLvl_SwStat_DRVU
{
    _mDPC_SwStat_DRVU_AMG_AR.SuspLvl_SwStat_DRVU.phys = getValue(this);
    _DPC_SwStat_DRVU_AMG_AR_SpontanFlag = 1;
}

DRVU_AWD_Disp_Rq_AR_check_output()
{
    if( !getValue( HMI__STMSG_DRVU_AWD_Disp_Rq_AR ) )
    {
        // Botschaft DRVU_AWD_Disp_Rq_AR ID: 645 --- Sendeart 0 cyclicX --- 
        _DRVU_AWD_Disp_Rq_AR_Cnt--;
        if( _DRVU_AWD_Disp_Rq_AR_Cnt < 1 )
        {
            DRVU_AWD_Disp_Rq_AR_output(); // Nachricht wg. abgelaufenem Zyklus ausgeben
            _DRVU_AWD_Disp_Rq_AR_Cnt = _DRVU_AWD_Disp_Rq_AR_CycleCount; // Zyklus-Zähler zurücksetzen
        }
    }
}

DRVU_AWD_Disp_Rq_AR_init()
{   /* Botschaft DRVU_AWD_Disp_Rq_AR ID: 1206 --- Sendeart 0 cyclicX --- 
BA_ "ApplMessage" BO_ 645 0;
BA_ "NmAsrMessage" BO_ 645 0;
BA_ "GenMsgMinAcceptLength" BO_ 645 8;
BA_ "GenMsgILSupport" BO_ 645 1;
BA_ "DiagState" BO_ 645 0;
BA_ "DiagRequest" BO_ 645 0;
BA_ "DiagResponse" BO_ 645 0;
BA_ "GenMsgStartValue" BO_ 645 "0";
BA_ "GenMsgStartDelayTime" BO_ 645 0;
BA_ "GenMsgCycleTime" BO_ 645 40;
BA_ "GenMsgSendType" BO_ 645 0;
    */
    _DRVU_AWD_Disp_Rq_AR_Timebase =      c_tDBKomTimer_20ms;
    _DRVU_AWD_Disp_Rq_AR_CycleCount =   40 / _DRVU_AWD_Disp_Rq_AR_Timebase;
    _DRVU_AWD_Disp_Rq_AR_StartDelay =      0 / _DRVU_AWD_Disp_Rq_AR_Timebase;
    _DRVU_AWD_Disp_Rq_AR_Cnt = _DRVU_AWD_Disp_Rq_AR_StartDelay;
    _DRVU_AWD_Disp_Rq_AR_SpontanFlag = 0;

    putValue( HMI__STMSGSD_DRVU_AWD_Disp_Rq_AR, _DRVU_AWD_Disp_Rq_AR_StartDelay * _DRVU_AWD_Disp_Rq_AR_Timebase );

    _mDRVU_AWD_Disp_Rq_AR.DrvTrq_Axle_F_Disp_Rq.phys = getValue( HMI_DrvTrq_Axle_F_Disp_Rq );
    _mDRVU_AWD_Disp_Rq_AR.DrvTrq_Axle_R_Disp_Rq.phys = getValue( HMI_DrvTrq_Axle_R_Disp_Rq );
    _mDRVU_AWD_Disp_Rq_AR.DrvTrq_FL_Disp_Rq.phys = getValue( HMI_DrvTrq_FL_Disp_Rq );
    _mDRVU_AWD_Disp_Rq_AR.DrvTrq_FR_Disp_Rq.phys = getValue( HMI_DrvTrq_FR_Disp_Rq );
    _mDRVU_AWD_Disp_Rq_AR.DrvTrq_RL_Disp_Rq.phys = getValue( HMI_DrvTrq_RL_Disp_Rq );
    _mDRVU_AWD_Disp_Rq_AR.DrvTrq_RR_Disp_Rq.phys = getValue( HMI_DrvTrq_RR_Disp_Rq );
    _mDRVU_AWD_Disp_Rq_AR.WhlTrq_FL_Disp_Rq.phys = getValue( HMI_WhlTrq_FL_Disp_Rq );
    _mDRVU_AWD_Disp_Rq_AR.WhlTrq_FR_Disp_Rq.phys = getValue( HMI_WhlTrq_FR_Disp_Rq );
    _mDRVU_AWD_Disp_Rq_AR.WhlTrq_RL_Disp_Rq.phys = getValue( HMI_WhlTrq_RL_Disp_Rq );
    _mDRVU_AWD_Disp_Rq_AR.WhlTrq_RR_Disp_Rq.phys = getValue( HMI_WhlTrq_RR_Disp_Rq );
    _mDRVU_AWD_Disp_Rq_AR.Rsrv1_DRVU_AWD_Disp_Rq.phys = getValue( HMI_Rsrv1_DRVU_AWD_Disp_Rq );
}

DRVU_AWD_Disp_Rq_AR_output(void)
{
    output( _mDRVU_AWD_Disp_Rq_AR );
}

DRVU_AWD_Disp_Rq_AR_saveEnvVars( dword hFile )
{
    filePutString("\n// Knoten EIS: DRVU_AWD_Disp_Rq_AR\n", 36, hFile );
    snprintf( buffer, elcount( buffer ), "0.0000 HMI__STMSG_DRVU_AWD_Disp_Rq_AR := %X\n", getValue( HMI__STMSG_DRVU_AWD_Disp_Rq_AR ) );        filePutString ( buffer, elcount( buffer ), hFile );
    snprintf( buffer, elcount( buffer ), "0.0000 HMI__STMSGT_DRVU_AWD_Disp_Rq_AR := %X\n", getValue( HMI__STMSGT_DRVU_AWD_Disp_Rq_AR ) );        filePutString ( buffer, elcount( buffer ), hFile );
    snprintf( buffer, elcount( buffer ), "0.0000 HMI_DrvTrq_Axle_F_Disp_Rq := %X\n", getValue( HMI_DrvTrq_Axle_F_Disp_Rq ) );        filePutString ( buffer, elcount( buffer ), hFile );
    snprintf( buffer, elcount( buffer ), "0.0000 HMI_DrvTrq_Axle_R_Disp_Rq := %X\n", getValue( HMI_DrvTrq_Axle_R_Disp_Rq ) );        filePutString ( buffer, elcount( buffer ), hFile );
    snprintf( buffer, elcount( buffer ), "0.0000 HMI_DrvTrq_FL_Disp_Rq := %X\n", getValue( HMI_DrvTrq_FL_Disp_Rq ) );        filePutString ( buffer, elcount( buffer ), hFile );
    snprintf( buffer, elcount( buffer ), "0.0000 HMI_DrvTrq_FR_Disp_Rq := %X\n", getValue( HMI_DrvTrq_FR_Disp_Rq ) );        filePutString ( buffer, elcount( buffer ), hFile );
    snprintf( buffer, elcount( buffer ), "0.0000 HMI_DrvTrq_RL_Disp_Rq := %X\n", getValue( HMI_DrvTrq_RL_Disp_Rq ) );        filePutString ( buffer, elcount( buffer ), hFile );
    snprintf( buffer, elcount( buffer ), "0.0000 HMI_DrvTrq_RR_Disp_Rq := %X\n", getValue( HMI_DrvTrq_RR_Disp_Rq ) );        filePutString ( buffer, elcount( buffer ), hFile );
    snprintf( buffer, elcount( buffer ), "0.0000 HMI_WhlTrq_FL_Disp_Rq := %X\n", getValue( HMI_WhlTrq_FL_Disp_Rq ) );        filePutString ( buffer, elcount( buffer ), hFile );
    snprintf( buffer, elcount( buffer ), "0.0000 HMI_WhlTrq_FR_Disp_Rq := %X\n", getValue( HMI_WhlTrq_FR_Disp_Rq ) );        filePutString ( buffer, elcount( buffer ), hFile );
    snprintf( buffer, elcount( buffer ), "0.0000 HMI_WhlTrq_RL_Disp_Rq := %X\n", getValue( HMI_WhlTrq_RL_Disp_Rq ) );        filePutString ( buffer, elcount( buffer ), hFile );
    snprintf( buffer, elcount( buffer ), "0.0000 HMI_WhlTrq_RR_Disp_Rq := %X\n", getValue( HMI_WhlTrq_RR_Disp_Rq ) );        filePutString ( buffer, elcount( buffer ), hFile );
    snprintf( buffer, elcount( buffer ), "0.0000 HMI_Rsrv1_DRVU_AWD_Disp_Rq := %X\n", getValue( HMI_Rsrv1_DRVU_AWD_Disp_Rq ) );        filePutString ( buffer, elcount( buffer ), hFile );
}

on timer _tDRVU_AWD_Disp_Rq_AR
{
    putValue( HMI__STMSG_DRVU_AWD_Disp_Rq_AR, 0 );
}

on EnvVar HMI__STMSG_DRVU_AWD_Disp_Rq_AR
{
    long tDelay;
    if( getValue( this ) == 2 )
    {
        tDelay = getValue( HMI__STMSGT_DRVU_AWD_Disp_Rq_AR );
        if( tDelay > 0)    
            setTimer( _tDRVU_AWD_Disp_Rq_AR, tDelay );
        else
            putValue( HMI__STMSG_DRVU_AWD_Disp_Rq_AR, 0 );
    }
}

on envVar HMI__STMSG_PO_DRVU_AWD_Disp_Rq_AR
{
    if( getValue( this ) )
        openPanel("DRVU_AWD_Disp_Rq_AR");
}

on EnvVar HMI_DrvTrq_Axle_F_Disp_Rq
{
    _mDRVU_AWD_Disp_Rq_AR.DrvTrq_Axle_F_Disp_Rq.phys = getValue(this);
}

on EnvVar HMI_DrvTrq_Axle_R_Disp_Rq
{
    _mDRVU_AWD_Disp_Rq_AR.DrvTrq_Axle_R_Disp_Rq.phys = getValue(this);
}

on EnvVar HMI_DrvTrq_FL_Disp_Rq
{
    _mDRVU_AWD_Disp_Rq_AR.DrvTrq_FL_Disp_Rq.phys = getValue(this);
}

on EnvVar HMI_DrvTrq_FR_Disp_Rq
{
    _mDRVU_AWD_Disp_Rq_AR.DrvTrq_FR_Disp_Rq.phys = getValue(this);
}

on EnvVar HMI_DrvTrq_RL_Disp_Rq
{
    _mDRVU_AWD_Disp_Rq_AR.DrvTrq_RL_Disp_Rq.phys = getValue(this);
}

on EnvVar HMI_DrvTrq_RR_Disp_Rq
{
    _mDRVU_AWD_Disp_Rq_AR.DrvTrq_RR_Disp_Rq.phys = getValue(this);
}

on EnvVar HMI_WhlTrq_FL_Disp_Rq
{
    _mDRVU_AWD_Disp_Rq_AR.WhlTrq_FL_Disp_Rq.phys = getValue(this);
}

on EnvVar HMI_WhlTrq_FR_Disp_Rq
{
    _mDRVU_AWD_Disp_Rq_AR.WhlTrq_FR_Disp_Rq.phys = getValue(this);
}

on EnvVar HMI_WhlTrq_RL_Disp_Rq
{
    _mDRVU_AWD_Disp_Rq_AR.WhlTrq_RL_Disp_Rq.phys = getValue(this);
}

on EnvVar HMI_WhlTrq_RR_Disp_Rq
{
    _mDRVU_AWD_Disp_Rq_AR.WhlTrq_RR_Disp_Rq.phys = getValue(this);
}

on EnvVar HMI_Rsrv1_DRVU_AWD_Disp_Rq
{
    _mDRVU_AWD_Disp_Rq_AR.Rsrv1_DRVU_AWD_Disp_Rq.phys = getValue(this);
}



DRVU_Stat_AR_check_output()
{
    if( !getValue( HMI__STMSG_DRVU_Stat_AR ))
    {
        // Botschaft DRVU_Stat_AR ID: 876 --- Sendeart 5 cyclicAndSpontanWithDelay --- Beginn DBKOM-Bewertung
        _DRVU_Stat_AR_Cnt--;
        if( _DRVU_Stat_AR_Cnt < 1)
        {
            // Nachricht wg. abgelaufenem Zyklus ausgeben
            DRVU_Stat_AR_output();
            _DRVU_Stat_AR_Cnt = _DRVU_Stat_AR_CycleCount; // Zyklus-Zähler zurücksetzen
            _DRVU_Stat_AR_SpontanFlag = 0; // Spontan-Flag zurücksetzen
        }
        else if( _DRVU_Stat_AR_SpontanFlag)
        {
            // Nachricht wg. spontaner Änderung ausgeben
            DRVU_Stat_AR_output();
            _DRVU_Stat_AR_SpontanFlag = 0; // Spontan-Flag zurücksetzen
        }
    }
}

DRVU_Stat_AR_init()
{    /* Botschaft DRVU_Stat_AR ID: 876 --- Sendeart 5 cyclicAndSpontanWithDelay --- 
BA_ "ApplMessage" BO_ 876 0;
BA_ "NmAsrMessage" BO_ 876 0;
BA_ "GenMsgMinAcceptLength" BO_ 876 8;
BA_ "GenMsgILSupport" BO_ 876 1;
BA_ "DiagState" BO_ 876 0;
BA_ "DiagRequest" BO_ 876 0;
BA_ "DiagResponse" BO_ 876 0;
BA_ "GenMsgStartValue" BO_ 876 "0";
BA_ "GenMsgStartDelayTime" BO_ 876 0;
BA_ "GenMsgDelayTime" BO_ 876 20;
BA_ "GenMsgNrOfRepetitions" BO_ 876 0;
BA_ "GenMsgCycleTime" BO_ 876 100;
BA_ "GenMsgSendType" BO_ 876 5;
    */
    _DRVU_Stat_AR_Timebase =             c_tDBKomTimer_20ms;
    _DRVU_Stat_AR_CycleCount =          100 / _DRVU_Stat_AR_Timebase;
    _DRVU_Stat_AR_StartDelay =            0 / _DRVU_Stat_AR_Timebase;
    _DRVU_Stat_AR_MinDelay =             20 / _DRVU_Stat_AR_Timebase;
    _DRVU_Stat_AR_Cnt = _DRVU_Stat_AR_StartDelay;
    _DRVU_Stat_AR_SpontanFlag = 0;
    _DRVU_Stat_AR_DelayCnt = 0;

    putValue( HMI__STMSGSD_DRVU_Stat_AR, _DRVU_Stat_AR_StartDelay );
    
    _mDRVU_Stat_AR.AMG_MenuSw_Psd.phys = getValue( HMI_AMG_MenuSw_Psd );
    _mDRVU_Stat_AR.AMG_StartSw_Psd.phys = getValue( HMI_AMG_StartSw_Psd );
    _mDRVU_Stat_AR.DiffLk_M_LkTrq_Rq_AMG.phys = getValue( HMI_DiffLk_M_LkTrq_Rq_AMG );
    _mDRVU_Stat_AR.DiffLk_Trq_Rq_AMG.phys = getValue( HMI_DiffLk_Trq_Rq_AMG );
	_mDRVU_Stat_AR.DRVU_LastMd_Disp_Rq_AMG.phys = getValue( HMI_DRVU_LastMd_Disp_Rq_AMG );
	_mDRVU_Stat_AR.EDIFF_MsgDisp_Rq_AMG.phys = getValue( HMI_EDIFF_MsgDisp_Rq_AMG );
    _mDRVU_Stat_AR.EngMountCtrl_Hard.phys = getValue( HMI_EngMountCtrl_Hard );
    _mDRVU_Stat_AR.EngMountCtrl_Stat.phys = getValue( HMI_EngMountCtrl_Stat );
    _mDRVU_Stat_AR.ESP_Md_Rq_AMG.phys = getValue( HMI_ESP_Md_Rq_AMG );
    _mDRVU_Stat_AR.ExhstFlap_Stg_Rq_AMG.phys = getValue( HMI_ExhstFlap_Stg_Rq_AMG );
    _mDRVU_Stat_AR.ExhstFlap_SwLED_Rq_AMG.phys = getValue( HMI_ExhstFlap_SwLED_Rq_AMG );
	_mDRVU_Stat_AR.IC_SpdLimit_MsgDisp_Rq.phys = getValue( HMI_IC_SpdLimit_MsgDisp_Rq );
	_mDRVU_Stat_AR.SpdLimit_MsgDisp_TrgRq_AMG.phys = getValue( HMI_SpdLimit_MsgDisp_TrgRq_AMG );
    _mDRVU_Stat_AR.Spoil_R_MsgDisp_Rq_AMG.phys = getValue( HMI_Spoil_R_MsgDisp_Rq_AMG );
    _mDRVU_Stat_AR.Spoil_R_Posn_AMG.phys = getValue( HMI_Spoil_R_Posn_AMG );
	_mDRVU_Stat_AR.Susp_StatMsg_Disp_Rq_AMG.phys = getValue( HMI_Susp_StatMsg_Disp_Rq_AMG );
	_mDRVU_Stat_AR.DRVU_MuteKey_Psd_AMG.phys = getValue( HMI_DRVU_MuteKey_Psd_AMG );
	_mDRVU_Stat_AR.DRVU_OBD_ErrMemClr_Trgr.phys = getValue( HMI_DRVU_OBD_ErrMemClr_Trgr );
	_mDRVU_Stat_AR.MIL_On_Rq_DRVU.phys = getValue( HMI_MIL_On_Rq_DRVU );
  	_mDRVU_Stat_AR.LoRng_Sw_Psd.phys = getValue( HMI_LoRng_Sw_Psd );
	_mDRVU_Stat_AR.SuspLvlAdjSw_Psd_DRVU.phys = getValue( HMI_SuspLvlAdjSw_Psd_DRVU );
	_mDRVU_Stat_AR.DRVU_OnKey_Psd_AMG.phys = getValue( HMI_DRVU_OnKey_Psd_AMG );
	_mDRVU_Stat_AR.DRVU_Vol_Rq_AMG.phys = getValue( HMI_DRVU_Vol_Rq_AMG );
	_mDRVU_Stat_AR.CoolShutter_Rq_DRVU_AMG.phys = getValue( HMI_CoolShutter_Rq_DRVU_AMG );
	_mDRVU_Stat_AR.DPC_GMd_Style_AMG.phys = getValue( HMI_DPC_GMd_Style_AMG );
}

void DRVU_Stat_AR_output(void)
{
    output( _mDRVU_Stat_AR );
}

DRVU_Stat_AR_saveEnvVars( dword hFile )
{
    filePutString("\n// Knoten DRVU: DRVU_Stat_AR\n", 33, hFile );
    snprintf(buffer, elcount(buffer), "0.0000 HMI__STMSG_DRVU_Stat_AR := %X\n", getValue( HMI__STMSG_DRVU_Stat_AR ));		filePutString (buffer, elcount(buffer), hFile);
    snprintf(buffer, elcount(buffer), "0.0000 HMI__STMSGT_DRVU_Stat_AR := %X\n", getValue( HMI__STMSGT_DRVU_Stat_AR ));		filePutString (buffer, elcount(buffer), hFile);
    snprintf(buffer, elcount(buffer), "0.0000 HMI_AMG_MenuSw_Psd := %X\n", getValue( HMI_AMG_MenuSw_Psd ) );		filePutString (buffer, elcount(buffer), hFile);
    snprintf(buffer, elcount(buffer), "0.0000 HMI_AMG_StartSw_Psd := %X\n", getValue( HMI_AMG_StartSw_Psd ) );		filePutString (buffer, elcount(buffer), hFile);
    snprintf(buffer, elcount(buffer), "0.0000 HMI_DiffLk_M_LkTrq_Rq_AMG := %X\n", getValue( HMI_DiffLk_M_LkTrq_Rq_AMG ) );		filePutString (buffer, elcount(buffer), hFile);
    snprintf(buffer, elcount(buffer), "0.0000 HMI_DiffLk_Trq_Rq_AMG := %X\n", getValue( HMI_DiffLk_Trq_Rq_AMG ) );		filePutString (buffer, elcount(buffer), hFile);
	snprintf(buffer, elcount(buffer), "0.0000 HMI_DRVU_LastMd_Disp_Rq_AMG := %X\n", getValue( HMI_DRVU_LastMd_Disp_Rq_AMG ) );		filePutString (buffer, elcount(buffer), hFile);
    snprintf(buffer, elcount(buffer), "0.0000 HMI_EDIFF_MsgDisp_Rq_AMG := %X\n", getValue( HMI_EDIFF_MsgDisp_Rq_AMG ) );		filePutString (buffer, elcount(buffer), hFile);
    snprintf(buffer, elcount(buffer), "0.0000 HMI_EngMountCtrl_Hard := %X\n", getValue( HMI_EngMountCtrl_Hard ) );		filePutString (buffer, elcount(buffer), hFile);
    snprintf(buffer, elcount(buffer), "0.0000 HMI_EngMountCtrl_Stat := %X\n", getValue( HMI_EngMountCtrl_Stat ) );		filePutString (buffer, elcount(buffer), hFile);
    snprintf(buffer, elcount(buffer), "0.0000 HMI_ESP_Md_Rq_AMG := %X\n", getValue( HMI_ESP_Md_Rq_AMG ) );		filePutString (buffer, elcount(buffer), hFile);
    snprintf(buffer, elcount(buffer), "0.0000 HMI_ExhstFlap_Stg_Rq_AMG := %X\n", getValue( HMI_ExhstFlap_Stg_Rq_AMG ) );		filePutString (buffer, elcount(buffer), hFile);
    snprintf(buffer, elcount(buffer), "0.0000 HMI_ExhstFlap_SwLED_Rq_AMG := %X\n", getValue( HMI_ExhstFlap_SwLED_Rq_AMG ) );		filePutString (buffer, elcount(buffer), hFile);
	snprintf(buffer, elcount(buffer), "0.0000 HMI_IC_SpdLimit_MsgDisp_Rq := %X\n", getValue( HMI_IC_SpdLimit_MsgDisp_Rq ) );		filePutString (buffer, elcount(buffer), hFile);
	snprintf(buffer, elcount(buffer), "0.0000 HMI_SpdLimit_MsgDisp_TrgRq_AMG := %X\n", getValue( HMI_SpdLimit_MsgDisp_TrgRq_AMG ) );		filePutString (buffer, elcount(buffer), hFile);
    snprintf(buffer, elcount(buffer), "0.0000 HMI_Spoil_R_MsgDisp_Rq_AMG := %X\n", getValue( HMI_Spoil_R_MsgDisp_Rq_AMG ) );		filePutString (buffer, elcount(buffer), hFile);
    snprintf(buffer, elcount(buffer), "0.0000 HMI_Spoil_R_Posn_AMG := %X\n", getValue( HMI_Spoil_R_Posn_AMG ) );		filePutString (buffer, elcount(buffer), hFile);
	snprintf(buffer, elcount(buffer), "0.0000 HMI_Susp_StatMsg_Disp_Rq_AMG := %X\n", getValue( HMI_Susp_StatMsg_Disp_Rq_AMG ) );		filePutString (buffer, elcount(buffer), hFile);
	snprintf(buffer, elcount(buffer), "0.0000 HMI_DRVU_MuteKey_Psd_AMG := %X\n", getValue( HMI_DRVU_MuteKey_Psd_AMG ) );		filePutString (buffer, elcount(buffer), hFile);
	snprintf(buffer, elcount(buffer), "0.0000 HMI_MIL_On_Rq_DRVU := %X\n", getValue( HMI_MIL_On_Rq_DRVU ) );		filePutString (buffer, elcount(buffer), hFile);
	snprintf(buffer, elcount(buffer), "0.0000 HMI_DRVU_OBD_ErrMemClr_Trgr := %X\n", getValue( HMI_DRVU_OBD_ErrMemClr_Trgr ) );		filePutString (buffer, elcount(buffer), hFile);
	snprintf(buffer, elcount(buffer), "0.0000 HMI_LoRng_Sw_Psd := %X\n", getValue( HMI_LoRng_Sw_Psd ) );		filePutString (buffer, elcount(buffer), hFile);
	snprintf(buffer, elcount(buffer), "0.0000 HMI_SuspLvlAdjSw_Psd_DRVU := %X\n", getValue( HMI_SuspLvlAdjSw_Psd_DRVU ) );		filePutString (buffer, elcount(buffer), hFile);
	snprintf(buffer, elcount(buffer), "0.0000 HMI_DRVU_OnKey_Psd_AMG := %X\n", getValue( HMI_DRVU_OnKey_Psd_AMG ) );		filePutString (buffer, elcount(buffer), hFile);
	snprintf(buffer, elcount(buffer), "0.0000 HMI_DRVU_Vol_Rq_AMG := %X\n", getValue( HMI_DRVU_Vol_Rq_AMG ) );		filePutString (buffer, elcount(buffer), hFile);
	snprintf(buffer, elcount(buffer), "0.0000 HMI_CoolShutter_Rq_DRVU_AMG := %X\n", getValue( HMI_CoolShutter_Rq_DRVU_AMG ) );		filePutString (buffer, elcount(buffer), hFile);
	snprintf(buffer, elcount(buffer), "0.0000 HMI_DPC_GMd_Style_AMG := %X\n", getValue( HMI_DPC_GMd_Style_AMG ) );		filePutString (buffer, elcount(buffer), hFile);
}

on timer _tDRVU_Stat_AR
{
	putValue( HMI__STMSG_DRVU_Stat_AR, 0 );
}

on EnvVar HMI__STMSG_DRVU_Stat_AR
{
    long tDelay;
    if( getValue( this ) == 2 )
    {
        tDelay = getValue( HMI__STMSGT_DRVU_Stat_AR );
        if( tDelay > 0 )
            setTimer( _tDRVU_Stat_AR, tDelay );
        else
            putValue( HMI__STMSG_DRVU_Stat_AR, 0 );
    }
}

on EnvVar HMI_AMG_MenuSw_Psd
{
    _mDRVU_Stat_AR.AMG_MenuSw_Psd.phys = getValue(this);
    _DRVU_Stat_AR_SpontanFlag = 1;
}

on EnvVar HMI_AMG_StartSw_Psd
{
    _mDRVU_Stat_AR.AMG_StartSw_Psd.phys = getValue(this);
    _DRVU_Stat_AR_SpontanFlag = 1;
}

on EnvVar HMI_DiffLk_M_LkTrq_Rq_AMG
{
    _mDRVU_Stat_AR.DiffLk_M_LkTrq_Rq_AMG.phys = getValue(this);
    _DRVU_Stat_AR_SpontanFlag = 1;
}

on EnvVar HMI_DiffLk_Trq_Rq_AMG
{
    _mDRVU_Stat_AR.DiffLk_Trq_Rq_AMG.phys = getValue(this);
    _DRVU_Stat_AR_SpontanFlag = 1;
}

on EnvVar HMI_DRVU_LastMd_Disp_Rq_AMG
{
    _mDRVU_Stat_AR.DRVU_LastMd_Disp_Rq_AMG.phys = getValue(this);
    _DRVU_Stat_AR_SpontanFlag = 1;
}

on EnvVar HMI_EDIFF_MsgDisp_Rq_AMG
{
    _mDRVU_Stat_AR.EDIFF_MsgDisp_Rq_AMG.phys = getValue(this);
    _DRVU_Stat_AR_SpontanFlag = 1;
}

on EnvVar HMI_EngMountCtrl_Hard
{
    _mDRVU_Stat_AR.EngMountCtrl_Hard.phys = getValue(this);
    _DRVU_Stat_AR_SpontanFlag = 1;
}

on EnvVar HMI_EngMountCtrl_Stat
{
    _mDRVU_Stat_AR.EngMountCtrl_Stat.phys = getValue(this);
    _DRVU_Stat_AR_SpontanFlag = 1;
}

on EnvVar HMI_ESP_Md_Rq_AMG
{
    _mDRVU_Stat_AR.ESP_Md_Rq_AMG.phys = getValue(this);
    _DRVU_Stat_AR_SpontanFlag = 1;
}

on EnvVar HMI_ExhstFlap_Stg_Rq_AMG
{
    _mDRVU_Stat_AR.ExhstFlap_Stg_Rq_AMG.phys = getValue(this);
    _DRVU_Stat_AR_SpontanFlag = 1;
}

on EnvVar HMI_ExhstFlap_SwLED_Rq_AMG
{
    _mDRVU_Stat_AR.ExhstFlap_SwLED_Rq_AMG.phys = getValue(this);
    _DRVU_Stat_AR_SpontanFlag = 1;
}

on EnvVar HMI_IC_SpdLimit_MsgDisp_Rq
{
    _mDRVU_Stat_AR.IC_SpdLimit_MsgDisp_Rq.phys = getValue(this);
    _DRVU_Stat_AR_SpontanFlag = 1;
}

on EnvVar HMI_SpdLimit_MsgDisp_TrgRq_AMG
{
    _mDRVU_Stat_AR.SpdLimit_MsgDisp_TrgRq_AMG.phys = getValue(this);
    _DRVU_Stat_AR_SpontanFlag = 1;
}

on EnvVar HMI_Spoil_R_MsgDisp_Rq_AMG
{
    _mDRVU_Stat_AR.Spoil_R_MsgDisp_Rq_AMG.phys = getValue(this);
    _DRVU_Stat_AR_SpontanFlag = 1;
}

on EnvVar HMI_Spoil_R_Posn_AMG
{
    _mDRVU_Stat_AR.Spoil_R_Posn_AMG.phys = getValue(this);
    _DRVU_Stat_AR_SpontanFlag = 1;
}

on EnvVar HMI_Susp_StatMsg_Disp_Rq_AMG
{
    _mDRVU_Stat_AR.Susp_StatMsg_Disp_Rq_AMG.phys = getValue(this);
    _DRVU_Stat_AR_SpontanFlag = 1;
}

on EnvVar HMI_DRVU_MuteKey_Psd_AMG
{
    _mDRVU_Stat_AR.DRVU_MuteKey_Psd_AMG.phys = getValue(this);
    _DRVU_Stat_AR_SpontanFlag = 1;
}

on EnvVar HMI_DRVU_OBD_ErrMemClr_Trgr
{
    _mDRVU_Stat_AR.DRVU_OBD_ErrMemClr_Trgr.phys = getValue(this);
    _DRVU_Stat_AR_SpontanFlag = 1;
}

on EnvVar HMI_MIL_On_Rq_DRVU
{
    _mDRVU_Stat_AR.MIL_On_Rq_DRVU.phys = getValue(this);
    _DRVU_Stat_AR_SpontanFlag = 1;
}
on EnvVar HMI_LoRng_Sw_Psd
{
    _mDRVU_Stat_AR.LoRng_Sw_Psd.phys = getValue(this);
    _DRVU_Stat_AR_SpontanFlag = 1;
}

on EnvVar HMI_SuspLvlAdjSw_Psd_DRVU
{
    _mDRVU_Stat_AR.SuspLvlAdjSw_Psd_DRVU.phys = getValue(this);
    _DRVU_Stat_AR_SpontanFlag = 1;
} 

on EnvVar HMI_DRVU_OnKey_Psd_AMG
{
    _mDRVU_Stat_AR.DRVU_OnKey_Psd_AMG.phys = getValue(this);
    _DRVU_Stat_AR_SpontanFlag = 1;
}

on EnvVar HMI_DRVU_Vol_Rq_AMG
{
    _mDRVU_Stat_AR.DRVU_Vol_Rq_AMG.phys = getValue(this);
    _DRVU_Stat_AR_SpontanFlag = 1;
}
 
on EnvVar HMI_CoolShutter_Rq_DRVU_AMG
{
    _mDRVU_Stat_AR.CoolShutter_Rq_DRVU_AMG.phys = getValue(this);
    _DRVU_Stat_AR_SpontanFlag = 1;
}
 
on EnvVar HMI_DPC_GMd_Style_AMG
{
    _mDRVU_Stat_AR.DPC_GMd_Style_AMG.phys = getValue(this);
    _DRVU_Stat_AR_SpontanFlag = 1;
}

ROE_DRVU_check_output()
{
    if( !getValue( HMI__STMSG_ROE_DRVU ))
    {
        // Botschaft ROE_DRVU ID: 2565819648 --- Sendeart 9 cyclicWithRepeatOnDemand --- 
        if( _ROE_DRVU_Cnt > 0 )
        {
            _ROE_DRVU_Cnt--;
            if( _ROE_DRVU_Cnt < 1 )
            {
                // Nachricht wg. abgelaufenem Zyklus ausgeben
                output( _mROE_DRVU );
                _ROE_DRVU_MsgRepetitions--;
                if( _ROE_DRVU_MsgRepetitions > 0 ) _ROE_DRVU_Cnt = _ROE_DRVU_CycleCount;
            }
        }
    }
}

ROE_DRVU_init()
{   /* Botschaft ROE_DRVU ID: 2565819648 --- Sendeart 9 cyclicWithRepeatOnDemand ---  
BA_ "ApplMessage" BO_ 2565819648 0;
BA_ "NmAsrMessage" BO_ 2565819648 0;
BA_ "GenMsgMinAcceptLength" BO_ 2565819648 8;
BA_ "GenMsgILSupport" BO_ 2565819648 1;
BA_ "DiagState" BO_ 2565819648 0;
BA_ "DiagRequest" BO_ 2565819648 0;
BA_ "DiagResponse" BO_ 2565819648 0;
BA_ "GenMsgStartValue" BO_ 2565819648 "0";
BA_ "GenMsgDelayTime" BO_ 2565819648 5;
BA_ "GenMsgNrOfRepetitions" BO_ 2565819648 0;
BA_ "GenMsgCycleTime" BO_ 2565819648 200;
BA_ "GenMsgSendType" BO_ 2565819648 9;
    */
    _ROE_DRVU_Timebase = 20;
    _ROE_DRVU_Cnt = 0;
    _ROE_DRVU_MsgRepetitions = 0;
    _mROE_DRVU.ROE_DTC_DRVU.phys = getValue(HMI_ROE_DTC_DRVU );
    _mROE_DRVU.ROE_DTC_Stat_DRVU.phys = getValue(HMI_ROE_DTC_Stat_DRVU );
    _mROE_DRVU.ROE_Header_DRVU.phys = getValue(HMI_ROE_Header_DRVU );
}

ROE_DRVU_saveEnvVars( dword hFile )
{
    filePutString("\n// Knoten TGW: ROE_DRVU\n", 30, hFile);
    snprintf( buffer, elcount(buffer), "0.0000 HMI__STMSG_ROE_DRVU := %X\n", getValue( HMI__STMSG_ROE_DRVU ));        filePutString( buffer, elcount(buffer), hFile);
    snprintf( buffer, elcount(buffer), "0.0000 HMI__STMSGT_ROE_DRVU := %X\n", getValue( HMI__STMSGT_ROE_DRVU ));        filePutString( buffer, elcount(buffer), hFile);
    snprintf( buffer, elcount(buffer), "0.0000 HMI_ROE_Header_DRVU := %X\n", getValue( HMI_ROE_Header_DRVU ) );        filePutString( buffer, elcount(buffer), hFile);
    snprintf( buffer, elcount(buffer), "0.0000 HMI_ROE_DTC_Stat_DRVU := %X\n", getValue( HMI_ROE_DTC_Stat_DRVU ) );        filePutString( buffer, elcount(buffer), hFile);
    snprintf( buffer, elcount(buffer), "0.0000 HMI_ROE_DTC_DRVU := %X\n", getValue( HMI_ROE_DTC_DRVU ) );        filePutString( buffer, elcount(buffer), hFile);
}

ROE_DRVU_restart(int nNumRepetitions)
{
    if( nNumRepetitions > _ROE_DRVU_MsgRepetitions )
    {
        if( _ROE_DRVU_MsgRepetitions < 1 )
            _ROE_DRVU_Cnt = 1;
        _ROE_DRVU_MsgRepetitions = nNumRepetitions;
    }
}

on envVar HMI__STMSG_PO_ROE_DRVU
{
    if( getValue( this ) )
        openPanel("ROE_DRVU");
}

on EnvVar HMI_ROE_Header_DRVU
{
    _mROE_DRVU.ROE_Header_DRVU.phys = getValue(this);
    ROE_DRVU_restart( 1 );
}

on EnvVar HMI_ROE_DTC_Stat_DRVU
{
    _mROE_DRVU.ROE_DTC_Stat_DRVU.phys = getValue(this);
    ROE_DRVU_restart( 1 );
}

on EnvVar HMI_ROE_DTC_DRVU
{
    _mROE_DRVU.ROE_DTC_DRVU.phys = getValue(this);
    ROE_DRVU_restart( 1 );
}

void ROE_EDIFF_check_output()
{
    if ( !getValue( HMI__STMSG_ROE_EDIFF ))
    {
        // Botschaft ROE_EDIFF --- Sendeart cyclicWithRepeatOnDemand --- 
        if( _ROE_EDIFF_Cnt > 0 )
        {
            _ROE_EDIFF_Cnt--;
            if( _ROE_EDIFF_Cnt < 1 )
            {
                // Nachricht wg. abgelaufenem Zyklus ausgeben
                output( _mROE_EDIFF );
                _ROE_EDIFF_MsgRepetitions--;
               if( _ROE_EDIFF_MsgRepetitions > 0 ) _ROE_EDIFF_Cnt = _ROE_EDIFF_CycleCount;
            }
       }
    }
}

ROE_EDIFF_init()
{   /* Botschaft ROE_EDIFF ID: 2565818624 --- Sendeart 9 cyclicWithRepeatOnDemand --- 
BA_ "ApplMessage" BO_ 2565818624 0;
BA_ "NmAsrMessage" BO_ 2565818624 0;
BA_ "GenMsgMinAcceptLength" BO_ 2565818624 8;
BA_ "GenMsgILSupport" BO_ 2565818624 1;
BA_ "DiagState" BO_ 2565818624 0;
BA_ "DiagRequest" BO_ 2565818624 0;
BA_ "DiagResponse" BO_ 2565818624 0;
BA_ "GenMsgStartValue" BO_ 2565818624 "0";
BA_ "GenMsgDelayTime" BO_ 2565818624 5;
BA_ "GenMsgNrOfRepetitions" BO_ 2565818624 0;
BA_ "GenMsgCycleTime" BO_ 2565818624 200;
BA_ "GenMsgSendType" BO_ 2565818624 9;
    */
    _ROE_EDIFF_Timebase =         c_tDBKomTimer_20ms;
    _ROE_EDIFF_CycleCount =     200 / _ROE_EDIFF_Timebase;
    _ROE_EDIFF_StartDelay =       0 / _ROE_EDIFF_Timebase;
    _ROE_EDIFF_Cnt = _ROE_EDIFF_StartDelay;
    _ROE_EDIFF_MsgRepetitions = 0;

    putValue( HMI__STMSGSD_ROE_EDIFF, _ROE_EDIFF_StartDelay * _ROE_EDIFF_Timebase);

    _mROE_EDIFF.ROE_DTC_EDIFF.phys = getValue( HMI_ROE_DTC_EDIFF );
    _mROE_EDIFF.ROE_DTC_Stat_EDIFF.phys = getValue( HMI_ROE_DTC_Stat_EDIFF );
    _mROE_EDIFF.ROE_Header_EDIFF.phys = getValue( HMI_ROE_Header_EDIFF );
}

void ROE_EDIFF_restart(int nNumRepetitions)
{
    if (nNumRepetitions > _ROE_EDIFF_MsgRepetitions)
    {
        if ( _ROE_EDIFF_MsgRepetitions < 1 )
            _ROE_EDIFF_Cnt = 1;
        _ROE_EDIFF_MsgRepetitions = nNumRepetitions;
    }
}

ROE_EDIFF_saveEnvVars( dword hFile )
{
    filePutString("\n// Knoten ROE_EDIFF\n", 33, hFile );
    snprintf(buffer, elcount(buffer), "0.0000 HMI__STMSG_ROE_EDIFF := %X\n", getValue( HMI__STMSG_ROE_EDIFF ));		filePutString (buffer, elcount(buffer), hFile);
    snprintf(buffer, elcount(buffer), "0.0000 HMI__STMSGT_ROE_EDIFF := %X\n", getValue( HMI__STMSGT_ROE_EDIFF ));		filePutString (buffer, elcount(buffer), hFile);
    snprintf(buffer, elcount(buffer), "0.0000 HMI_ROE_Header_EDIFF := %X\n", getValue( HMI_ROE_Header_EDIFF ) );		filePutString (buffer, elcount(buffer), hFile);
    snprintf(buffer, elcount(buffer), "0.0000 HMI_ROE_DTC_Stat_EDIFF := %X\n", getValue( HMI_ROE_DTC_Stat_EDIFF ) );		filePutString (buffer, elcount(buffer), hFile);
    snprintf(buffer, elcount(buffer), "0.0000 HMI_ROE_DTC_EDIFF := %X\n", getValue( HMI_ROE_DTC_EDIFF ) );		filePutString (buffer, elcount(buffer), hFile);
}

on EnvVar HMI_ROE_Header_EDIFF
{
    _mROE_EDIFF.ROE_Header_EDIFF.phys = getValue(this);
    ROE_EDIFF_restart(1);
}

on EnvVar HMI_ROE_DTC_Stat_EDIFF
{
    _mROE_EDIFF.ROE_DTC_Stat_EDIFF.phys = getValue(this);
    ROE_EDIFF_restart(1);
}

on EnvVar HMI_ROE_DTC_EDIFF
{
    _mROE_EDIFF.ROE_DTC_EDIFF.phys = getValue(this);
    ROE_EDIFF_restart(1);
}

void ROE_EMC_check_output()
{
    if ( !getValue( HMI__STMSG_ROE_EMC ))
    {
        // Botschaft ROE_EMC --- Sendeart cyclicWithRepeatOnDemand --- 
        if( _ROE_EMC_Cnt > 0 )
        {
            _ROE_EMC_Cnt--;
            if( _ROE_EMC_Cnt < 1 )
            {
                // Nachricht wg. abgelaufenem Zyklus ausgeben
                output( _mROE_EMC );
                _ROE_EMC_MsgRepetitions--;
               if( _ROE_EMC_MsgRepetitions > 0 ) _ROE_EMC_Cnt = _ROE_EMC_CycleCount;
            }
       }
    }
}

ROE_EMC_init()
{   /* Botschaft ROE_EMC ID: 2565818880 --- Sendeart 9 cyclicWithRepeatOnDemand ---  
BA_ "ApplMessage" BO_ 2565818880 0;
BA_ "NmAsrMessage" BO_ 2565818880 0;
BA_ "GenMsgMinAcceptLength" BO_ 2565818880 8;
BA_ "GenMsgILSupport" BO_ 2565818880 1;
BA_ "DiagState" BO_ 2565818880 0;
BA_ "DiagRequest" BO_ 2565818880 0;
BA_ "DiagResponse" BO_ 2565818880 0;
BA_ "GenMsgStartValue" BO_ 2565818880 "0";
BA_ "GenMsgDelayTime" BO_ 2565818880 5;
BA_ "GenMsgNrOfRepetitions" BO_ 2565818880 0;
BA_ "GenMsgCycleTime" BO_ 2565818880 200;
BA_ "GenMsgSendType" BO_ 2565818880 9;
    */
    _ROE_EMC_Timebase =         c_tDBKomTimer_20ms;
    _ROE_EMC_CycleCount =     200 / _ROE_EMC_Timebase;
    _ROE_EMC_StartDelay =       0 / _ROE_EMC_Timebase;
    _ROE_EMC_Cnt = _ROE_EMC_StartDelay;
    _ROE_EMC_MsgRepetitions = 0;

    putValue( HMI__STMSGSD_ROE_EMC, _ROE_EMC_StartDelay * _ROE_EMC_Timebase);

    _mROE_EMC.ROE_DTC_EMC.phys = getValue( HMI_ROE_DTC_EMC );
    _mROE_EMC.ROE_DTC_Stat_EMC.phys = getValue( HMI_ROE_DTC_Stat_EMC );
    _mROE_EMC.ROE_Header_EMC.phys = getValue( HMI_ROE_Header_EMC );
}

void ROE_EMC_restart(int nNumRepetitions)
{
    if ( nNumRepetitions > _ROE_EMC_MsgRepetitions )
    {
        if (_ROE_EMC_MsgRepetitions < 1)
            _ROE_EMC_Cnt = 1;
        _ROE_EMC_MsgRepetitions = nNumRepetitions;
    }
}

ROE_EMC_saveEnvVars( dword hFile )
{
    filePutString("\n// Knoten ROE_EMC\n", 33, hFile );
    snprintf(buffer, elcount(buffer), "0.0000 HMI__STMSG_ROE_EMC := %X\n", getValue( HMI__STMSG_ROE_EMC ));		filePutString (buffer, elcount(buffer), hFile);
    snprintf(buffer, elcount(buffer), "0.0000 HMI__STMSGT_ROE_EMC := %X\n", getValue( HMI__STMSGT_ROE_EMC ));		filePutString (buffer, elcount(buffer), hFile);
    snprintf(buffer, elcount(buffer), "0.0000 HMI_ROE_Header_EMC := %X\n", getValue( HMI_ROE_Header_EMC ) );		filePutString (buffer, elcount(buffer), hFile);
    snprintf(buffer, elcount(buffer), "0.0000 HMI_ROE_DTC_Stat_EMC := %X\n", getValue( HMI_ROE_DTC_Stat_EMC ) );		filePutString (buffer, elcount(buffer), hFile);
    snprintf(buffer, elcount(buffer), "0.0000 HMI_ROE_DTC_EMC := %X\n", getValue( HMI_ROE_DTC_EMC ) );		filePutString (buffer, elcount(buffer), hFile);
}

on EnvVar HMI_ROE_Header_EMC
{
    _mROE_EMC.ROE_Header_EMC.phys = getValue(this);
    ROE_EMC_restart(1);
}

on EnvVar HMI_ROE_DTC_Stat_EMC
{
    _mROE_EMC.ROE_DTC_Stat_EMC.phys = getValue(this);
    ROE_EMC_restart(1);
}

on EnvVar HMI_ROE_DTC_EMC
{
    _mROE_EMC.ROE_DTC_EMC.phys = getValue(this);
    ROE_EMC_restart(1);
}

void ROE_TXMC_check_output()
{
    if ( !getValue( HMI__STMSG_ROE_TXMC ))
    {
        // Botschaft ROE_TXMC --- Sendeart cyclicWithRepeatOnDemand --- 
        if( _ROE_TXMC_Cnt > 0 )
        {
            _ROE_TXMC_Cnt--;
            if( _ROE_TXMC_Cnt < 1 )
            {
                // Nachricht wg. abgelaufenem Zyklus ausgeben
                output( _mROE_TXMC );
                _ROE_TXMC_MsgRepetitions--;
               if( _ROE_TXMC_MsgRepetitions > 0 ) _ROE_TXMC_Cnt = _ROE_TXMC_CycleCount;
            }
       }
    }
}

ROE_TXMC_init()
{   /* Botschaft ROE_TXMC ID: 2565819136 --- Sendeart 9 cyclicWithRepeatOnDemand --- 
BA_ "ApplMessage" BO_ 2565819136 0;
BA_ "NmAsrMessage" BO_ 2565819136 0;
BA_ "GenMsgMinAcceptLength" BO_ 2565819136 8;
BA_ "GenMsgILSupport" BO_ 2565819136 1;
BA_ "DiagState" BO_ 2565819136 0;
BA_ "DiagRequest" BO_ 2565819136 0;
BA_ "DiagResponse" BO_ 2565819136 0;
BA_ "GenMsgStartValue" BO_ 2565819136 "0";
BA_ "GenMsgDelayTime" BO_ 2565819136 5;
BA_ "GenMsgNrOfRepetitions" BO_ 2565819136 0;
BA_ "GenMsgCycleTime" BO_ 2565819136 200;
BA_ "GenMsgSendType" BO_ 2565819136 9;
    */
    _ROE_TXMC_Timebase =         c_tDBKomTimer_20ms;
    _ROE_TXMC_CycleCount =     200 / _ROE_TXMC_Timebase;
    _ROE_TXMC_StartDelay =       0 / _ROE_TXMC_Timebase;
    _ROE_TXMC_Cnt = _ROE_TXMC_StartDelay;
    _ROE_TXMC_MsgRepetitions = 0;

    putValue( HMI__STMSGSD_ROE_TXMC, _ROE_TXMC_StartDelay * _ROE_TXMC_Timebase);

    _mROE_TXMC.ROE_DTC_TXMC.phys = getValue( HMI_ROE_DTC_TXMC );
    _mROE_TXMC.ROE_DTC_Stat_TXMC.phys = getValue( HMI_ROE_DTC_Stat_TXMC );
    _mROE_TXMC.ROE_Header_TXMC.phys = getValue( HMI_ROE_Header_TXMC );
}

void ROE_TXMC_restart(int nNumRepetitions)
{
    if (nNumRepetitions > _ROE_TXMC_MsgRepetitions)
    {
        if (_ROE_TXMC_MsgRepetitions < 1)
            _ROE_TXMC_Cnt = 1;
        _ROE_TXMC_MsgRepetitions = nNumRepetitions;
    }
}

ROE_TXMC_saveEnvVars( dword hFile )
{
    filePutString("\n// Knoten ROE_TXMC\n", 33, hFile );
    snprintf(buffer, elcount(buffer), "0.0000 HMI__STMSG_ROE_TXMC := %X\n", getValue( HMI__STMSG_ROE_TXMC ));		filePutString (buffer, elcount(buffer), hFile);
    snprintf(buffer, elcount(buffer), "0.0000 HMI__STMSGT_ROE_TXMC := %X\n", getValue( HMI__STMSGT_ROE_TXMC ));		filePutString (buffer, elcount(buffer), hFile);
    snprintf(buffer, elcount(buffer), "0.0000 HMI_ROE_Header_TXMC := %X\n", getValue( HMI_ROE_Header_TXMC ) );		filePutString (buffer, elcount(buffer), hFile);
    snprintf(buffer, elcount(buffer), "0.0000 HMI_ROE_DTC_Stat_TXMC := %X\n", getValue( HMI_ROE_DTC_Stat_TXMC ) );		filePutString (buffer, elcount(buffer), hFile);
    snprintf(buffer, elcount(buffer), "0.0000 HMI_ROE_DTC_TXMC := %X\n", getValue( HMI_ROE_DTC_TXMC ) );		filePutString (buffer, elcount(buffer), hFile);
}

on EnvVar HMI_ROE_Header_TXMC
{
    _mROE_TXMC.ROE_Header_TXMC.phys = getValue(this);
    ROE_TXMC_restart(1);
}

on EnvVar HMI_ROE_DTC_Stat_TXMC
{
    _mROE_TXMC.ROE_DTC_Stat_TXMC.phys = getValue(this);
    ROE_TXMC_restart(1);
}

on EnvVar HMI_ROE_DTC_TXMC
{
    _mROE_TXMC.ROE_DTC_TXMC.phys = getValue(this);
    ROE_TXMC_restart(1);
}

//////////////////////////////CHECK OUPUT BELOW//////////////////////////////////////////////////
DRVU_Aero_Stat_AR_check_output()
{
    if( !getValue( HMI__STMSG_DRVU_Aero_Stat_AR ))
    {
        // Botschaft DRVU_Aero_Stat_AR ID: 306 --- Sendeart 5 cyclicAndSpontanWithDelay --- Beginn DBKOM-Bewertung
        _DRVU_Aero_Stat_AR_Cnt--;
        if( _DRVU_Aero_Stat_AR_Cnt < 1)
        {
            // Nachricht wg. abgelaufenem Zyklus ausgeben
            DRVU_Aero_Stat_AR_output();
            _DRVU_Aero_Stat_AR_Cnt = _DRVU_Aero_Stat_AR_CycleCount; // Zyklus-Zähler zurücksetzen
            _DRVU_Aero_Stat_AR_SpontanFlag = 0; // Spontan-Flag zurücksetzen
        }
        else if( _DRVU_Aero_Stat_AR_SpontanFlag)
        {
            // Nachricht wg. spontaner Änderung ausgeben
            DRVU_Aero_Stat_AR_output();
            _DRVU_Aero_Stat_AR_SpontanFlag = 0; // Spontan-Flag zurücksetzen
        }
    }
}

DRVU_Aero_Stat_AR_init()
{    /* Botschaft DRVU_Aero_Stat_AR ID: 306 --- Sendeart 5 cyclicAndSpontanWithDelay --- 
BA_ "ApplMessage" BO_ 306 0;
BA_ "NmAsrMessage" BO_ 306 0;
BA_ "GenMsgMinAcceptLength" BO_ 306 8;
BA_ "GenMsgILSupport" BO_ 306 1;
BA_ "DiagState" BO_ 306 0;
BA_ "DiagRequest" BO_ 306 0;
BA_ "DiagResponse" BO_ 306 0;
BA_ "GenMsgStartValue" BO_ 306 "0";
BA_ "GenMsgStartDelayTime" BO_ 306 0;
BA_ "GenMsgDelayTime" BO_ 306 20;
BA_ "GenMsgNrOfRepetitions" BO_ 306 0;
BA_ "GenMsgCycleTime" BO_ 306 1000;
BA_ "GenMsgSendType" BO_ 306 5;
    */
    _DRVU_Aero_Stat_AR_Timebase =             c_tDBKomTimer_20ms;
    _DRVU_Aero_Stat_AR_CycleCount =          1000 / _DRVU_Aero_Stat_AR_Timebase;
    _DRVU_Aero_Stat_AR_StartDelay =            0 / _DRVU_Aero_Stat_AR_Timebase;
    _DRVU_Aero_Stat_AR_MinDelay =             20 / _DRVU_Aero_Stat_AR_Timebase;
    _DRVU_Aero_Stat_AR_Cnt = _DRVU_Aero_Stat_AR_StartDelay;
    _DRVU_Aero_Stat_AR_SpontanFlag = 0;
    _DRVU_Aero_Stat_AR_DelayCnt = 0;

    putValue( HMI__STMSGSD_DRVU_Aero_Stat_AR, _DRVU_Aero_Stat_AR_StartDelay );
    
    _mDRVU_Aero_Stat_AR.Aero_Blister_IconDisp_Rq_AMG.phys = getValue( HMI_Aero_Blister_IconDisp_Rq_AMG );
    _mDRVU_Aero_Stat_AR.Aero_SpeedLimit_Disp_Rq_AMG.phys = getValue( HMI_Aero_SpeedLimit_Disp_Rq_AMG );
    _mDRVU_Aero_Stat_AR.Aero_Spoiler_IconDisp_Rq_AMG.phys = getValue( HMI_Aero_Spoiler_IconDisp_Rq_AMG );
    _mDRVU_Aero_Stat_AR.Aero_Spoiler_MsgDisp_Rq_AMG.phys = getValue( HMI_Aero_Spoiler_MsgDisp_Rq_AMG );
	}

void DRVU_Aero_Stat_AR_output(void)
{
    output( _mDRVU_Aero_Stat_AR );
}

DRVU_Aero_Stat_AR_saveEnvVars( dword hFile )
{
    filePutString("\n// Knoten DRVU: DRVU_Aero_Stat_AR\n", 33, hFile );
    snprintf(buffer, elcount(buffer), "0.0000 HMI__STMSG_DRVU_Aero_Stat_AR := %X\n", getValue( HMI__STMSG_DRVU_Aero_Stat_AR ));		filePutString (buffer, elcount(buffer), hFile);
    snprintf(buffer, elcount(buffer), "0.0000 HMI__STMSGT_DRVU_Aero_Stat_AR := %X\n", getValue( HMI__STMSGT_DRVU_Aero_Stat_AR ));		filePutString (buffer, elcount(buffer), hFile);
    snprintf(buffer, elcount(buffer), "0.0000 HMI_Aero_Blister_IconDisp_Rq_AMG := %X\n", getValue( HMI_Aero_Blister_IconDisp_Rq_AMG ) );		filePutString (buffer, elcount(buffer), hFile);
    snprintf(buffer, elcount(buffer), "0.0000 HMI_Aero_SpeedLimit_Disp_Rq_AMG := %X\n", getValue( HMI_Aero_SpeedLimit_Disp_Rq_AMG ) );		filePutString (buffer, elcount(buffer), hFile);
    snprintf(buffer, elcount(buffer), "0.0000 HMI_Aero_Spoiler_IconDisp_Rq_AMG := %X\n", getValue( HMI_Aero_Spoiler_IconDisp_Rq_AMG ) );		filePutString (buffer, elcount(buffer), hFile);
    snprintf(buffer, elcount(buffer), "0.0000 HMI_Aero_Spoiler_MsgDisp_Rq_AMG := %X\n", getValue( HMI_Aero_Spoiler_MsgDisp_Rq_AMG ) );		filePutString (buffer, elcount(buffer), hFile);
	}

on timer _tDRVU_Aero_Stat_AR
{
	putValue( HMI__STMSG_DRVU_Aero_Stat_AR, 0 );
}

on EnvVar HMI__STMSG_DRVU_Aero_Stat_AR
{
    long tDelay;
    if( getValue( this ) == 2 )
    {
        tDelay = getValue( HMI__STMSGT_DRVU_Aero_Stat_AR );
        if( tDelay > 0 )
            setTimer( _tDRVU_Aero_Stat_AR, tDelay );
        else
            putValue( HMI__STMSG_DRVU_Aero_Stat_AR, 0 );
    }
}

on EnvVar HMI_Aero_Blister_IconDisp_Rq_AMG
{
    _mDRVU_Aero_Stat_AR.Aero_Blister_IconDisp_Rq_AMG.phys = getValue(this);
    _DRVU_Aero_Stat_AR_SpontanFlag = 1;
}

on EnvVar HMI_Aero_SpeedLimit_Disp_Rq_AMG
{
    _mDRVU_Aero_Stat_AR.Aero_SpeedLimit_Disp_Rq_AMG.phys = getValue(this);
    _DRVU_Aero_Stat_AR_SpontanFlag = 1;
}

on EnvVar HMI_Aero_Spoiler_IconDisp_Rq_AMG
{
    _mDRVU_Aero_Stat_AR.Aero_Spoiler_IconDisp_Rq_AMG.phys = getValue(this);
    _DRVU_Aero_Stat_AR_SpontanFlag = 1;
}

on EnvVar HMI_Aero_Spoiler_MsgDisp_Rq_AMG
{
    _mDRVU_Aero_Stat_AR.Aero_Spoiler_MsgDisp_Rq_AMG.phys = getValue(this);
    _DRVU_Aero_Stat_AR_SpontanFlag = 1;
}

DRVU_DrvDyn_Disp_Rq_AR_check_output()
{
    if( !getValue( HMI__STMSG_DRVU_DrvDyn_Disp_Rq_AR ) )
    {
    //  message   DRVU_DrvDyn_Disp_Rq_AR ID: 1164 --- Sendeart 5 cyclicAndSpontanWithDelay --- 
        if( _DRVU_DrvDyn_Disp_Rq_AR_DelayCnt > 0) _DRVU_DrvDyn_Disp_Rq_AR_DelayCnt--; // Mindestsendeabstand
        _DRVU_DrvDyn_Disp_Rq_AR_Cnt--;
        if( _DRVU_DrvDyn_Disp_Rq_AR_Cnt < 1 )
        {
            if( _DRVU_DrvDyn_Disp_Rq_AR_DelayCnt < 1 )
            {
                DRVU_DrvDyn_Disp_Rq_AR_output(); // Nachricht wg. abgelaufenem Zyklus ausgeben (Mindestsendeabstand eingehalten)
                _DRVU_DrvDyn_Disp_Rq_AR_SpontanFlag = 0; // Spontan-Flag zur?cksetzen
                _DRVU_DrvDyn_Disp_Rq_AR_DelayCnt = _DRVU_DrvDyn_Disp_Rq_AR_MinDelay;
            }
            else
            {
                // Spontanflag setzen damit nach Ablauf Mindestsendeabstand gesendet wird
                 _DRVU_DrvDyn_Disp_Rq_AR_SpontanFlag = 1;
            }
            _DRVU_DrvDyn_Disp_Rq_AR_Cnt = _DRVU_DrvDyn_Disp_Rq_AR_CycleCount; // Zyklus-Z?hler zur?cksetzen
        }
        else if( _DRVU_DrvDyn_Disp_Rq_AR_SpontanFlag)
        {
            if( _DRVU_DrvDyn_Disp_Rq_AR_DelayCnt < 1 )
            {
                DRVU_DrvDyn_Disp_Rq_AR_output(); // Nachricht wg. spontaner ?nderung ausgeben (Mindestsendeabstand eingehalten)
                _DRVU_DrvDyn_Disp_Rq_AR_SpontanFlag = 0; // Spontan-Flag zur?cksetzen
                _DRVU_DrvDyn_Disp_Rq_AR_DelayCnt = _DRVU_DrvDyn_Disp_Rq_AR_MinDelay;
            }
        }
    }
}

DRVU_DrvDyn_Disp_Rq_AR_init()
{   /* Botschaft DRVU_DrvDyn_Disp_Rq_AR ID: 1164 --- Sendeart 5 cyclicAndSpontanWithDelay --- 
BA_ "ApplMessage" BO_ 1164 0;
BA_ "NmAsrMessage" BO_ 1164 0;
BA_ "GenMsgMinAcceptLength" BO_ 1164 8;
BA_ "GenMsgILSupport" BO_ 1164 1;
BA_ "DiagState" BO_ 1164 0;
BA_ "DiagRequest" BO_ 1164 0;
BA_ "DiagResponse" BO_ 1164 0;
BA_ "GenMsgStartValue" BO_ 1164 "0";
BA_ "GenMsgStartDelayTime" BO_ 1164 0;
BA_ "GenMsgDelayTime" BO_ 1164 5;
BA_ "GenMsgNrOfRepetitions" BO_ 1164 0;
BA_ "GenMsgCycleTime" BO_ 1164 200;
BA_ "GenMsgSendType" BO_ 1164 5;
    */
    _DRVU_DrvDyn_Disp_Rq_AR_Timebase =             c_tDBKomTimer_20ms;
    _DRVU_DrvDyn_Disp_Rq_AR_CycleCount =          200 / _DRVU_DrvDyn_Disp_Rq_AR_Timebase;
    _DRVU_DrvDyn_Disp_Rq_AR_StartDelay =            0 / _DRVU_DrvDyn_Disp_Rq_AR_Timebase;
    _DRVU_DrvDyn_Disp_Rq_AR_MinDelay =              5 / _DRVU_DrvDyn_Disp_Rq_AR_Timebase;
    _DRVU_DrvDyn_Disp_Rq_AR_Cnt = _DRVU_DrvDyn_Disp_Rq_AR_StartDelay;
    _DRVU_DrvDyn_Disp_Rq_AR_SpontanFlag = 0;
    _DRVU_DrvDyn_Disp_Rq_AR_DelayCnt = 0;

    putValue( HMI__STMSGSD_DRVU_DrvDyn_Disp_Rq_AR, _DRVU_DrvDyn_Disp_Rq_AR_StartDelay * _DRVU_DrvDyn_Disp_Rq_AR_Timebase );

    _mDRVU_DrvDyn_Disp_Rq_AR.FAIA_Warn_Fail_Disp_Rq.phys = getValue( HMI_FAIA_Warn_Fail_Disp_Rq );
    _mDRVU_DrvDyn_Disp_Rq_AR.OvrStRate.phys = getValue( HMI_OvrStRate );
    _mDRVU_DrvDyn_Disp_Rq_AR.UnderStRate.phys = getValue( HMI_UnderStRate );
    _mDRVU_DrvDyn_Disp_Rq_AR.ASCM_Temp_ErrMsg_Disp_AMG.phys = getValue( HMI_ASCM_Temp_ErrMsg_Disp_AMG );
    _mDRVU_DrvDyn_Disp_Rq_AR.VehDriftAngl_Stat_AMG.phys = getValue( HMI_VehDriftAngl_Stat_AMG );
    _mDRVU_DrvDyn_Disp_Rq_AR.VehSlip_Disp_Rq_AMG.phys = getValue( HMI_VehSlip_Disp_Rq_AMG );
    _mDRVU_DrvDyn_Disp_Rq_AR.WhlSlip_FL_Disp_Rq_AMG.phys = getValue( HMI_WhlSlip_FL_Disp_Rq_AMG );
    _mDRVU_DrvDyn_Disp_Rq_AR.WhlSlip_FR_Disp_Rq_AMG.phys = getValue( HMI_WhlSlip_FR_Disp_Rq_AMG );
    _mDRVU_DrvDyn_Disp_Rq_AR.WhlSlip_RL_Disp_Rq_AMG.phys = getValue( HMI_WhlSlip_RL_Disp_Rq_AMG );
    _mDRVU_DrvDyn_Disp_Rq_AR.WhlSlip_RR_Disp_Rq_AMG.phys = getValue( HMI_WhlSlip_RR_Disp_Rq_AMG );
}

DRVU_DrvDyn_Disp_Rq_AR_output(void)
{
    output( _mDRVU_DrvDyn_Disp_Rq_AR );
}

DRVU_DrvDyn_Disp_Rq_AR_saveEnvVars( dword hFile )
{
    filePutString("\n// Knoten EIS: DRVU_DrvDyn_Disp_Rq_AR\n", 26, hFile );
    snprintf( buffer, elcount( buffer ), "0.0000 HMI__STMSG_DRVU_DrvDyn_Disp_Rq_AR := %X\n", getValue( HMI__STMSG_DRVU_DrvDyn_Disp_Rq_AR ) );    filePutString( buffer, elcount( buffer ), hFile );
    snprintf( buffer, elcount( buffer ), "0.0000 HMI__STMSGT_DRVU_DrvDyn_Disp_Rq_AR := %X\n", getValue( HMI__STMSGT_DRVU_DrvDyn_Disp_Rq_AR ) );    filePutString( buffer, elcount( buffer ), hFile );
    snprintf( buffer, elcount( buffer ), "0.0000 HMI_FAIA_Warn_Fail_Disp_Rq := %X\n", getValue( HMI_FAIA_Warn_Fail_Disp_Rq ) );    filePutString( buffer, elcount( buffer ), hFile );
    snprintf( buffer, elcount( buffer ), "0.0000 HMI_OvrStRate := %X\n", getValue( HMI_OvrStRate ) );    filePutString( buffer, elcount( buffer ), hFile );
    snprintf( buffer, elcount( buffer ), "0.0000 HMI_UnderStRate := %X\n", getValue( HMI_UnderStRate ) );    filePutString( buffer, elcount( buffer ), hFile );
    snprintf( buffer, elcount( buffer ), "0.0000 HMI_ASCM_Temp_ErrMsg_Disp_AMG := %X\n", getValue( HMI_ASCM_Temp_ErrMsg_Disp_AMG ) );    filePutString( buffer, elcount( buffer ), hFile );
    snprintf( buffer, elcount( buffer ), "0.0000 HMI_VehDriftAngl_Stat_AMG := %X\n", getValue( HMI_VehDriftAngl_Stat_AMG ) );    filePutString( buffer, elcount( buffer ), hFile );
    snprintf( buffer, elcount( buffer ), "0.0000 HMI_VehSlip_Disp_Rq_AMG := %X\n", getValue( HMI_VehSlip_Disp_Rq_AMG ) );    filePutString( buffer, elcount( buffer ), hFile );
    snprintf( buffer, elcount( buffer ), "0.0000 HMI_WhlSlip_FL_Disp_Rq_AMG := %X\n", getValue( HMI_WhlSlip_FL_Disp_Rq_AMG ) );    filePutString( buffer, elcount( buffer ), hFile );
    snprintf( buffer, elcount( buffer ), "0.0000 HMI_WhlSlip_FR_Disp_Rq_AMG := %X\n", getValue( HMI_WhlSlip_FR_Disp_Rq_AMG ) );    filePutString( buffer, elcount( buffer ), hFile );
    snprintf( buffer, elcount( buffer ), "0.0000 HMI_WhlSlip_RL_Disp_Rq_AMG := %X\n", getValue( HMI_WhlSlip_RL_Disp_Rq_AMG ) );    filePutString( buffer, elcount( buffer ), hFile );
    snprintf( buffer, elcount( buffer ), "0.0000 HMI_WhlSlip_RR_Disp_Rq_AMG := %X\n", getValue( HMI_WhlSlip_RR_Disp_Rq_AMG ) );    filePutString( buffer, elcount( buffer ), hFile );
}

on timer _tDRVU_DrvDyn_Disp_Rq_AR
{
    putValue( HMI__STMSG_DRVU_DrvDyn_Disp_Rq_AR, 0 );
}

on EnvVar HMI__STMSG_DRVU_DrvDyn_Disp_Rq_AR
{
    long tDelay;
    if( getValue( this ) == 2 )
    {
        tDelay = getValue( HMI__STMSGT_DRVU_DrvDyn_Disp_Rq_AR );
        if( tDelay > 0)    
            setTimer( _tDRVU_DrvDyn_Disp_Rq_AR, tDelay );
        else
            putValue( HMI__STMSG_DRVU_DrvDyn_Disp_Rq_AR, 0 );
    }
}

on envVar HMI__STMSG_PO_DRVU_DrvDyn_Disp_Rq_AR
{
    if( getValue( this ) )
        openPanel("DRVU_DrvDyn_Disp_Rq_AR");
}

on EnvVar HMI_OvrStRate
{
    _mDRVU_DrvDyn_Disp_Rq_AR.OvrStRate.phys = getValue(this);
    _DRVU_DrvDyn_Disp_Rq_AR_SpontanFlag = 1;
}

on EnvVar HMI_UnderStRate
{
    _mDRVU_DrvDyn_Disp_Rq_AR.UnderStRate.phys = getValue(this);
    _DRVU_DrvDyn_Disp_Rq_AR_SpontanFlag = 1;
}

on EnvVar HMI_ASCM_Temp_ErrMsg_Disp_AMG
{
    _mDRVU_DrvDyn_Disp_Rq_AR.ASCM_Temp_ErrMsg_Disp_AMG.phys = getValue(this);
    _DRVU_DrvDyn_Disp_Rq_AR_SpontanFlag = 1;
}

on EnvVar HMI_VehDriftAngl_Stat_AMG
{
    _mDRVU_DrvDyn_Disp_Rq_AR.VehDriftAngl_Stat_AMG.phys = getValue(this);
    _DRVU_DrvDyn_Disp_Rq_AR_SpontanFlag = 1;
}

on EnvVar HMI_VehSlip_Disp_Rq_AMG
{
    _mDRVU_DrvDyn_Disp_Rq_AR.VehSlip_Disp_Rq_AMG.phys = getValue(this);
    _DRVU_DrvDyn_Disp_Rq_AR_SpontanFlag = 1;
}

on EnvVar HMI_WhlSlip_FL_Disp_Rq_AMG
{
    _mDRVU_DrvDyn_Disp_Rq_AR.WhlSlip_FL_Disp_Rq_AMG.phys = getValue(this);
    _DRVU_DrvDyn_Disp_Rq_AR_SpontanFlag = 1;
}

on EnvVar HMI_WhlSlip_FR_Disp_Rq_AMG
{
    _mDRVU_DrvDyn_Disp_Rq_AR.WhlSlip_FR_Disp_Rq_AMG.phys = getValue(this);
    _DRVU_DrvDyn_Disp_Rq_AR_SpontanFlag = 1;
}

on EnvVar HMI_WhlSlip_RL_Disp_Rq_AMG
{
    _mDRVU_DrvDyn_Disp_Rq_AR.WhlSlip_RL_Disp_Rq_AMG.phys = getValue(this);
    _DRVU_DrvDyn_Disp_Rq_AR_SpontanFlag = 1;
}

on EnvVar HMI_WhlSlip_RR_Disp_Rq_AMG
{
    _mDRVU_DrvDyn_Disp_Rq_AR.WhlSlip_RR_Disp_Rq_AMG.phys = getValue(this);
    _DRVU_DrvDyn_Disp_Rq_AR_SpontanFlag = 1;
}

on EnvVar HMI_FAIA_Warn_Fail_Disp_Rq
{
	_mDRVU_DrvDyn_Disp_Rq_AR.FAIA_Warn_Fail_Disp_Rq.phys = getValue(this);
	_DRVU_DrvDyn_Disp_Rq_AR_SpontanFlag = 1;
}

