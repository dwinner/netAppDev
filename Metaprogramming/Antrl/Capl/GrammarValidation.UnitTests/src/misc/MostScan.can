//-----------------------------------------------------------------------------
//  Copyright (C) Continental Automotive All Right Reserved
//            File        : MostScan.can
//            Author      : Ratheesh
//            Environment : CAPL
//-----------------------------------------------------------------------------
//  Type        : CAPL script
//  Description : This file contains the simulation of MOST150 device scan
//                functions
//  Code Status : Not tested
//  Reference   : UM_OS81110_INIC_API_V01_08_02-2.pdf
//-----------------------------------------------------------------------------
//  Revision History
//  Version     Modified by         Date            Description
//  1.0         Ratheesh            01-Apr-2013     Initial version
//-----------------------------------------------------------------------------
includes
{
  #include "MostDefs.cin"
  #include "MostScan.cin"
}

variables
{
  // Scan step
  int gScanStep;
  msTimer tResponse;
  const int kResponseDelay = 1000;
  // maximum ams message length
  const int ams_data_length = 400;
  // flag indicating whether device scan is processing
  byte gbDeviceScan = 0;
  // MOST scan task timer
  msTimer tMostScan;
  // MOST scan task timeout
  const int kMostScanTOut = 2;
  // Max. scan steps
  const byte ku8_MaxScanStep = 16;
  // Scan response flag
  enum ScanResp
  {
    en_RespFalse,
    en_RespTrue
  };
  // ScanStep table
  struct ScanTab
  {
    byte u8_Step;
    byte u8_FBlockId;
    word u16_FuncId;
    enum ScanResp en_ScanResp;
  };
  struct ScanTab gst_ScanStep[ku8_MaxScanStep] =
  {
    {kScanStep_NBMIN_NodeAddress,      fblockID_NBMIN, fbNB_NodeAddress,     en_RespFalse},  // 0 - Accessible
    {kScanStep_NBMIN_GroupAddress,     fblockID_NBMIN, fbNB_GroupAddress,    en_RespFalse},  // 1 - Accessible
    {kScanStep_NBMIN_RetryParameters,  fblockID_NBMIN, fbNB_RetryParams,     en_RespFalse},  // 2 - Accessible
    {kScanStep_INIC_ConfString,        fblockID_INIC, fbINIC_VersionInfo,   en_RespFalse},  // 3 - Accessible
    {kScanStep_INIC_RMCK,              fblockID_INIC, fbINIC_RMCK,          en_RespFalse},  // 4 - Accessible
    {kScanStep_INIC_RemoteAccess,      fblockID_INIC, fbINIC_RemoteAccess,  en_RespFalse},  // 5 - Accessible
    {kScanStep_INIC_WatchdogMode,      fblockID_INIC, fbINIC_WatchdogMode,  en_RespFalse},  // 6 - Accessible
    {kScanStep_INIC_AddressConfig,     fblockID_INIC, fbNull,               en_RespFalse},  // 7 - Not Accessible
    {kScanStep_INIC_PortConfiguration, fblockID_INIC, fbNull,               en_RespFalse},  // 8 - Not Accessible
    {kScanStep_INIC_SCMConfig,         fblockID_INIC, fbNull,               en_RespFalse},  // 9 - Not Accessible
    {kScanStep_INIC_Bandwidth,         fblockID_INIC, fbINIC_Bandwidth,     en_RespFalse},  // 10 - Accessible
    {kScanStep_INIC_DeviceMode,        fblockID_INIC, fbINIC_DeviceMode,    en_RespFalse},  // 11 - Accessible
    {kScanStep_INIC_RBDOptions,        fblockID_INIC, fbNull,               en_RespFalse},  // 12 - Not Accessible
    {kScanStep_INIC_NIStartUpMode,     fblockID_INIC, fbINIC_NIStartUpMode, en_RespFalse},  // 13 - Accessible
    {kScanStep_INIC_PMIConfig,         fblockID_INIC, fbNull,               en_RespFalse},  // 14 - Not Accessible
    {kScanStep_INIC_UseStatusPin,      fblockID_INIC, fbNull,               en_RespFalse}   // 15 - Not Accessible
  };
  // MOST scan states
  enum MostScanState
  {
    en_ScanState_Init = 0,
    en_ScanState_Send = 1,
    en_ScanState_Wait = 2,
    en_ScanState_Exit = 3
  };
  enum MostScanState gen_ScanState;
  // MOST scan error codes
  enum MostScanErr
  {
    en_MostScan_Ok = 0,
    en_MostScan_Err = 1
  };
  // Scan step
  byte gu8_Idx;
  // Instance Id of scanned node
  long gu32_SelectDevice;
}

on sysvar SCAN::Button_ScanDevice
{
  if (@this == 0)
    return;

  // If scan is already in progress, then exit
  if (isTimerActive(tMostScan))
  {
    write("%FILE_NAME%: Couldn't start device scan");
  }
  else
  {
    gen_ScanState = en_ScanState_Init;
    setTimerCyclic(tMostScan, kMostScanTOut);
  }
}

on timer tMostScan
{
  ProcMostScan();
}

on timer tResponse
{
  // Do nothing
}

void ProcMostScan(void)
{
  switch(gen_ScanState)
  {
    case en_ScanState_Init:
    {
      MostScanPanelClear();
      gu32_SelectDevice = @SCAN::SelectDevice;
      if(gu32_SelectDevice == MostGetNPR(MostGetChannel()))
      {
        write("%FILE_NAME%: ProcMostScan(): Wrong device selected");
        // Exit task
        gen_ScanState = en_ScanState_Exit;
      }
      else
      {
        gbDeviceScan = 1;
        // Initialise the index
        gu8_Idx = kScanStep_NBMIN_NodeAddress;
        // State change
        gen_ScanState = en_ScanState_Send;
      }
    }
    break;
    case en_ScanState_Send:
    {
      if (gst_ScanStep[gu8_Idx].u16_FuncId != fbNull)
      {
        mostMessage * msg;
        msg.FBlockId = gst_ScanStep[gu8_Idx].u8_FBlockId;
        msg.FunctionId = gst_ScanStep[gu8_Idx].u16_FuncId;
        msg.InstanceID = gu32_SelectDevice; // InstanceID  = node position
        msg.OpType = kOpTGet;
        msg.DA = 0x400 + gu32_SelectDevice; // Destination = node position address
        if(gst_ScanStep[gu8_Idx].u8_Step == kScanStep_INIC_ConfString)
        {
          msg.BYTE(0) = 0x05;
          msg.BYTE(1) = 0x00;
          msg.DLC = 0x02;
        }
        else
        {
          msg.DLC = 0x00;
        }
        output(msg);
        gst_ScanStep[gu8_Idx].en_ScanResp = en_RespFalse;
        setTimer(tResponse, kResponseDelay);
        gen_ScanState = en_ScanState_Wait;
      }
      else
      {
        gu8_Idx++;
        if (gu8_Idx > kScanStep_INIC_UseStatusPin)
        {
          // Exit task
          gen_ScanState = en_ScanState_Exit;
        }
      }
    }
    break;
    case en_ScanState_Wait:
    {
      if (gst_ScanStep[gu8_Idx].en_ScanResp == en_RespTrue)
      {
        gu8_Idx++;
        if (gu8_Idx > kScanStep_INIC_UseStatusPin)
        {
          // Exit task
          gen_ScanState = en_ScanState_Exit;
        }
        else
        {
          gen_ScanState = en_ScanState_Send;
        }
      }
      else if(!isTimerActive(tResponse))
      {
        // Display error
        write("%FILE_NAME%: ProcMostScan(): Timeout occured for scan index %d", gu8_Idx);
        gu8_Idx++;
        if (gu8_Idx > kScanStep_INIC_UseStatusPin)
        {
          // Exit task
          gen_ScanState = en_ScanState_Exit;
        }
        else
        {
          gen_ScanState = en_ScanState_Send;
        }
      }
      else
      {
        // Do nothing
      }
    }
    break;
    case en_ScanState_Exit:
    {
      gbDeviceScan = 0;
      // Kill task itself
      cancelTimer(tMostScan);
    }
    break;
    default:
    {
      // Invalid state
    }
    break;
  }
}

on mostAMSMessage MsgChannel1.*
{
  byte data[ams_data_length];
  int length, i;
  mostAMSMessage * copy = {DLC = ams_data_length};

  // do not handle any message if not scanning the devices
  if(gbDeviceScan == 0)
    return;

  // we only react on received messages
  if( this.dir == Tx )
    return;

  // we only react on reports
  if(this.OpType <= 0x08)
    return;

  if(this.Most_IsSpy)
    return;

  // get a copy of the recieved message
  copy = this;

  if((copy.FBlockID == fblockID_INIC) || (copy.FBlockID == fblockID_NBMIN))
  {
    MostScanRespHandler(copy);
  }
}

void MostScanRespHandler(mostAMSMessage * recMsg)
{
  // Check whether we received the response for actual scanned FBlock and FunctionId
  if ((recMsg.FBlockId == gst_ScanStep[gu8_Idx].u8_FBlockId) &&
    (recMsg.FunctionId == gst_ScanStep[gu8_Idx].u16_FuncId))
  {
    // check for error response
    if (recMsg.OpType == 0xF)
    {
      if (recMsg.DLC > 0)
      {
        MostScanPrintErr(recMsg.Byte(0));
      }
      else
      {
        write("%FILE_NAME%: MostScanRespErrorCheck(): Error code received is NULL");
      }
    }
    else
    {
      MostScanPanelUpdate(recMsg);
    }
    // Set the response received flag
    gst_ScanStep[gu8_Idx].en_ScanResp = en_RespTrue;
  }
  else
  {
    write("%FILE_NAME%: MostScanRespHandler(): Unexpected message received");
  }
}

void MostScanPanelUpdate(mostAMSMessage * recMsg)
{
  switch(gst_ScanStep[gu8_Idx].u8_Step)
  {
    case kScanStep_NBMIN_NodeAddress:
    {
      word u16_NodeAddr;
      char s_NodeAddr[10];

      u16_NodeAddr = ((recMsg.Byte(0) << 8) | recMsg.Byte(1));
      snprintf(s_NodeAddr, elcount(s_NodeAddr), "0x%.4X", u16_NodeAddr);
      sysSetVariableString(sysvar::SCAN::NBMIN_NodeAddress_NodeAddress, s_NodeAddr);
    }
    break;
    case kScanStep_NBMIN_GroupAddress:
    {
      word u16_GroupAddr;
      char s_GroupAddr[10];

      u16_GroupAddr = ((recMsg.Byte(0) << 8) | recMsg.Byte(1));
      snprintf(s_GroupAddr, elcount(s_GroupAddr), "0x%.4X", u16_GroupAddr);
      sysSetVariableString(sysvar::SCAN::NBMIN_GroupAddress_GroupAddress, s_GroupAddr);
    }
    break;
    case kScanStep_NBMIN_RetryParameters:
    {
      char s_RetryTime[10];
      char s_RetryNo[10];

      snprintf(s_RetryTime, elcount(s_RetryTime), "%d", recMsg.Byte(0));
      snprintf(s_RetryNo, elcount(s_RetryNo), "%d", recMsg.Byte(1));
      sysSetVariableString(sysvar::SCAN::NBMIN_RetryParameters_RetryTime, s_RetryTime);
      sysSetVariableString(sysvar::SCAN::NBMIN_RetryParameters_RetryNumbers, s_RetryNo);
    }
    break;
    case kScanStep_INIC_ConfString:
    {
      char s_Major[10];
      char s_Minor[10];
      char s_Release[10];

      snprintf(s_Major, elcount(s_Major), "%d", recMsg.Byte(2));
      snprintf(s_Minor, elcount(s_Minor), "%d", recMsg.Byte(3));
      snprintf(s_Release, elcount(s_Release), "%d", recMsg.Byte(4));
      sysSetVariableString(sysvar::SCAN::INIC_VersionInfo_ConfString_Major, s_Major);
      sysSetVariableString(sysvar::SCAN::INIC_VersionInfo_ConfString_Minor, s_Minor);
      sysSetVariableString(sysvar::SCAN::INIC_VersionInfo_ConfString_Release, s_Release);
    }
    break;
    case kScanStep_INIC_RMCK:
    {
      char s_RMCKDivider[25];

      if (recMsg.Byte(1) < kRMCKDividerMaxSize)
      {
        snprintf(s_RMCKDivider, elcount(s_RMCKDivider), "%s", gRMCKDivider[recMsg.Byte(0)]);
        sysSetVariableString(sysvar::SCAN::INIC_RMCK_Divider, s_RMCKDivider);
      }
    }
    break;
    case kScanStep_INIC_RemoteAccess:
    {
      char s_AccessMode[10];

      if (recMsg.Byte(0) & 0x01)
      {
        snprintf(s_AccessMode, elcount(s_AccessMode),"True");
      }
      else
      {
        snprintf(s_AccessMode, elcount(s_AccessMode),"False");
      }
      sysSetVariableString(sysvar::SCAN::INIC_RemoteAccess_AccessMode, s_AccessMode);
    }
    break;
    case kScanStep_INIC_WatchdogMode:
    {
      char s_ShutdownDelay[10];

      snprintf(s_ShutdownDelay, elcount(s_ShutdownDelay), "%d", (word)((recMsg.Byte(3)<<8) | recMsg.Byte(4)));
      sysSetVariableString(sysvar::SCAN::INIC_WatchdogMode_AutoShutDownDelay, s_ShutdownDelay);
    }
    break;
//    case kScanStep_INIC_AddressConfig:
//    {
//      
//    }
//    break;
//    case kScanStep_INIC_PortConfiguration:
//    {
//      
//    }
//    break;
//    case kScanStep_INIC_SCMConfig:
//    {
//      
//    }
//    break;
    case kScanStep_INIC_Bandwidth:
    {
      char s_BW[10];

      snprintf(s_BW, elcount(s_BW), "%d", recMsg.Byte(0));
      sysSetVariableString(sysvar::SCAN::INIC_Bandwidth_AssignBWInit, s_BW);
    }
    break;
    case kScanStep_INIC_DeviceMode:
    {
      char s_DeviceMode[25];

      if (recMsg.Byte(0) < kDeviceModeMaxSize)
      {
        snprintf(s_DeviceMode, elcount(s_DeviceMode), "%s", gDeviceMode[recMsg.Byte(0)]);
        sysSetVariableString(sysvar::SCAN::INIC_DeviceMode_DeviceMode, s_DeviceMode);
      }
    }
    break;
//    case kScanStep_INIC_RBDOptions:
//    {
//      
//    }
//    break;
    case kScanStep_INIC_NIStartUpMode:
    {
      char s_Mode[10];

      snprintf(s_Mode, elcount(s_Mode), "0x%.2X", recMsg.Byte(0));
      sysSetVariableString(sysvar::SCAN::INIC_NIStartUpMode_Mode, s_Mode);
    }
    break;
//    case kScanStep_INIC_PMIConfig:
//    {
//      
//    }
//    break;
//    case kScanStep_INIC_UseStatusPin:
//    {
//      
//    }
//    break;
    default:
    {
      write("%FILE_NAME%: MostScanPanelUpdate(): Invalid index");
    }
    break;
  }
}

// Function to print string dependent on the type of error
void MostScanPrintErr(byte u8_Err)
{
  if((u8_Err > 0) && (u8_Err < kMostScanErrCodeMaxSize))
  {
    write("%FILE_NAME%: MostScanPrintErr(): ERROR - %s", gs_MostScanErrCode[u8_Err]);
  }
  else
  {
    write("%FILE_NAME%: MostScanPrintErr(): ERROR - %s", gs_MostScanErrCode[0]);
  }
}

void MostScanPanelClear(void)
{
  sysSetVariableString(sysvar::SCAN::INIC_Bandwidth_AssignBWInit, "");
  sysSetVariableString(sysvar::SCAN::INIC_DeviceMode_DeviceMode, "");
  sysSetVariableString(sysvar::SCAN::INIC_NIStartUpMode_Mode, "");
  sysSetVariableString(sysvar::SCAN::INIC_RemoteAccess_AccessMode, "");
  sysSetVariableString(sysvar::SCAN::INIC_RMCK_Divider, "");
  sysSetVariableString(sysvar::SCAN::INIC_VersionInfo_ConfString_Major, "");
  sysSetVariableString(sysvar::SCAN::INIC_VersionInfo_ConfString_Minor, "");
  sysSetVariableString(sysvar::SCAN::INIC_VersionInfo_ConfString_Release, "");
  sysSetVariableString(sysvar::SCAN::INIC_WatchdogMode_AutoShutDownDelay, "");
  sysSetVariableString(sysvar::SCAN::NBMIN_GroupAddress_GroupAddress, "");
  sysSetVariableString(sysvar::SCAN::NBMIN_NodeAddress_NodeAddress, "");
  sysSetVariableString(sysvar::SCAN::NBMIN_RetryParameters_RetryNumbers, "");
  sysSetVariableString(sysvar::SCAN::NBMIN_RetryParameters_RetryTime, "");
}
