/*@!Encoding:1252*/
includes
{
}

variables
{
  //
  // Global variables
  //
  msTimer msTimerStressCyclic;
  int toggle = 0;
  ethernetPacket gStressTxPacket;
  int StressCyclicActive = 0;
  int StressCyclicTime = 0;
}

on start
{
  byte dstbuf[17];
  sysvarData * svData1;
  byte srcbuf[17];
  long TypeID;
  long MACsize = 17;

  TypeID=8100;
  
  srcbuf[0]= '0';
  srcbuf[1]= '0';
  srcbuf[2]= ':';
  srcbuf[3]= '5';
  srcbuf[4]= '4';
  srcbuf[5]= ':';
  srcbuf[6]= 'A';
  srcbuf[7]= 'F';
  srcbuf[8]= ':';
  srcbuf[9]= '8';
  srcbuf[10]= '6';
  srcbuf[11]= ':';
  srcbuf[12]= '0';
  srcbuf[13]= '2';
  srcbuf[14]= ':';
  srcbuf[15]= 'F';
  srcbuf[16]= '9';

  dstbuf[0]= '3';
  dstbuf[1]= 'C';
  dstbuf[2]= ':';
  dstbuf[3]= '1';
  dstbuf[4]= 'E';
  dstbuf[5]= ':';
  dstbuf[6]= '0';
  dstbuf[7]= '4';
  dstbuf[8]= ':';
  dstbuf[9]= 'F';
  dstbuf[10]= '3';
  dstbuf[11]= ':';
  dstbuf[12]= 'A';
  dstbuf[13]= 'F';
  dstbuf[14]= ':';
  dstbuf[15]= 'A';
  dstbuf[16]= 'D';
  //0:54:AF:86:02:F9";

  StressCyclicActive = sysGetVariableInt(sysvar::EthStress::StressCyclic);
  StressCyclicTime = sysGetVariableInt(sysvar::EthStress::StressCycleTime);
  if (StressCyclicActive)
  {
    settimer(msTimerStressCyclic,StressCyclicTime);
  }

  sysSetVariableData(sysvar::EthStress::EthSourceMacAddress, dstbuf, MACsize);  //source address 3C:1E:04:F3:AF:AD
  sysSetVariableData(sysvar::EthStress::EthDestinationMacAddress, srcbuf, MACsize);  //putValue(EthDestinationMacAddress,"00:54:AF:86:02:F9");
  sysSetVariableInt(sysvar::EthStress::EthType,TypeID);//Type 8100

}
on timer msTimerStressCyclic
{
  canceltimer(msTimerStressCyclic);
  if(toggle==0)
  {
    toggle=1;
    StressStart();
  }
  else
  {
    toggle=0;
    StressStop();
  }
  StressCyclicActive = sysGetVariableInt(sysvar::EthStress::StressCyclic);
  StressCyclicTime = sysGetVariableInt(sysvar::EthStress::StressCycleTime);
  if ((StressCyclicActive==1)||(toggle==1))//check if last cycle has to be finished or if option is deactivated in panel
  {
    settimer(msTimerStressCyclic,StressCyclicTime);
  }
}
/// <EthStress_Control>
on sysvar sysvar::EthStress::StressCyclic
{
    StressCyclicActive = sysGetVariableInt(sysvar::EthStress::StressCyclic);
    StressCyclicTime = sysGetVariableInt(sysvar::EthStress::StressCycleTime);
    if (StressCyclicActive)
    {
      settimer(msTimerStressCyclic,StressCyclicTime);
    }
}

on sysvar sysvar::EthStress::Start
{
  if (@this > 0)
  {
    StressStart();
  }
}

/// <EthStress_Control>
on sysvar sysvar::EthStress::Stop
{
  if (@this > 0)
  {
    StressStop();
  }
}

/// <EthStress_Control>
void StressStart()
{
  dword numberOfFrames;
  long  result;
  byte  data[1600];
  long  dataLength, i;
  char  sourceMacAddr[20];
  char  destinationMacAddr[20];
  
  sysGetVariableData( sysvar::EthStress::EthData, data, dataLength );
  sysGetVariableString( sysvar::EthStress::EthSourceMacAddress, sourceMacAddr, elcount(sourceMacAddr) );
  sysGetVariableString( sysvar::EthStress::EthDestinationMacAddress, destinationMacAddr, elcount(destinationMacAddr) );
  
  // set Ethernet packet data
  gStressTxPacket.msgChannel  = 1;
  gStressTxPacket.source      = EthGetMacAddressAsNumber( sourceMacAddr );
  gStressTxPacket.destination = EthGetMacAddressAsNumber( destinationMacAddr );
  gStressTxPacket.Length      = dataLength;
  gStressTxPacket.type        = @sysvar::EthStress::EthType;
  //DaCa: add VLAN info to 5
  gStressTxPacket.SetVlan(0x8100, 0x0005);
  
  for( i = 0; i < dataLength; i++ )
  {
    gStressTxPacket.Byte(i) = data[i];
  }
  
  Eth1.status;
  
  // set number of frames to send
  if (@sysvar::EthStress::EnableNumberOfFrames > 0)
  {
    numberOfFrames = @sysvar::EthStress::NumberOfFrames;
  }
  else
  {
    numberOfFrames = 0xFFFFFFFF;
  }
  
  // start sending with packet generator...
  if (@sysvar::EthStress::EnableCounter == 0)
  {
    // ... without counter
    result = EthStartPacketGenerator( gStressTxPacket
                                    , @sysvar::EthStress::TransmissionRate
                                    , numberOfFrames );
  }
  else if (@sysvar::EthStress::EnableCounter > 0)
  {
    // ... wit counter
    result = EthStartPacketGenerator( gStressTxPacket
                                    , @sysvar::EthStress::TransmissionRate
                                    , numberOfFrames
                                    , @sysvar::EthStress::CounterByteOffset );
  }
  
  if (result == 0)
  {
    enableControl( "EthStress", "StartButton", 0 );
    enableControl( "EthStress", "StopButton", 1 );
  }
  else
  {
    enableControl( "EthStress", "StartButton", 1 );
    enableControl( "EthStress", "StopButton", 0 );
  }
}

/// <EthStress_Control>
void StressStop()
{
  EthStopPacketGenerator( gStressTxPacket );

  enableControl( "EthStress", "StartButton", 1 );
  enableControl( "EthStress", "StopButton", 0 );
}

