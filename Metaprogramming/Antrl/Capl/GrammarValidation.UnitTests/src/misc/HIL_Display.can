/*@!Encoding:1252*/
/*
based on database : MQB2020_Kombi_KW24_19_EIDs_20190612_Mar.dbc
*/

variables
{
    word msgDEV_Kombi_54_Ctr=0;
    word DEV_Kombi_54_defTxCycle;
    double mDEV_Kombi_54_time_prev = 0;
    double mDEV_Kombi_54_cycleTime = 0;
    double DEV_Kombi_54_min=0, DEV_Kombi_54_max = 0;
    word DEV_Kombi_54_RedStatCtr;
    byte DEV_Kombi_54_TxFlg;
}

on message DEV_Kombi_11
{
    putValue( HIL_b_SI_BUS_01, this.b_SI_BUS_01.phys );
    putValue( HIL_b_SI_BUS_02, this.b_SI_BUS_02.phys );
    putValue( HIL_b_SI_BUS_03, this.b_SI_BUS_03.phys );
    putValue( HIL_b_SI_BUS_04, this.b_SI_BUS_04.phys );
    putValue( HIL_b_SI_BUS_06, this.b_SI_BUS_06.phys );
    putValue( HIL_b_SI_BUS_10, this.b_SI_BUS_10.phys );
    putValue( HIL_b_SI_BUS_14, this.b_SI_BUS_14.phys );
    putValue( HIL_s_ara_DLC_fehler, this.s_ara_DLC_fehler.phys );
    putValue( HIL_s_ara_falsch_codiert, this.s_ara_falsch_codiert.phys );
    putValue( HIL_s_ara_timeout_fehler, this.s_ara_timeout_fehler.phys );
    putValue( HIL_s_bcm1_DLC_fehler, this.s_bcm1_DLC_fehler.phys );
    putValue( HIL_s_bcm1_timeout, this.s_bcm1_timeout.phys );
    putValue( HIL_s_bcm1_timeout_fehler, this.s_bcm1_timeout_fehler.phys );
    putValue( HIL_s_daempfer_DLC_fehler, this.s_daempfer_DLC_fehler.phys );
    putValue( HIL_s_daempfer_falsch_codiert, this.s_daempfer_falsch_codiert.phys );
    putValue( HIL_s_daempfer_timeout, this.s_daempfer_timeout.phys );
    putValue( HIL_s_daempfer_timeout_fehler, this.s_daempfer_timeout_fehler.phys );
    putValue( HIL_s_DCDC_02_DLC_fehler, this.s_DCDC_02_DLC_fehler.phys );
    putValue( HIL_s_DCDC_02_timeout, this.s_DCDC_02_timeout.phys );
    putValue( HIL_s_DCDC_02_timeout_fehler, this.s_DCDC_02_timeout_fehler.phys );
    putValue( HIL_s_eCall_timeout_fehler, this.s_eCall_timeout_fehler.phys );
    putValue( HIL_s_elv_DLC_fehler, this.s_elv_DLC_fehler.phys );
    putValue( HIL_s_elv_falsch_codiert, this.s_elv_falsch_codiert.phys );
    putValue( HIL_s_elv_timeout, this.s_elv_timeout.phys );
    putValue( HIL_s_elv_timeout_fehler, this.s_elv_timeout_fehler.phys );
    putValue( HIL_s_epb_falsch_codiert, this.s_epb_falsch_codiert.phys );
    putValue( HIL_s_EPS_01_fifo_safe_state, this.s_EPS_01_fifo_safe_state.phys );
    putValue( HIL_s_eps_falsch_codiert, this.s_eps_falsch_codiert.phys );
    putValue( HIL_s_ESP_24_fifo_safe_state, this.s_ESP_24_fifo_safe_state.phys );
    putValue( HIL_s_gateway_DLC_fehler, this.s_gateway_DLC_fehler.phys );
    putValue( HIL_s_gateway_timeout, this.s_gateway_timeout.phys );
    putValue( HIL_s_gateway_timeout_fehler, this.s_gateway_timeout_fehler.phys );
    putValue( HIL_s_HVLM_05_timeout, this.s_HVLM_05_timeout.phys );
    putValue( HIL_s_kessy_timeout, this.s_kessy_timeout.phys );
    putValue( HIL_s_KFG_DLC_fehler, this.s_KFG_DLC_fehler.phys );
    putValue( HIL_s_KFG_timeout, this.s_KFG_timeout.phys );
    putValue( HIL_s_KFG_timeout_fehler, this.s_KFG_timeout_fehler.phys );
    putValue( HIL_s_Klima_12_timeout, this.s_Klima_12_timeout.phys );
    putValue( HIL_s_ldw_DLC_fehler, this.s_ldw_DLC_fehler.phys );
    putValue( HIL_s_ldw_timeout, this.s_ldw_timeout.phys );
    putValue( HIL_s_ldw_timeout_fehler, this.s_ldw_timeout_fehler.phys );
    putValue( HIL_s_mainunit_DLC_fehler, this.s_mainunit_DLC_fehler.phys );
    putValue( HIL_s_mainunit_timeout, this.s_mainunit_timeout.phys );
    putValue( HIL_s_mainunit_timeout_fehler, this.s_mainunit_timeout_fehler.phys );
    putValue( HIL_s_mem_bfs_timeout, this.s_mem_bfs_timeout.phys );
    putValue( HIL_s_mem_fs_timeout, this.s_mem_fs_timeout.phys );
    putValue( HIL_s_motor_DLC_fehler, this.s_motor_DLC_fehler.phys );
    putValue( HIL_s_motor_timeout, this.s_motor_timeout.phys );
    putValue( HIL_s_motor_timeout_fehler, this.s_motor_timeout_fehler.phys );
    putValue( HIL_s_MVK_01_CRC_fehler2, this.s_MVK_01_CRC_fehler2.phys );
    putValue( HIL_s_MVK_01_fifo_bz_fehler, this.s_MVK_01_fifo_bz_fehler.phys );
    putValue( HIL_s_MVK_01_fifo_safe_state, this.s_MVK_01_fifo_safe_state.phys );
    putValue( HIL_s_MVK_01_fifo_to_fehler, this.s_MVK_01_fifo_to_fehler.phys );
    putValue( HIL_s_ocu_timeout, this.s_ocu_timeout.phys );
    putValue( HIL_s_perso_DLC_fehler, this.s_perso_DLC_fehler.phys );
    putValue( HIL_s_perso_timeout, this.s_perso_timeout.phys );
    putValue( HIL_s_perso_timeout_fehler, this.s_perso_timeout_fehler.phys );
    putValue( HIL_s_pla_DLC_fehler, this.s_pla_DLC_fehler.phys );
    putValue( HIL_s_pla_timeout, this.s_pla_timeout.phys );
    putValue( HIL_s_pla_timeout_fehler, this.s_pla_timeout_fehler.phys );
    putValue( HIL_s_TSL_timeout, this.s_TSL_timeout.phys );
    putValue( HIL_s_TSR_timeout, this.s_TSR_timeout.phys );
}

on start
{
    DEV_Kombi_54_min = DEV_Kombi_54_max = DEV_Kombi_54_defTxCycle;
    DEV_Kombi_54_RedStatCtr = 0;
}

on message DEV_Kombi_12
{
    putValue( HIL_s_acc_DLC_fehler, this.s_acc_DLC_fehler.phys );
    putValue( HIL_s_acc_timeout, this.s_acc_timeout.phys );
    putValue( HIL_s_acc_timeout_fehler, this.s_acc_timeout_fehler.phys );
    putValue( HIL_s_afs_DLC_fehler, this.s_afs_DLC_fehler.phys );
    putValue( HIL_s_afs_timeout, this.s_afs_timeout.phys );
    putValue( HIL_s_afs_timeout_fehler, this.s_afs_timeout_fehler.phys );
    putValue( HIL_s_aga_DLC_fehler, this.s_aga_DLC_fehler.phys );
    putValue( HIL_s_aga_timeout, this.s_aga_timeout.phys );
    putValue( HIL_s_aga_timeout_fehler, this.s_aga_timeout_fehler.phys );
    putValue( HIL_s_Airbag_01_DLC_fehler, this.s_Airbag_01_DLC_fehler.phys );
    putValue( HIL_s_Airbag_01_fifo_safe_state, this.s_Airbag_01_fifo_safe_state.phys );
    putValue( HIL_s_anhaenger_timeout, this.s_anhaenger_timeout.phys );
    putValue( HIL_s_ara_timeout, this.s_ara_timeout.phys );
    putValue( HIL_s_awv_DLC_fehler, this.s_awv_DLC_fehler.phys );
    putValue( HIL_s_awv_timeout, this.s_awv_timeout.phys );
    putValue( HIL_s_awv_timeout_fehler, this.s_awv_timeout_fehler.phys );
    putValue( HIL_s_BEM_06_CRC_fehler2, this.s_BEM_06_CRC_fehler2.phys );
    putValue( HIL_s_BEM_06_fifo_safe_state, this.s_BEM_06_fifo_safe_state.phys );
    putValue( HIL_s_bus_off_fehler, this.s_bus_off_fehler.phys );
    putValue( HIL_s_can_ram_check_fehler, this.s_can_ram_check_fehler.phys );
    putValue( HIL_s_feststellbremse_konv, this.s_feststellbremse_konv.phys );
    putValue( HIL_s_rdk_DLC_fehler, this.s_rdk_DLC_fehler.phys );
    putValue( HIL_s_rdk_falsch_codiert, this.s_rdk_falsch_codiert.phys );
    putValue( HIL_s_rdk_timeout, this.s_rdk_timeout.phys );
    putValue( HIL_s_rdk_timeout_fehler, this.s_rdk_timeout_fehler.phys );
    putValue( HIL_s_rka_DLC_fehler, this.s_rka_DLC_fehler.phys );
    putValue( HIL_s_rka_falsch_codiert, this.s_rka_falsch_codiert.phys );
    putValue( HIL_s_rka_timeout, this.s_rka_timeout.phys );
    putValue( HIL_s_rka_timeout_fehler, this.s_rka_timeout_fehler.phys );
    putValue( HIL_s_SCR_timeout, this.s_SCR_timeout.phys );
    putValue( HIL_s_SMLS_01_timeout, this.s_SMLS_01_timeout.phys );
    putValue( HIL_s_STH_01_timeout, this.s_STH_01_timeout.phys );
    putValue( HIL_s_swa_DLC_fehler, this.s_swa_DLC_fehler.phys );
    putValue( HIL_s_swa_falsch_codiert, this.s_swa_falsch_codiert.phys );
    putValue( HIL_s_swa_timeout, this.s_swa_timeout.phys );
    putValue( HIL_s_swa_timeout_fehler, this.s_swa_timeout_fehler.phys );
    putValue( HIL_s_TCO_01_DLC_fehler, this.s_TCO_01_DLC_fehler.phys );
    putValue( HIL_s_TCO_01_timeout, this.s_TCO_01_timeout.phys );
    putValue( HIL_s_TCO_01_timeout_fehler, this.s_TCO_01_timeout_fehler.phys );
    putValue( HIL_s_verdeck_01_timeout, this.s_verdeck_01_timeout.phys );
    putValue( HIL_s_Wischer_timeout, this.s_Wischer_timeout.phys );
}

on message DEV_Kombi_13
{
    putValue( HIL_b_SI_CAB_V09, this.b_SI_CAB_V09.phys );
    putValue( HIL_s_Airbag_01_CRC_fehler2, this.s_Airbag_01_CRC_fehler2.phys );
    putValue( HIL_s_Airbag_01_fifo_bz_fehler, this.s_Airbag_01_fifo_bz_fehler.phys );
    putValue( HIL_s_Airbag_01_fifo_to_fehler, this.s_Airbag_01_fifo_to_fehler.phys );
    putValue( HIL_s_BEM_06_fifo_bz_fehler, this.s_BEM_06_fifo_bz_fehler.phys );
    putValue( HIL_s_BEM_06_fifo_to_fehler, this.s_BEM_06_fifo_to_fehler.phys );
    putValue( HIL_s_BMS_DLC_fehler, this.s_BMS_DLC_fehler.phys );
    putValue( HIL_s_BMS_timeout, this.s_BMS_timeout.phys );
    putValue( HIL_s_BMS_timeout_fehler, this.s_BMS_timeout_fehler.phys );
    putValue( HIL_s_EPB_03_CRC_fehler2, this.s_EPB_03_CRC_fehler2.phys );
    putValue( HIL_s_EPB_03_fifo_bz_fehler, this.s_EPB_03_fifo_bz_fehler.phys );
    putValue( HIL_s_EPB_03_fifo_to_fehler, this.s_EPB_03_fifo_to_fehler.phys );
    putValue( HIL_s_EPS_01_CRC_fehler2, this.s_EPS_01_CRC_fehler2.phys );
    putValue( HIL_s_EPS_01_fifo_bz_fehler, this.s_EPS_01_fifo_bz_fehler.phys );
    putValue( HIL_s_EPS_01_fifo_to_fehler, this.s_EPS_01_fifo_to_fehler.phys );
    putValue( HIL_s_ESP_24_CRC_fehler2, this.s_ESP_24_CRC_fehler2.phys );
    putValue( HIL_s_ESP_24_fifo_bz_fehler, this.s_ESP_24_fifo_bz_fehler.phys );
    putValue( HIL_s_ESP_24_fifo_to_fehler, this.s_ESP_24_fifo_to_fehler.phys );
    putValue( HIL_s_ESP_30_CRC_fehler2, this.s_ESP_30_CRC_fehler2.phys );
    putValue( HIL_s_ESP_30_fifo_bz_fehler, this.s_ESP_30_fifo_bz_fehler.phys );
    putValue( HIL_s_ESP_30_fifo_safe_state, this.s_ESP_30_fifo_safe_state.phys );
    putValue( HIL_s_ESP_30_fifo_to_fehler, this.s_ESP_30_fifo_to_fehler.phys );
    putValue( HIL_s_LSH_timeout, this.s_LSH_timeout.phys );
    putValue( HIL_s_TSG_FT_DLC_fehler, this.s_TSG_FT_DLC_fehler.phys );
    putValue( HIL_s_TSG_FT_timeout, this.s_TSG_FT_timeout.phys );
    putValue( HIL_s_TSG_FT_timeout_fehler, this.s_TSG_FT_timeout_fehler.phys );
    putValue( HIL_s_WBA_03_CRC_fehler2, this.s_WBA_03_CRC_fehler2.phys );
    putValue( HIL_s_WBA_03_fifo_bz_fehler, this.s_WBA_03_fifo_bz_fehler.phys );
    putValue( HIL_s_WBA_03_fifo_safe_state, this.s_WBA_03_fifo_safe_state.phys );
    putValue( HIL_s_WBA_03_fifo_to_fehler, this.s_WBA_03_fifo_to_fehler.phys );
}

on message DEV_Kombi_14
{
    putValue( HIL_b_BCM_Anf_AAW_MoLaWa, this.b_BCM_Anf_AAW_MoLaWa.phys );
    putValue( HIL_b_BCM_anf_VLW, this.b_BCM_anf_VLW.phys );
    putValue( HIL_b_BCM_Handbremse_Hinweis, this.b_BCM_Handbremse_Hinweis.phys );
    putValue( HIL_b_BCM_Remotestart_KL15_Anf, this.b_BCM_Remotestart_KL15_Anf.phys );
    putValue( HIL_b_BCM_Waehlhebel_P_Hinweis, this.b_BCM_Waehlhebel_P_Hinweis.phys );
    putValue( HIL_b_ELV_LED_Rot, this.b_ELV_LED_Rot.phys );
    putValue( HIL_b_ELV_Txt_Defekt, this.b_ELV_Txt_Defekt.phys );
    putValue( HIL_b_ELV_Txt_Lkg_Bewegen, this.b_ELV_Txt_Lkg_Bewegen.phys );
    putValue( HIL_b_ELV_Txt_Werkstatt, this.b_ELV_Txt_Werkstatt.phys );
    putValue( HIL_b_FBS_Warn_Schluessel_Batt, this.b_FBS_Warn_Schluessel_Batt.phys );
    putValue( HIL_b_GE_Tipschaltempfehlung_verfuegbar, this.b_GE_Tipschaltempfehlung_verfuegbar.phys );
    putValue( HIL_b_KL_Geblaese_Status, this.b_KL_Geblaese_Status.phys );
    putValue( HIL_b_KST_Fahrerhinweis_6, this.b_KST_Fahrerhinweis_6.phys );
    putValue( HIL_b_KST_Txt_Komfortabschaltung, this.b_KST_Txt_Komfortabschaltung.phys );
    putValue( HIL_b_KST_Txt_P_Gang, this.b_KST_Txt_P_Gang.phys );
    putValue( HIL_b_KST_Txt_Panikabschaltung, this.b_KST_Txt_Panikabschaltung.phys );
    putValue( HIL_b_KST_Txt_Werkstatt, this.b_KST_Txt_Werkstatt.phys );
    putValue( HIL_b_KST_Warn_P2_ZST_def, this.b_KST_Warn_P2_ZST_def.phys );
    putValue( HIL_b_KST_Zuendungswarnung, this.b_KST_Zuendungswarnung.phys );
    putValue( HIL_b_RSt_Fahrerhinweise, this.b_RSt_Fahrerhinweise.phys );
    putValue( HIL_b_ZV_SafeFunktion_aktiv, this.b_ZV_SafeFunktion_aktiv.phys );
    putValue( HIL_hmi_wba_fahrstufe_anzeigen, this.hmi_wba_fahrstufe_anzeigen.phys );
    putValue( HIL_s_kanal1_belegt, this.s_kanal1_belegt.phys );
    putValue( HIL_s_kanal2_belegt, this.s_kanal2_belegt.phys );
    putValue( HIL_s_KBI_Audioabsenkung_MIB, this.s_KBI_Audioabsenkung_MIB.phys );
    putValue( HIL_s_schluesselwarnung, this.s_schluesselwarnung.phys );
    putValue( HIL_s_zpm_akustik_grundlautstaerke, this.s_zpm_akustik_grundlautstaerke.phys );
    putValue( HIL_s_zpm_akustik_ID, this.s_zpm_akustik_ID.phys );
    putValue( HIL_s_zpm_akustik_kennfeld_ID, this.s_zpm_akustik_kennfeld_ID.phys );
    putValue( HIL_s_zpm_akustik_sync, this.s_zpm_akustik_sync.phys );
}

on message DEV_Kombi_15
{
    putValue( HIL_b_GE_Sollgang, this.b_GE_Sollgang.phys );
    putValue( HIL_b_GE_Sumpftemperatur, this.b_GE_Sumpftemperatur.phys );
    putValue( HIL_b_Getriebe_14_alt, this.b_Getriebe_14_alt.phys );
    putValue( HIL_b_MO_Antriebsstrang_Warnung_HS, this.b_MO_Antriebsstrang_Warnung_HS.phys );
    putValue( HIL_b_MO_WH_Texte, this.b_MO_WH_Texte.phys );
    putValue( HIL_b_WBA_Anforderung_Akustik, this.b_WBA_Anforderung_Akustik.phys );
    putValue( HIL_b_WBA_eing_Gang_02, this.b_WBA_eing_Gang_02.phys );
    putValue( HIL_b_WBA_Fahrstufe_02, this.b_WBA_Fahrstufe_02.phys );
    putValue( HIL_b_WBA_GE_Texte, this.b_WBA_GE_Texte.phys );
    putValue( HIL_b_WBA_GE_Texte_02, this.b_WBA_GE_Texte_02.phys );
    putValue( HIL_b_WBA_GE_Warnung_02, this.b_WBA_GE_Warnung_02.phys );
    putValue( HIL_b_WBA_GE_Zusatzwarnungen, this.b_WBA_GE_Zusatzwarnungen.phys );
    putValue( HIL_b_WBA_Schaltschema_02, this.b_WBA_Schaltschema_02.phys );
    putValue( HIL_b_WBA_Schaltschema_Fahreraktion, this.b_WBA_Schaltschema_Fahreraktion.phys );
    putValue( HIL_b_WBA_Schaltschema_FS_inaktiv, this.b_WBA_Schaltschema_FS_inaktiv.phys );
    putValue( HIL_b_WBA_Schaltschema_FS_vorwaerts, this.b_WBA_Schaltschema_FS_vorwaerts.phys );
    putValue( HIL_b_WBA_Schaltschema_Tippgasse, this.b_WBA_Schaltschema_Tippgasse.phys );
    putValue( HIL_b_WBA_Segeln_aktiv, this.b_WBA_Segeln_aktiv.phys );
    putValue( HIL_b_WBA_Shiftlock_Lampe, this.b_WBA_Shiftlock_Lampe.phys );
    putValue( HIL_b_WH_Verbau_Entsperrtaste, this.b_WH_Verbau_Entsperrtaste.phys );
    putValue( HIL_b_WH_Warnung_02, this.b_WH_Warnung_02.phys );
    putValue( HIL_hmi_bc_getriebetemperatur_anzeigen, this.hmi_bc_getriebetemperatur_anzeigen.phys );
    putValue( HIL_hmi_Tipschaltempfehlung_anzeigen, this.hmi_Tipschaltempfehlung_anzeigen.phys );
    putValue( HIL_hmi_wba_eingelegter_gang_anzeigen, this.hmi_wba_eingelegter_gang_anzeigen.phys );
    putValue( HIL_s_LED_Shiftlock, this.s_LED_Shiftlock.phys );
}

on message DEV_Kombi_21
{
    putValue( HIL_hmi_Uhrzeit_Format, this.hmi_Uhrzeit_Format.phys );
    putValue( HIL_s_laptimer_aktuelle_rundenzeit, this.s_laptimer_aktuelle_rundenzeit.phys );
    putValue( HIL_s_laptimer_gesamtzeit, this.s_laptimer_gesamtzeit.phys );
    putValue( HIL_s_manuell_zeit_uhrzeit_minute, this.s_manuell_zeit_uhrzeit_minute.phys );
    putValue( HIL_s_Zeit_Uhrzeit_Minute, this.s_Zeit_Uhrzeit_Minute.phys );
    putValue( HIL_s_Zeit_Uhrzeit_Sekunde, this.s_Zeit_Uhrzeit_Sekunde.phys );
}

on message DEV_Kombi_22
{
    putValue( HIL_hmi_Uhrzeit_Minute, this.hmi_Uhrzeit_Minute.phys );
    putValue( HIL_s_laptimer_abbruch, this.s_laptimer_abbruch.phys );
    putValue( HIL_s_laptimer_loeschen, this.s_laptimer_loeschen.phys );
    putValue( HIL_s_laptimer_pause, this.s_laptimer_pause.phys );
    putValue( HIL_s_laptimer_rundenzahl, this.s_laptimer_rundenzahl.phys );
    putValue( HIL_s_laptimer_schnellste_rundenzeit, this.s_laptimer_schnellste_rundenzeit.phys );
    putValue( HIL_s_laptimer_start, this.s_laptimer_start.phys );
    putValue( HIL_s_laptimer_stop, this.s_laptimer_stop.phys );
    putValue( HIL_s_laptimer_zwischen, this.s_laptimer_zwischen.phys );
    putValue( HIL_s_laptimer_zwischenzeit, this.s_laptimer_zwischenzeit.phys );
    putValue( HIL_s_manuell_zeit_set, this.s_manuell_zeit_set.phys );
}

on message DEV_Kombi_23
{
    putValue( HIL_hmi_Datum_Wochentag, this.hmi_Datum_Wochentag.phys );
    putValue( HIL_hmi_Uhrzeit_Stunde, this.hmi_Uhrzeit_Stunde.phys );
    putValue( HIL_s_laptimer_durchschnitt_rundenzeit, this.s_laptimer_durchschnitt_rundenzeit.phys );
    putValue( HIL_s_laptimer_langsamste_rundenzeit, this.s_laptimer_langsamste_rundenzeit.phys );
    putValue( HIL_s_manuell_zeit_uhrzeit_stunde, this.s_manuell_zeit_uhrzeit_stunde.phys );
    putValue( HIL_s_symbol_uhrzeitquelle, this.s_symbol_uhrzeitquelle.phys );
    putValue( HIL_s_Zeit_Uhrzeit_Stunde, this.s_Zeit_Uhrzeit_Stunde.phys );
}

on message DEV_Kombi_24
{
    putValue( HIL_hmi_symbol_uhrzeitquelle, this.hmi_symbol_uhrzeitquelle.phys );
    putValue( HIL_hmi_uhrzeit_blinktakt, this.hmi_uhrzeit_blinktakt.phys );
    putValue( HIL_hmi_uhrzeit_verstellmodus_minuten_anzeigen, this.hmi_uhrzeit_verstellmodus_minuten_anzeigen.phys );
    putValue( HIL_hmi_uhrzeit_verstellmodus_stunden_anzeigen, this.hmi_uhrzeit_verstellmodus_stunden_anzeigen.phys );
    putValue( HIL_s_betriebszeit, this.s_betriebszeit.phys );
    putValue( HIL_s_Gueltigkeit_Synchzeit, this.s_Gueltigkeit_Synchzeit.phys );
    putValue( HIL_s_KBI_Einheit_Uhrzeit, this.s_KBI_Einheit_Uhrzeit.phys );
    putValue( HIL_s_laptimer_abStart_wartet, this.s_laptimer_abStart_wartet.phys );
    putValue( HIL_s_manuell_datum_set, this.s_manuell_datum_set.phys );
    putValue( HIL_s_UH_Jahr, this.s_UH_Jahr.phys );
    putValue( HIL_s_UH_Monat, this.s_UH_Monat.phys );
    putValue( HIL_s_UH_Sekunde, this.s_UH_Sekunde.phys );
    putValue( HIL_s_UH_Tag, this.s_UH_Tag.phys );
}

on message DEV_Kombi_25
{
    putValue( HIL_s_AuthTime_Trigger_Distribution, this.s_AuthTime_Trigger_Distribution.phys );
    putValue( HIL_s_laptimer_runde, this.s_laptimer_runde.phys );
    putValue( HIL_s_laptimer_rundenzeiten_n_, this.s_laptimer_rundenzeiten_n_.phys );
    putValue( HIL_s_laptimer_zustand, this.s_laptimer_zustand.phys );
    putValue( HIL_s_Motor_gelaufen, this.s_Motor_gelaufen.phys );
    putValue( HIL_s_UH_Minute, this.s_UH_Minute.phys );
    putValue( HIL_s_UH_Stunde, this.s_UH_Stunde.phys );
    putValue( HIL_s_UH_Typ, this.s_UH_Typ.phys );
    putValue( HIL_s_Zeit_Datum_Jahr, this.s_Zeit_Datum_Jahr.phys );
    putValue( HIL_s_Zeit_Datum_Monat, this.s_Zeit_Datum_Monat.phys );
    putValue( HIL_s_Zeit_Datum_Tag, this.s_Zeit_Datum_Tag.phys );
}

on message DEV_Kombi_31
{
    putValue( HIL_b_AFS_Fehlertext, this.b_AFS_Fehlertext.phys );
    putValue( HIL_b_AFS_Lampe, this.b_AFS_Lampe.phys );
    putValue( HIL_b_AFS_LED_Blinkmode, this.b_AFS_LED_Blinkmode.phys );
    putValue( HIL_b_BCM1_Fahrlicht_Hinweis, this.b_BCM1_Fahrlicht_Hinweis.phys );
    putValue( HIL_b_BCM1_Hinweis_Lichtnachlauf, this.b_BCM1_Hinweis_Lichtnachlauf.phys );
    putValue( HIL_b_BCM1_Lichtwarn_Texte, this.b_BCM1_Lichtwarn_Texte.phys );
    putValue( HIL_b_BCM_LTM_Allwetterl_Status, this.b_BCM_LTM_Allwetterl_Status.phys );
    putValue( HIL_b_BCM_LTM_Nebell_Status, this.b_BCM_LTM_Nebell_Status.phys );
    putValue( HIL_b_BCM_LTM_Nebelschluss_Status, this.b_BCM_LTM_Nebelschluss_Status.phys );
    putValue( HIL_b_BCM_LTM_PopUp_Anf, this.b_BCM_LTM_PopUp_Anf.phys );
    putValue( HIL_b_BCM_LTM_PopUp_Inhalt, this.b_BCM_LTM_PopUp_Inhalt.phys );
    putValue( HIL_b_BCM_LTM_PopUp_Status, this.b_BCM_LTM_PopUp_Status.phys );
    putValue( HIL_b_BCM_Rueckfahrlicht_Anf, this.b_BCM_Rueckfahrlicht_Anf.phys );
    putValue( HIL_b_BM_Warnblinken, this.b_BM_Warnblinken.phys );
    putValue( HIL_b_Gong_TFL_Umschaltung, this.b_Gong_TFL_Umschaltung.phys );
    putValue( HIL_b_LH_Aussenlicht_def, this.b_LH_Aussenlicht_def.phys );
    putValue( HIL_b_LV_Abblendlicht_Anzeige, this.b_LV_Abblendlicht_Anzeige.phys );
    putValue( HIL_b_LV_AFL_defekt, this.b_LV_AFL_defekt.phys );
    putValue( HIL_b_LV_Aussenlicht_def, this.b_LV_Aussenlicht_def.phys );
    putValue( HIL_b_LV_Fernlicht_Anzeige, this.b_LV_Fernlicht_Anzeige.phys );
    putValue( HIL_b_LV_FLA_aktiv_Anzeige, this.b_LV_FLA_aktiv_Anzeige.phys );
    putValue( HIL_b_LV_FLA_defekt, this.b_LV_FLA_defekt.phys );
    putValue( HIL_b_LV_FLA_Sensor_blockiert, this.b_LV_FLA_Sensor_blockiert.phys );
    putValue( HIL_b_LV_Nebellicht_Anzeige, this.b_LV_Nebellicht_Anzeige.phys );
    putValue( HIL_b_LV_Nebelschlusslicht_Anzeige, this.b_LV_Nebelschlusslicht_Anzeige.phys );
    putValue( HIL_b_LWR_Lampe, this.b_LWR_Lampe.phys );
    putValue( HIL_b_LWR_Reisemodus_Texte, this.b_LWR_Reisemodus_Texte.phys );
    putValue( HIL_s_LED_Abblendlicht, this.s_LED_Abblendlicht.phys );
    putValue( HIL_s_LED_Fernlicht, this.s_LED_Fernlicht.phys );
    putValue( HIL_s_LED_FLA, this.s_LED_FLA.phys );
    putValue( HIL_s_LED_Nebellicht, this.s_LED_Nebellicht.phys );
    putValue( HIL_s_LED_Nebelschlusslicht, this.s_LED_Nebelschlusslicht.phys );
    putValue( HIL_s_LED_Standlicht, this.s_LED_Standlicht.phys );
}

on message DEV_Kombi_32
{
    putValue( HIL_b_AAG_Blinker_H_aktiv, this.b_AAG_Blinker_H_aktiv.phys );
    putValue( HIL_b_AAG_Blinker_HL_def, this.b_AAG_Blinker_HL_def.phys );
    putValue( HIL_b_AAG_Blinker_HR_def, this.b_AAG_Blinker_HR_def.phys );
    putValue( HIL_b_AAG_Bremslicht_H_def, this.b_AAG_Bremslicht_H_def.phys );
    putValue( HIL_b_AAG_Schlusslicht_HL_def, this.b_AAG_Schlusslicht_HL_def.phys );
    putValue( HIL_b_AAG_Schlusslicht_HR_def, this.b_AAG_Schlusslicht_HR_def.phys );
    putValue( HIL_b_Blinken_li_Kombi_Takt, this.b_Blinken_li_Kombi_Takt.phys );
    putValue( HIL_b_Blinken_re_Kombi_Takt, this.b_Blinken_re_Kombi_Takt.phys );
    putValue( HIL_b_LH_3_Bremsl_def, this.b_LH_3_Bremsl_def.phys );
    putValue( HIL_b_LH_Blinker_li_def, this.b_LH_Blinker_li_def.phys );
    putValue( HIL_b_LH_Blinker_re_def, this.b_LH_Blinker_re_def.phys );
    putValue( HIL_b_LH_Brems_Blk_li_def, this.b_LH_Brems_Blk_li_def.phys );
    putValue( HIL_b_LH_Brems_Blk_re_def, this.b_LH_Brems_Blk_re_def.phys );
    putValue( HIL_b_LH_Bremsl_li_def, this.b_LH_Bremsl_li_def.phys );
    putValue( HIL_b_LH_Bremsl_li_ges_def, this.b_LH_Bremsl_li_ges_def.phys );
    putValue( HIL_b_LH_Bremsl_re_def, this.b_LH_Bremsl_re_def.phys );
    putValue( HIL_b_LH_Bremsl_re_ges_def, this.b_LH_Bremsl_re_ges_def.phys );
    putValue( HIL_b_LH_Kennzl_def, this.b_LH_Kennzl_def.phys );
    putValue( HIL_b_LH_Nebel_li_def, this.b_LH_Nebel_li_def.phys );
    putValue( HIL_b_LH_Nebel_mi_def, this.b_LH_Nebel_mi_def.phys );
    putValue( HIL_b_LH_Nebel_re_def, this.b_LH_Nebel_re_def.phys );
    putValue( HIL_b_LH_Rueckf_li_def, this.b_LH_Rueckf_li_def.phys );
    putValue( HIL_b_LH_Rueckf_mi_def, this.b_LH_Rueckf_mi_def.phys );
    putValue( HIL_b_LH_Rueckf_re_def, this.b_LH_Rueckf_re_def.phys );
    putValue( HIL_b_LH_Schluss_Brems_li_def, this.b_LH_Schluss_Brems_li_def.phys );
    putValue( HIL_b_LH_Schluss_Brems_Nebel_li_def, this.b_LH_Schluss_Brems_Nebel_li_def.phys );
    putValue( HIL_b_LH_Schluss_Brems_Nebel_re_def, this.b_LH_Schluss_Brems_Nebel_re_def.phys );
    putValue( HIL_b_LH_Schluss_Brems_re_def, this.b_LH_Schluss_Brems_re_def.phys );
    putValue( HIL_b_LH_Schluss_Nebel_li_def, this.b_LH_Schluss_Nebel_li_def.phys );
    putValue( HIL_b_LH_Schluss_Nebel_re_def, this.b_LH_Schluss_Nebel_re_def.phys );
    putValue( HIL_b_LH_Schlusslicht_li_def, this.b_LH_Schlusslicht_li_def.phys );
    putValue( HIL_b_LH_Schlusslicht_re_def, this.b_LH_Schlusslicht_re_def.phys );
    putValue( HIL_b_LH_SL_BRL_BLK_li_def, this.b_LH_SL_BRL_BLK_li_def.phys );
    putValue( HIL_b_LH_SL_BRL_BLK_re_def, this.b_LH_SL_BRL_BLK_re_def.phys );
    putValue( HIL_b_LV_Abbiegelicht_li_def, this.b_LV_Abbiegelicht_li_def.phys );
    putValue( HIL_b_LV_Abbiegelicht_re_def, this.b_LV_Abbiegelicht_re_def.phys );
    putValue( HIL_b_LV_Abblend_Fernlicht_li_def, this.b_LV_Abblend_Fernlicht_li_def.phys );
    putValue( HIL_b_LV_Abblend_Fernlicht_re_def, this.b_LV_Abblend_Fernlicht_re_def.phys );
    putValue( HIL_b_LV_Abblendlicht_li_def, this.b_LV_Abblendlicht_li_def.phys );
    putValue( HIL_b_LV_Abblendlicht_re_def, this.b_LV_Abblendlicht_re_def.phys );
    putValue( HIL_b_LV_Abblendlicht_TFL_li_def, this.b_LV_Abblendlicht_TFL_li_def.phys );
    putValue( HIL_b_LV_Abblendlicht_TFL_re_def, this.b_LV_Abblendlicht_TFL_re_def.phys );
    putValue( HIL_b_LV_Blinker_li_def, this.b_LV_Blinker_li_def.phys );
    putValue( HIL_b_LV_Blinker_re_def, this.b_LV_Blinker_re_def.phys );
    putValue( HIL_b_LV_Blk_li_Seite_def, this.b_LV_Blk_li_Seite_def.phys );
    putValue( HIL_b_LV_Blk_re_Seite_def, this.b_LV_Blk_re_Seite_def.phys );
    putValue( HIL_b_LV_Fernlicht_li_def, this.b_LV_Fernlicht_li_def.phys );
    putValue( HIL_b_LV_Fernlicht_re_def, this.b_LV_Fernlicht_re_def.phys );
    putValue( HIL_b_LV_LED_Scheinwerfer_li_def, this.b_LV_LED_Scheinwerfer_li_def.phys );
    putValue( HIL_b_LV_LED_Scheinwerfer_re_def, this.b_LV_LED_Scheinwerfer_re_def.phys );
    putValue( HIL_b_LV_Nebellicht_li_def, this.b_LV_Nebellicht_li_def.phys );
    putValue( HIL_b_LV_Nebellicht_re_def, this.b_LV_Nebellicht_re_def.phys );
    putValue( HIL_b_LV_Nebellicht_TFL_li_def, this.b_LV_Nebellicht_TFL_li_def.phys );
    putValue( HIL_b_LV_Nebellicht_TFL_re_def, this.b_LV_Nebellicht_TFL_re_def.phys );
    putValue( HIL_b_LV_Standlicht_Anzeige, this.b_LV_Standlicht_Anzeige.phys );
    putValue( HIL_b_LV_Standlicht_li_def, this.b_LV_Standlicht_li_def.phys );
    putValue( HIL_b_LV_Standlicht_re_def, this.b_LV_Standlicht_re_def.phys );
    putValue( HIL_b_LV_Standlicht_TFL_li_def, this.b_LV_Standlicht_TFL_li_def.phys );
    putValue( HIL_b_LV_Standlicht_TFL_re_def, this.b_LV_Standlicht_TFL_re_def.phys );
    putValue( HIL_b_LV_Tagfahrlicht_li_def, this.b_LV_Tagfahrlicht_li_def.phys );
    putValue( HIL_b_LV_Tagfahrlicht_re_def, this.b_LV_Tagfahrlicht_re_def.phys );
    putValue( HIL_s_LED_AnhaengerBlinker, this.s_LED_AnhaengerBlinker.phys );
    putValue( HIL_s_LED_Blinker_links, this.s_LED_Blinker_links.phys );
    putValue( HIL_s_LED_Blinker_rechts, this.s_LED_Blinker_rechts.phys );
}

on message DEV_Kombi_33
{
    putValue( HIL_b_BCM_RGB_Blau, this.b_BCM_RGB_Blau.phys );
    putValue( HIL_b_BCM_RGB_Gruen, this.b_BCM_RGB_Gruen.phys );
    putValue( HIL_b_BCM_RGB_Rot, this.b_BCM_RGB_Rot.phys );
    putValue( HIL_s_Ambientelicht_aktiv, this.s_Ambientelicht_aktiv.phys );
    putValue( HIL_s_BCM_RGB_Blau, this.s_BCM_RGB_Blau.phys );
    putValue( HIL_s_BCM_RGB_Gruen, this.s_BCM_RGB_Gruen.phys );
    putValue( HIL_s_BCM_RGB_Rot, this.s_BCM_RGB_Rot.phys );
}

on message DEV_Kombi_34
{
    putValue( HIL_b_BCM_Ausparken_Betrieb, this.b_BCM_Ausparken_Betrieb.phys );
    putValue( HIL_s_aufpruefung_aktiv, this.s_aufpruefung_aktiv.phys );
    putValue( HIL_s_aufpruefung_pilopa_aktiv, this.s_aufpruefung_pilopa_aktiv.phys );
    putValue( HIL_s_LED_Abstandswarnung, this.s_LED_Abstandswarnung.phys );
    putValue( HIL_s_LED_ACA_Quer_aktiv, this.s_LED_ACA_Quer_aktiv.phys );
    putValue( HIL_s_LED_ACA_Quer_passiv, this.s_LED_ACA_Quer_passiv.phys );
    putValue( HIL_s_LED_ACA_Quer_Warnung, this.s_LED_ACA_Quer_Warnung.phys );
    putValue( HIL_s_LED_ACC_Ego_weiss, this.s_LED_ACC_Ego_weiss.phys );
    putValue( HIL_s_LED_ACC_Radar_gruen, this.s_LED_ACC_Radar_gruen.phys );
    putValue( HIL_s_LED_ACC_Radar_rot_blinken, this.s_LED_ACC_Radar_rot_blinken.phys );
    putValue( HIL_s_LED_ACC_Radar_weiss, this.s_LED_ACC_Radar_weiss.phys );
    putValue( HIL_s_LED_ACC_VorFzg_gruen, this.s_LED_ACC_VorFzg_gruen.phys );
    putValue( HIL_s_LED_ACC_VorFzg_rot_blinken1, this.s_LED_ACC_VorFzg_rot_blinken1.phys );
    putValue( HIL_s_LED_ACC_VorFzg_weiss, this.s_LED_ACC_VorFzg_weiss.phys );
    putValue( HIL_s_LED_AEB, this.s_LED_AEB.phys );
    putValue( HIL_s_LED_aLDW_li_erkannt, this.s_LED_aLDW_li_erkannt.phys );
    putValue( HIL_s_LED_aLDW_li_nicht_erkannt, this.s_LED_aLDW_li_nicht_erkannt.phys );
    putValue( HIL_s_LED_aLDW_li_Warnung, this.s_LED_aLDW_li_Warnung.phys );
    putValue( HIL_s_LED_aLDW_re_erkannt, this.s_LED_aLDW_re_erkannt.phys );
    putValue( HIL_s_LED_aLDW_re_nicht_erkannt, this.s_LED_aLDW_re_nicht_erkannt.phys );
    putValue( HIL_s_LED_aLDW_re_Warnung, this.s_LED_aLDW_re_Warnung.phys );
    putValue( HIL_s_LED_Antriebsart_weiss, this.s_LED_Antriebsart_weiss.phys );
    putValue( HIL_s_LED_CNG_Betrieb, this.s_LED_CNG_Betrieb.phys );
    putValue( HIL_s_LED_EPB_NAR_gruen, this.s_LED_EPB_NAR_gruen.phys );
    putValue( HIL_s_LED_EPB_RDW_gruen, this.s_LED_EPB_RDW_gruen.phys );
    putValue( HIL_s_LED_FLA_auto, this.s_LED_FLA_auto.phys );
    putValue( HIL_s_LED_GRA_weiss, this.s_LED_GRA_weiss.phys );
    putValue( HIL_s_LED_Hands_Off, this.s_LED_Hands_Off.phys );
    putValue( HIL_s_LED_LIM_weiss, this.s_LED_LIM_weiss.phys );
    putValue( HIL_s_LED_Querfuehrung_aktiv, this.s_LED_Querfuehrung_aktiv.phys );
    putValue( HIL_s_LED_Querfuehrung_passiv, this.s_LED_Querfuehrung_passiv.phys );
    putValue( HIL_s_LED_Querfuehrung_Warnung, this.s_LED_Querfuehrung_Warnung.phys );
}

on message DEV_Kombi_41
{
    putValue( HIL_b_FAS_Taster, this.b_FAS_Taster.phys );
    putValue( HIL_b_FAS_Taster_Fehler, this.b_FAS_Taster_Fehler.phys );
    putValue( HIL_b_LSS_Tastencode, this.b_LSS_Tastencode.phys );
    putValue( HIL_b_MFL_Eventcode_1, this.b_MFL_Eventcode_1.phys );
    putValue( HIL_b_MFL_Eventcode_2, this.b_MFL_Eventcode_2.phys );
    putValue( HIL_b_MFL_Marke, this.b_MFL_Marke.phys );
    putValue( HIL_b_MFL_Tastencode_1, this.b_MFL_Tastencode_1.phys );
    putValue( HIL_b_MFL_Tastencode_2, this.b_MFL_Tastencode_2.phys );
    putValue( HIL_b_MFL_Variante, this.b_MFL_Variante.phys );
    putValue( HIL_b_ZV_STSG_eKiSi_defekt, this.b_ZV_STSG_eKiSi_defekt.phys );
    putValue( HIL_hmi_data_wheel_ticks, this.hmi_data_wheel_ticks.phys );
    putValue( HIL_hmi_event_wheel_ticks, this.hmi_event_wheel_ticks.phys );
    putValue( HIL_hmi_FAS_Taster_long_press, this.hmi_FAS_Taster_long_press.phys );
    putValue( HIL_hmi_FAS_Taster_short_press, this.hmi_FAS_Taster_short_press.phys );
    putValue( HIL_hmi_mfl_marke, this.hmi_mfl_marke.phys );
    putValue( HIL_hmi_mfl_variante, this.hmi_mfl_variante.phys );
    putValue( HIL_hmi_ok_long_press, this.hmi_ok_long_press.phys );
    putValue( HIL_hmi_up_short_press, this.hmi_up_short_press.phys );
    putValue( HIL_s_mfl_gueltig, this.s_mfl_gueltig.phys );
}

on message DEV_Kombi_42
{
    putValue( HIL_b_AAG_ASTA_Status, this.b_AAG_ASTA_Status.phys );
    putValue( HIL_b_AAG_AVS_Fehler_02, this.b_AAG_AVS_Fehler_02.phys );
    putValue( HIL_b_ASTA_Anhaengerlast, this.b_ASTA_Anhaengerlast.phys );
    putValue( HIL_b_ASTA_Einheit, this.b_ASTA_Einheit.phys );
    putValue( HIL_b_ASTA_Stuetzlast, this.b_ASTA_Stuetzlast.phys );
    putValue( HIL_b_ASTAs_01_alt, this.b_ASTAs_01_alt.phys );
    putValue( HIL_b_BCM1_MH_Schalter, this.b_BCM1_MH_Schalter.phys );
    putValue( HIL_b_MF_2BatSOCzugering, this.b_MF_2BatSOCzugering.phys );
    putValue( HIL_b_MF_NotStartAktiv, this.b_MF_NotStartAktiv.phys );
    putValue( HIL_b_VSG_Meldungen, this.b_VSG_Meldungen.phys );
    putValue( HIL_b_ZV_BT_offen, this.b_ZV_BT_offen.phys );
    putValue( HIL_b_ZV_FT_offen, this.b_ZV_FT_offen.phys );
    putValue( HIL_b_ZV_HBFS_offen, this.b_ZV_HBFS_offen.phys );
    putValue( HIL_b_ZV_HD_offen, this.b_ZV_HD_offen.phys );
    putValue( HIL_b_ZV_HFS_offen, this.b_ZV_HFS_offen.phys );
    putValue( HIL_b_ZV_HS_offen, this.b_ZV_HS_offen.phys );
    putValue( HIL_b_ZV_Tankklappe_offen, this.b_ZV_Tankklappe_offen.phys );
    putValue( HIL_b_ZV_verriegelt_extern_ist, this.b_ZV_verriegelt_extern_ist.phys );
    putValue( HIL_hmi_anhaengerlast_anzeigen, this.hmi_anhaengerlast_anzeigen.phys );
    putValue( HIL_hmi_anhaengerlast_fehler, this.hmi_anhaengerlast_fehler.phys );
    putValue( HIL_hmi_caroutlineunterdrueckung, this.hmi_caroutlineunterdrueckung.phys );
    putValue( HIL_hmi_stuetzlast_anzeigen, this.hmi_stuetzlast_anzeigen.phys );
    putValue( HIL_hmi_stuetzlast_fehler, this.hmi_stuetzlast_fehler.phys );
    putValue( HIL_hmi_variante, this.hmi_variante.phys );
    putValue( HIL_s_car_outline_aktiv, this.s_car_outline_aktiv.phys );
    putValue( HIL_s_car_outline_hochprior, this.s_car_outline_hochprior.phys );
    putValue( HIL_s_car_outline_trigger_v_hinweis, this.s_car_outline_trigger_v_hinweis.phys );
    putValue( HIL_s_event_car_outline_trigger, this.s_event_car_outline_trigger.phys );
    putValue( HIL_s_LED_Tankdeckel, this.s_LED_Tankdeckel.phys );
    putValue( HIL_s_LED_Verdeck, this.s_LED_Verdeck.phys );
    putValue( HIL_s_motorhaube_offen_hinweis, this.s_motorhaube_offen_hinweis.phys );
    putValue( HIL_s_tuerzustand_hinten_links, this.s_tuerzustand_hinten_links.phys );
    putValue( HIL_s_tuerzustand_hinten_rechts, this.s_tuerzustand_hinten_rechts.phys );
    putValue( HIL_s_tuerzustand_vorne_links, this.s_tuerzustand_vorne_links.phys );
    putValue( HIL_s_tuerzustand_vorne_rechts, this.s_tuerzustand_vorne_rechts.phys );
}

on message DEV_Kombi_43
{
    putValue( HIL_b_AB_wSBR_Batteriestatus, this.b_AB_wSBR_Batteriestatus.phys );
    putValue( HIL_b_ACC_Tempolimit_Einheit, this.b_ACC_Tempolimit_Einheit.phys );
    putValue( HIL_b_BCM_ValetTaster_Fkts_LED, this.b_BCM_ValetTaster_Fkts_LED.phys );
    putValue( HIL_b_BCM_Waschwasser_Sensor, this.b_BCM_Waschwasser_Sensor.phys );
    putValue( HIL_b_BFS_MMB_storage_beep, this.b_BFS_MMB_storage_beep.phys );
    putValue( HIL_b_eCall_Mute_Anf, this.b_eCall_Mute_Anf.phys );
    putValue( HIL_b_FS_MMB_storage_beep, this.b_FS_MMB_storage_beep.phys );
    putValue( HIL_b_FT_Kisi_Fehler, this.b_FT_Kisi_Fehler.phys );
    putValue( HIL_b_KL_LRH_Stufe, this.b_KL_LRH_Stufe.phys );
    putValue( HIL_b_KL_VoKo_LED, this.b_KL_VoKo_LED.phys );
    putValue( HIL_b_LRH_on_off, this.b_LRH_on_off.phys );
    putValue( HIL_b_MF_2BattAb, this.b_MF_2BattAb.phys );
    putValue( HIL_b_MF_2BattLadWarn, this.b_MF_2BattLadWarn.phys );
    putValue( HIL_b_MF_ExterneLadungWarn, this.b_MF_ExterneLadungWarn.phys );
    putValue( HIL_b_MF_Fahrerhinweis, this.b_MF_Fahrerhinweis.phys );
    putValue( HIL_b_MF_Motorweiterlauf, this.b_MF_Motorweiterlauf.phys );
    putValue( HIL_b_MF_Summer, this.b_MF_Summer.phys );
    putValue( HIL_b_MO_Kuehlmittel_Temp, this.b_MO_Kuehlmittel_Temp.phys );
    putValue( HIL_b_PEA_Ereignisanzeige_temporaer, this.b_PEA_Ereignisanzeige_temporaer.phys );
    putValue( HIL_b_RS_defekt, this.b_RS_defekt.phys );
    putValue( HIL_b_STH_Texte, this.b_STH_Texte.phys );
    putValue( HIL_b_Wischer_vorne_defekt, this.b_Wischer_vorne_defekt.phys );
    putValue( HIL_b_ZV_STSG_Crashzustand, this.b_ZV_STSG_Crashzustand.phys );
    putValue( HIL_hmi_down_short_press, this.hmi_down_short_press.phys );
    putValue( HIL_hmi_FAS_Taster_long_release, this.hmi_FAS_Taster_long_release.phys );
    putValue( HIL_hmi_FAS_Taster_short_release, this.hmi_FAS_Taster_short_release.phys );
    putValue( HIL_s_Anzahl_gesteckte_Fondgurte, this.s_Anzahl_gesteckte_Fondgurte.phys );
    putValue( HIL_s_warnfall_fond_ohne_SBR, this.s_warnfall_fond_ohne_SBR.phys );
    putValue( HIL_s_warnsequenz_ende, this.s_warnsequenz_ende.phys );
    putValue( HIL_s_KL_VoKo_LED, this.s_KL_VoKo_LED.phys );
    putValue( HIL_s_LED_Lenkradheizung_0, this.s_LED_Lenkradheizung_0.phys );
    putValue( HIL_s_LED_Lenkradheizung_1, this.s_LED_Lenkradheizung_1.phys );
    putValue( HIL_s_LED_Lenkradheizung_2, this.s_LED_Lenkradheizung_2.phys );
    putValue( HIL_s_LED_Standheizung, this.s_LED_Standheizung.phys );
    putValue( HIL_s_Anzahl_belegte_Fondsitze, this.s_Anzahl_belegte_Fondsitze.phys );
    putValue( HIL_s_Anzeige_Anzahl_Fondsitze, this.s_Anzeige_Anzahl_Fondsitze.phys );
    putValue( HIL_s_waschwassermangel_warn, this.s_waschwassermangel_warn.phys );
}

on message DEV_Kombi_44
{
    putValue( HIL_b_AB_Gurtwarn_Reihe2_BF, this.b_AB_Gurtwarn_Reihe2_BF.phys );
    putValue( HIL_b_AB_Gurtwarn_Reihe2_FA, this.b_AB_Gurtwarn_Reihe2_FA.phys );
    putValue( HIL_b_AB_Gurtwarn_Reihe2_MI, this.b_AB_Gurtwarn_Reihe2_MI.phys );
    putValue( HIL_b_AB_Gurtwarn_Reihe3_BF, this.b_AB_Gurtwarn_Reihe3_BF.phys );
    putValue( HIL_b_AB_Gurtwarn_Reihe3_FA, this.b_AB_Gurtwarn_Reihe3_FA.phys );
    putValue( HIL_b_AB_Gurtwarn_Reihe3_MI, this.b_AB_Gurtwarn_Reihe3_MI.phys );
    putValue( HIL_b_AB_Gurtwarn_VB, this.b_AB_Gurtwarn_VB.phys );
    putValue( HIL_b_AB_Gurtwarn_VF, this.b_AB_Gurtwarn_VF.phys );
    putValue( HIL_b_AB_SBR_hinten_verbau, this.b_AB_SBR_hinten_verbau.phys );
    putValue( HIL_hmi_AB_Gurtschloss_Reihe2_links_blinken, this.hmi_AB_Gurtschloss_Reihe2_links_blinken.phys );
    putValue( HIL_hmi_AB_Gurtschloss_Reihe2_links_gesteckt, this.hmi_AB_Gurtschloss_Reihe2_links_gesteckt.phys );
    putValue( HIL_hmi_AB_Gurtschloss_Reihe2_links_verbaut, this.hmi_AB_Gurtschloss_Reihe2_links_verbaut.phys );
    putValue( HIL_hmi_AB_Gurtschloss_Reihe2_mitte_blinken, this.hmi_AB_Gurtschloss_Reihe2_mitte_blinken.phys );
    putValue( HIL_hmi_AB_Gurtschloss_Reihe2_mitte_gesteckt, this.hmi_AB_Gurtschloss_Reihe2_mitte_gesteckt.phys );
    putValue( HIL_hmi_AB_Gurtschloss_Reihe2_mitte_verbaut, this.hmi_AB_Gurtschloss_Reihe2_mitte_verbaut.phys );
    putValue( HIL_hmi_AB_Gurtschloss_Reihe2_rechts_blinken, this.hmi_AB_Gurtschloss_Reihe2_rechts_blinken.phys );
    putValue( HIL_hmi_AB_Gurtschloss_Reihe2_rechts_gesteckt, this.hmi_AB_Gurtschloss_Reihe2_rechts_gesteckt.phys );
    putValue( HIL_hmi_AB_Gurtschloss_Reihe2_rechts_verbaut, this.hmi_AB_Gurtschloss_Reihe2_rechts_verbaut.phys );
    putValue( HIL_hmi_AB_Gurtschloss_Reihe3_links_blinken, this.hmi_AB_Gurtschloss_Reihe3_links_blinken.phys );
    putValue( HIL_hmi_AB_Gurtschloss_Reihe3_links_gesteckt, this.hmi_AB_Gurtschloss_Reihe3_links_gesteckt.phys );
    putValue( HIL_hmi_AB_Gurtschloss_Reihe3_links_verbaut, this.hmi_AB_Gurtschloss_Reihe3_links_verbaut.phys );
    putValue( HIL_hmi_AB_Gurtschloss_Reihe3_mitte_blinken, this.hmi_AB_Gurtschloss_Reihe3_mitte_blinken.phys );
    putValue( HIL_hmi_AB_Gurtschloss_Reihe3_mitte_gesteckt, this.hmi_AB_Gurtschloss_Reihe3_mitte_gesteckt.phys );
    putValue( HIL_hmi_AB_Gurtschloss_Reihe3_mitte_verbaut, this.hmi_AB_Gurtschloss_Reihe3_mitte_verbaut.phys );
    putValue( HIL_hmi_AB_Gurtschloss_Reihe3_rechts_blinken, this.hmi_AB_Gurtschloss_Reihe3_rechts_blinken.phys );
    putValue( HIL_hmi_AB_Gurtschloss_Reihe3_rechts_gesteckt, this.hmi_AB_Gurtschloss_Reihe3_rechts_gesteckt.phys );
    putValue( HIL_hmi_AB_Gurtschloss_Reihe3_rechts_verbaut, this.hmi_AB_Gurtschloss_Reihe3_rechts_verbaut.phys );
    putValue( HIL_hmi_Gurtschloss_anzeigen, this.hmi_Gurtschloss_anzeigen.phys );
    putValue( HIL_s_Anzahl_Fondsitze, this.s_Anzahl_Fondsitze.phys );
    putValue( HIL_s_gurt_fond_gong, this.s_gurt_fond_gong.phys );
    putValue( HIL_s_gurtschloss_optisch_2_links, this.s_gurtschloss_optisch_2_links.phys );
    putValue( HIL_s_gurtschloss_optisch_2_mitte, this.s_gurtschloss_optisch_2_mitte.phys );
    putValue( HIL_s_gurtschloss_optisch_2_rechts, this.s_gurtschloss_optisch_2_rechts.phys );
    putValue( HIL_s_gurtschloss_optisch_3_links, this.s_gurtschloss_optisch_3_links.phys );
    putValue( HIL_s_gurtschloss_optisch_3_mitte, this.s_gurtschloss_optisch_3_mitte.phys );
    putValue( HIL_s_gurtschloss_optisch_3_rechts, this.s_gurtschloss_optisch_3_rechts.phys );
    putValue( HIL_s_gurtwarnung_akustisch_1, this.s_gurtwarnung_akustisch_1.phys );
    putValue( HIL_s_gurtwarnung_akustisch_2, this.s_gurtwarnung_akustisch_2.phys );
    putValue( HIL_s_gurtwarnung_akustisch_3, this.s_gurtwarnung_akustisch_3.phys );
    putValue( HIL_s_gurtwarnung_akustisch_US, this.s_gurtwarnung_akustisch_US.phys );
    putValue( HIL_s_gurtwarnung_optisch, this.s_gurtwarnung_optisch.phys );
    putValue( HIL_s_LED_Gurtwarnung, this.s_LED_Gurtwarnung.phys );
}

on message DEV_Kombi_45
{
    putValue( HIL_b_AB_Anzeige_Fussg, this.b_AB_Anzeige_Fussg.phys );
    putValue( HIL_b_AB_Deaktiviert, this.b_AB_Deaktiviert.phys );
    putValue( HIL_b_AB_Erh_Auf_VB, this.b_AB_Erh_Auf_VB.phys );
    putValue( HIL_b_AB_Gurtschloss_Reihe2_BF, this.b_AB_Gurtschloss_Reihe2_BF.phys );
    putValue( HIL_b_AB_Gurtschloss_Reihe2_FA, this.b_AB_Gurtschloss_Reihe2_FA.phys );
    putValue( HIL_b_AB_Gurtschloss_Reihe2_MI, this.b_AB_Gurtschloss_Reihe2_MI.phys );
    putValue( HIL_b_AB_Gurtschloss_Reihe3_BF, this.b_AB_Gurtschloss_Reihe3_BF.phys );
    putValue( HIL_b_AB_Gurtschloss_Reihe3_FA, this.b_AB_Gurtschloss_Reihe3_FA.phys );
    putValue( HIL_b_AB_Gurtschloss_Reihe3_MI, this.b_AB_Gurtschloss_Reihe3_MI.phys );
    putValue( HIL_b_AB_Gurtschloss_Reihe4_BF, this.b_AB_Gurtschloss_Reihe4_BF.phys );
    putValue( HIL_b_AB_Gurtschloss_Reihe4_FA, this.b_AB_Gurtschloss_Reihe4_FA.phys );
    putValue( HIL_b_AB_Gurtschloss_Reihe4_MI, this.b_AB_Gurtschloss_Reihe4_MI.phys );
    putValue( HIL_b_AB_Gurtwarn_Reihe4_BF, this.b_AB_Gurtwarn_Reihe4_BF.phys );
    putValue( HIL_b_AB_Gurtwarn_Reihe4_FA, this.b_AB_Gurtwarn_Reihe4_FA.phys );
    putValue( HIL_b_AB_Gurtwarn_Reihe4_MI, this.b_AB_Gurtwarn_Reihe4_MI.phys );
    putValue( HIL_b_AB_Lampe, this.b_AB_Lampe.phys );
    putValue( HIL_b_AB_Systemfehler, this.b_AB_Systemfehler.phys );
    putValue( HIL_b_AB_Versorgungsspannung, this.b_AB_Versorgungsspannung.phys );
    putValue( HIL_b_eCall_Funktionsstatus, this.b_eCall_Funktionsstatus.phys );
    putValue( HIL_b_SC_PreCrash_Texte, this.b_SC_PreCrash_Texte.phys );
    putValue( HIL_b_SC_PreCrash_Warnung, this.b_SC_PreCrash_Warnung.phys );
    putValue( HIL_hmi_AB_Gurtschloss_Reihe4_links_blinken, this.hmi_AB_Gurtschloss_Reihe4_links_blinken.phys );
    putValue( HIL_hmi_AB_Gurtschloss_Reihe4_links_gesteckt, this.hmi_AB_Gurtschloss_Reihe4_links_gesteckt.phys );
    putValue( HIL_hmi_AB_Gurtschloss_Reihe4_links_verbaut, this.hmi_AB_Gurtschloss_Reihe4_links_verbaut.phys );
    putValue( HIL_hmi_AB_Gurtschloss_Reihe4_mitte_blinken, this.hmi_AB_Gurtschloss_Reihe4_mitte_blinken.phys );
    putValue( HIL_hmi_AB_Gurtschloss_Reihe4_mitte_gesteckt, this.hmi_AB_Gurtschloss_Reihe4_mitte_gesteckt.phys );
    putValue( HIL_hmi_AB_Gurtschloss_Reihe4_mitte_verbaut, this.hmi_AB_Gurtschloss_Reihe4_mitte_verbaut.phys );
    putValue( HIL_hmi_AB_Gurtschloss_Reihe4_rechts_blinken, this.hmi_AB_Gurtschloss_Reihe4_rechts_blinken.phys );
    putValue( HIL_hmi_AB_Gurtschloss_Reihe4_rechts_gesteckt, this.hmi_AB_Gurtschloss_Reihe4_rechts_gesteckt.phys );
    putValue( HIL_hmi_AB_Gurtschloss_Reihe4_rechts_verbaut, this.hmi_AB_Gurtschloss_Reihe4_rechts_verbaut.phys );
    putValue( HIL_s_gurtschloss_optisch_4_links, this.s_gurtschloss_optisch_4_links.phys );
    putValue( HIL_s_gurtschloss_optisch_4_mitte, this.s_gurtschloss_optisch_4_mitte.phys );
    putValue( HIL_s_gurtschloss_optisch_4_rechts, this.s_gurtschloss_optisch_4_rechts.phys );
    putValue( HIL_s_LED_Airbag, this.s_LED_Airbag.phys );
    putValue( HIL_s_warnfall_fond_retrigger_event, this.s_warnfall_fond_retrigger_event.phys );
}

on message DEV_Kombi_51
{
    putValue( HIL_b_RW_Gesamt_Reichweite, this.b_RW_Gesamt_Reichweite.phys );
    putValue( HIL_b_RW_Primaer_Reichweite, this.b_RW_Primaer_Reichweite.phys );
    putValue( HIL_b_RW_Primaer_Reichweite_Anzeige, this.b_RW_Primaer_Reichweite_Anzeige.phys );
    putValue( HIL_b_RW_Reichweite_Einheit_Anzeige, this.b_RW_Reichweite_Einheit_Anzeige.phys );
    putValue( HIL_b_RW_Sekundaer_Reichweite, this.b_RW_Sekundaer_Reichweite.phys );
    putValue( HIL_b_RW_Sekundaer_Reichweite_Anzeige, this.b_RW_Sekundaer_Reichweite_Anzeige.phys );
    putValue( HIL_hmi_CANRW_Gesamt_Max_sonderbehandlung, this.hmi_CANRW_Gesamt_Max_sonderbehandlung.phys );
    putValue( HIL_hmi_CANRW_Gesamt_sonderbehandlung, this.hmi_CANRW_Gesamt_sonderbehandlung.phys );
    putValue( HIL_hmi_CANRW_Primaer_sonderbehandlung, this.hmi_CANRW_Primaer_sonderbehandlung.phys );
    putValue( HIL_hmi_CANRW_Sekundaer_sonderbehandlung, this.hmi_CANRW_Sekundaer_sonderbehandlung.phys );
    putValue( HIL_hmi_reichweite_e1_available, this.hmi_reichweite_e1_available.phys );
    putValue( HIL_s_CANRW_Primaer_Anzeigefreigabe_Bargraph, this.s_CANRW_Primaer_Anzeigefreigabe_Bargraph.phys );
    putValue( HIL_s_CANRW_Sekundaer_Anzeigefreigabe_Bargraph, this.s_CANRW_Sekundaer_Anzeigefreigabe_Bargraph.phys );
    putValue( HIL_s_CANRW_Systemfehler, this.s_CANRW_Systemfehler.phys );
}

on message DEV_Kombi_52
{
    putValue( HIL_b_RW_Gesamt_Reichweite_Anzeige, this.b_RW_Gesamt_Reichweite_Anzeige.phys );
    putValue( HIL_b_RW_Gesamt_Reichweite_Max_Anzeige, this.b_RW_Gesamt_Reichweite_Max_Anzeige.phys );
    putValue( HIL_b_STH_Heizleistung, this.b_STH_Heizleistung.phys );
    putValue( HIL_hmi_CANRW_Gesamt_Reichweite, this.hmi_CANRW_Gesamt_Reichweite.phys );
    putValue( HIL_hmi_CANRW_Primaer_Reichweite, this.hmi_CANRW_Primaer_Reichweite.phys );
    putValue( HIL_hmi_CANRW_Sekundaer_Reichweite, this.hmi_CANRW_Sekundaer_Reichweite.phys );
    putValue( HIL_hmi_reichweite_e2_available, this.hmi_reichweite_e2_available.phys );
    putValue( HIL_hmi_reichweite_e3_available, this.hmi_reichweite_e3_available.phys );
}

on message DEV_Kombi_53
{
    putValue( HIL_b_BCM1_Aussen_Temp_ungef, this.b_BCM1_Aussen_Temp_ungef.phys );
    putValue( HIL_hmi_aussentemperatur, this.hmi_aussentemperatur.phys );
    putValue( HIL_hmi_aussentemperatur_einheit, this.hmi_aussentemperatur_einheit.phys );
    putValue( HIL_hmi_aussentemperatur_eisstern, this.hmi_aussentemperatur_eisstern.phys );
    putValue( HIL_hmi_aussentemperatur_fehler, this.hmi_aussentemperatur_fehler.phys );
    putValue( HIL_hmi_CANRW_Gesamt_Reichweite_Max, this.hmi_CANRW_Gesamt_Reichweite_Max.phys );
    putValue( HIL_hmi_CANRW_Gesamt_Reichweite_Norm, this.hmi_CANRW_Gesamt_Reichweite_Norm.phys );
    putValue( HIL_s_aussentemp_letzter_wert, this.s_aussentemp_letzter_wert.phys );
    putValue( HIL_s_aussentemperatur_anzeige_temp, this.s_aussentemperatur_anzeige_temp.phys );
    putValue( HIL_s_eiswarnung, this.s_eiswarnung.phys );
    putValue( HIL_s_motor_warm, this.s_motor_warm.phys );
    putValue( HIL_s_w_blockierung, this.s_w_blockierung.phys );
    putValue( HIL_s_z_blockierung, this.s_z_blockierung.phys );
}

on message DEV_Kombi_54
{
    if (getValue(ENV_KombiMQB_TxCycle_Check) == 0x01)
    {
        DEV_Kombi_54_TxFlg = 0x01;      //flag for TxMute check

        mDEV_Kombi_54_cycleTime = 0;

        if (msgDEV_Kombi_54_Ctr==0)
        {

        mDEV_Kombi_54_time_prev = this.time;
        }
        else
        {
        mDEV_Kombi_54_cycleTime= (this.time - mDEV_Kombi_54_time_prev)/100;
        mDEV_Kombi_54_time_prev = this.time;
        

        //status 
        if (mDEV_Kombi_54_cycleTime == DEV_Kombi_54_defTxCycle)       //green
        putValue(ENV_DEV_Kombi_54_TxC_stat,1);

        else if (mDEV_Kombi_54_cycleTime >= (DEV_Kombi_54_defTxCycle - (DEV_Kombi_54_defTxCycle*0.10)) && mDEV_Kombi_54_cycleTime <= (DEV_Kombi_54_defTxCycle + (DEV_Kombi_54_defTxCycle*0.10)))  //yellow
        putValue(ENV_DEV_Kombi_54_TxC_stat,2);

        else if ((mDEV_Kombi_54_cycleTime < (DEV_Kombi_54_defTxCycle - (DEV_Kombi_54_defTxCycle*0.10)) || mDEV_Kombi_54_cycleTime > (DEV_Kombi_54_defTxCycle + (DEV_Kombi_54_defTxCycle*0.10)))  && msgDEV_Kombi_54_Ctr!=0)  //red
        {
        putValue(ENV_DEV_Kombi_54_TxC_stat,3);
        putValue(ENV_DEV_Kombi_54_TxC_timeStamp,mDEV_Kombi_54_time_prev/100000);
        DEV_Kombi_54_RedStatCtr++;
        putvalue(ENV_DEV_Kombi_54_RedCtr,DEV_Kombi_54_RedStatCtr);
        putValue(ENV_TxCycleCheck_ErrSummary, 3);
        }

        //MIN-MAX

        if (mDEV_Kombi_54_cycleTime < DEV_Kombi_54_min)
        {
        DEV_Kombi_54_min = mDEV_Kombi_54_cycleTime;
        putValue(ENV_DEV_Kombi_54_TxC_min, DEV_Kombi_54_min);
        }

        if (mDEV_Kombi_54_cycleTime > DEV_Kombi_54_max)
        {
        DEV_Kombi_54_max = mDEV_Kombi_54_cycleTime;
        putValue(ENV_DEV_Kombi_54_TxC_max, DEV_Kombi_54_max);
        }

        }
        msgDEV_Kombi_54_Ctr++;
    }

    putValue( HIL_b_BCM1_FStatus_Aussentemp_ungef, this.b_BCM1_FStatus_Aussentemp_ungef.phys );
    putValue( HIL_b_EFF_Verbrauch_STH, this.b_EFF_Verbrauch_STH.phys );
    putValue( HIL_b_LSH_Heizleistung, this.b_LSH_Heizleistung.phys );
    putValue( HIL_b_LSH_KVS, this.b_LSH_KVS.phys );
    putValue( HIL_b_LSH_KVS_Ueberlauf, this.b_LSH_KVS_Ueberlauf.phys );
    putValue( HIL_b_STH_KVS, this.b_STH_KVS.phys );
    putValue( HIL_b_STH_KVS_Ueberlauf, this.b_STH_KVS_Ueberlauf.phys );
    putValue( HIL_s_aussentemp_in_anzeige, this.s_aussentemp_in_anzeige.phys );
    putValue( HIL_s_EFF_Verbrauch_STH, this.s_EFF_Verbrauch_STH.phys );
    putValue( HIL_s_STH_KVS, this.s_STH_KVS.phys );
}

on message DEV_Kombi_55
{
    putValue( HIL_hmi_durchschnittsgeschwindigkeit_e1_available, this.hmi_durchschnittsgeschwindigkeit_e1_available.phys );
    putValue( HIL_hmi_durchschnittsgeschwindigkeit_e2_available, this.hmi_durchschnittsgeschwindigkeit_e2_available.phys );
    putValue( HIL_hmi_durchschnittsgeschwindigkeit_e3, this.hmi_durchschnittsgeschwindigkeit_e3.phys );
    putValue( HIL_hmi_durchschnittsgeschwindigkeit_e3_available, this.hmi_durchschnittsgeschwindigkeit_e3_available.phys );
    putValue( HIL_hmi_durchschnittsgeschwindigkeit_einheit, this.hmi_durchschnittsgeschwindigkeit_einheit.phys );
    putValue( HIL_hmi_durchschnittsgeschwindigkeit_sonderbehandlung_e1, this.hmi_durchschnittsgeschwindigkeit_sonderbehandlung_e1.phys );
    putValue( HIL_hmi_durchschnittsgeschwindigkeit_sonderbehandlung_e2, this.hmi_durchschnittsgeschwindigkeit_sonderbehandlung_e2.phys );
    putValue( HIL_hmi_durchschnittsgeschwindigkeit_sonderbehandlung_e3, this.hmi_durchschnittsgeschwindigkeit_sonderbehandlung_e3.phys );
    putValue( HIL_s_durchschnittsgeschwindigkeit_e1, this.s_durchschnittsgeschwindigkeit_e1.phys );
    putValue( HIL_s_durchschnittsgeschwindigkeit_e2, this.s_durchschnittsgeschwindigkeit_e2.phys );
    putValue( HIL_s_durchschnittsgeschwindigkeit_e3, this.s_durchschnittsgeschwindigkeit_e3.phys );
}

on message DEV_Kombi_61
{
    putValue( HIL_b_BMS_Ladevorgang_aktiv, this.b_BMS_Ladevorgang_aktiv.phys );
    putValue( HIL_b_MO_Freilauf_Status, this.b_MO_Freilauf_Status.phys );
    putValue( HIL_hmi_bc_e3_auto_reset, this.hmi_bc_e3_auto_reset.phys );
    putValue( HIL_hmi_bc_momentanverbrauch_einheit_gas, this.hmi_bc_momentanverbrauch_einheit_gas.phys );
    putValue( HIL_hmi_durchschnittsgeschwindigkeit_e1, this.hmi_durchschnittsgeschwindigkeit_e1.phys );
    putValue( HIL_hmi_durchschnittsgeschwindigkeit_e2, this.hmi_durchschnittsgeschwindigkeit_e2.phys );
    putValue( HIL_hmi_durchschnittsverbrauch_e1_available, this.hmi_durchschnittsverbrauch_e1_available.phys );
    putValue( HIL_hmi_durchschnittsverbrauch_e2_available, this.hmi_durchschnittsverbrauch_e2_available.phys );
    putValue( HIL_s_at_zeitkonstante, this.s_at_zeitkonstante.phys );
    putValue( HIL_s_bc_reset_durchschnittsgeschwindigkeit_e1, this.s_bc_reset_durchschnittsgeschwindigkeit_e1.phys );
    putValue( HIL_s_bc_reset_durchschnittsgeschwindigkeit_e2, this.s_bc_reset_durchschnittsgeschwindigkeit_e2.phys );
    putValue( HIL_s_bc_reset_durchschnittsgeschwindigkeit_e3, this.s_bc_reset_durchschnittsgeschwindigkeit_e3.phys );
    putValue( HIL_s_bc_reset_durchschnittsverbrauch_e1, this.s_bc_reset_durchschnittsverbrauch_e1.phys );
    putValue( HIL_s_bc_reset_durchschnittsverbrauch_e2, this.s_bc_reset_durchschnittsverbrauch_e2.phys );
    putValue( HIL_s_bc_reset_durchschnittsverbrauch_e3, this.s_bc_reset_durchschnittsverbrauch_e3.phys );
    putValue( HIL_s_bc_reset_e1, this.s_bc_reset_e1.phys );
    putValue( HIL_s_bc_reset_e2, this.s_bc_reset_e2.phys );
    putValue( HIL_s_bc_reset_e3, this.s_bc_reset_e3.phys );
    putValue( HIL_s_bc_reset_fahrstrecke_e1, this.s_bc_reset_fahrstrecke_e1.phys );
    putValue( HIL_s_bc_reset_fahrstrecke_e2, this.s_bc_reset_fahrstrecke_e2.phys );
    putValue( HIL_s_bc_reset_fahrstrecke_e3, this.s_bc_reset_fahrstrecke_e3.phys );
    putValue( HIL_s_bc_reset_fahrzeit_e1, this.s_bc_reset_fahrzeit_e1.phys );
    putValue( HIL_s_bc_reset_fahrzeit_e2, this.s_bc_reset_fahrzeit_e2.phys );
    putValue( HIL_s_bc_reset_fahrzeit_e3, this.s_bc_reset_fahrzeit_e3.phys );
    putValue( HIL_s_fallende_tendenz, this.s_fallende_tendenz.phys );
    putValue( HIL_s_KBI_BC_Reset_E1, this.s_KBI_BC_Reset_E1.phys );
    putValue( HIL_s_KBI_BC_Reset_E2, this.s_KBI_BC_Reset_E2.phys );
    putValue( HIL_s_KBI_BC_Reset_E3, this.s_KBI_BC_Reset_E3.phys );
    putValue( HIL_s_KBI_QBit_Aussen_Temp_gef, this.s_KBI_QBit_Aussen_Temp_gef.phys );
    putValue( HIL_s_kurzzeit_altwert_ende, this.s_kurzzeit_altwert_ende.phys );
    putValue( HIL_s_kurzzeit_reset, this.s_kurzzeit_reset.phys );
    putValue( HIL_s_tankstop_altwert_ende, this.s_tankstop_altwert_ende.phys );
    putValue( HIL_s_tankstop_reset, this.s_tankstop_reset.phys );
    putValue( HIL_set_hmi_e1_reset, this.set_hmi_e1_reset.phys );
    putValue( HIL_set_hmi_e2_reset, this.set_hmi_e2_reset.phys );
    putValue( HIL_set_hmi_e3_reset, this.set_hmi_e3_reset.phys );
}

on message DEV_Kombi_62
{
    putValue( HIL_b_MO_CNG_Ueberlauf, this.b_MO_CNG_Ueberlauf.phys );
    putValue( HIL_b_MO_KVS, this.b_MO_KVS.phys );
    putValue( HIL_b_MO_KVS_Ueberlauf, this.b_MO_KVS_Ueberlauf.phys );
    putValue( HIL_b_MO_LPG_Ueberlauf, this.b_MO_LPG_Ueberlauf.phys );
    putValue( HIL_b_MO_Verbrauch_CNG, this.b_MO_Verbrauch_CNG.phys );
    putValue( HIL_b_MO_Verbrauch_LPG, this.b_MO_Verbrauch_LPG.phys );
    putValue( HIL_hmi_durchschnittsverbrauch_e1_sonderbehandlung, this.hmi_durchschnittsverbrauch_e1_sonderbehandlung.phys );
    putValue( HIL_s_durchschnittsverbrauch_e1, this.s_durchschnittsverbrauch_e1.phys );
    putValue( HIL_hmi_durchschnittsverbrauch_e1_sonderbehandlung, this.hmi_durchschnittsverbrauch_e1_sonderbehandlung.phys );
    putValue( HIL_s_durchschnittsverbrauch_e1, this.s_durchschnittsverbrauch_e1.phys );
}

on message DEV_Kombi_63
{
      //update MY20
    putValue( HIL_hmi_durchschnittsverbrauch_e2_sonderbehandlung, this.hmi_durchschnittsverbrauch_e2_sonderbehandlung.phys );
    putValue( HIL_hmi_durchschnittsverbrauch_e3_sonderbehandlung, this.hmi_durchschnittsverbrauch_e3_sonderbehandlung.phys );
    putValue( HIL_hmi_durchschnittsverbrauch_gas_e1_sonderbehandlung, this.hmi_durchschnittsverbrauch_gas_e1_sonderbehandlung.phys );
    putValue( HIL_hmi_durchschnittsverbrauch_gas_e2_sonderbehandlung, this.hmi_durchschnittsverbrauch_gas_e2_sonderbehandlung.phys );
    putValue( HIL_s_durchschnittsverbrauch_e2, this.s_durchschnittsverbrauch_e2.phys );
    putValue( HIL_s_durchschnittsverbrauch_e3, this.s_durchschnittsverbrauch_e3.phys );
    putValue( HIL_s_durchschnittsverbrauch_gas_e1, this.s_durchschnittsverbrauch_gas_e1.phys );
    putValue( HIL_s_durchschnittsverbrauch_gas_e2, this.s_durchschnittsverbrauch_gas_e2.phys );
    //end update MY20
}

on message DEV_Kombi_64
{
    //update MY20
    putValue( HIL_hmi_durchschnittsverbrauch_e1, this.hmi_durchschnittsverbrauch_e1.phys );
    putValue( HIL_hmi_durchschnittsverbrauch_e2, this.hmi_durchschnittsverbrauch_e2.phys );
    putValue( HIL_hmi_durchschnittsverbrauch_e3, this.hmi_durchschnittsverbrauch_e3.phys );
    putValue( HIL_hmi_durchschnittsverbrauch_gas_e1, this.hmi_durchschnittsverbrauch_gas_e1.phys );
    putValue( HIL_hmi_durchschnittsverbrauch_gas_e3_sonderbehandlung, this.hmi_durchschnittsverbrauch_gas_e3_sonderbehandlung.phys );
    putValue( HIL_s_durchschnittsverbrauch_gas_e3, this.s_durchschnittsverbrauch_gas_e3.phys );
    //end update MY20
}

on message DEV_Kombi_65
{
  //update MY20

    putValue( HIL_hmi_durchschnittsverbrauch_einheit, this.hmi_durchschnittsverbrauch_einheit.phys );
    putValue( HIL_hmi_durchschnittsverbrauch_gas_e2, this.hmi_durchschnittsverbrauch_gas_e2.phys );
    putValue( HIL_hmi_durchschnittsverbrauch_gas_e3, this.hmi_durchschnittsverbrauch_gas_e3.phys );
    putValue( HIL_s_KBI_Aussen_Temp_gef, this.s_KBI_Aussen_Temp_gef.phys );
    putValue( HIL_s_momentanverbrauch_lpro100km, this.s_momentanverbrauch_lpro100km.phys );
    putValue( HIL_s_momentanverbrauch_lproh, this.s_momentanverbrauch_lproh.phys );
  //end update MY20
}

on message DEV_Kombi_71
{
    putValue( HIL_hmi_bc_momentanverbrauch, this.hmi_bc_momentanverbrauch.phys );
    putValue( HIL_hmi_bc_momentanverbrauch_bargraph, this.hmi_bc_momentanverbrauch_bargraph.phys );
    putValue( HIL_hmi_bc_momentanverbrauch_einheit, this.hmi_bc_momentanverbrauch_einheit.phys );
    putValue( HIL_hmi_bc_momentanverbrauch_einheit_bargraph, this.hmi_bc_momentanverbrauch_einheit_bargraph.phys );
    putValue( HIL_hmi_bc_momentanverbrauch_einheit_gas_bargraph, this.hmi_bc_momentanverbrauch_einheit_gas_bargraph.phys );
    putValue( HIL_hmi_bc_momentanverbrauch_gas, this.hmi_bc_momentanverbrauch_gas.phys );
    putValue( HIL_hmi_bc_momentanverbrauch_gas_bargraph, this.hmi_bc_momentanverbrauch_gas_bargraph.phys );
    putValue( HIL_hmi_bc_momentanverbrauch_gas_not_a_number_bargraph, this.hmi_bc_momentanverbrauch_gas_not_a_number_bargraph.phys );
    putValue( HIL_hmi_bc_momentanverbrauch_not_a_number, this.hmi_bc_momentanverbrauch_not_a_number.phys );
    putValue( HIL_hmi_bc_momentanverbrauch_not_a_number_bargraph, this.hmi_bc_momentanverbrauch_not_a_number_bargraph.phys );
    putValue( HIL_hmi_bc_momentanverbrauch_not_a_number_gas, this.hmi_bc_momentanverbrauch_not_a_number_gas.phys );
    putValue( HIL_hmi_momentanverbrauch_e1_available, this.hmi_momentanverbrauch_e1_available.phys );
    putValue( HIL_hmi_momentanverbrauch_e2_available, this.hmi_momentanverbrauch_e2_available.phys );
    putValue( HIL_hmi_momentanverbrauch_e3_available, this.hmi_momentanverbrauch_e3_available.phys );
}

on message DEV_Kombi_72
{
    putValue( HIL_hmi_durchschnittsverbrauch_einheit_gas, this.hmi_durchschnittsverbrauch_einheit_gas.phys );
    putValue( HIL_s_acc_laeufer, this.s_acc_laeufer.phys );
    putValue( HIL_s_acc_laeufer_hist_negativ, this.s_acc_laeufer_hist_negativ.phys );
    putValue( HIL_s_acc_laeufer_hist_positiv, this.s_acc_laeufer_hist_positiv.phys );
    putValue( HIL_s_momentanverbrauch_gas_pro100km, this.s_momentanverbrauch_gas_pro100km.phys );
    putValue( HIL_s_momentanverbrauch_gas_proh, this.s_momentanverbrauch_gas_proh.phys );
    putValue( HIL_s_schubabschaltung, this.s_schubabschaltung.phys );
    putValue( HIL_s_schubabschaltung_gas, this.s_schubabschaltung_gas.phys );
}

on message DEV_Kombi_73
{
    putValue( HIL_hmi_bc_fahrstrecke_e1, this.hmi_bc_fahrstrecke_e1.phys );
    putValue( HIL_hmi_bc_gesamt_reichweite_symbol, this.hmi_bc_gesamt_reichweite_symbol.phys );
    putValue( HIL_hmi_bc_sekundaer_reichweite_symbol, this.hmi_bc_sekundaer_reichweite_symbol.phys );  
    putValue( HIL_hmi_durchschnittsverbrauch_e3_available, this.hmi_durchschnittsverbrauch_e3_available.phys );
    putValue( HIL_hmi_fahrzeit_e1_available, this.hmi_fahrzeit_e1_available.phys );
    putValue( HIL_hmi_fahrzeit_e2_available, this.hmi_fahrzeit_e2_available.phys );
    putValue( HIL_hmi_fahrzeit_e3_available, this.hmi_fahrzeit_e3_available.phys );
    putValue( HIL_s_fahrstrecke_e3, this.s_fahrstrecke_e3.phys );
}

on message DEV_Kombi_74
{
    putValue( HIL_hmi_fahrstrecke_e1_available, this.hmi_fahrstrecke_e1_available.phys );
    putValue( HIL_hmi_fahrstrecke_e2_available, this.hmi_fahrstrecke_e2_available.phys );
    putValue( HIL_hmi_fahrstrecke_e3_available, this.hmi_fahrstrecke_e3_available.phys );
    putValue( HIL_hmi_fahrstrecke_einheit, this.hmi_fahrstrecke_einheit.phys );
    putValue( HIL_s_fahrstrecke_e1, this.s_fahrstrecke_e1.phys );
    putValue( HIL_s_fahrstrecke_e2, this.s_fahrstrecke_e2.phys );
}

on message DEV_Kombi_75
{
    putValue( HIL_b_RW_Prim_rRWB_aktiv, this.b_RW_Prim_rRWB_aktiv.phys );
    putValue( HIL_b_RW_Prim_rRWB_Reichw_Gesamt_Anz, this.b_RW_Prim_rRWB_Reichw_Gesamt_Anz.phys );  
    putValue( HIL_hmi_bc_fahrstrecke_e2, this.hmi_bc_fahrstrecke_e2.phys );
    putValue( HIL_hmi_bc_fahrstrecke_e3, this.hmi_bc_fahrstrecke_e3.phys );
    putValue( HIL_hmi_bc_primaer_reichweite_symbol, this.hmi_bc_primaer_reichweite_symbol.phys );
}

on message DEV_Kombi_81
{
    putValue( HIL_b_MO_Anzeige_StSt_Symbol, this.b_MO_Anzeige_StSt_Symbol.phys );
    putValue( HIL_b_MO_Anzeige_StSt_Text, this.b_MO_Anzeige_StSt_Text.phys );
    putValue( HIL_b_MO_AnzeigeGasbetrieb, this.b_MO_AnzeigeGasbetrieb.phys );
    putValue( HIL_b_MO_Effizienzmodus, this.b_MO_Effizienzmodus.phys );
    putValue( HIL_b_MO_EPCL, this.b_MO_EPCL.phys );
    putValue( HIL_b_MO_Erdgasqualitaet, this.b_MO_Erdgasqualitaet.phys );
    putValue( HIL_b_MO_Ethanol_BS_Texte, this.b_MO_Ethanol_BS_Texte.phys );
    putValue( HIL_b_MO_Istgang, this.b_MO_Istgang.phys );
    putValue( HIL_b_MO_KJS_nicht_bereit, this.b_MO_KJS_nicht_bereit.phys );
    putValue( HIL_b_MO_Motor_laeuft, this.b_MO_Motor_laeuft.phys );
    putValue( HIL_b_MO_Schaltempf_verfbar, this.b_MO_Schaltempf_verfbar.phys );
    putValue( HIL_b_MO_Sollgang, this.b_MO_Sollgang.phys );
    putValue( HIL_b_MO_StartStopp_Codiert, this.b_MO_StartStopp_Codiert.phys );
    putValue( HIL_b_MO_StartStopp_PopUp, this.b_MO_StartStopp_PopUp.phys );
    putValue( HIL_b_MO_Tankbereitschaft_Status, this.b_MO_Tankbereitschaft_Status.phys );
    putValue( HIL_b_MO_Tankmasse_CNG, this.b_MO_Tankmasse_CNG.phys );
    putValue( HIL_b_MO_Text_Motorstart, this.b_MO_Text_Motorstart.phys );
    putValue( HIL_b_MO_Text_Partikelfil_Reg, this.b_MO_Text_Partikelfil_Reg.phys );
    putValue( HIL_b_MO_Vorglueh_Lampe, this.b_MO_Vorglueh_Lampe.phys );
    putValue( HIL_hmi_motorstarttexte, this.hmi_motorstarttexte.phys );
    putValue( HIL_s_LED_EPC, this.s_LED_EPC.phys );
    putValue( HIL_s_LED_Vorgluehlampe, this.s_LED_Vorgluehlampe.phys );
    putValue( HIL_s_MO_akt_Betrieb, this.s_MO_akt_Betrieb.phys );
    putValue( HIL_s_MO_AnzeigeGasbetrieb, this.s_MO_AnzeigeGasbetrieb.phys );
    putValue( HIL_s_MO_Erdgasqualitaet, this.s_MO_Erdgasqualitaet.phys );
}

on message DEV_Kombi_82
{
    putValue( HIL_b_WIV_Russindex, this.b_WIV_Russindex.phys );
    putValue( HIL_b_WIV_t_max, this.b_WIV_t_max.phys );
    putValue( HIL_b_WIV_t_min, this.b_WIV_t_min.phys );
    putValue( HIL_b_WIV_Verschleissindex, this.b_WIV_Verschleissindex.phys );
    putValue( HIL_b_WIV_W_max, this.b_WIV_W_max.phys );
    putValue( HIL_b_WIV_W_min, this.b_WIV_W_min.phys );
    putValue( HIL_s_insp_reset_stelltaster, this.s_insp_reset_stelltaster.phys );
    putValue( HIL_s_oel_vorwarnung_in_km, this.s_oel_vorwarnung_in_km.phys );
    putValue( HIL_s_oel_vorwarnung_in_tagen, this.s_oel_vorwarnung_in_tagen.phys );
    putValue( HIL_s_oil_insp_reset_stelltaster, this.s_oil_insp_reset_stelltaster.phys );
    putValue( HIL_s_service_vorwarnung_aktiv, this.s_service_vorwarnung_aktiv.phys );
    putValue( HIL_s_service_warnung_aktiv, this.s_service_warnung_aktiv.phys );
}

on message DEV_Kombi_83
{
    putValue( HIL_hmi_oil_restlauf_strecke, this.hmi_oil_restlauf_strecke.phys );
    putValue( HIL_hmi_service_restlauf_strecke, this.hmi_service_restlauf_strecke.phys );
    putValue( HIL_s_insp_faellig_km, this.s_insp_faellig_km.phys );
    putValue( HIL_s_insp_faellig_tage, this.s_insp_faellig_tage.phys );
    putValue( HIL_s_insp_praediktion_aktiv, this.s_insp_praediktion_aktiv.phys );
    putValue( HIL_s_insp_praediktion_aktiv_km, this.s_insp_praediktion_aktiv_km.phys );
    putValue( HIL_s_insp_praediktion_aktiv_tage, this.s_insp_praediktion_aktiv_tage.phys );
    putValue( HIL_s_insp_reset_km_DIAG_event, this.s_insp_reset_km_DIAG_event.phys );
    putValue( HIL_s_insp_reset_km_HMI_event, this.s_insp_reset_km_HMI_event.phys );
    putValue( HIL_s_insp_reset_tage_DIAG_event, this.s_insp_reset_tage_DIAG_event.phys );
    putValue( HIL_s_insp_vorwarnung_in_km, this.s_insp_vorwarnung_in_km.phys );
    putValue( HIL_s_insp_vorwarnung_in_tagen, this.s_insp_vorwarnung_in_tagen.phys );
    putValue( HIL_s_insp_warnung, this.s_insp_warnung.phys );
    putValue( HIL_s_KBI_Oil_dis, this.s_KBI_Oil_dis.phys );
    putValue( HIL_s_KBI_Oil_dis_status, this.s_KBI_Oil_dis_status.phys );
    putValue( HIL_s_KBI_Oil_dis_unit, this.s_KBI_Oil_dis_unit.phys );
    putValue( HIL_s_oel_insp_vorwarnung_in_km, this.s_oel_insp_vorwarnung_in_km.phys );
    putValue( HIL_s_oel_insp_vorwarnung_in_tagen, this.s_oel_insp_vorwarnung_in_tagen.phys );
    putValue( HIL_s_oel_insp_warnung, this.s_oel_insp_warnung.phys );
    putValue( HIL_s_oel_warnung, this.s_oel_warnung.phys );
    putValue( HIL_s_oil_faellig_km, this.s_oil_faellig_km.phys );
    putValue( HIL_s_oil_faellig_tage, this.s_oil_faellig_tage.phys );
    putValue( HIL_s_oil_praediktion_aktiv, this.s_oil_praediktion_aktiv.phys );
    putValue( HIL_s_oil_praediktion_aktiv_km, this.s_oil_praediktion_aktiv_km.phys );
    putValue( HIL_s_oil_praediktion_aktiv_tage, this.s_oil_praediktion_aktiv_tage.phys );
    putValue( HIL_s_oil_reset_DIAG_event, this.s_oil_reset_DIAG_event.phys );
    putValue( HIL_s_oil_reset_HMI_event, this.s_oil_reset_HMI_event.phys );
    putValue( HIL_s_oil_restlauf_nyc, this.s_oil_restlauf_nyc.phys );
    putValue( HIL_s_praediktion_aktiv, this.s_praediktion_aktiv.phys );
}

on message DEV_Kombi_84
{
    putValue( HIL_b_MO_Kraftstofffilter_Wasser, this.b_MO_Kraftstofffilter_Wasser.phys );
    putValue( HIL_b_MO_OBD2_Lampe, this.b_MO_OBD2_Lampe.phys );
    putValue( HIL_b_MO_Text_Tankdeckelwarn, this.b_MO_Text_Tankdeckelwarn.phys );
    putValue( HIL_hmi_insp_restlauf_strecke, this.hmi_insp_restlauf_strecke.phys );
    putValue( HIL_hmi_wiv_Oelmenge, this.hmi_wiv_Oelmenge.phys );
    putValue( HIL_hmi_wiv_Oelmenge_Einheit, this.hmi_wiv_Oelmenge_Einheit.phys );
    putValue( HIL_s_insp_reset_tage_HMI_event, this.s_insp_reset_tage_HMI_event.phys );
    putValue( HIL_s_KBI_Insp_dis, this.s_KBI_Insp_dis.phys );
    putValue( HIL_s_KBI_Insp_time, this.s_KBI_Insp_time.phys );
    putValue( HIL_s_KBI_Oil_time, this.s_KBI_Oil_time.phys );
    putValue( HIL_s_LED_OBD, this.s_LED_OBD.phys );
    putValue( HIL_s_MO_OBD2_Lampe_warn, this.s_MO_OBD2_Lampe_warn.phys );
    putValue( HIL_s_wiv_daten_unplausibel, this.s_wiv_daten_unplausibel.phys );
    putValue( HIL_s_WIV_Russindex_fehler, this.s_WIV_Russindex_fehler.phys );
    putValue( HIL_s_WIV_Verschleissindex_fehler, this.s_WIV_Verschleissindex_fehler.phys );
}

on message DEV_Kombi_85
{
    putValue( HIL_b_MO_Anzeige_Leistung_Max, this.b_MO_Anzeige_Leistung_Max.phys );
    putValue( HIL_b_MO_Ladedruck, this.b_MO_Ladedruck.phys );
    putValue( HIL_b_MO_Leistung, this.b_MO_Leistung.phys );
    putValue( HIL_b_MO_max_Ladedruck, this.b_MO_max_Ladedruck.phys );
    putValue( HIL_b_MO_rel_Ladedruck, this.b_MO_rel_Ladedruck.phys );
    putValue( HIL_b_TSK_Status_vMax_FahrerInfo, this.b_TSK_Status_vMax_FahrerInfo.phys );
    putValue( HIL_hmi_Ladedruck, this.hmi_Ladedruck.phys );
    putValue( HIL_hmi_wiv_Oelstand, this.hmi_wiv_Oelstand.phys );
    putValue( HIL_s_KBI_Vorglueh_System_Lampe, this.s_KBI_Vorglueh_System_Lampe.phys );
    putValue( HIL_s_MO_CNG_LPG, this.s_MO_CNG_LPG.phys );
}

on message DEV_Kombi_91
{
    putValue( HIL_b_MO_Anzahl_Zyl, this.b_MO_Anzahl_Zyl.phys );
    putValue( HIL_b_MO_Anzeige_Drehmoment, this.b_MO_Anzeige_Drehmoment.phys );
    putValue( HIL_b_MO_Anzeige_Drehmoment_Max, this.b_MO_Anzeige_Drehmoment_Max.phys );
    putValue( HIL_b_MO_MKB_01, this.b_MO_MKB_01.phys );
    putValue( HIL_b_MO_MKB_02, this.b_MO_MKB_02.phys );
    putValue( HIL_b_MO_MKB_03, this.b_MO_MKB_03.phys );
    putValue( HIL_b_MO_MKB_04, this.b_MO_MKB_04.phys );
    putValue( HIL_b_MO_Zylabsch_Texte_02, this.b_MO_Zylabsch_Texte_02.phys );
    putValue( HIL_hmi_anzahl_aktiver_zylinder, this.hmi_anzahl_aktiver_zylinder.phys );
    putValue( HIL_hmi_anzahl_zylinder, this.hmi_anzahl_zylinder.phys );
    putValue( HIL_hmi_zylinderabschaltung_anzeigen, this.hmi_zylinderabschaltung_anzeigen.phys );
    putValue( HIL_hmi_zylinderabschaltung_stoerung, this.hmi_zylinderabschaltung_stoerung.phys );
    putValue( HIL_hmi_zylinderabschaltung_uebergangsbetrieb, this.hmi_zylinderabschaltung_uebergangsbetrieb.phys );
}

on message DEV_Kombi_92
{
    putValue( HIL_b_MO_ITM_Warnung_Pumpe, this.b_MO_ITM_Warnung_Pumpe.phys );
    putValue( HIL_b_SCR_Einheit, this.b_SCR_Einheit.phys );
    putValue( HIL_b_SCR_Nachfuellmenge_Einheit, this.b_SCR_Nachfuellmenge_Einheit.phys );
    putValue( HIL_b_SCR_Nachfuellmenge_max, this.b_SCR_Nachfuellmenge_max.phys );
    putValue( HIL_b_SCR_Nachfuellmenge_min, this.b_SCR_Nachfuellmenge_min.phys );
    putValue( HIL_b_SCR_Restreichweite, this.b_SCR_Restreichweite.phys );
    putValue( HIL_b_SCR_Retriggersignal, this.b_SCR_Retriggersignal.phys );
    putValue( HIL_b_SCR_verbaut, this.b_SCR_verbaut.phys );
    putValue( HIL_b_SCR_Zustand, this.b_SCR_Zustand.phys );
    putValue( HIL_hmi_bc_oeltemperatur, this.hmi_bc_oeltemperatur.phys );
    putValue( HIL_hmi_scr_reichweite, this.hmi_scr_reichweite.phys );
}

on message DEV_Kombi_93
{
    putValue( HIL_b_MO_Anzeige_Fahrbereitschaft, this.b_MO_Anzeige_Fahrbereitschaft.phys );
    putValue( HIL_b_MO_Anzeige_FMAus_Text, this.b_MO_Anzeige_FMAus_Text.phys );
    putValue( HIL_b_MO_Anzeigedrehz, this.b_MO_Anzeigedrehz.phys );
    putValue( HIL_b_MO_Drehzahl_Warnung, this.b_MO_Drehzahl_Warnung.phys );
    putValue( HIL_b_MO_EFLEX_Lampe, this.b_MO_EFLEX_Lampe.phys );
    putValue( HIL_b_MO_Fehler_Oeldrucksensor, this.b_MO_Fehler_Oeldrucksensor.phys );
    putValue( HIL_b_MO_obere_Drehzahlgrenze, this.b_MO_obere_Drehzahlgrenze.phys );
    putValue( HIL_b_MO_Oelwarnung_max, this.b_MO_Oelwarnung_max.phys );
    putValue( HIL_b_MO_Verbau_StartSys_Q_Diode, this.b_MO_Verbau_StartSys_Q_Diode.phys );
    putValue( HIL_b_WIV_nachfuellanzeige_ein, this.b_WIV_nachfuellanzeige_ein.phys );
    putValue( HIL_b_WIV_Oeldr_Warn_Motor, this.b_WIV_Oeldr_Warn_Motor.phys );
    putValue( HIL_b_WIV_Oelmenge, this.b_WIV_Oelmenge.phys );
    putValue( HIL_b_WIV_Oelmin_Warn, this.b_WIV_Oelmin_Warn.phys );
    putValue( HIL_b_WIV_Oelstand, this.b_WIV_Oelstand.phys );
    putValue( HIL_b_WIV_Oelsystem_aktiv, this.b_WIV_Oelsystem_aktiv.phys );
    putValue( HIL_b_WIV_Sensorfehler, this.b_WIV_Sensorfehler.phys );
    putValue( HIL_b_WIV_Ueberfuell_deaktiv, this.b_WIV_Ueberfuell_deaktiv.phys );
    putValue( HIL_b_WIV_Ueberfuell_Warn, this.b_WIV_Ueberfuell_Warn.phys );
    putValue( HIL_b_WIV_Unterfuell_Warn, this.b_WIV_Unterfuell_Warn.phys );
    putValue( HIL_s_drehzahl_displayanzeige, this.s_drehzahl_displayanzeige.phys );
    putValue( HIL_s_dzm_zeigerposition, this.s_dzm_zeigerposition.phys );
    putValue( HIL_s_LED_Vorgluehlampe_blinken, this.s_LED_Vorgluehlampe_blinken.phys );
    putValue( HIL_s_MO_MKB_MUX, this.s_MO_MKB_MUX.phys );
    putValue( HIL_s_MO_Oel_Temp_Client_vorhanden, this.s_MO_Oel_Temp_Client_vorhanden.phys );
    putValue( HIL_s_MO_Oel_Temp_Werte_vorhanden, this.s_MO_Oel_Temp_Werte_vorhanden.phys );
}

on message DEV_Kombi_94
{
    putValue( HIL_b_BCM_Kuehlmittel_Sensor, this.b_BCM_Kuehlmittel_Sensor.phys );
    putValue( HIL_b_BCM_Kuehlmittel_Sensor_02, this.b_BCM_Kuehlmittel_Sensor_02.phys );
    putValue( HIL_b_MO_Heissleuchte, this.b_MO_Heissleuchte.phys );
    putValue( HIL_b_MO_ITM_Kuehlmittel_Temp, this.b_MO_ITM_Kuehlmittel_Temp.phys );
    putValue( HIL_b_MO_Oel_Temp, this.b_MO_Oel_Temp.phys );
    putValue( HIL_b_OLEV_Oelstand_nicht_vorhanden, this.b_OLEV_Oelstand_nicht_vorhanden.phys );
    putValue( HIL_b_OLEV_Systemstoerung, this.b_OLEV_Systemstoerung.phys );
    putValue( HIL_b_WIV_Anzeige_aktiv, this.b_WIV_Anzeige_aktiv.phys );
    putValue( HIL_hmi_bc_kuehlmitteltemperatur, this.hmi_bc_kuehlmitteltemperatur.phys );
    putValue( HIL_s_kuehlmittel_kalt_warn, this.s_kuehlmittel_kalt_warn.phys );
    putValue( HIL_s_kuehlmittelmangel_warn, this.s_kuehlmittelmangel_warn.phys );
    putValue( HIL_s_kuehlmitteltemp, this.s_kuehlmitteltemp.phys );
    putValue( HIL_s_kuehlmitteltemp_analog, this.s_kuehlmitteltemp_analog.phys );
    putValue( HIL_s_kuehlmitteltemp_displayanzeige, this.s_kuehlmitteltemp_displayanzeige.phys );
    putValue( HIL_s_LED_Kaltleuchte, this.s_LED_Kaltleuchte.phys );
    putValue( HIL_s_LED_Kuehlmittelmangel_blinken, this.s_LED_Kuehlmittelmangel_blinken.phys );
    putValue( HIL_s_MO_Kuehl_Temp_Werte_vorhanden, this.s_MO_Kuehl_Temp_Werte_vorhanden.phys );
    putValue( HIL_s_MO_Oel_Temp, this.s_MO_Oel_Temp.phys );
}

on message DEV_Kombi_95
{
    putValue( HIL_b_BCM_Bremsfluessigkeit_Sensor, this.b_BCM_Bremsfluessigkeit_Sensor.phys );
    putValue( HIL_b_CHA_Kombi_Texte, this.b_CHA_Kombi_Texte.phys );
    putValue( HIL_b_CHA_Kombi_Texte_02, this.b_CHA_Kombi_Texte_02.phys );
    putValue( HIL_b_CHA_Offroad_LED, this.b_CHA_Offroad_LED.phys );
    putValue( HIL_b_ESC_Lernfreigabe_Abrollumfang, this.b_ESC_Lernfreigabe_Abrollumfang.phys );
    putValue( HIL_b_ESP_Meldungen, this.b_ESP_Meldungen.phys );
    putValue( HIL_b_ESP_Textanzeigen_03, this.b_ESP_Textanzeigen_03.phys );
    putValue( HIL_b_MO_Anz_Kuehlerluefter, this.b_MO_Anz_Kuehlerluefter.phys );
    putValue( HIL_b_MO_Schaltblitz_Anz, this.b_MO_Schaltblitz_Anz.phys );
    putValue( HIL_dah_schaltblitz_blinkfrequenz, this.dah_schaltblitz_blinkfrequenz.phys );
    putValue( HIL_hmi_analoggeschwindigkeit_digital_einheit, this.hmi_analoggeschwindigkeit_digital_einheit.phys );
    putValue( HIL_s_Bremsbelag_RdW, this.s_Bremsbelag_RdW.phys );
    putValue( HIL_s_gap_mfa, this.s_gap_mfa.phys );
    putValue( HIL_s_gap_texte, this.s_gap_texte.phys );
    putValue( HIL_s_LED_RDK, this.s_LED_RDK.phys );
    putValue( HIL_s_LED_RDK_blinken, this.s_LED_RDK_blinken.phys );
}

on message DEV_Kombi_101
{
    putValue( HIL_b_ESP_Wegimp_VA, this.b_ESP_Wegimp_VA.phys );
    putValue( HIL_b_ESP_Zaehnezahl, this.b_ESP_Zaehnezahl.phys );
    putValue( HIL_s_gesamtwegstrecke, this.s_gesamtwegstrecke.phys );
    putValue( HIL_s_tageswegstrecke_reset_rueckgaengig, this.s_tageswegstrecke_reset_rueckgaengig.phys );
}

on message DEV_Kombi_102
{
    putValue( HIL_b_BCM_Bremsbelag_Sensor, this.b_BCM_Bremsbelag_Sensor.phys );
    putValue( HIL_b_EPB_Autoholdlampe_02, this.b_EPB_Autoholdlampe_02.phys );
    putValue( HIL_b_EPB_Funktionslampe_02, this.b_EPB_Funktionslampe_02.phys );
    putValue( HIL_b_EPB_Texte_02, this.b_EPB_Texte_02.phys );
    putValue( HIL_b_ESP_Wegimp_Ueberlauf, this.b_ESP_Wegimp_Ueberlauf.phys );
    putValue( HIL_b_RDK_FMVSS138_MIL, this.b_RDK_FMVSS138_MIL.phys );
    putValue( HIL_hmi_gesamtwegstrecke, this.hmi_gesamtwegstrecke.phys );
    putValue( HIL_hmi_gesamtwegstrecke_einheit, this.hmi_gesamtwegstrecke_einheit.phys );
    putValue( HIL_hmi_tageswegstrecke, this.hmi_tageswegstrecke.phys );
    putValue( HIL_hmi_tageswegstrecke_einheit , this.hmi_tageswegstrecke_einheit .phys );
    putValue( HIL_s_Bremsbelag_US, this.s_Bremsbelag_US.phys );
    putValue( HIL_s_feststellbremse_warnung, this.s_feststellbremse_warnung.phys );
    putValue( HIL_s_gws_teilfehler, this.s_gws_teilfehler.phys );
    putValue( HIL_s_gws_totalfehler, this.s_gws_totalfehler.phys );
    putValue( HIL_s_LED_BVA, this.s_LED_BVA.phys );
    putValue( HIL_s_LED_EPB_gruen, this.s_LED_EPB_gruen.phys );
    putValue( HIL_s_RDK_mil, this.s_RDK_mil.phys );
    putValue( HIL_s_RDK_Systemstoerung, this.s_RDK_Systemstoerung.phys );
}

on message DEV_Kombi_103
{
    putValue( HIL_b_ESP_m_Raddrehz, this.b_ESP_m_Raddrehz.phys );
    putValue( HIL_s_geschwindigkeit_analog, this.s_geschwindigkeit_analog.phys );
    putValue( HIL_s_geschwindigkeit_plaus2, this.s_geschwindigkeit_plaus2.phys );
    putValue( HIL_s_KBI_angez_Geschw, this.s_KBI_angez_Geschw.phys );
    putValue( HIL_s_kombi_tachokennlinie_fehler, this.s_kombi_tachokennlinie_fehler.phys );
    putValue( HIL_s_radumfang_max, this.s_radumfang_max.phys );
}

on message DEV_Kombi_104
{
    putValue( HIL_b_ABS_Lampe, this.b_ABS_Lampe.phys );
    putValue( HIL_b_CHA_Current_Mode_FPA, this.b_CHA_Current_Mode_FPA.phys );
    putValue( HIL_b_DR_Gelbe_Warnlampe, this.b_DR_Gelbe_Warnlampe.phys );
    putValue( HIL_b_EPB_Autohold_Standbyanzeige, this.b_EPB_Autohold_Standbyanzeige.phys );
    putValue( HIL_b_Quersperre_Anz_Sperre_Auslegen, this.b_Quersperre_Anz_Sperre_Auslegen.phys );
    putValue( HIL_b_Quersperre_Anz_Sperre_Einlegen, this.b_Quersperre_Anz_Sperre_Einlegen.phys );
    putValue( HIL_b_Quersperre_Anz_Sperre_Geschl, this.b_Quersperre_Anz_Sperre_Geschl.phys );
    putValue( HIL_b_RDK_Warnungen_02, this.b_RDK_Warnungen_02.phys );
    putValue( HIL_b_TC_Lampe, this.b_TC_Lampe.phys );
    putValue( HIL_hmi_analoggeschwindigkeit, this.hmi_analoggeschwindigkeit.phys );
    putValue( HIL_hmi_analoggeschwindigkeit_einheit, this.hmi_analoggeschwindigkeit_einheit.phys );
    putValue( HIL_hmi_digital_zweitgeschwindigkeit, this.hmi_digital_zweitgeschwindigkeit.phys );
    putValue( HIL_hmi_digital_zweitgeschwindigkeit_einheit, this.hmi_digital_zweitgeschwindigkeit_einheit.phys );
    putValue( HIL_s_bremsfluessigkeitsmangel_warn, this.s_bremsfluessigkeitsmangel_warn.phys );
    putValue( HIL_s_geschwindigkeit_berechnet, this.s_geschwindigkeit_berechnet.phys );
    putValue( HIL_s_LED_ABS, this.s_LED_ABS.phys );
    putValue( HIL_s_LED_ABS_US, this.s_LED_ABS_US.phys );
    putValue( HIL_s_LED_Autohold_Standby_weiss, this.s_LED_Autohold_Standby_weiss.phys );
    putValue( HIL_s_LED_Quersperre, this.s_LED_Quersperre.phys );
    putValue( HIL_s_LED_Quersperre_blinken, this.s_LED_Quersperre_blinken.phys );
    putValue( HIL_s_LED_TC, this.s_LED_TC.phys );
    putValue( HIL_s_mittlere_raddrehzahl_fehler, this.s_mittlere_raddrehzahl_fehler.phys );
}

on message DEV_Kombi_105
{
    putValue( HIL_b_BK_Lampe_02, this.b_BK_Lampe_02.phys );
    putValue( HIL_b_BR_Systemart, this.b_BR_Systemart.phys );
    putValue( HIL_b_EPS_Warnungen, this.b_EPS_Warnungen.phys );
    putValue( HIL_b_ESP_BKV_Warnung, this.b_ESP_BKV_Warnung.phys );
    putValue( HIL_b_ESP_Lampe, this.b_ESP_Lampe.phys );
    putValue( HIL_b_ESP_Off_Lampe, this.b_ESP_Off_Lampe.phys );
    putValue( HIL_b_GNSS_Ortung_2D_Geschw_ue_Grund, this.b_GNSS_Ortung_2D_Geschw_ue_Grund.phys );
    putValue( HIL_b_LWI_Lenkradwinkel, this.b_LWI_Lenkradwinkel.phys );
    putValue( HIL_b_LWI_VZ_Lenkradwinkel, this.b_LWI_VZ_Lenkradwinkel.phys );
    putValue( HIL_b_RDK_FMVSS138_Lampe, this.b_RDK_FMVSS138_Lampe.phys );
    putValue( HIL_b_RDK_Kalibrierung, this.b_RDK_Kalibrierung.phys );
    putValue( HIL_b_RKA_FMVSS138_Lampe, this.b_RKA_FMVSS138_Lampe.phys );
    putValue( HIL_b_RKA_FMVSS138_MIL, this.b_RKA_FMVSS138_MIL.phys );
    putValue( HIL_b_RKA_Warnungen_02, this.b_RKA_Warnungen_02.phys );
    putValue( HIL_b_RLE_Anzeigen, this.b_RLE_Anzeigen.phys );
    putValue( HIL_s_ESP_Lampe, this.s_ESP_Lampe.phys );
    putValue( HIL_s_LED_BKL, this.s_LED_BKL.phys );
    putValue( HIL_s_LED_BKL_US, this.s_LED_BKL_US.phys );
    putValue( HIL_s_LED_ESP, this.s_LED_ESP.phys );
    putValue( HIL_s_LED_ESP_OFF, this.s_LED_ESP_OFF.phys );
    putValue( HIL_s_LED_Lenkhilfe_gelb, this.s_LED_Lenkhilfe_gelb.phys );
    putValue( HIL_s_LED_Lenkhilfe_gelb_blinken, this.s_LED_Lenkhilfe_gelb_blinken.phys );
    putValue( HIL_s_LED_Lenkhilfe_rot, this.s_LED_Lenkhilfe_rot.phys );
    putValue( HIL_s_RKA_mil, this.s_RKA_mil.phys );
    putValue( HIL_s_RKA_Systemstoerung, this.s_RKA_Systemstoerung.phys );
}

on message DEV_Kombi_111
{
    putValue( HIL_s_tank_beschl_x_vorgefiltert, this.s_tank_beschl_x_vorgefiltert.phys );
    putValue( HIL_s_tank_beschl_y_vorgefiltert, this.s_tank_beschl_y_vorgefiltert.phys );
    putValue( HIL_s_tank_nte_log_error_n, this.s_tank_nte_log_error_n.phys );
    putValue( HIL_s_tank_tankstop, this.s_tank_tankstop.phys );
    putValue( HIL_s_tank_tanksystemwarnung, this.s_tank_tanksystemwarnung.phys );
    putValue( HIL_s_tank_tankwarnung, this.s_tank_tankwarnung.phys );
    putValue( HIL_s_tank_vol_geber_avrg_ntb_log_n, this.s_tank_vol_geber_avrg_ntb_log_n.phys );
    putValue( HIL_s_tank_wsa_log_n, this.s_tank_wsa_log_n.phys );
}

on message DEV_Kombi_112
{
    putValue( HIL_b_ESP_QBit_Laengsbeschl, this.b_ESP_QBit_Laengsbeschl.phys );
    putValue( HIL_b_ESP_QBit_Querb, this.b_ESP_QBit_Querb.phys );
    putValue( HIL_b_MO_akt_Betrieb, this.b_MO_akt_Betrieb.phys );
    putValue( HIL_s_bargraph_extern_an, this.s_bargraph_extern_an.phys );
    putValue( HIL_s_bargraph_tnk_aktiv, this.s_bargraph_tnk_aktiv.phys );
    putValue( HIL_s_bargraph_tnk_intern_an, this.s_bargraph_tnk_intern_an.phys );
    putValue( HIL_s_gastank_anzeige_dyn_Rotbereich, this.s_gastank_anzeige_dyn_Rotbereich.phys );
    putValue( HIL_s_gastank_anzeige_winkel, this.s_gastank_anzeige_winkel.phys );
    putValue( HIL_s_tank_anzeige_relativ, this.s_tank_anzeige_relativ.phys );
    putValue( HIL_s_tank_anzeigefreigabe, this.s_tank_anzeigefreigabe.phys );
    putValue( HIL_s_tank_delta_event, this.s_tank_delta_event.phys );
    putValue( HIL_s_tank_geber_kopplung_beschl_x, this.s_tank_geber_kopplung_beschl_x.phys );
    putValue( HIL_s_tank_lookup_vol_nte_zu, this.s_tank_lookup_vol_nte_zu.phys );
    putValue( HIL_s_tank_obd_warnung, this.s_tank_obd_warnung.phys );
    putValue( HIL_s_tank_ottodiesel_anzeigefreigabe, this.s_tank_ottodiesel_anzeigefreigabe.phys );
    putValue( HIL_s_tank_zustand_v_gr_0, this.s_tank_zustand_v_gr_0.phys );
}

on message DEV_Kombi_113
{
    putValue( HIL_hmi_bc_nachtankmenge_sonderbehandlung, this.hmi_bc_nachtankmenge_sonderbehandlung.phys );
    putValue( HIL_hmi_bc_nachtankmenge_vorhanden, this.hmi_bc_nachtankmenge_vorhanden.phys );
    putValue( HIL_s_gastank_anzeige_prozent, this.s_gastank_anzeige_prozent.phys );
    putValue( HIL_s_nachtankvolumen, this.s_nachtankvolumen.phys );
    putValue( HIL_s_tank_anzeige_dyn_Rotbereich, this.s_tank_anzeige_dyn_Rotbereich.phys );
    putValue( HIL_s_tank_anzeige_prozent, this.s_tank_anzeige_prozent.phys );
    putValue( HIL_s_tank_anzeige_winkel, this.s_tank_anzeige_winkel.phys );
}

on message DEV_Kombi_114
{
    putValue( HIL_b_MO_CNG_LPG, this.b_MO_CNG_LPG.phys );
    putValue( HIL_b_MO_CNG_Tankstopp, this.b_MO_CNG_Tankstopp.phys );
    putValue( HIL_b_MO_Fuellungsgrad_CNG, this.b_MO_Fuellungsgrad_CNG.phys );
    putValue( HIL_b_MO_Fuellungsgrad_LPG, this.b_MO_Fuellungsgrad_LPG.phys );
    putValue( HIL_b_MO_LPG_Tankstopp, this.b_MO_LPG_Tankstopp.phys );
    putValue( HIL_s_bargraph_gastnk_aktiv, this.s_bargraph_gastnk_aktiv.phys );
    putValue( HIL_s_bargraph_gastnk_intern_an, this.s_bargraph_gastnk_intern_an.phys );
    putValue( HIL_s_gasbargraph_extern_an, this.s_gasbargraph_extern_an.phys );
    putValue( HIL_s_gastank_anzeige_relativ, this.s_gastank_anzeige_relativ.phys );
    putValue( HIL_s_gastank_anzeigefreigabe, this.s_gastank_anzeigefreigabe.phys );
    putValue( HIL_s_gastank_fuellungsgrad, this.s_gastank_fuellungsgrad.phys );
    putValue( HIL_s_gastank_systemfehler_cng, this.s_gastank_systemfehler_cng.phys );
    putValue( HIL_s_gastank_systemfehler_lpg, this.s_gastank_systemfehler_lpg.phys );
    putValue( HIL_s_gastank_warnung_cng_LED, this.s_gastank_warnung_cng_LED.phys );
    putValue( HIL_s_gastank_warnung_lpg, this.s_gastank_warnung_lpg.phys );
    putValue( HIL_s_LED_CNG_Reserve, this.s_LED_CNG_Reserve.phys );
}

on message DEV_Kombi_115
{
    putValue( HIL_s_adc_guete_g3, this.s_adc_guete_g3.phys );
    putValue( HIL_s_adc_guete_g4, this.s_adc_guete_g4.phys );
    putValue( HIL_s_adc_ohmwert_skaliert_g2, this.s_adc_ohmwert_skaliert_g2.phys );
    putValue( HIL_s_adc_ohmwert_skaliert_g3, this.s_adc_ohmwert_skaliert_g3.phys );
    putValue( HIL_s_adc_r12_gemessen, this.s_adc_r12_gemessen.phys );
    putValue( HIL_s_adc_r1s, this.s_adc_r1s.phys );
    putValue( HIL_s_adc_r32_gemessen, this.s_adc_r32_gemessen.phys );
}

on message DEV_Kombi_121
{
    putValue( HIL_s_adc_guete_g1, this.s_adc_guete_g1.phys );
    putValue( HIL_s_adc_ohmwert_skaliert_g4, this.s_adc_ohmwert_skaliert_g4.phys );
    putValue( HIL_s_adc_r21_gemessen, this.s_adc_r21_gemessen.phys );
    putValue( HIL_s_adc_r2s, this.s_adc_r2s.phys );
    putValue( HIL_s_adc_r31_gemessen, this.s_adc_r31_gemessen.phys );
    putValue( HIL_s_adc_r3s, this.s_adc_r3s.phys );
    putValue( HIL_s_adc_r4s, this.s_adc_r4s.phys );
}

on message DEV_Kombi_122
{
    putValue( HIL_s_adc_r11_gemessen, this.s_adc_r11_gemessen.phys );
    putValue( HIL_s_adc_r11_r1s, this.s_adc_r11_r1s.phys );
    putValue( HIL_s_adc_r21_r2s, this.s_adc_r21_r2s.phys );
    putValue( HIL_s_adc_r31_r3s, this.s_adc_r31_r3s.phys );
    putValue( HIL_s_adc_r41_gemessen, this.s_adc_r41_gemessen.phys );
    putValue( HIL_s_adc_r41_r4s, this.s_adc_r41_r4s.phys );
}

on message DEV_Kombi_123
{
    putValue( HIL_s_adc_guete_g2, this.s_adc_guete_g2.phys );
    putValue( HIL_s_adc_ohmwert_skaliert_g1, this.s_adc_ohmwert_skaliert_g1.phys );
    putValue( HIL_s_adc_r22_gemessen, this.s_adc_r22_gemessen.phys );
    putValue( HIL_s_adc_r42_gemessen, this.s_adc_r42_gemessen.phys );
    putValue( HIL_s_tank_vol_geber_1_kalibriert, this.s_tank_vol_geber_1_kalibriert.phys );
    putValue( HIL_s_tankwarnung_klassisch, this.s_tankwarnung_klassisch.phys );
    putValue( HIL_s_tankwarnung_klassisch_0km, this.s_tankwarnung_klassisch_0km.phys );
    putValue( HIL_s_tankwarnung_phev_batterie, this.s_tankwarnung_phev_batterie.phys );
    putValue( HIL_s_tankwarnung_phev_tank, this.s_tankwarnung_phev_tank.phys );
    putValue( HIL_s_tankwarnung_phev_tank_0km, this.s_tankwarnung_phev_tank_0km.phys );
    putValue( HIL_s_tankwarnung_phev_tank_0km_batterie, this.s_tankwarnung_phev_tank_0km_batterie.phys );
    putValue( HIL_s_tankwarnung_phev_tank_batterie, this.s_tankwarnung_phev_tank_batterie.phys );
    putValue( HIL_s_tankwarnung_phev_tank_leistung, this.s_tankwarnung_phev_tank_leistung.phys );
    putValue( HIL_s_tankwarnung_twin_cng, this.s_tankwarnung_twin_cng.phys );
    putValue( HIL_s_tankwarnung_twin_tank, this.s_tankwarnung_twin_tank.phys );
    putValue( HIL_s_tankwarnung_twin_tank_0km, this.s_tankwarnung_twin_tank_0km.phys );
    putValue( HIL_s_tankwarnung_twin_tank_0km_cng, this.s_tankwarnung_twin_tank_0km_cng.phys );
    putValue( HIL_s_tankwarnung_twin_tank_cng, this.s_tankwarnung_twin_tank_cng.phys );
}

on message DEV_Kombi_124
{
    putValue( HIL_s_tank_geber_kopplung, this.s_tank_geber_kopplung.phys );
    putValue( HIL_s_tank_geber_kopplung_beschl_y, this.s_tank_geber_kopplung_beschl_y.phys );
    putValue( HIL_s_tank_geber_kopplung_v, this.s_tank_geber_kopplung_v.phys );
    putValue( HIL_s_tank_geber_kopplung_vol, this.s_tank_geber_kopplung_vol.phys );
    putValue( HIL_s_tank_zustand_avrg_gueltig, this.s_tank_zustand_avrg_gueltig.phys );
    putValue( HIL_s_tank_zustand_avrg_schnell_gueltig, this.s_tank_zustand_avrg_schnell_gueltig.phys );
    putValue( HIL_s_tank_zustand_nte, this.s_tank_zustand_nte.phys );
    putValue( HIL_s_tank_zustand_ref_gebildet, this.s_tank_zustand_ref_gebildet.phys );
}

on message DEV_Kombi_125
{
    putValue( HIL_s_tank_kvs_gew, this.s_tank_kvs_gew.phys );
    putValue( HIL_s_tank_vol_geber_1_roh, this.s_tank_vol_geber_1_roh.phys );
    putValue( HIL_s_tank_vol_geber_2_kalibriert, this.s_tank_vol_geber_2_kalibriert.phys );
    putValue( HIL_s_tank_vol_geber_3_kalibriert, this.s_tank_vol_geber_3_kalibriert.phys );
    putValue( HIL_s_tank_vol_geber_4_kalibriert, this.s_tank_vol_geber_4_kalibriert.phys );
}

on message DEV_Kombi_131
{
    putValue( HIL_b_DGN_Verlernzaehler, this.b_DGN_Verlernzaehler.phys );
    putValue( HIL_b_UH_Jahr, this.b_UH_Jahr.phys );
    putValue( HIL_b_UH_Minute, this.b_UH_Minute.phys );
    putValue( HIL_b_UH_Monat, this.b_UH_Monat.phys );
    putValue( HIL_b_UH_Sekunde, this.b_UH_Sekunde.phys );
    putValue( HIL_b_UH_Stunde, this.b_UH_Stunde.phys );
    putValue( HIL_b_UH_Tag, this.b_UH_Tag.phys );
    putValue( HIL_hmi_event_display_off, this.hmi_event_display_off.phys );
    putValue( HIL_hmi_event_display_on, this.hmi_event_display_on.phys );
    putValue( HIL_hmi_inszenierung_beendet, this.hmi_inszenierung_beendet.phys );
    putValue( HIL_s_externe_taste_fehler, this.s_externe_taste_fehler.phys );
    putValue( HIL_s_fsp_kombi_nicht_codiert, this.s_fsp_kombi_nicht_codiert.phys );
    putValue( HIL_s_inszenierung_beendet, this.s_inszenierung_beendet.phys );
    putValue( HIL_s_inszenierung_start, this.s_inszenierung_start.phys );
    putValue( HIL_s_meldungsfreigabe_ftuer, this.s_meldungsfreigabe_ftuer.phys );
    putValue( HIL_s_taste_check, this.s_taste_check.phys );
    putValue( HIL_s_taste_check_fehler, this.s_taste_check_fehler.phys );
    putValue( HIL_s_taste_check_hil, this.s_taste_check_hil.phys );
    putValue( HIL_s_taste_menue, this.s_taste_menue.phys );
    putValue( HIL_s_taste_menue_fehler, this.s_taste_menue_fehler.phys );
    putValue( HIL_s_taste_menue_hil, this.s_taste_menue_hil.phys );
    putValue( HIL_s_taste_twsa, this.s_taste_twsa.phys );
    putValue( HIL_s_taste_twsa_fehler, this.s_taste_twsa_fehler.phys );
    putValue( HIL_s_taste_twsa_hil, this.s_taste_twsa_hil.phys );
    putValue( HIL_s_ub_dauerhaft_hoch, this.s_ub_dauerhaft_hoch.phys );
    putValue( HIL_s_ub_dauerhaft_niedrig, this.s_ub_dauerhaft_niedrig.phys );
    putValue( HIL_s_ub_kurzzeitig_hoch, this.s_ub_kurzzeitig_hoch.phys );
    putValue( HIL_s_ub_nio, this.s_ub_nio.phys );
}

on message DEV_Kombi_132
{
    putValue( HIL_b_Perso_Kontonummer, this.b_Perso_Kontonummer.phys );
    putValue( HIL_b_Perso_Status, this.b_Perso_Status.phys );
    putValue( HIL_b_Perso_Steuerung, this.b_Perso_Steuerung.phys );
    putValue( HIL_b_Perso_Steuerungsparameter, this.b_Perso_Steuerungsparameter.phys );
    putValue( HIL_b_SI_P_Mode, this.b_SI_P_Mode.phys );
    putValue( HIL_b_SI_P_Mode_gueltig, this.b_SI_P_Mode_gueltig.phys );
    putValue( HIL_hmi_ego_fahrzeug, this.hmi_ego_fahrzeug.phys );
    putValue( HIL_hmi_v_kunde_aktiv, this.hmi_v_kunde_aktiv.phys );
    putValue( HIL_hmi_v_kunde_einheit, this.hmi_v_kunde_einheit.phys );
    putValue( HIL_hmi_v_kunde_sollgeschwindigkeit, this.hmi_v_kunde_sollgeschwindigkeit.phys );
    putValue( HIL_s_blinktakt, this.s_blinktakt.phys );
    putValue( HIL_s_hmi_blinktakt_request, this.s_hmi_blinktakt_request.phys );
    putValue( HIL_s_hmi_blinktakt_reset_event, this.s_hmi_blinktakt_reset_event.phys );
    putValue( HIL_s_Kombi_RAM_defekt, this.s_Kombi_RAM_defekt.phys );
    putValue( HIL_s_Kombi_ROM_defekt, this.s_Kombi_ROM_defekt.phys );
    putValue( HIL_s_kontrolllampenmanager_blinktakt_request, this.s_kontrolllampenmanager_blinktakt_request.phys );
    putValue( HIL_s_kontrolllampenmanager_blinktakt_reset_event, this.s_kontrolllampenmanager_blinktakt_reset_event.phys );
    putValue( HIL_s_selektiertes_design, this.s_selektiertes_design.phys );
    putValue( HIL_s_v_kunde_aktiv, this.s_v_kunde_aktiv.phys );
    putValue( HIL_s_v_kunde_sollgeschwindigkeit, this.s_v_kunde_sollgeschwindigkeit.phys );
    putValue( HIL_s_v_warnung_gesetzlich, this.s_v_warnung_gesetzlich.phys );
    putValue( HIL_s_v_warnung_kunde, this.s_v_warnung_kunde.phys );
    putValue( HIL_s_v_Warnung_Stufe_1_Akustik, this.s_v_Warnung_Stufe_1_Akustik.phys );
    putValue( HIL_s_v_warnung_winterreifen, this.s_v_warnung_winterreifen.phys );
    putValue( HIL_s_zpm_blinktakt_request, this.s_zpm_blinktakt_request.phys );
    putValue( HIL_s_zpm_blinktakt_reset_event, this.s_zpm_blinktakt_reset_event.phys );
}

on message DEV_Kombi_133
{
    putValue( HIL_b_KBI_Kilometerstand, this.b_KBI_Kilometerstand.phys );
    putValue( HIL_b_MO_Anzeige_StSt_gueltig, this.b_MO_Anzeige_StSt_gueltig.phys );
    putValue( HIL_b_MO_Kuppl_schalter, this.b_MO_Kuppl_schalter.phys );
    putValue( HIL_b_ZAS_Kl_15, this.b_ZAS_Kl_15.phys );
    putValue( HIL_b_ZAS_Kl_S, this.b_ZAS_Kl_S.phys );
    putValue( HIL_hmi_klemme15, this.hmi_klemme15.phys );
    putValue( HIL_hmi_klemmeS, this.hmi_klemmeS.phys );
    putValue( HIL_hmi_motorkennbuchstaben_anzeigen, this.hmi_motorkennbuchstaben_anzeigen.phys );
    putValue( HIL_hmi_t_FreezeKlemme15Aus_ms, this.hmi_t_FreezeKlemme15Aus_ms.phys );
    putValue( HIL_hmi_t_FreezeKlemme15Ein_ms, this.hmi_t_FreezeKlemme15Ein_ms.phys );
    putValue( HIL_hmi_transportmodus_anzeigen, this.hmi_transportmodus_anzeigen.phys );
    putValue( HIL_hmi_ZV_verriegelt, this.hmi_ZV_verriegelt.phys );
    putValue( HIL_s_hmi_display_status, this.s_hmi_display_status.phys );
    putValue( HIL_s_HMI_LastMode_hmi_MFA_store, this.s_HMI_LastMode_hmi_MFA_store.phys );
    putValue( HIL_s_HMI_LastMode_hmi_ShowTrackChangePopup, this.s_HMI_LastMode_hmi_ShowTrackChangePopup.phys );
    putValue( HIL_s_klemme_15, this.s_klemme_15.phys );
    putValue( HIL_s_klemme_15_timeout, this.s_klemme_15_timeout.phys );
    putValue( HIL_s_v_Warnung_Stufe_1, this.s_v_Warnung_Stufe_1.phys );
    putValue( HIL_s_v_Warnung_Stufe_2, this.s_v_Warnung_Stufe_2.phys );
    putValue( HIL_s_verstellmodus_aktiv, this.s_verstellmodus_aktiv.phys );
    putValue( HIL_s_zpm_zentrale_warnlampe, this.s_zpm_zentrale_warnlampe.phys );
}

on message DEV_Kombi_134
{
    putValue( HIL_b_DI_Display_Nachtdesign, this.b_DI_Display_Nachtdesign.phys );
    putValue( HIL_b_DI_KL_58xd, this.b_DI_KL_58xd.phys );
    putValue( HIL_b_DI_KL_58xs, this.b_DI_KL_58xs.phys );
    putValue( HIL_b_DI_KL_58xt, this.b_DI_KL_58xt.phys );
    putValue( HIL_b_ESP_07_alt, this.b_ESP_07_alt.phys );
    putValue( HIL_b_ESP_Rollenmodus_Deaktivieren, this.b_ESP_Rollenmodus_Deaktivieren.phys );
    putValue( HIL_b_MO_Fahrzeugtyp, this.b_MO_Fahrzeugtyp.phys );
    putValue( HIL_b_MO_Hybridfahrzeug, this.b_MO_Hybridfahrzeug.phys );
    putValue( HIL_b_MO_Kraftstoffart, this.b_MO_Kraftstoffart.phys );
    putValue( HIL_b_MO_Verbau_StartSys_RSG_MV, this.b_MO_Verbau_StartSys_RSG_MV.phys );
    putValue( HIL_b_MO_Verbau_StartSys_RSG_NV, this.b_MO_Verbau_StartSys_RSG_NV.phys );
    putValue( HIL_s_fhrz_typ, this.s_fhrz_typ.phys );
    putValue( HIL_s_fhrz_typ_prim_antr, this.s_fhrz_typ_prim_antr.phys );
    putValue( HIL_s_fhrz_typ_sek_antr, this.s_fhrz_typ_sek_antr.phys );
    putValue( HIL_s_fusi_lampe_abs, this.s_fusi_lampe_abs.phys );
    putValue( HIL_s_fusi_lampe_airbag, this.s_fusi_lampe_airbag.phys );
    putValue( HIL_s_fusi_lampe_bkl, this.s_fusi_lampe_bkl.phys );
    putValue( HIL_s_fusi_lampe_epb_status, this.s_fusi_lampe_epb_status.phys );
    putValue( HIL_s_fusi_lampe_eps_rot, this.s_fusi_lampe_eps_rot.phys );
    putValue( HIL_s_fusi_lampe_esc, this.s_fusi_lampe_esc.phys );
    putValue( HIL_s_fusi_zwl_gelb, this.s_fusi_zwl_gelb.phys );
    putValue( HIL_s_fusi_zwl_rot, this.s_fusi_zwl_rot.phys );
    putValue( HIL_s_KBI_Display_Ausfall, this.s_KBI_Display_Ausfall.phys );
    putValue( HIL_s_KBI_FoD_PopUP_Quittiert, this.s_KBI_FoD_PopUP_Quittiert.phys );
    putValue( HIL_s_mfl_joker_hinweisfehler, this.s_mfl_joker_hinweisfehler.phys );
}

on message DEV_Kombi_135
{
    putValue( HIL_b_AZK_Kessy_defekt, this.b_AZK_Kessy_defekt.phys );
    putValue( HIL_b_AZK_Kessy_nicht_gefunden, this.b_AZK_Kessy_nicht_gefunden.phys );
    putValue( HIL_b_AZK_MobileKey_defekt, this.b_AZK_MobileKey_defekt.phys );
    putValue( HIL_b_AZK_Mobilgeraet_nicht_gefunden, this.b_AZK_Mobilgeraet_nicht_gefunden.phys );
    putValue( HIL_b_AZK_Schluessel_im_Fzg, this.b_AZK_Schluessel_im_Fzg.phys );
    putValue( HIL_b_AZK_Weiterfahrt_mit_Mobilgeraet, this.b_AZK_Weiterfahrt_mit_Mobilgeraet.phys );
    putValue( HIL_b_AZK_Weiterfahrt_mit_Schluessel, this.b_AZK_Weiterfahrt_mit_Schluessel.phys );
    putValue( HIL_b_FoD_Anz_Funktionsabschaltung, this.b_FoD_Anz_Funktionsabschaltung.phys );
    putValue( HIL_b_WFS_Fahrerhinweise, this.b_WFS_Fahrerhinweise.phys );
    putValue( HIL_b_WFS_LZ, this.b_WFS_LZ.phys );
    putValue( HIL_b_WFS_Safe, this.b_WFS_Safe.phys );
    putValue( HIL_b_WFS_Schluessel_Fahrberecht, this.b_WFS_Schluessel_Fahrberecht.phys );
    putValue( HIL_b_WFS_Schluessel_Ist, this.b_WFS_Schluessel_Ist.phys );
    putValue( HIL_b_WFS_Schluessel_Soll, this.b_WFS_Schluessel_Soll.phys );
    putValue( HIL_hmi_global_active_layout, this.hmi_global_active_layout.phys );
    putValue( HIL_s_aktives_design, this.s_aktives_design.phys );
    putValue( HIL_s_Fahrbereitschaft, this.s_Fahrbereitschaft.phys );
    putValue( HIL_s_FoD_Kombi_Variante, this.s_FoD_Kombi_Variante.phys );
    putValue( HIL_s_fsp_D10000, this.s_fsp_D10000.phys );
    putValue( HIL_s_fsp_D30000, this.s_fsp_D30000.phys );
    putValue( HIL_s_fsp_EA6100, this.s_fsp_EA6100.phys );
    putValue( HIL_s_fsp_EA6200, this.s_fsp_EA6200.phys );
    putValue( HIL_s_fsp_EA6400, this.s_fsp_EA6400.phys );
    putValue( HIL_s_Kombi_KompSchutz, this.s_Kombi_KompSchutz.phys );
    putValue( HIL_s_ks_safe, this.s_ks_safe.phys );
    putValue( HIL_s_ks_safe_text, this.s_ks_safe_text.phys );
    putValue( HIL_s_LED_ZWL_gelb, this.s_LED_ZWL_gelb.phys );
    putValue( HIL_s_LED_ZWL_gelb_Blinken, this.s_LED_ZWL_gelb_Blinken.phys );
    putValue( HIL_s_LED_ZWL_rot, this.s_LED_ZWL_rot.phys );
    putValue( HIL_s_LED_ZWL_rot_Blinken, this.s_LED_ZWL_rot_Blinken.phys );
    putValue( HIL_s_mfl_joker_hinweis, this.s_mfl_joker_hinweis.phys );
    putValue( HIL_s_WFS_Diag_LF_Aktiv_02, this.s_WFS_Diag_LF_Aktiv_02.phys );
    putValue( HIL_s_WFS_LF_aktiv_02, this.s_WFS_LF_aktiv_02.phys );
    putValue( HIL_s_WFS_Transp_Mod_Unterbrechung_02, this.s_WFS_Transp_Mod_Unterbrechung_02.phys );
}

on message DEV_Kombi_141
{
    putValue( HIL_b_HRE_Anzeigetexte, this.b_HRE_Anzeigetexte.phys );
    putValue( HIL_b_LDW_Gong, this.b_LDW_Gong.phys );
    putValue( HIL_b_MKE_Stufe, this.b_MKE_Stufe.phys );
    putValue( HIL_b_MKE_Texte, this.b_MKE_Texte.phys );
    putValue( HIL_b_PLA_Abstand_zur_Parkluecke, this.b_PLA_Abstand_zur_Parkluecke.phys );
    putValue( HIL_b_PLA_Anf_Akustik, this.b_PLA_Anf_Akustik.phys );
    putValue( HIL_b_PLA_Anf_Anzeige_Bremsfuss, this.b_PLA_Anf_Anzeige_Bremsfuss.phys );
    putValue( HIL_b_PLA_Anf_Anzeige_Mini, this.b_PLA_Anf_Anzeige_Mini.phys );
    putValue( HIL_b_PLA_Anf_Anzeige_Schwellpfeil, this.b_PLA_Anf_Anzeige_Schwellpfeil.phys );
    putValue( HIL_b_PLA_Anf_Anzeigemodus, this.b_PLA_Anf_Anzeigemodus.phys );
    putValue( HIL_b_PLA_Anf_Meldungen, this.b_PLA_Anf_Meldungen.phys );
    putValue( HIL_b_PLA_Anzahl_Segmente_Schwellpfeil, this.b_PLA_Anzahl_Segmente_Schwellpfeil.phys );
    putValue( HIL_b_PLA_Mini_Modus, this.b_PLA_Mini_Modus.phys );
    putValue( HIL_b_PLA_Status_Aktive_Seite, this.b_PLA_Status_Aktive_Seite.phys );
    putValue( HIL_b_PLA_Status_beenden_Mini, this.b_PLA_Status_beenden_Mini.phys );
    putValue( HIL_b_PLA_Status_Funktion, this.b_PLA_Status_Funktion.phys );
    putValue( HIL_b_SWA_Anzeigen, this.b_SWA_Anzeigen.phys );
    putValue( HIL_b_SWA_Sta_aktiv, this.b_SWA_Sta_aktiv.phys );
    putValue( HIL_b_SWA_Sta_passiv, this.b_SWA_Sta_passiv.phys );
    putValue( HIL_hmi_pla3_zpm, this.hmi_pla3_zpm.phys );
    putValue( HIL_hmi_swa_timeout, this.hmi_swa_timeout.phys );
    putValue( HIL_s_LED_Hands_Off_rot, this.s_LED_Hands_Off_rot.phys );
    putValue( HIL_s_LED_Hands_Off_weiss, this.s_LED_Hands_Off_weiss.phys );
    putValue( HIL_s_LED_SWA_gelb, this.s_LED_SWA_gelb.phys );
    putValue( HIL_s_LED_SWA_gruen, this.s_LED_SWA_gruen.phys );
    putValue( HIL_s_SWA_Sta_aktiv, this.s_SWA_Sta_aktiv.phys );
    putValue( HIL_s_SWA_Sta_passiv, this.s_SWA_Sta_passiv.phys );
}

on message DEV_Kombi_142
{
    putValue( HIL_b_AWV_AW_Texte_Zusatzanzeige, this.b_AWV_AW_Texte_Zusatzanzeige.phys );
    putValue( HIL_b_DSSS_Warning, this.b_DSSS_Warning.phys );
    putValue( HIL_b_Heckradar_Kombitexte, this.b_Heckradar_Kombitexte.phys );
    putValue( HIL_b_ISA_Status, this.b_ISA_Status.phys );
    putValue( HIL_b_LDW_Lernmodus_seitenabhaengig, this.b_LDW_Lernmodus_seitenabhaengig.phys );
    putValue( HIL_b_LDW_Status_LED_gelb, this.b_LDW_Status_LED_gelb.phys );
    putValue( HIL_b_LDW_Status_LED_gruen, this.b_LDW_Status_LED_gruen.phys );
    putValue( HIL_b_LDW_Texte, this.b_LDW_Texte.phys );
    putValue( HIL_b_RCTA_Kombitexte, this.b_RCTA_Kombitexte.phys );
    putValue( HIL_b_TA_Spurwechsel, this.b_TA_Spurwechsel.phys );
    putValue( HIL_b_TA_Status, this.b_TA_Status.phys );
    putValue( HIL_b_TA_Texte, this.b_TA_Texte.phys );
    putValue( HIL_b_TSK_06_alt, this.b_TSK_06_alt.phys );
    putValue( HIL_b_TSK_Fahrzeugstatus_GRA, this.b_TSK_Fahrzeugstatus_GRA.phys );
    putValue( HIL_b_TSK_Fahrzeugstatus_Limiter, this.b_TSK_Fahrzeugstatus_Limiter.phys );
    putValue( HIL_b_TSK_Limiter_Anzeige, this.b_TSK_Limiter_Anzeige.phys );
    putValue( HIL_b_TSK_Limiter_Fahrerinfo, this.b_TSK_Limiter_Fahrerinfo.phys );
    putValue( HIL_b_TSK_Status_Anzeige, this.b_TSK_Status_Anzeige.phys );
    putValue( HIL_b_TSK_Texte_Primaeranz, this.b_TSK_Texte_Primaeranz.phys );
    putValue( HIL_b_TSK_Wunschgeschw, this.b_TSK_Wunschgeschw.phys );
    putValue( HIL_s_GRA_Status, this.s_GRA_Status.phys );
    putValue( HIL_s_LED_LDW_gelb, this.s_LED_LDW_gelb.phys );
    putValue( HIL_s_LED_LDW_gruen, this.s_LED_LDW_gruen.phys );
    putValue( HIL_s_LIM_Status, this.s_LIM_Status.phys );
}

on message DEV_Kombi_143
{
    putValue( HIL_b_ARA_Aktiver_Grafikmodus, this.b_ARA_Aktiver_Grafikmodus.phys );
    putValue( HIL_b_ARA_Bremsfuss, this.b_ARA_Bremsfuss.phys );
    putValue( HIL_b_ARA_Knickwinkel_Ist, this.b_ARA_Knickwinkel_Ist.phys );
    putValue( HIL_b_ARA_Knickwinkel_Max, this.b_ARA_Knickwinkel_Max.phys );
    putValue( HIL_b_ARA_Knickwinkel_Soll, this.b_ARA_Knickwinkel_Soll.phys );
    putValue( HIL_b_ARA_Modus, this.b_ARA_Modus.phys );
    putValue( HIL_b_ARA_Texte, this.b_ARA_Texte.phys );
    putValue( HIL_b_ESP_HDC_Regelgeschw, this.b_ESP_HDC_Regelgeschw.phys );
    putValue( HIL_b_VZE_FoD_Status, this.b_VZE_FoD_Status.phys );
    putValue( HIL_hmi_ARA_Knickwinkel_Ist, this.hmi_ARA_Knickwinkel_Ist.phys );
    putValue( HIL_hmi_ARA_Knickwinkel_Soll, this.hmi_ARA_Knickwinkel_Soll.phys );
    putValue( HIL_s_ara_timeout_reakt, this.s_ara_timeout_reakt.phys );
    putValue( HIL_s_LED_Shiftlock_rot, this.s_LED_Shiftlock_rot.phys );
}

on message DEV_Kombi_144
{
    putValue( HIL_b_ACC_Regelgeschw, this.b_ACC_Regelgeschw.phys );
    putValue( HIL_b_ACC_Tempolimit, this.b_ACC_Tempolimit.phys );
    putValue( HIL_b_ACC_Texte_Sekundaeranz, this.b_ACC_Texte_Sekundaeranz.phys );
    putValue( HIL_b_ACC_Warnung_Verkehrszeichen_1, this.b_ACC_Warnung_Verkehrszeichen_1.phys );
    putValue( HIL_b_AWV_AW_Abstand, this.b_AWV_AW_Abstand.phys );
    putValue( HIL_b_AWV_Texte, this.b_AWV_Texte.phys );
    putValue( HIL_b_AWV_Warnlevel, this.b_AWV_Warnlevel.phys );
    putValue( HIL_b_AWV_Warnung, this.b_AWV_Warnung.phys );
    putValue( HIL_b_TA_HMI_Obj_02_dx, this.b_TA_HMI_Obj_02_dx.phys );
    putValue( HIL_hmi_ACC_Regelgeschw, this.hmi_ACC_Regelgeschw.phys );
    putValue( HIL_s_LED_ACC_Ego_rot, this.s_LED_ACC_Ego_rot.phys );
    putValue( HIL_s_LED_ACC_Ego_rot_blinken, this.s_LED_ACC_Ego_rot_blinken.phys );
}

on message DEV_Kombi_145
{
    putValue( HIL_b_ACC_Abstand_Abstandswarner, this.b_ACC_Abstand_Abstandswarner.phys );
    putValue( HIL_b_ACC_Abstand_RNS, this.b_ACC_Abstand_RNS.phys );
    putValue( HIL_b_ACC_Akustik_03, this.b_ACC_Akustik_03.phys );
    putValue( HIL_b_ACC_Anzeige_Zeitluecke, this.b_ACC_Anzeige_Zeitluecke.phys );
    putValue( HIL_b_ACC_Display_Prio, this.b_ACC_Display_Prio.phys );
    putValue( HIL_b_ACC_Einheit_maxSetzgeschw, this.b_ACC_Einheit_maxSetzgeschw.phys );
    putValue( HIL_b_ACC_ENG_Texte, this.b_ACC_ENG_Texte.phys );
    putValue( HIL_b_ACC_Gesetzte_Zeitluecke, this.b_ACC_Gesetzte_Zeitluecke.phys );
    putValue( HIL_b_ACC_maxSetzgeschw, this.b_ACC_maxSetzgeschw.phys );
    putValue( HIL_b_ACC_Modus_Pop_Up, this.b_ACC_Modus_Pop_Up.phys );
    putValue( HIL_b_ACC_Optischer_Fahrerhinweis, this.b_ACC_Optischer_Fahrerhinweis.phys );
    putValue( HIL_b_ACC_Relevantes_Objekt_02, this.b_ACC_Relevantes_Objekt_02.phys );
    putValue( HIL_b_ACC_RUV, this.b_ACC_RUV.phys );
    putValue( HIL_b_ACC_Tachokranz, this.b_ACC_Tachokranz.phys );
    putValue( HIL_b_ACC_Typ_Tachokranz_unten, this.b_ACC_Typ_Tachokranz_unten.phys );
    putValue( HIL_b_ACC_Warnhinweis, this.b_ACC_Warnhinweis.phys );
    putValue( HIL_b_ACC_Wunschgeschw_02, this.b_ACC_Wunschgeschw_02.phys );
    putValue( HIL_s_ACC_Status, this.s_ACC_Status.phys );
    putValue( HIL_s_LED_ACC_Ego_gruen, this.s_LED_ACC_Ego_gruen.phys );
}

on message DEV_Kombi_151
{
    putValue( HIL_b_ACC_Abstand_LNS, this.b_ACC_Abstand_LNS.phys );
    putValue( HIL_b_ACC_Abstandsindex_02, this.b_ACC_Abstandsindex_02.phys );
    putValue( HIL_b_ACC_Status_Anzeige, this.b_ACC_Status_Anzeige.phys );
    putValue( HIL_b_ACC_Texte_02, this.b_ACC_Texte_02.phys );
    putValue( HIL_b_ACC_Texte_Primaeranz_03, this.b_ACC_Texte_Primaeranz_03.phys );
    putValue( HIL_b_ACC_Texte_Zusatzanz_03, this.b_ACC_Texte_Zusatzanz_03.phys );
    putValue( HIL_b_FOD_State_ACC, this.b_FOD_State_ACC.phys );
    putValue( HIL_b_PH_Stoermeldung, this.b_PH_Stoermeldung.phys );
    putValue( HIL_b_PH_Verschmutzungsmeldung, this.b_PH_Verschmutzungsmeldung.phys );
    putValue( HIL_b_PH_WAH_Meldung, this.b_PH_WAH_Meldung.phys );
    putValue( HIL_hmi_ACC_Wunschgeschw_02, this.hmi_ACC_Wunschgeschw_02.phys );
    putValue( HIL_s_FOD_State_ACC, this.s_FOD_State_ACC.phys );
}

on message DEV_Kombi_152
{
    putValue( HIL_b_ASW_Kombitexte, this.b_ASW_Kombitexte.phys );
    putValue( HIL_b_AWV_Status_Anzeige, this.b_AWV_Status_Anzeige.phys );
    putValue( HIL_b_EA_Texte, this.b_EA_Texte.phys );
    putValue( HIL_b_LoGeWa_C2C_Event_Einheit, this.b_LoGeWa_C2C_Event_Einheit.phys );
    putValue( HIL_b_LoGeWa_C2C_Event_Entfernung, this.b_LoGeWa_C2C_Event_Entfernung.phys );
    putValue( HIL_b_LoGeWa_C2C_Event_Richtung, this.b_LoGeWa_C2C_Event_Richtung.phys );
    putValue( HIL_b_LoGeWa_C2C_Event_Status, this.b_LoGeWa_C2C_Event_Status.phys );
    putValue( HIL_b_LoGeWa_C2C_Event_Warnung, this.b_LoGeWa_C2C_Event_Warnung.phys );
    putValue( HIL_b_TSK_Texte, this.b_TSK_Texte.phys );
    putValue( HIL_hmi_VZA_available, this.hmi_VZA_available.phys );
}

on message DEV_Kombi_153
{
    putValue( HIL_b_LH_Bremslicht_H_aktiv, this.b_LH_Bremslicht_H_aktiv.phys );
    putValue( HIL_hmi_zpm_anzeigeID, this.hmi_zpm_anzeigeID.phys );
    putValue( HIL_hmi_zpm_meldungsspeicher_anzahl, this.hmi_zpm_meldungsspeicher_anzahl.phys );
    putValue( HIL_hmi_zpm_meldungsspeicher_warningID, this.hmi_zpm_meldungsspeicher_warningID.phys );
    putValue( HIL_s_emv_reku_charge_aktiv, this.s_emv_reku_charge_aktiv.phys );
    putValue( HIL_s_emv_reku_fahrz_stand, this.s_emv_reku_fahrz_stand.phys );
}

on message DEV_Kombi_154
{
    putValue( HIL_b_FT_Tuer_Status, this.b_FT_Tuer_Status.phys );
    putValue( HIL_b_ISA_Regelung_aktiv, this.b_ISA_Regelung_aktiv.phys );  
    putValue( HIL_b_ISA_Tempolimitwarnung, this.b_ISA_Tempolimitwarnung.phys );
    putValue( HIL_b_TSK_Fahrzeugstatus_praed_Fkt, this.b_TSK_Fahrzeugstatus_praed_Fkt.phys );
    putValue( HIL_b_TSK_naechstes_Event, this.b_TSK_naechstes_Event.phys );
    putValue( HIL_b_TSK_praediktiver_Hinweis, this.b_TSK_praediktiver_Hinweis.phys );
    putValue( HIL_hmi_acc_optischer_fahrerhinweis, this.hmi_acc_optischer_fahrerhinweis.phys );
    putValue( HIL_hmi_aktive_Tubenfunktion, this.hmi_aktive_Tubenfunktion.phys );
    putValue( HIL_hmi_bc_nachtankmenge, this.hmi_bc_nachtankmenge.phys );
    putValue( HIL_hmi_blinken_links, this.hmi_blinken_links.phys );
    putValue( HIL_hmi_blinken_rechts, this.hmi_blinken_rechts.phys );
    putValue( HIL_hmi_car_outline_aktiv, this.hmi_car_outline_aktiv.phys );
    putValue( HIL_hmi_defekt_anzeigen, this.hmi_defekt_anzeigen.phys );
    putValue( HIL_hmi_heckdeckel_offen, this.hmi_heckdeckel_offen.phys );
    putValue( HIL_hmi_heckscheibe_offen, this.hmi_heckscheibe_offen.phys );
    putValue( HIL_hmi_motorhaube_offen, this.hmi_motorhaube_offen.phys );
    putValue( HIL_hmi_pla_akustik, this.hmi_pla_akustik.phys );
    putValue( HIL_hmi_pla_bremssymbol, this.hmi_pla_bremssymbol.phys );
    putValue( HIL_hmi_pla_schwellpfeil_anzeigen, this.hmi_pla_schwellpfeil_anzeigen.phys );
    putValue( HIL_hmi_tankklappe_offen, this.hmi_tankklappe_offen.phys );
    putValue( HIL_hmi_tuerzustand_hinten_links, this.hmi_tuerzustand_hinten_links.phys );
    putValue( HIL_hmi_tuerzustand_hinten_rechts, this.hmi_tuerzustand_hinten_rechts.phys );
    putValue( HIL_hmi_tuerzustand_vorne_links, this.hmi_tuerzustand_vorne_links.phys );
    putValue( HIL_hmi_tuerzustand_vorne_rechts, this.hmi_tuerzustand_vorne_rechts.phys );
    putValue( HIL_hmi_zpm_meldungsspeicher_anzeigen, this.hmi_zpm_meldungsspeicher_anzeigen.phys );
    putValue( HIL_hmi_zpm_piktogrammrolle_anzeigen, this.hmi_zpm_piktogrammrolle_anzeigen.phys );
}

on message DEV_Kombi_155
{
    putValue( HIL_hmi_bc_oeltemperatur_sonderbehandlung, this.hmi_bc_oeltemperatur_sonderbehandlung.phys );
    putValue( HIL_hmi_bc_oeltemperatur_vorhanden, this.hmi_bc_oeltemperatur_vorhanden.phys );
    putValue( HIL_hmi_BcmE_ConsumerList_available, this.hmi_BcmE_ConsumerList_available.phys );
    putValue( HIL_hmi_BcmE_LifeTips_available, this.hmi_BcmE_LifeTips_available.phys );
    putValue( HIL_hmi_digitalgeschwindigkeit_available, this.hmi_digitalgeschwindigkeit_available.phys );
    //update MY20
    //putValue( HIL_hmi_ShowTrackChangePopup, this.hmi_ShowTrackChangePopup.phys );
    //end update MY20
}

on message DEV_Kombi_161
{
    putValue( HIL_b_AGA_ohne_Funktion, this.b_AGA_ohne_Funktion.phys );
    putValue( HIL_b_AGA_Texte, this.b_AGA_Texte.phys );
    putValue( HIL_b_BEM_Batteriediagnose, this.b_BEM_Batteriediagnose.phys );
    putValue( HIL_b_BEM_Generatordiagnose, this.b_BEM_Generatordiagnose.phys );
    putValue( HIL_b_BEM_Ladezustand, this.b_BEM_Ladezustand.phys );
    putValue( HIL_b_HVEM_Text_1, this.b_HVEM_Text_1.phys );
    putValue( HIL_b_HVLM_Bat_laden_aktiv, this.b_HVLM_Bat_laden_aktiv.phys );
    putValue( HIL_b_HVLM_Ladeart, this.b_HVLM_Ladeart.phys );
    putValue( HIL_b_HVLM_Ladesystemhinweise, this.b_HVLM_Ladesystemhinweise.phys );
    putValue( HIL_b_HVLM_Stecker_Status, this.b_HVLM_Stecker_Status.phys );
    putValue( HIL_b_MO_E_Mode, this.b_MO_E_Mode.phys );
    putValue( HIL_b_MO_E_Texte, this.b_MO_E_Texte.phys );
    putValue( HIL_b_MO_E_Warnungen, this.b_MO_E_Warnungen.phys );
    putValue( HIL_b_MO_HYB_Fahrbereitschaft, this.b_MO_HYB_Fahrbereitschaft.phys );
    putValue( HIL_b_MO_RedFahrleistung_Lampe, this.b_MO_RedFahrleistung_Lampe.phys );
    putValue( HIL_b_MVK_MV_Netz_Warnungen, this.b_MVK_MV_Netz_Warnungen.phys );
    putValue( HIL_b_NVEM_Batterie_Service, this.b_NVEM_Batterie_Service.phys );
    putValue( HIL_b_NVEM_Bordnetzdiagnose, this.b_NVEM_Bordnetzdiagnose.phys );
    putValue( HIL_b_SI_T_Schutz, this.b_SI_T_Schutz.phys );
    putValue( HIL_hmi_bc_momentanrekuperation_not_a_number, this.hmi_bc_momentanrekuperation_not_a_number.phys );
    putValue( HIL_s_batteriekapazitaet_display, this.s_batteriekapazitaet_display.phys );
    putValue( HIL_s_Fahrbereitschaftsakustik_ausg, this.s_Fahrbereitschaftsakustik_ausg.phys );
    putValue( HIL_s_Ladezustand_02, this.s_Ladezustand_02.phys );
    putValue( HIL_s_Ladezustand_02_Werte_vorhanden, this.s_Ladezustand_02_Werte_vorhanden.phys );
    putValue( HIL_s_LED_HYB_Fahrbereitschaft, this.s_LED_HYB_Fahrbereitschaft.phys );
    putValue( HIL_s_LED_TurtleMode, this.s_LED_TurtleMode.phys );
    putValue( HIL_s_MO_HYB_Fahrbereitschaft_ausg, this.s_MO_HYB_Fahrbereitschaft_ausg.phys );
}

on message DEV_Kombi_162
{
    putValue( HIL_b_BMS_KundenWarnung, this.b_BMS_KundenWarnung.phys );
    putValue( HIL_hmi_bc_fahrzeit_e2, this.hmi_bc_fahrzeit_e2.phys );
    putValue( HIL_hmi_bc_fahrzeit_e3, this.hmi_bc_fahrzeit_e3.phys );
    putValue( HIL_s_batteriekapazitaet_anzeigefreigabe, this.s_batteriekapazitaet_anzeigefreigabe.phys );
}

on message DEV_Kombi_163
{
    putValue( HIL_b_DC_Verbrauch_Ueberlauf, this.b_DC_Verbrauch_Ueberlauf.phys );
    putValue( HIL_b_MO_Rekuperation_EM_Ges_Ueberlauf, this.b_MO_Rekuperation_EM_Ges_Ueberlauf.phys );
    putValue( HIL_b_MO_Rekuperation_Ges_EM, this.b_MO_Rekuperation_Ges_EM.phys );
    putValue( HIL_b_MO_Verbrauch_EM_Ges_Ueberlauf, this.b_MO_Verbrauch_EM_Ges_Ueberlauf.phys );
    putValue( HIL_b_MO_Zust_Antrieb, this.b_MO_Zust_Antrieb.phys );
    putValue( HIL_b_Thermo_Verbrauch_BTL, this.b_Thermo_Verbrauch_BTL.phys );
    putValue( HIL_b_Thermo_Verbrauch_BTL_Ueberlauf, this.b_Thermo_Verbrauch_BTL_Ueberlauf.phys );
    putValue( HIL_s_chrg_reku_gewinn, this.s_chrg_reku_gewinn.phys );
}

on message DEV_Kombi_164
{
    putValue( HIL_b_BMS_Rekuperation, this.b_BMS_Rekuperation.phys );
    putValue( HIL_b_BMS_Rekuperation_Ueberlauf, this.b_BMS_Rekuperation_Ueberlauf.phys );
    putValue( HIL_b_DC_Verbrauch, this.b_DC_Verbrauch.phys );
    putValue( HIL_b_Ladezustand_02, this.b_Ladezustand_02.phys );
    putValue( HIL_b_MO_Verbrauch_EM_Ges, this.b_MO_Verbrauch_EM_Ges.phys );
    putValue( HIL_s_Ladezustand_02_ausg, this.s_Ladezustand_02_ausg.phys );
}

on message DEV_Kombi_165
{
    putValue( HIL_b_EV_Rekuperationsstufe, this.b_EV_Rekuperationsstufe.phys );
    putValue( HIL_b_HVLM_Anzeigetexte, this.b_HVLM_Anzeigetexte.phys );
    putValue( HIL_b_HVLM_Restladezeit_HV_Bat_02, this.b_HVLM_Restladezeit_HV_Bat_02.phys );
    putValue( HIL_b_MO_Waehlpos, this.b_MO_Waehlpos.phys );
    putValue( HIL_b_RW_Prim_Reichweitenverbrauch, this.b_RW_Prim_Reichweitenverbrauch.phys );
    putValue( HIL_b_RW_Reservewarnung_aktiv, this.b_RW_Reservewarnung_aktiv.phys );
    putValue( HIL_b_RW_Sek_Reichweitenverbrauch, this.b_RW_Sek_Reichweitenverbrauch.phys );
    putValue( HIL_b_RW_Texte, this.b_RW_Texte.phys );
    putValue( HIL_b_Thermo_Verbrauch_Innen_Ueberlauf, this.b_Thermo_Verbrauch_Innen_Ueberlauf.phys );
    putValue( HIL_hmi_chrg_reku_rwgewinn_aktiv, this.hmi_chrg_reku_rwgewinn_aktiv.phys );
    putValue( HIL_s_MO_ePerformance, this.s_MO_ePerformance.phys );
}

on message DEV_Kombi_171
{
    putValue( HIL_b_MO_Powermeter_Charge_Grenze, this.b_MO_Powermeter_Charge_Grenze.phys );
    putValue( HIL_b_MO_Powermeter_Elm_02, this.b_MO_Powermeter_Elm_02.phys );
    putValue( HIL_b_MO_Powermeter_Grenze_strategisch, this.b_MO_Powermeter_Grenze_strategisch.phys );
    putValue( HIL_b_MO_Powermeter_obere_E_Grenze, this.b_MO_Powermeter_obere_E_Grenze.phys );
    putValue( HIL_b_MO_Powermeter_untere_E_Grenze, this.b_MO_Powermeter_untere_E_Grenze.phys );
    putValue( HIL_s_bargraph_batteriekapazitaet_intern_an, this.s_bargraph_batteriekapazitaet_intern_an.phys );
    putValue( HIL_s_batteriebargraph_extern_an, this.s_batteriebargraph_extern_an.phys );
}

on message DEV_Kombi_172
{
    putValue( HIL_b_HVK_Gesamtst_Spgfreiheit, this.b_HVK_Gesamtst_Spgfreiheit.phys );
    putValue( HIL_b_MO_Anzeige_Betriebsmodus, this.b_MO_Anzeige_Betriebsmodus.phys );
    putValue( HIL_b_MO_ePowermeter, this.b_MO_ePowermeter.phys );
    putValue( HIL_b_MO_Powermeter, this.b_MO_Powermeter.phys );
    putValue( HIL_b_MO_Powermeter_Grenze, this.b_MO_Powermeter_Grenze.phys );
    putValue( HIL_s_bargraph_bat_aktiv, this.s_bargraph_bat_aktiv.phys );
    putValue( HIL_s_HVK_Gesamtst_Spgfreiheit, this.s_HVK_Gesamtst_Spgfreiheit.phys );
    putValue( HIL_s_powermeter_displayanzeige, this.s_powermeter_displayanzeige.phys );
}

on message DEV_Kombi_173
{
    putValue( HIL_b_LE_Kuehlmittel_Sensor, this.b_LE_Kuehlmittel_Sensor.phys );
    putValue( HIL_b_MO_ePerformance, this.b_MO_ePerformance.phys );
    putValue( HIL_s_KBI_Phototransistor, this.s_KBI_Phototransistor.phys );
    putValue( HIL_hmi_chrg_reku_rwgewinn, this.hmi_chrg_reku_rwgewinn.phys );
    putValue( HIL_hmi_chrg_reku_rwgewinn_einheit, this.hmi_chrg_reku_rwgewinn_einheit.phys );
    putValue( HIL_s_Batterie_Reserve_BEV, this.s_Batterie_Reserve_BEV.phys );
    putValue( HIL_s_Batterie_Reserve_PHEV, this.s_Batterie_Reserve_PHEV.phys );
    putValue( HIL_s_ePerformance_displayanzeige, this.s_ePerformance_displayanzeige.phys );
    putValue( HIL_s_KBI_Phototransistor, this.s_KBI_Phototransistor.phys );
    putValue( HIL_s_kuehlmittelmangel_LE, this.s_kuehlmittelmangel_LE.phys );
}

on message DEV_Kombi_174
{
    putValue( HIL_s_fahrzeit_e1, this.s_fahrzeit_e1.phys );
    putValue( HIL_s_fahrzeit_e2, this.s_fahrzeit_e2.phys );
}

on message DEV_Kombi_175
{
    putValue( HIL_hmi_bc_fahrzeit_e1, this.hmi_bc_fahrzeit_e1.phys );
    putValue( HIL_s_fahrzeit_e3, this.s_fahrzeit_e3.phys );
}

on message DEV_Kombi_181
{
    putValue( HIL_hmi_durchschnittsverbrauch_einheit_elektrisch, this.hmi_durchschnittsverbrauch_einheit_elektrisch.phys );
    putValue( HIL_hmi_durchschnittsverbrauch_elektrisch_e1, this.hmi_durchschnittsverbrauch_elektrisch_e1.phys );
    putValue( HIL_hmi_durchschnittsverbrauch_elektrisch_e1_sonderbehandlung, this.hmi_durchschnittsverbrauch_elektrisch_e1_sonderbehandlung.phys );
    putValue( HIL_hmi_durchschnittsverbrauch_elektrisch_e2, this.hmi_durchschnittsverbrauch_elektrisch_e2.phys );
    putValue( HIL_hmi_durchschnittsverbrauch_elektrisch_e2_sonderbehandlung, this.hmi_durchschnittsverbrauch_elektrisch_e2_sonderbehandlung.phys );
    putValue( HIL_hmi_durchschnittsverbrauch_elektrisch_e3, this.hmi_durchschnittsverbrauch_elektrisch_e3.phys );
    putValue( HIL_hmi_durchschnittsverbrauch_elektrisch_e3_sonderbehandlung, this.hmi_durchschnittsverbrauch_elektrisch_e3_sonderbehandlung.phys );
    putValue( HIL_hmi_momentanverbrauch_einheit_elektrisch, this.hmi_momentanverbrauch_einheit_elektrisch.phys );
    putValue( HIL_hmi_momentanverbrauch_einheit_elektrisch_bargraph, this.hmi_momentanverbrauch_einheit_elektrisch_bargraph.phys );
    putValue( HIL_hmi_momentanverbrauch_elektrisch_not_a_number, this.hmi_momentanverbrauch_elektrisch_not_a_number.phys );
    putValue( HIL_hmi_momentanverbrauch_elektrisch_not_a_number_bargraph, this.hmi_momentanverbrauch_elektrisch_not_a_number_bargraph.phys );
}

on message DEV_Kombi_182
{
    putValue( HIL_b_BMS_Verbrauch, this.b_BMS_Verbrauch.phys );
    putValue( HIL_b_BMS_Verbrauch_Ueberlauf, this.b_BMS_Verbrauch_Ueberlauf.phys );
    putValue( HIL_b_MO_Anzeige_Rekuperation, this.b_MO_Anzeige_Rekuperation.phys );
    putValue( HIL_b_MO_Anzeige_Verbr_Einheit, this.b_MO_Anzeige_Verbr_Einheit.phys );
    putValue( HIL_b_MO_Anzeige_Verbrauch_oE, this.b_MO_Anzeige_Verbrauch_oE.phys );
    putValue( HIL_s_mv_einheit_verbrauch, this.s_mv_einheit_verbrauch.phys );
    putValue( HIL_s_mv_fahrz_stand, this.s_mv_fahrz_stand.phys );
    putValue( HIL_s_mv_schub_fahrt, this.s_mv_schub_fahrt.phys );
    putValue( HIL_s_mv_schub_stand, this.s_mv_schub_stand.phys );
    putValue( HIL_s_mv_x_100km, this.s_mv_x_100km.phys );
}

on message DEV_Kombi_183
{
    putValue( HIL_s_dv_prozent, this.s_dv_prozent.phys );
    putValue( HIL_s_dv_prozent_gas, this.s_dv_prozent_gas.phys );
    putValue( HIL_s_mv_gefiltert, this.s_mv_gefiltert.phys );
    putValue( HIL_s_mv_mit_hyst, this.s_mv_mit_hyst.phys );
}

on message DEV_Kombi_184
{
    putValue( HIL_s_mv_kg_100km_anzverbr, this.s_mv_kg_100km_anzverbr.phys );
    putValue( HIL_s_mv_mit_reku, this.s_mv_mit_reku.phys );
    putValue( HIL_s_mv_prozent, this.s_mv_prozent.phys );
    putValue( HIL_s_mv_schub_anzverbr, this.s_mv_schub_anzverbr.phys );
}

on message DEV_Kombi_185
{
    putValue( HIL_hmi_momentanverbrauch_elektrisch, this.hmi_momentanverbrauch_elektrisch.phys );
    putValue( HIL_hmi_momentanverbrauch_elektrisch_bargraph, this.hmi_momentanverbrauch_elektrisch_bargraph.phys );
    putValue( HIL_s_mv_l_100km_anzverbr, this.s_mv_l_100km_anzverbr.phys );
    putValue( HIL_s_rekuperationsfaktor, this.s_rekuperationsfaktor.phys );
}

on message DEV_Kombi_191
{
    putValue( HIL_s_tank_vol_geber_2_roh, this.s_tank_vol_geber_2_roh.phys );
    putValue( HIL_s_tank_vol_geber_3_roh, this.s_tank_vol_geber_3_roh.phys );
    putValue( HIL_s_tank_vol_geber_4_roh, this.s_tank_vol_geber_4_roh.phys );
    putValue( HIL_s_tank_vol_geber_g1_kalibriert_unbegrenzt, this.s_tank_vol_geber_g1_kalibriert_unbegrenzt.phys );
    putValue( HIL_s_tank_vol_geber_g2_kalibriert_unbegrenzt, this.s_tank_vol_geber_g2_kalibriert_unbegrenzt.phys );
    putValue( HIL_s_tank_vol_nte_zu, this.s_tank_vol_nte_zu.phys );
}

on message DEV_Kombi_192
{
    putValue( HIL_s_tank_vol_geber_g3_kalibriert_unbegrenzt, this.s_tank_vol_geber_g3_kalibriert_unbegrenzt.phys );
    putValue( HIL_s_tank_vol_geber_g4_kalibriert_unbegrenzt, this.s_tank_vol_geber_g4_kalibriert_unbegrenzt.phys );
    putValue( HIL_s_tank_vol_geber_gesamt_roh, this.s_tank_vol_geber_gesamt_roh.phys );
    putValue( HIL_s_zeigerposition_kraftstoffvorrat, this.s_zeigerposition_kraftstoffvorrat.phys );
    putValue( HIL_s_zeigerposition_kraftstoffvorrat_gas, this.s_zeigerposition_kraftstoffvorrat_gas.phys );
}

on message DEV_Kombi_193
{
    putValue( HIL_s_tank_verbr_gewichtung, this.s_tank_verbr_gewichtung.phys );
    putValue( HIL_s_tank_vol_geber_avrg, this.s_tank_vol_geber_avrg.phys );
    putValue( HIL_s_tank_vol_geber_avrg_clip, this.s_tank_vol_geber_avrg_clip.phys );
    putValue( HIL_s_tank_vol_geber_gesamt_kalibriert, this.s_tank_vol_geber_gesamt_kalibriert.phys );
    putValue( HIL_s_tank_vol_gedaempft, this.s_tank_vol_gedaempft.phys );
    putValue( HIL_s_tank_vol_ref, this.s_tank_vol_ref.phys );
}

on message DEV_Kombi_194
{
    putValue( HIL_s_tank_vol_anzeige, this.s_tank_vol_anzeige.phys );
    putValue( HIL_s_tank_vol_anzeige_alt, this.s_tank_vol_anzeige_alt.phys );
}

on message DEV_Kombi_195
{
    putValue( HIL_s_adc_obd_nibble_g1, this.s_adc_obd_nibble_g1.phys );
    putValue( HIL_s_adc_obd_nibble_g2, this.s_adc_obd_nibble_g2.phys );
    putValue( HIL_s_adc_obd_nibble_g3, this.s_adc_obd_nibble_g3.phys );
    putValue( HIL_s_adc_obd_ohmwert_g1, this.s_adc_obd_ohmwert_g1.phys );
    putValue( HIL_s_adc_obd_ohmwert_g2, this.s_adc_obd_ohmwert_g2.phys );
    putValue( HIL_s_adc_obd_ohmwert_g3, this.s_adc_obd_ohmwert_g3.phys );
    putValue( HIL_s_adc_obd_ohmwert_g4, this.s_adc_obd_ohmwert_g4.phys );
}

on message DEV_Kombi_201
{
    putValue( HIL_b_ESP_Laengsbeschl, this.b_ESP_Laengsbeschl.phys );
    putValue( HIL_b_ESP_Querbeschleunigung, this.b_ESP_Querbeschleunigung.phys );
    putValue( HIL_s_gastank_warnung_cng, this.s_gastank_warnung_cng.phys );
    putValue( HIL_s_KBI_FStatus_Tank, this.s_KBI_FStatus_Tank.phys );
    putValue( HIL_s_KBI_Max_Tankinhalt, this.s_KBI_Max_Tankinhalt.phys );
    putValue( HIL_s_KBI_Min_Tankinhalt, this.s_KBI_Min_Tankinhalt.phys );
    putValue( HIL_s_KBI_Tankfuellstand_Prozent, this.s_KBI_Tankfuellstand_Prozent.phys );
    putValue( HIL_s_KBI_Tankinhalt_hochaufl, this.s_KBI_Tankinhalt_hochaufl.phys );
    putValue( HIL_s_KBI_Tankinhalt_roh, this.s_KBI_Tankinhalt_roh.phys );
}

on message DEV_Kombi_202
{
    putValue( HIL_s_adc_obd_nibble_g4, this.s_adc_obd_nibble_g4.phys );
    putValue( HIL_s_KBI_Inhalt_Tank, this.s_KBI_Inhalt_Tank.phys );
    putValue( HIL_s_KBI_Nachtanken_erkannt, this.s_KBI_Nachtanken_erkannt.phys );
    putValue( HIL_s_KBI_Tankwarnung, this.s_KBI_Tankwarnung.phys );
    putValue( HIL_s_KBI_Tankwarnung_ungueltig, this.s_KBI_Tankwarnung_ungueltig.phys );
}

on message DEV_Kombi_211
{
    putValue( HIL_b_ACC_Anzeige_Objektregelung, this.b_ACC_Anzeige_Objektregelung.phys );
    putValue( HIL_b_ACC_Sollabstand_1, this.b_ACC_Sollabstand_1.phys );
    putValue( HIL_b_ACC_Sollabstand_2, this.b_ACC_Sollabstand_2.phys );
    putValue( HIL_b_ACC_Sollabstand_3, this.b_ACC_Sollabstand_3.phys );
    putValue( HIL_b_ACC_Sollabstand_4, this.b_ACC_Sollabstand_4.phys );
    putValue( HIL_b_ACC_Sollabstand_5, this.b_ACC_Sollabstand_5.phys );
    putValue( HIL_b_ACC_Statusicon, this.b_ACC_Statusicon.phys );
    putValue( HIL_b_ACC_Wunschgeschw_Farbe_02, this.b_ACC_Wunschgeschw_Farbe_02.phys );
    putValue( HIL_s_KBI_aktive_Laengsfunktion_02, this.s_KBI_aktive_Laengsfunktion_02.phys );
}

on message DEV_Kombi_212
{
    putValue( HIL_b_ACC_Texte_Sekundaeranz_02, this.b_ACC_Texte_Sekundaeranz_02.phys );
    putValue( HIL_b_ACC_Typ_LNS, this.b_ACC_Typ_LNS.phys );
    putValue( HIL_b_ACC_Typ_RNS, this.b_ACC_Typ_RNS.phys );
    putValue( HIL_b_ACC_Typ_WZO, this.b_ACC_Typ_WZO.phys );
    putValue( HIL_b_PLA_Fortschritt_bis_Zugende, this.b_PLA_Fortschritt_bis_Zugende.phys );
    putValue( HIL_b_TA_HMI_Ego_li_Seg1_QuerAbst, this.b_TA_HMI_Ego_li_Seg1_QuerAbst.phys );
    putValue( HIL_b_TA_HMI_Ego_li_Typ, this.b_TA_HMI_Ego_li_Typ.phys );
    putValue( HIL_b_TA_HMI_Ego_re_Typ, this.b_TA_HMI_Ego_re_Typ.phys );
    putValue( HIL_b_TA_HMI_Nachb_li_Typ, this.b_TA_HMI_Nachb_li_Typ.phys );
    putValue( HIL_b_TA_HMI_Nachb_re_Typ, this.b_TA_HMI_Nachb_re_Typ.phys );
    putValue( HIL_b_TA_HMI_Zoomstufe, this.b_TA_HMI_Zoomstufe.phys );
    putValue( HIL_s_KBI_Anzeigefehler_SWA, this.s_KBI_Anzeigefehler_SWA.phys );
    putValue( HIL_s_KBI_Anzeigestatus_ACC, this.s_KBI_Anzeigestatus_ACC.phys );
    putValue( HIL_s_KBI_ARA_in_Anzeige, this.s_KBI_ARA_in_Anzeige.phys );
    putValue( HIL_s_KBI_Fehler_Anzeige_ACC, this.s_KBI_Fehler_Anzeige_ACC.phys );
    putValue( HIL_s_KBI_Konsistenz_ACC, this.s_KBI_Konsistenz_ACC.phys );
    putValue( HIL_s_kbi_pla_in_anzeige, this.s_kbi_pla_in_anzeige.phys );
    putValue( HIL_s_pla_timeout_reakt, this.s_pla_timeout_reakt.phys );
}

on message DEV_Kombi_213
{
    putValue( HIL_b_TA_HMI_Ego_re_Seg1_QuerAbst, this.b_TA_HMI_Ego_re_Seg1_QuerAbst.phys );
    putValue( HIL_b_TA_HMI_Nachb_li_Seg1_QuerAbst, this.b_TA_HMI_Nachb_li_Seg1_QuerAbst.phys );
    putValue( HIL_b_TA_HMI_Nachb_re_Seg1_QuerAbst, this.b_TA_HMI_Nachb_re_Seg1_QuerAbst.phys );
    putValue( HIL_b_TA_HMI_Seg1_Kruemmung, this.b_TA_HMI_Seg1_Kruemmung.phys );
    putValue( HIL_b_TA_HMI_Seg2_Beginn, this.b_TA_HMI_Seg2_Beginn.phys );
    putValue( HIL_b_TA_HMI_TrajektSeg2_Beginn, this.b_TA_HMI_TrajektSeg2_Beginn.phys );
}

on message DEV_Kombi_214
{
    putValue( HIL_b_TA_HMI_Obj_01_Typ, this.b_TA_HMI_Obj_01_Typ.phys );
    putValue( HIL_b_TA_HMI_Seg1_Gierwinkel, this.b_TA_HMI_Seg1_Gierwinkel.phys );
    putValue( HIL_b_TA_HMI_Seg2_Kruemmung, this.b_TA_HMI_Seg2_Kruemmung.phys );
    putValue( HIL_b_TA_HMI_Spurwechsel_re, this.b_TA_HMI_Spurwechsel_re.phys );
    putValue( HIL_b_TA_HMI_TrajektSeg1_Kruemmung, this.b_TA_HMI_TrajektSeg1_Kruemmung.phys );
    putValue( HIL_b_TA_HMI_TrajektSeg1_QuerAbst, this.b_TA_HMI_TrajektSeg1_QuerAbst.phys );
    putValue( HIL_b_TA_HMI_TrajektSeg2_Kruemmung, this.b_TA_HMI_TrajektSeg2_Kruemmung.phys );
}

on message DEV_Kombi_215
{
    putValue( HIL_b_TA_HMI_EgoObj_dy, this.b_TA_HMI_EgoObj_dy.phys );
    putValue( HIL_b_TA_HMI_Kurvenwarnung, this.b_TA_HMI_Kurvenwarnung.phys );
    putValue( HIL_b_TA_HMI_Obj_01_dx, this.b_TA_HMI_Obj_01_dx.phys );
    putValue( HIL_b_TA_HMI_Obj_02_Typ, this.b_TA_HMI_Obj_02_Typ.phys );
    putValue( HIL_b_TA_HMI_Obj_03_Typ, this.b_TA_HMI_Obj_03_Typ.phys );
    putValue( HIL_b_TA_HMI_Obj_04_Typ, this.b_TA_HMI_Obj_04_Typ.phys );
    putValue( HIL_b_TA_HMI_Obj_05_Typ, this.b_TA_HMI_Obj_05_Typ.phys );
    putValue( HIL_b_TA_HMI_Obj_06_Typ, this.b_TA_HMI_Obj_06_Typ.phys );
    putValue( HIL_b_TA_HMI_Obj_07_Typ, this.b_TA_HMI_Obj_07_Typ.phys );
    putValue( HIL_b_TA_HMI_Obj_08_Typ, this.b_TA_HMI_Obj_08_Typ.phys );
    putValue( HIL_b_TA_HMI_Obj_09_Typ, this.b_TA_HMI_Obj_09_Typ.phys );
    putValue( HIL_b_TA_HMI_Obj_10_Typ, this.b_TA_HMI_Obj_10_Typ.phys );
    putValue( HIL_b_TA_HMI_Obj_11_Typ, this.b_TA_HMI_Obj_11_Typ.phys );
    putValue( HIL_b_TA_HMI_Spurwechsel_li, this.b_TA_HMI_Spurwechsel_li.phys );
    putValue( HIL_b_TA_HMI_TaZoomstufeAktiv, this.b_TA_HMI_TaZoomstufeAktiv.phys );
    putValue( HIL_b_TA_HMI_TrajektSeg1_Gierwinkel, this.b_TA_HMI_TrajektSeg1_Gierwinkel.phys );
    putValue( HIL_b_TA_HMI_TrajektSeg1_Valid, this.b_TA_HMI_TrajektSeg1_Valid.phys );
}

on message DEV_Kombi_221
{
    putValue( HIL_b_TA_HMI_Obj_01_Spurzuordnung, this.b_TA_HMI_Obj_01_Spurzuordnung.phys );
    putValue( HIL_b_TA_HMI_Obj_03_dx, this.b_TA_HMI_Obj_03_dx.phys );
    putValue( HIL_b_TA_HMI_Obj_04_dx, this.b_TA_HMI_Obj_04_dx.phys );
    putValue( HIL_b_TA_HMI_Obj_05_dx, this.b_TA_HMI_Obj_05_dx.phys );
    putValue( HIL_b_TA_HMI_Obj_06_dx, this.b_TA_HMI_Obj_06_dx.phys );
    putValue( HIL_b_TA_HMI_Obj_07_dx, this.b_TA_HMI_Obj_07_dx.phys );
    putValue( HIL_b_TA_HMI_Obj_11_dy, this.b_TA_HMI_Obj_11_dy.phys );
}

on message DEV_Kombi_222
{
    putValue( HIL_b_TA_HMI_Obj_01_dy, this.b_TA_HMI_Obj_01_dy.phys );
    putValue( HIL_b_TA_HMI_Obj_02_dy, this.b_TA_HMI_Obj_02_dy.phys );
    putValue( HIL_b_TA_HMI_Obj_02_Spurzuordnung, this.b_TA_HMI_Obj_02_Spurzuordnung.phys );
    putValue( HIL_b_TA_HMI_Obj_03_Spurzuordnung, this.b_TA_HMI_Obj_03_Spurzuordnung.phys );
    putValue( HIL_b_TA_HMI_Obj_04_Spurzuordnung, this.b_TA_HMI_Obj_04_Spurzuordnung.phys );
    putValue( HIL_b_TA_HMI_Obj_08_dx, this.b_TA_HMI_Obj_08_dx.phys );
    putValue( HIL_b_TA_HMI_Obj_09_dx, this.b_TA_HMI_Obj_09_dx.phys );
    putValue( HIL_b_TA_HMI_Obj_10_dx, this.b_TA_HMI_Obj_10_dx.phys );
    putValue( HIL_b_TA_HMI_Obj_11_dx, this.b_TA_HMI_Obj_11_dx.phys );
}

on message DEV_Kombi_223
{
    putValue( HIL_b_TA_HMI_Obj_03_dy, this.b_TA_HMI_Obj_03_dy.phys );
    putValue( HIL_b_TA_HMI_Obj_04_dy, this.b_TA_HMI_Obj_04_dy.phys );
    putValue( HIL_b_TA_HMI_Obj_05_dy, this.b_TA_HMI_Obj_05_dy.phys );
    putValue( HIL_b_TA_HMI_Obj_05_Spurzuordnung, this.b_TA_HMI_Obj_05_Spurzuordnung.phys );
    putValue( HIL_b_TA_HMI_Obj_06_dy, this.b_TA_HMI_Obj_06_dy.phys );
    putValue( HIL_b_TA_HMI_Obj_06_Spurzuordnung, this.b_TA_HMI_Obj_06_Spurzuordnung.phys );
    putValue( HIL_b_TA_HMI_Obj_07_dy, this.b_TA_HMI_Obj_07_dy.phys );
    putValue( HIL_b_TA_HMI_Obj_07_Spurzuordnung, this.b_TA_HMI_Obj_07_Spurzuordnung.phys );
    putValue( HIL_b_TA_HMI_Obj_08_dy, this.b_TA_HMI_Obj_08_dy.phys );
    putValue( HIL_b_TA_HMI_Obj_08_Spurzuordnung, this.b_TA_HMI_Obj_08_Spurzuordnung.phys );
    putValue( HIL_b_TA_HMI_Obj_09_dy, this.b_TA_HMI_Obj_09_dy.phys );
    putValue( HIL_b_TA_HMI_Obj_10_dy, this.b_TA_HMI_Obj_10_dy.phys );
}

on message DEV_Kombi_224
{
    putValue( HIL_b_ACC_Abstand_WZO, this.b_ACC_Abstand_WZO.phys );
    putValue( HIL_b_ACC_Status_GRA_Modus, this.b_ACC_Status_GRA_Modus.phys );
    putValue( HIL_b_AWV_AW_Texte, this.b_AWV_AW_Texte.phys );
    putValue( HIL_b_AWV_AW_Zeitluecke, this.b_AWV_AW_Zeitluecke.phys );
    putValue( HIL_b_TA_HMI_Obj_01_LaengsRegelung, this.b_TA_HMI_Obj_01_LaengsRegelung.phys );
    putValue( HIL_b_TA_HMI_Obj_01_QuerRegelung, this.b_TA_HMI_Obj_01_QuerRegelung.phys );
    putValue( HIL_b_TA_HMI_Obj_02_LaengsRegelung, this.b_TA_HMI_Obj_02_LaengsRegelung.phys );
    putValue( HIL_b_TA_HMI_Obj_02_QuerRegelung, this.b_TA_HMI_Obj_02_QuerRegelung.phys );
    putValue( HIL_b_TA_HMI_Obj_03_LaengsRegelung, this.b_TA_HMI_Obj_03_LaengsRegelung.phys );
    putValue( HIL_b_TA_HMI_Obj_03_QuerRegelung, this.b_TA_HMI_Obj_03_QuerRegelung.phys );
    putValue( HIL_b_TA_HMI_Obj_04_LaengsRegelung, this.b_TA_HMI_Obj_04_LaengsRegelung.phys );
    putValue( HIL_b_TA_HMI_Obj_04_QuerRegelung, this.b_TA_HMI_Obj_04_QuerRegelung.phys );
    putValue( HIL_b_TA_HMI_Obj_05_LaengsRegelung, this.b_TA_HMI_Obj_05_LaengsRegelung.phys );
    putValue( HIL_b_TA_HMI_Obj_05_QuerRegelung, this.b_TA_HMI_Obj_05_QuerRegelung.phys );
    putValue( HIL_b_TA_HMI_Obj_06_LaengsRegelung, this.b_TA_HMI_Obj_06_LaengsRegelung.phys );
    putValue( HIL_b_TA_HMI_Obj_06_QuerRegelung, this.b_TA_HMI_Obj_06_QuerRegelung.phys );
    putValue( HIL_b_TA_HMI_Obj_07_LaengsRegelung, this.b_TA_HMI_Obj_07_LaengsRegelung.phys );
    putValue( HIL_b_TA_HMI_Obj_07_QuerRegelung, this.b_TA_HMI_Obj_07_QuerRegelung.phys );
    putValue( HIL_b_TA_HMI_Obj_08_LaengsRegelung, this.b_TA_HMI_Obj_08_LaengsRegelung.phys );
    putValue( HIL_b_TA_HMI_Obj_08_QuerRegelung, this.b_TA_HMI_Obj_08_QuerRegelung.phys );
    putValue( HIL_b_TA_HMI_Obj_09_LaengsRegelung, this.b_TA_HMI_Obj_09_LaengsRegelung.phys );
    putValue( HIL_b_TA_HMI_Obj_09_QuerRegelung, this.b_TA_HMI_Obj_09_QuerRegelung.phys );
    putValue( HIL_b_TA_HMI_Obj_09_Spurzuordnung, this.b_TA_HMI_Obj_09_Spurzuordnung.phys );
    putValue( HIL_b_TA_HMI_Obj_10_LaengsRegelung, this.b_TA_HMI_Obj_10_LaengsRegelung.phys );
    putValue( HIL_b_TA_HMI_Obj_10_QuerRegelung, this.b_TA_HMI_Obj_10_QuerRegelung.phys );
    putValue( HIL_b_TA_HMI_Obj_10_Spurzuordnung, this.b_TA_HMI_Obj_10_Spurzuordnung.phys );
    putValue( HIL_b_TA_HMI_Obj_11_LaengsRegelung, this.b_TA_HMI_Obj_11_LaengsRegelung.phys );
    putValue( HIL_b_TA_HMI_Obj_11_QuerRegelung, this.b_TA_HMI_Obj_11_QuerRegelung.phys );
    putValue( HIL_b_TA_HMI_Obj_11_Spurzuordnung, this.b_TA_HMI_Obj_11_Spurzuordnung.phys );
    putValue( HIL_s_KBI_Anzeigestatus_GRA, this.s_KBI_Anzeigestatus_GRA.phys );
    putValue( HIL_s_KBI_Anzeigestatus_LIM, this.s_KBI_Anzeigestatus_LIM.phys );
    putValue( HIL_s_LED_GRA, this.s_LED_GRA.phys );
    putValue( HIL_s_LED_GRA_US, this.s_LED_GRA_US.phys );
    putValue( HIL_s_LED_Laengsregelung, this.s_LED_Laengsregelung.phys );
    putValue( HIL_s_LED_Laengsregelung_blinken, this.s_LED_Laengsregelung_blinken.phys );
    putValue( HIL_s_LED_LIM, this.s_LED_LIM.phys );
    putValue( HIL_s_LED_LIM_blinken, this.s_LED_LIM_blinken.phys );
}

on message DEV_Kombi_225
{
    putValue( HIL_hmi_FAS_Wunschgeschwindigkeit_in_kodierter_einheit, this.hmi_FAS_Wunschgeschwindigkeit_in_kodierter_einheit.phys );
}

on message DEV_Kombi_231
{
    putValue( HIL_b_ESC_FBA_Meldungen, this.b_ESC_FBA_Meldungen.phys );
    putValue( HIL_s_KBI_angez_Geschw_CAN, this.s_KBI_angez_Geschw_CAN.phys );
    putValue( HIL_s_KBI_GAP_Warn_Zeit_abgelaufen, this.s_KBI_GAP_Warn_Zeit_abgelaufen.phys );
    putValue( HIL_s_KBI_Kilometerstand_HiRes, this.s_KBI_Kilometerstand_HiRes.phys );
    putValue( HIL_s_KBI_MFA_v_Einheit, this.s_KBI_MFA_v_Einheit.phys );
    putValue( HIL_s_KBI_RDK_Kalibrier_Anf, this.s_KBI_RDK_Kalibrier_Anf.phys );
    putValue( HIL_s_KBI_V_Digital, this.s_KBI_V_Digital.phys );
    putValue( HIL_s_radumfang_mittel, this.s_radumfang_mittel.phys );
    putValue( HIL_s_tageswegstrecke_reset, this.s_tageswegstrecke_reset.phys );
}

on message DEV_Kombi_232
{
    putValue( HIL_b_DBK_Fahrerwarnung, this.b_DBK_Fahrerwarnung.phys );
    putValue( HIL_b_EPB_Fehlermeldungen_02, this.b_EPB_Fehlermeldungen_02.phys );
    putValue( HIL_hmi_navi_rg_distancebargraph_available, this.hmi_navi_rg_distancebargraph_available.phys );
    putValue( HIL_hmi_navi_rg_timebargraph_available, this.hmi_navi_rg_timebargraph_available.phys );
    putValue( HIL_s_feststellbremse_konv_ausg, this.s_feststellbremse_konv_ausg.phys );
    putValue( HIL_s_KBI_Weg_Zaehler, this.s_KBI_Weg_Zaehler.phys );
    putValue( HIL_s_KBI_Weg_Zaehler_F, this.s_KBI_Weg_Zaehler_F.phys );
    putValue( HIL_s_LED_EPB_NAR_rot, this.s_LED_EPB_NAR_rot.phys );
    putValue( HIL_s_LED_EPB_RDW_rot, this.s_LED_EPB_RDW_rot.phys );
    putValue( HIL_s_tageswegstrecke, this.s_tageswegstrecke.phys );
}

on message DEV_Kombi_233
{
    putValue( HIL_b_KBI_Kilometerstand_HiRes_meter, this.b_KBI_Kilometerstand_HiRes_meter.phys );
    putValue( HIL_hmi_HistoryState_LeftTube_PHEV_Skin0, this.hmi_HistoryState_LeftTube_PHEV_Skin0.phys );
    putValue( HIL_hmi_HistoryState_LeftTube_PHEV_Skin1, this.hmi_HistoryState_LeftTube_PHEV_Skin1.phys );
    putValue( HIL_hmi_HistoryState_LeftTube_PHEV_Skin2, this.hmi_HistoryState_LeftTube_PHEV_Skin2.phys );
    putValue( HIL_hmi_HistoryState_Nebenanzeige_Skin0, this.hmi_HistoryState_Nebenanzeige_Skin0.phys );
    putValue( HIL_hmi_HistoryState_Nebenanzeige_Skin1, this.hmi_HistoryState_Nebenanzeige_Skin1.phys );
    putValue( HIL_hmi_HistoryState_Nebenanzeige_Skin2, this.hmi_HistoryState_Nebenanzeige_Skin2.phys );
    putValue( HIL_hmi_HistoryState_Zusatzanzeige_Skin1, this.hmi_HistoryState_Zusatzanzeige_Skin1.phys );
}

on message DEV_Kombi_234
{
    putValue( HIL_hmi_aktive_Nebenanzeige_links, this.hmi_aktive_Nebenanzeige_links.phys );
    putValue( HIL_hmi_aktive_Nebenanzeige_rechts, this.hmi_aktive_Nebenanzeige_rechts.phys );
    putValue( HIL_hmi_aktiver_View, this.hmi_aktiver_View.phys );
    putValue( HIL_s_DTC_Kombi_defekt, this.s_DTC_Kombi_defekt.phys );
    putValue( HIL_s_DTC_TI_B174404, this.s_DTC_TI_B174404.phys );
    putValue( HIL_s_DTC_TI_B200041, this.s_DTC_TI_B200041.phys );
    putValue( HIL_s_DTC_TI_B200043, this.s_DTC_TI_B200043.phys );
    putValue( HIL_s_DTC_TI_B200FF0, this.s_DTC_TI_B200FF0.phys );
    putValue( HIL_s_KBI_Einheit_Datum, this.s_KBI_Einheit_Datum.phys );
    putValue( HIL_s_KBI_Einheit_Druck, this.s_KBI_Einheit_Druck.phys );
    putValue( HIL_s_KBI_Einheit_Masse, this.s_KBI_Einheit_Masse.phys );
    putValue( HIL_s_KBI_Einheit_Streckenanz, this.s_KBI_Einheit_Streckenanz.phys );
    putValue( HIL_s_KBI_Einheit_Tacho, this.s_KBI_Einheit_Tacho.phys );
    putValue( HIL_s_KBI_Einheit_Temp, this.s_KBI_Einheit_Temp.phys );
    putValue( HIL_s_KBI_Einheit_Verbrauch, this.s_KBI_Einheit_Verbrauch.phys );
    putValue( HIL_s_KBI_Einheit_Verbrauch_elektr, this.s_KBI_Einheit_Verbrauch_elektr.phys );
    putValue( HIL_s_KBI_Einheit_Verbrauch_Gas, this.s_KBI_Einheit_Verbrauch_Gas.phys );
    putValue( HIL_s_KBI_Einheit_Volumen, this.s_KBI_Einheit_Volumen.phys );
    putValue( HIL_s_KBI_im_Stellgliedtest, this.s_KBI_im_Stellgliedtest.phys );
    putValue( HIL_s_KBI_KD_fehler, this.s_KBI_KD_fehler.phys );
    putValue( HIL_s_KBI_Variante, this.s_KBI_Variante.phys );
    putValue( HIL_s_Kombi_01_BZ, this.s_Kombi_01_BZ.phys );
    putValue( HIL_s_Kombi_Abschaltstufe, this.s_Kombi_Abschaltstufe.phys );
    putValue( HIL_s_Kombi_Transport_Mode, this.s_Kombi_Transport_Mode.phys );
    putValue( HIL_s_NM_Kombi_CAB, this.s_NM_Kombi_CAB.phys );
    putValue( HIL_s_NM_Kombi_Car_Wakeup, this.s_NM_Kombi_Car_Wakeup.phys );
    putValue( HIL_s_NM_Kombi_NM_aktiv_Buzzer, this.s_NM_Kombi_NM_aktiv_Buzzer.phys );
}

on message DEV_Kombi_235
{
    putValue( HIL_b_MO_Anzeige_Leistung, this.b_MO_Anzeige_Leistung.phys );
    putValue( HIL_b_TSK_Einheit_vMax_FahrerInfo, this.b_TSK_Einheit_vMax_FahrerInfo.phys );
    putValue( HIL_b_TSK_vMax_FahrerInfo, this.b_TSK_vMax_FahrerInfo.phys );
    putValue( HIL_b_WIV_laufender_Motor, this.b_WIV_laufender_Motor.phys );
    putValue( HIL_b_WIV_nicht_betriebswarm, this.b_WIV_nicht_betriebswarm.phys );
    putValue( HIL_b_WIV_Schieflage, this.b_WIV_Schieflage.phys );
    putValue( HIL_hmi_service_sonderbehandlung, this.hmi_service_sonderbehandlung.phys );
    putValue( HIL_hmi_WBA_Schaltempfehlung_vorhanden, this.hmi_WBA_Schaltempfehlung_vorhanden.phys );
    putValue( HIL_s_fusi_Auto_P, this.s_fusi_Auto_P.phys );
    putValue( HIL_s_KBI_Oelwechsel_durchgefuehrt, this.s_KBI_Oelwechsel_durchgefuehrt.phys );
    putValue( HIL_s_KBI_Standzeit_02, this.s_KBI_Standzeit_02.phys );
    putValue( HIL_s_LED_Oeldruck, this.s_LED_Oeldruck.phys );
    putValue( HIL_s_manuell_zeit_datum_monat, this.s_manuell_zeit_datum_monat.phys );
    putValue( HIL_s_manuell_zeit_uhrzeit_sekunde, this.s_manuell_zeit_uhrzeit_sekunde.phys );
    putValue( HIL_s_NM_Kombi_Wakeup, this.s_NM_Kombi_Wakeup.phys );
    putValue( HIL_s_UH_DLS, this.s_UH_DLS.phys );
}

on message DEV_Kombi_251
{
    putValue( HIL_s_insp_restlauf_km, this.s_insp_restlauf_km.phys );
    putValue( HIL_s_insp_restlauf_tage, this.s_insp_restlauf_tage.phys );
    putValue( HIL_s_oil_ueberschreitung_km, this.s_oil_ueberschreitung_km.phys );
    putValue( HIL_s_oil_ueberschreitung_tage, this.s_oil_ueberschreitung_tage.phys );
}

on message DEV_Kombi_252
{
    putValue( HIL_s_service_restlauf_km, this.s_service_restlauf_km.phys );
    putValue( HIL_s_service_restlauf_tage, this.s_service_restlauf_tage.phys );
    putValue( HIL_s_oil_restlauf_km, this.s_oil_restlauf_km.phys );
    putValue( HIL_s_oil_restlauf_tage, this.s_oil_restlauf_tage.phys );
}

on message DEV_Kombi_253
{
    putValue( HIL_s_gMeter_ax_oben_max, this.s_gMeter_ax_oben_max.phys );
    putValue( HIL_s_gMeter_ax_unten_max, this.s_gMeter_ax_unten_max.phys );
    putValue( HIL_s_gMeter_ay_links_max, this.s_gMeter_ay_links_max.phys );
    putValue( HIL_s_gMeter_ay_rechts_max, this.s_gMeter_ay_rechts_max.phys );
    putValue( HIL_s_gMeter_Winkel, this.s_gMeter_Winkel.phys );
    putValue( HIL_set_HMI_G_max_Reset, this.set_HMI_G_max_Reset.phys );
}

on message DEV_Kombi_254
{
    putValue( HIL_hmi_boot_download_finished, this.hmi_boot_download_finished.phys );
    putValue( HIL_hmi_laptimer_letzte_rundenzeit, this.hmi_laptimer_letzte_rundenzeit.phys );
    putValue( HIL_s_laptimer_rundenzeiten, this.s_laptimer_rundenzeiten.phys );
    putValue( HIL_s_manuell_zeit_datum_jahr, this.s_manuell_zeit_datum_jahr.phys );
    putValue( HIL_s_manuell_zeit_datum_tag, this.s_manuell_zeit_datum_tag.phys );
}

on message DEV_Kombi_255
{
    putValue( HIL_s_dzm_zeigerposition_drehzahl, this.s_dzm_zeigerposition_drehzahl.phys );
}

on message DEV_Kombi_271
{
    putValue( HIL_s_emv_reku_delta_dc, this.s_emv_reku_delta_dc.phys );
    putValue( HIL_s_emv_reku_delta_weg, this.s_emv_reku_delta_weg.phys );
    putValue( HIL_s_emv_reku_mv_nebenverbrauch, this.s_emv_reku_mv_nebenverbrauch.phys );
}

on message DEV_Kombi_272
{
    putValue( HIL_s_emv_reku_delta_antrieb_reku, this.s_emv_reku_delta_antrieb_reku.phys );
    putValue( HIL_s_emv_reku_delta_antrieb_verbr, this.s_emv_reku_delta_antrieb_verbr.phys );
    putValue( HIL_s_emv_reku_delta_tme, this.s_emv_reku_delta_tme.phys );
    putValue( HIL_s_emv_reku_mv_antrieb_hyst, this.s_emv_reku_mv_antrieb_hyst.phys );
}

on message DEV_Kombi_273
{
    putValue( HIL_s_emv_reku_dv_slider_prozent, this.s_emv_reku_dv_slider_prozent.phys );
    putValue( HIL_s_emv_reku_mv_gesamt_nachfilter, this.s_emv_reku_mv_gesamt_nachfilter.phys );
    putValue( HIL_s_emv_reku_mv_gesamt_prozent, this.s_emv_reku_mv_gesamt_prozent.phys );
    putValue( HIL_s_emv_reku_stand_umsch_aktiv, this.s_emv_reku_stand_umsch_aktiv.phys );
    putValue( HIL_s_KBI_Kilometerstand, this.s_KBI_Kilometerstand.phys ); 
}

on message DEV_Kombi_274
{
    putValue( HIL_s_emv_reku_mv_antrieb, this.s_emv_reku_mv_antrieb.phys );
    putValue( HIL_b_KBI_Kilometerstand_Extended, this.b_KBI_Kilometerstand_Extended.phys ); 
}

on message DEV_Kombi_291
{
    putValue( HIL_s_GNSS_V_Geschw, this.s_GNSS_V_Geschw.phys );
    putValue( HIL_s_radumfang_korrektur, this.s_radumfang_korrektur.phys );
    putValue( HIL_s_radumfang_opt, this.s_radumfang_opt.phys );
    putValue( HIL_s_radumfang_sync, this.s_radumfang_sync.phys );
}

on message DEV_Kombi_292
{
    putValue( HIL_b_GNSS_V_Geschw_2D, this.b_GNSS_V_Geschw_2D.phys );
    putValue( HIL_b_GNSS_V_Geschw_Vertikal, this.b_GNSS_V_Geschw_Vertikal.phys );
    putValue( HIL_s_GNSS_Geschw_fehler, this.s_GNSS_Geschw_fehler.phys );
    putValue( HIL_s_sync_ESP_m_Raddrehz, this.s_sync_ESP_m_Raddrehz.phys );
    putValue( HIL_s_sync_GNSS_V_Geschw, this.s_sync_GNSS_V_Geschw.phys );
}

on message DEV_Kombi_293
{
    putValue( HIL_b_GNSS_Nachrichtenpaket_ID5, this.b_GNSS_Nachrichtenpaket_ID5.phys );
    putValue( HIL_b_GNSS_Nachrichtenpaket_ID7, this.b_GNSS_Nachrichtenpaket_ID7.phys );
    putValue( HIL_b_GNSS_V_FIX_Typ, this.b_GNSS_V_FIX_Typ.phys );
    putValue( HIL_b_GNSS_V_Latenz_vollstaendig, this.b_GNSS_V_Latenz_vollstaendig.phys );
    putValue( HIL_s_Gewichtungsfaktor_altersbasiert, this.s_Gewichtungsfaktor_altersbasiert.phys );
    putValue( HIL_s_Gewichtungsfaktor_geschwindigkeitsbasiert, this.s_Gewichtungsfaktor_geschwindigkeitsbasiert.phys );
    putValue( HIL_s_Gewichtungsfaktor_Ringspeicher, this.s_Gewichtungsfaktor_Ringspeicher.phys );
    putValue( HIL_s_GNSS_2D_fehler, this.s_GNSS_2D_fehler.phys );
    putValue( HIL_s_GNSS_3D_fehler, this.s_GNSS_3D_fehler.phys );
    putValue( HIL_s_koeff_lernen_verlernen, this.s_koeff_lernen_verlernen.phys );
    putValue( HIL_s_laenge_puffer_zeitliche_synchronisierung, this.s_laenge_puffer_zeitliche_synchronisierung.phys );
    putValue( HIL_s_n_Eintraege_Ringspeicher, this.s_n_Eintraege_Ringspeicher.phys );
    putValue( HIL_s_trigger_ringspeicher, this.s_trigger_ringspeicher.phys );
}

on message DEV_Kombi_294
{
    putValue( HIL_b_GNSS_UTC_Zeit, this.b_GNSS_UTC_Zeit.phys );
    putValue( HIL_b_GNSS_V_Daten_Veraltet, this.b_GNSS_V_Daten_Veraltet.phys );
    putValue( HIL_b_GNSS_V_Geschw_2D_Guete95, this.b_GNSS_V_Geschw_2D_Guete95.phys );
    putValue( HIL_b_GNSS_V_Geschw_Vertikal_Guete95, this.b_GNSS_V_Geschw_Vertikal_Guete95.phys );
}

on message DEV_Kombi_295
{
    putValue( HIL_s_sync_GNSS_UTC_Zeit, this.s_sync_GNSS_UTC_Zeit.phys );
}

on message DEV_Kombi_301
{
    putValue( HIL_s_gMeter_ax_oben, this.s_gMeter_ax_oben.phys );
    putValue( HIL_s_gMeter_ax_oben_kz_max, this.s_gMeter_ax_oben_kz_max.phys );
    putValue( HIL_s_gMeter_ax_unten, this.s_gMeter_ax_unten.phys );
    putValue( HIL_s_gMeter_ax_unten_kz_max, this.s_gMeter_ax_unten_kz_max.phys );
    putValue( HIL_s_gMeter_ay_links, this.s_gMeter_ay_links.phys );
    putValue( HIL_s_gMeter_ay_rechts, this.s_gMeter_ay_rechts.phys );
}

on message DEV_Kombi_302
{
    putValue( HIL_s_gMeter_ax_oben_kz_max_prozent, this.s_gMeter_ax_oben_kz_max_prozent.phys );
    putValue( HIL_s_gMeter_ax_oben_max_prozent, this.s_gMeter_ax_oben_max_prozent.phys );
    putValue( HIL_s_gMeter_ax_unten_kz_max_prozent, this.s_gMeter_ax_unten_kz_max_prozent.phys );
    putValue( HIL_s_gMeter_ax_unten_max_prozent, this.s_gMeter_ax_unten_max_prozent.phys );
    putValue( HIL_s_gMeter_ay_links_kz_max_prozent, this.s_gMeter_ay_links_kz_max_prozent.phys );
    putValue( HIL_s_gMeter_ay_links_max_prozent, this.s_gMeter_ay_links_max_prozent.phys );
    putValue( HIL_s_gMeter_ay_rechts_kz_max_prozent, this.s_gMeter_ay_rechts_kz_max_prozent.phys );
    putValue( HIL_s_gMeter_ay_rechts_max_prozent, this.s_gMeter_ay_rechts_max_prozent.phys );
   // putValue( HIL_s_gMeter_Hist_Sektor_X_Max_filt, this.s_gMeter_Hist_Sektor_X_Max_filt.phys );
}

on message DEV_Kombi_303
{
    putValue( HIL_b_FDR_M_HL_02, this.b_FDR_M_HL_02.phys );
    putValue( HIL_b_FDR_M_HR_02, this.b_FDR_M_HR_02.phys );
    putValue( HIL_b_FDR_M_VL_02, this.b_FDR_M_VL_02.phys );
    putValue( HIL_b_FDR_M_VR_02, this.b_FDR_M_VR_02.phys );
    putValue( HIL_b_TSL_Warnung, this.b_TSL_Warnung.phys );
    putValue( HIL_b_TSR_Warnung, this.b_TSR_Warnung.phys );
    putValue( HIL_hmi_gmeter_aktuelle_Darstellung, this.hmi_gmeter_aktuelle_Darstellung.phys );
    putValue( HIL_s_gMeter_anzeige_ungueltig, this.s_gMeter_anzeige_ungueltig.phys );
    putValue( HIL_s_gMeter_ay_links_kz_max, this.s_gMeter_ay_links_kz_max.phys );
    putValue( HIL_s_gMeter_ay_rechts_kz_max, this.s_gMeter_ay_rechts_kz_max.phys );
}

