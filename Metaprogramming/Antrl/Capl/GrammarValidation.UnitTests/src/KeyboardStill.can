/*@!Encoding:1252*/
includes
{
  
}

variables
{
//  message 0x7FF bla;
//  int toggle = 0;
  message 0x570 m1;
  message 0x570 m2;
  message 0x100 timestamp;
}

on start {
  m1.DLC = 7;
  m2.DLC = 7;
  
  m1.BYTE(0) = 0;
  m1.BYTE(1) = 0;
  m1.BYTE(2) = 0;
  m2.BYTE(0) = 1;
  
  // 0x6DDD00000005
  timestamp.DLC = 6;
  timestamp.BYTE(0) = 0x06;
  timestamp.BYTE(1) = 0xDD;
  timestamp.BYTE(2) = 0xD0;
  timestamp.BYTE(3) = 0x00;
  timestamp.BYTE(4) = 0x00;
  timestamp.BYTE(5) = 0x05;
}

on key 'a' {
  output(timestamp);
}

//on key 's' {
//  output(m2);
//}

//on key 'a' {
//  bla.ID = 0x0;
//  bla.DLC = 2;
//  bla.byte(0) = 1;
//  bla.byte(1) = 0xD;
//  output(bla);
//}
//on key 's' {
//  bla.ID = 0x7FF;
//  output(bla);
//}
//on key 'd' {
//  bla.ID = 0x20D;
//  output(bla);
//}
//on key 'f' {
//  bla.ID = 0x80;
//  output(bla);
//}
//on key 'p' {
//  toggle = toggle ^ 1;
//  bla.ID = 0x23C;
//  bla.DLC = 8;
//  if (toggle == 0) {
//   bla.byte(0) = 0x0;
//   //bla.byte(7) = 0xFF;
//  }
//  else {
//   bla.byte(0) = 0xC;
//   //bla.byte(7) = 0x00;
//  }
//  
//  output(bla);
//}
